## CMakeLists.txt
```
# SPDX-License-Identifier: Apache-2.0

cmake_minimum_required(VERSION 3.20.0)

find_package(Zephyr REQUIRED HINTS $ENV{ZEPHYR_BASE})
project(g1_net)

# P4 iteration 29 -- the single divergence between the shipped ESB core and the
# pinned NCS v2.5.1 source: the shipped firmware pends SWI3 as the ESB event
# IRQ because MPSL already owns SWI0 on CPUNET (mpsl_init.c:38).  Force-include
# a header that defines the SDK header's own include guard, so the pinned SDK
# tree stays untouched and only the ESB library sees the change.  See
# src/esb_peripherals_g1.h for the byte evidence.
if(TARGET ..__nrf__subsys__esb)
  target_compile_options(..__nrf__subsys__esb PRIVATE
    "-include" "${CMAKE_CURRENT_LIST_DIR}/src/esb_peripherals_g1.h")
else()
  message(FATAL_ERROR
    "expected the NCS ESB library target ..__nrf__subsys__esb to exist; "
    "the G1 ESB event-IRQ override could not be applied")
endif()

# Integration probes must expose ownership collisions and unresolved calls in
# every retained reconstruction, including functions not yet reachable from
# the temporary shell entry point.  Zephyr normally garbage-collects those
# input sections, which can make an incomplete image appear to link cleanly.
# This option deliberately retains application and already-selected SDK input
# sections; it does not force archive members into the link or mask failures.
option(G1_INTEGRATION_PROBE_RETAIN_ALL
  "Retain all linked sections while auditing reconstruction ownership" ON)
if(G1_INTEGRATION_PROBE_RETAIN_ALL)
  # NCS v2.5.1 / Zephyr 3.4 exposes linker flags through this helper.
  zephyr_ld_options(-Wl,--no-gc-sections)

  # subsys/bluetooth/common/bt_str.c is unconditional, but its bt_uuid_str()
  # helper calls bt_uuid_to_str(), whose normal owner (host/uuid.c) is omitted
  # when CONFIG_BT_HCI_RAW=y disables CONFIG_BT_HCI_HOST.  Normal section GC
  # discards that unused helper in the shipped controller configuration.  The
  # retain-all audit deliberately keeps it, so select the pinned Zephyr source
  # as an audit-only dependency instead of inventing a firmware reconstruction.
  target_sources(app PRIVATE
    "${ZEPHYR_BASE}/subsys/bluetooth/host/uuid.c"
  )
endif()

set(G1_RETAINED_SOURCE_MANIFEST
    "${CMAKE_CURRENT_LIST_DIR}/../../generated/net_retained_sources.cmake")
if(NOT EXISTS "${G1_RETAINED_SOURCE_MANIFEST}")
  message(FATAL_ERROR
    "Missing generated net source manifest: ${G1_RETAINED_SOURCE_MANIFEST}\n"
    "Generate it from recon/ownership/adoption_manifest.json; do not replace "
    "it with a source glob.")
endif()

include("${G1_RETAINED_SOURCE_MANIFEST}")
if(NOT DEFINED G1_RETAINED_SOURCES)
  message(FATAL_ERROR
    "${G1_RETAINED_SOURCE_MANIFEST} must define G1_RETAINED_SOURCES")
endif()

# The timeslot closure uses its canonical raw sources because the worker and
# producer need cohesive-build relocations to the same real Zephyr message
# queue.  Remove the two older symbolized copies before adding the complete
# four-function ownership unit below.
list(FILTER G1_RETAINED_SOURCES EXCLUDE
  REGEX "/FUN_0102(a4c8|ab14|ab50|abac|ac00|ac0c|acb4|ace8|acf4|adac|adf0|afbc|b15c|b1c8|b2ac|b7d0|b900)\\.c$")

set(G1_PRODUCT_ENDPOINT_SOURCES
  "${CMAKE_CURRENT_LIST_DIR}/../../net/src/FUN_0102a4c8.c"
  "${CMAKE_CURRENT_LIST_DIR}/../../net/src/FUN_0102ab14.c"
  "${CMAKE_CURRENT_LIST_DIR}/../../net/src/FUN_0102ab50.c"
  "${CMAKE_CURRENT_LIST_DIR}/../../net/src/FUN_0102abac.c"
  "${CMAKE_CURRENT_LIST_DIR}/../../net/src/FUN_0102ac00.c"
  "${CMAKE_CURRENT_LIST_DIR}/../../net/src/FUN_0102ac0c.c"
  "${CMAKE_CURRENT_LIST_DIR}/../../net/src/FUN_0102acb4.c"
  "${CMAKE_CURRENT_LIST_DIR}/../../net/src/FUN_0102ace8.c"
  "${CMAKE_CURRENT_LIST_DIR}/../../net/src/FUN_0102acf4.c"
  "${CMAKE_CURRENT_LIST_DIR}/../../net/src/FUN_0102adac.c"
  "${CMAKE_CURRENT_LIST_DIR}/../../net/src/FUN_0102adf0.c"
  "${CMAKE_CURRENT_LIST_DIR}/../../net/src/FUN_0102afbc.c"
  "${CMAKE_CURRENT_LIST_DIR}/../../net/src/FUN_0102b15c.c"
  "${CMAKE_CURRENT_LIST_DIR}/../../net/src/FUN_0102b1c8.c"
  "${CMAKE_CURRENT_LIST_DIR}/../../net/src/FUN_0102b2ac.c"
  "${CMAKE_CURRENT_LIST_DIR}/src/g1_product_endpoints.c"
)

# P4 iteration 30 -- the ESB uplink worker closure.  Four functions Ghidra
# never catalogued (they sit in the gaps 0x0102a408..0x0102a448,
# 0x0102a474..0x0102a498, 0x0102a668..0x0102a698 and inside FUN_0102b1c8's
# folded tail 0x0102b204..0x0102b2ac).  FUN_0102b204 is the thread FUN_0102b1c8
# creates; it is the ONLY caller of FUN_0102a408, the {0x0d, 0x02} relay that
# sets the app core's device_info[0x105a] = 2 and releases sync_to_slave.
# Canonical sources: they need the same cohesive-build RAM relocations as the
# product-endpoint closure they belong to.
set(G1_ESB_UPLINK_WORKER_SOURCES
  "${CMAKE_CURRENT_LIST_DIR}/../../net/src/FUN_0102a408.c"
  "${CMAKE_CURRENT_LIST_DIR}/../../net/src/FUN_0102a474.c"
  "${CMAKE_CURRENT_LIST_DIR}/../../net/src/FUN_0102a668.c"
  "${CMAKE_CURRENT_LIST_DIR}/../../net/src/FUN_0102b204.c"
)

set(G1_TIMESLOT_OWNER_SOURCES
  "${CMAKE_CURRENT_LIST_DIR}/../../net/src/FUN_0102b7d0.c"
  "${CMAKE_CURRENT_LIST_DIR}/../../net/src/FUN_0102b810.c"
  "${CMAKE_CURRENT_LIST_DIR}/../../net/src/FUN_0102b900.c"
  "${CMAKE_CURRENT_LIST_DIR}/../../net/src/FUN_0102b944.c"
  "${CMAKE_CURRENT_LIST_DIR}/src/timeslot_owner.c"
)

# The durable adoption manifest still records 29 private MPSL/SDC functions as
# archive-owned, and three readable private dependencies are absent from the
# generated list.  Those decisions are report-only: the obfuscated archive
# spellings are provenance, not safe link aliases.  Keep the corresponding
# CFG-proven reconstructions in the cohesive link until the manifest generator
# consumes the private-recovery receipts.  This explicit list is intentionally
# separate from G1_RETAINED_SOURCES so a clean probe cannot silently regress to
# archive substitution.
set(G1_PRIVATE_REPORT_ONLY_SOURCES
  "${CMAKE_CURRENT_LIST_DIR}/../../symbolized/net/controller_radio_state_get.c"
  "${CMAKE_CURRENT_LIST_DIR}/../../symbolized/net/controller_timing_snapshot_build.c"
  "${CMAKE_CURRENT_LIST_DIR}/../../symbolized/net/controller_radio_event_cleanup.c"
  "${CMAKE_CURRENT_LIST_DIR}/../../symbolized/net/FUN_01021940.c"
  "${CMAKE_CURRENT_LIST_DIR}/../../symbolized/net/FUN_01021ac0.c"
  "${CMAKE_CURRENT_LIST_DIR}/../../symbolized/net/FUN_01022a30.c"
  "${CMAKE_CURRENT_LIST_DIR}/../../symbolized/net/FUN_01022a50.c"
  "${CMAKE_CURRENT_LIST_DIR}/../../symbolized/net/FUN_01022e34.c"
  "${CMAKE_CURRENT_LIST_DIR}/../../symbolized/net/FUN_01022ea8.c"
  "${CMAKE_CURRENT_LIST_DIR}/../../symbolized/net/FUN_01022f0c.c"
  "${CMAKE_CURRENT_LIST_DIR}/../../symbolized/net/sdc_conn_window_admit.c"
  "${CMAKE_CURRENT_LIST_DIR}/../../symbolized/net/FUN_01023ac4.c"
  "${CMAKE_CURRENT_LIST_DIR}/../../symbolized/net/FUN_01023d38.c"
  "${CMAKE_CURRENT_LIST_DIR}/../../symbolized/net/FUN_01023e88.c"
  "${CMAKE_CURRENT_LIST_DIR}/../../symbolized/net/FUN_01024440.c"
  "${CMAKE_CURRENT_LIST_DIR}/../../symbolized/net/FUN_0102445c.c"
  "${CMAKE_CURRENT_LIST_DIR}/../../symbolized/net/FUN_010245d8.c"
  "${CMAKE_CURRENT_LIST_DIR}/../../symbolized/net/FUN_01024c6c.c"
  "${CMAKE_CURRENT_LIST_DIR}/../../symbolized/net/FUN_0102524c.c"
  "${CMAKE_CURRENT_LIST_DIR}/../../symbolized/net/FUN_010256dc.c"
  "${CMAKE_CURRENT_LIST_DIR}/../../symbolized/net/FUN_010257e4.c"
  "${CMAKE_CURRENT_LIST_DIR}/../../symbolized/net/controller_deferred_event_raise.c"
  "${CMAKE_CURRENT_LIST_DIR}/../../symbolized/net/FUN_0102590c.c"
  "${CMAKE_CURRENT_LIST_DIR}/../../symbolized/net/FUN_01025998.c"
  "${CMAKE_CURRENT_LIST_DIR}/../../symbolized/net/FUN_01025a84.c"
  "${CMAKE_CURRENT_LIST_DIR}/../../symbolized/net/FUN_01025c44.c"
  "${CMAKE_CURRENT_LIST_DIR}/../../symbolized/net/FUN_01025c9c.c"
  "${CMAKE_CURRENT_LIST_DIR}/../../symbolized/net/FUN_01025cc8.c"
  "${CMAKE_CURRENT_LIST_DIR}/../../symbolized/net/controller_transition_pending_check.c"
  "${CMAKE_CURRENT_LIST_DIR}/../../symbolized/net/FUN_01025d0c.c"
  "${CMAKE_CURRENT_LIST_DIR}/../../symbolized/net/sdc_byte_lock_try_acquire.c"
  "${CMAKE_CURRENT_LIST_DIR}/../../symbolized/net/sdc_byte_lock_release.c"
)

# The clock callback is a real production root: FUN_0102b5bc registers the
# runtime Thumb pointer 0x0102bf59 stored at analysis literal 0x0102b660. Keep
# its complete recovered private closure, plus the two exact ESB public leaves,
# until final exact-source assembly can remove those SDK duplicates safely.
set(G1_ESB_CLOCK_CALLBACK_CLOSURE_SOURCES
  "${CMAKE_CURRENT_LIST_DIR}/../../net/src/FUN_0102b3f0.c"
  "${CMAKE_CURRENT_LIST_DIR}/../../net/src/FUN_0102b664.c"
  "${CMAKE_CURRENT_LIST_DIR}/../../net/src/FUN_0102b718.c"
  "${CMAKE_CURRENT_LIST_DIR}/../../net/src/FUN_0102b758.c"
  # P4 iteration 29: FUN_01033858 (esb_start_tx) and FUN_010339d0 (esb_tx_full)
  # were the "two exact ESB public leaves" kept here.  esb.c is now proven to be
  # the STOCK NCS 2.5.1 unit (39 sections tile 0x01032764..0x01033b18 exactly
  # under CONFIG_ESB_MAX_PAYLOAD_LENGTH=251 + ESB_EVT_IRQ=SWI3), so the whole
  # unit is displaced and these two are provided by it -- keeping them here
  # would re-create the duplicate the displacement removes.
  # P4 iteration 23: the two RADIO packet-configuration trampolines
  # FUN_010333b4 stores into its callback slot as the runtime Thumb pointers
  # 0x010333a5 / 0x010333e5 (analysis 0x01032ba4 / 0x01032be4), plus the RADIO
  # PCNF0/PCNF1 packer they share (analysis 0x01032b4c), are recovered from a
  # Ghidra gap and are picked up automatically by gen_retained_sources.py once
  # their symbolized copies carry an identity header -- no explicit entry here.
)

# The recovered product main deliberately emits its reversible raw identity
# FUN_0102a720.  Bind Zephyr's public `main` entry directly to that body (with
# no wrapper instructions) and make the raw symbol a production GC root.
zephyr_ld_options(
  -Wl,-u,FUN_0102a720
  # Address-taken clock callback stored as runtime Thumb pointer 0x0102bf59;
  # the original literal has no ELF relocation for section GC to follow.
  -Wl,-u,FUN_0102b758
)

# Firmware/controller functions are selected explicitly by the generated
# manifest above; upstream controller and crypto objects remain under their
# normal NCS module CMake integration.
target_sources(app PRIVATE
  "${CMAKE_CURRENT_LIST_DIR}/../../net/src/FUN_0102a720.c"
  src/cfg_boundary_lowerings.c
  # P4 iteration 26: storage for every recovered absolute CPUNET RAM address
  # (structural close of the collision class).  Generated by
  # recon/application/gen_net_ram_relocs.py.
  src/g1_net_ram_relocs.c
  # P4 iteration 29: real 256-byte storage for the two `struct esb_payload`
  # objects the ESB session layer hands to the stock ESB core.  The generic
  # relocation blocks size them at 24 B, so every received ESB frame overruns
  # into the sibling block.  The sizing is PROVEN (see the file header) but is
  # OFF by default: enabling it unmasks the announce-response path, which halts
  # both cores after the first ESB ACK.  Enable with
  #   -DG1_ESB_REAL_RX_PAYLOAD_OBJECT (and -DG1_ESB_REAL_TX_PAYLOAD_OBJECT)
  # via target_compile_definitions when chasing that defect.
  src/g1_esb_payload_objects.c
  ${G1_RETAINED_SOURCES}
  ${G1_PRIVATE_REPORT_ONLY_SOURCES}
  ${G1_ESB_CLOCK_CALLBACK_CLOSURE_SOURCES}
  ${G1_PRODUCT_ENDPOINT_SOURCES}
  ${G1_ESB_UPLINK_WORKER_SOURCES}
  ${G1_TIMESLOT_OWNER_SOURCES}
  # Byte-exact literal/data pools split from CFG-inflated net functions.
  # These are reviewed reconstruction artifacts, not synthesized link stubs.
  "${CMAKE_CURRENT_LIST_DIR}/../../net/data/rodata_0x100ef04.c"
  "${CMAKE_CURRENT_LIST_DIR}/../../net/data/rodata_0x101fdb8.c"
  "${CMAKE_CURRENT_LIST_DIR}/../../net/data/rodata_0x101fdcc.c"
  "${CMAKE_CURRENT_LIST_DIR}/../../net/data/rodata_0x10217fc.c"
  "${CMAKE_CURRENT_LIST_DIR}/../../net/data/rodata_0x10237a4.c"
  "${CMAKE_CURRENT_LIST_DIR}/../../net/data/rodata_0x103c190.c"
)

# Canonical parity sources retain their fixed-address form by default.  The
# cohesive firmware build selects only reviewed object/callback relocations.
target_compile_definitions(app PRIVATE G1_COHESIVE_BUILD=1)

# P4 iteration 30 -- real 256-byte storage for the two `struct esb_payload`
# objects (see src/g1_esb_payload_objects.c for the proof of the size).  The
# generic relocation blocks size them at 24 B, so stock esb_read_rx_payload()
# overruns g_esb_rx_payload on every received frame and FUN_0102a4c8's
# `event->payload[0x11]` read lands outside the block.
option(G1_ESB_REAL_PAYLOAD_OBJECTS
  "Give g_esb_rx_payload / g_esb_sync_response_packet their true 256-byte extent"
  OFF)
if(G1_ESB_REAL_PAYLOAD_OBJECTS)
  target_compile_definitions(app PRIVATE
    G1_ESB_REAL_RX_PAYLOAD_OBJECT
    G1_ESB_REAL_TX_PAYLOAD_OBJECT)
endif()

# Symbolized reconstruction inputs include the generated reversible VA/name
# declarations from this directory.
target_include_directories(app PRIVATE
  "${CMAKE_CURRENT_LIST_DIR}/../../symbols"
  "${ZEPHYR_BASE}/subsys/ipc/ipc_service/backends"
)

# Symbolized sources name original-image RAM and read-only objects rather than
# embedding raw addresses.  Resolve those names with the generated, reversible
# VA pins used by the parity/full-link pipeline.  The small aliases fragment is
# separately reviewed and contains only known interior/shared-tail addresses.
# PROVIDE keeps real SDK definitions authoritative when one exists.
zephyr_linker_sources(SECTIONS
  "${CMAKE_CURRENT_LIST_DIR}/../../symbols/g1_net_globals.ld"
  "${CMAKE_CURRENT_LIST_DIR}/../../symbols/g1_net_aliases.ld"
  "${CMAKE_CURRENT_LIST_DIR}/../../symbols/g1_net_function_aliases.ld"
  "${CMAKE_CURRENT_LIST_DIR}/src/stock_call_aliases.ld"
)
```

## prj.conf
```kconfig
# G1 CPUNET: standalone HCI-RPMsg/SoftDevice Controller build shell.
# Target: nrf5340dk_nrf5340_cpunet (Cortex-M33, soft-float).

CONFIG_SIZE_OPTIMIZATIONS=y

# CPUNET executes the shipped payload through the nRF53 network-core runtime
# alias, 0x800 bytes above the analysis coordinate used by netcore_image.bin.
# The raw payload is catalogued at 0x01008000; its linked/runtime origin is
# therefore 0x01008800.  Keep this offset explicit so clean Zephyr links do not
# silently fall back to the board default 0x01000000.
CONFIG_FLASH_LOAD_OFFSET=0x8800

# The shipped image retains Zephyr's API argument assertions (for example the
# two __ASSERT_NO_MSG checks in k_work_init).
CONFIG_ASSERT=y
CONFIG_ASSERT_NO_COND_INFO=y
CONFIG_ASSERT_NO_MSG_INFO=y

# Firmware k_spinlock objects carry the owner word used by
# z_spin_lock_valid/z_spin_unlock_valid/z_spin_lock_set_owner.  This also makes
# struct onoff_manager exactly 0x20 bytes and k_msgq_init exactly 40 bytes.
# SMP is independently ruled out: it would grow onoff_manager to 0x24.
CONFIG_SPIN_VALIDATE=y
CONFIG_SMP=n

# The shipped kernel thread ABI places arch.swap_return_value at offset 0x90.
# With this Zephyr revision, the 20-byte thread-name field is the difference
# from the otherwise identical 0x7c CPUNET shell layout.
CONFIG_THREAD_NAME=y
CONFIG_THREAD_MAX_NAME_LEN=20

# The shipped image uses deferred Zephyr logging and routes printk through the
# logging backend.  This selects the exact NCS v2.5.1 log_msg.c owner recovered
# at 0x0102e284; the reconstruction is excluded only when that SDK owner is
# present in the build.
CONFIG_LOG=y
CONFIG_LOG_MODE_DEFERRED=y
CONFIG_LOG_FRONTEND=n
CONFIG_LOG_PRINTK=y

# HCI transport to the application core.
CONFIG_BT=y
CONFIG_BT_HCI_RAW=y
CONFIG_BT_HCI_RAW_RESERVE=1
CONFIG_IPC_SERVICE=y
CONFIG_IPC_SERVICE_BACKEND_RPMSG=y
CONFIG_MBOX=y

# CPUNET is the OpenAMP remote/device endpoint.  Building both roles retains a
# host-only branch in rpmsg_virtio_get_buffer_size which is absent from the
# shipped firmware.
CONFIG_OPENAMP_MASTER=n
CONFIG_OPENAMP_SLAVE=y

# Exact NCS v2.5.1 multirole SoftDevice Controller archive selection.
CONFIG_BT_LL_SOFTDEVICE=y
CONFIG_BT_LL_SOFTDEVICE_BUILD_TYPE_LIB=y
CONFIG_BT_LL_SOFTDEVICE_MULTIROLE=y
# BT_CTLR_LE_ENC_SUPPORT is hidden and selected by BT_LL_SOFTDEVICE.
CONFIG_BT_CTLR_LE_ENC=y

# The original iterable log-constant table contains the stock `esb`,
# `NRFX_TIMER`, `NRF_RPC`, `NRF_RPC_CBOR`, `NRF_RPC_OS`, and `nrf_rpc_ipc`
# owners.  ESB shares the network-core radio with the full SDC/MPSL build, so
# it must use dynamic direct IRQ attachment; the default static-IRQ choice
# selects the mutually incompatible MPSL_FEM_ONLY configuration.
CONFIG_DYNAMIC_INTERRUPTS=y
CONFIG_DYNAMIC_DIRECT_INTERRUPTS=y
CONFIG_ESB=y
CONFIG_ESB_DYNAMIC_INTERRUPTS=y
# P4 iteration 29 -- MEASURED, not guessed.  The shipped esb.c `.bss` objects
# tile contiguously only at payload_length 251:
#   rx_payload.0 0x21005256 .. +0x800   (8 x 256 B)
#   tx_payload.1 0x21005a56 .. +0x800   (8 x 256 B)   sizeof(esb_payload)=5+251
#   pids         0x21006256 (8 B)
#   rx_payload_buffer 0x2100625e (253 B = 251 + 2)
#   tx_payload_buffer 0x2100635b (253 B)
#   esb_state    0x21006458,  esb_initialized 0x21006459
# and with 251 (and only 251) the stock sections .text.esb_write_payload,
# .text.start_tx_transaction, .text.rx_fifo_push_rfbuf and
# .text.update_rf_payload_format_esb_dpl become byte-identical to the shipped
# image.  It also agrees with the shipped esb_config template decoded in
# iteration 24 (`payload_length = 0xfb`).  Evidence:
# recon/ownership/net_esb_core_singleton_adoption.json.
CONFIG_ESB_MAX_PAYLOAD_LENGTH=251
CONFIG_NRF_RPC=y

# The product ESB path opens one MPSL timeslot session.  The original static
# timeslot worker has exactly one session-id slot and enqueues one OPEN before
# its first REQUEST; zero sessions makes that shipped startup path fail.
CONFIG_MPSL_TIMESLOT_SESSION_COUNT=1

# The shipped PRE_KERNEL_1 table contains the four NCS 2.5.1 POSIX pool
# initializers.  Each pool iterates exactly five objects, matching the stock
# MAX_PTHREAD_*_COUNT defaults selected by POSIX_API.
CONFIG_POSIX_API=y

# The shipped POST_KERNEL table contains fw_info.c:check_ext_api_requests(),
# and its image-info literal is runtime base + 0x200 (0x01008a00), exactly the
# NCS 2.5.1 FW_INFO_OFFSET default.
CONFIG_FW_INFO=y

# AES primitive used by the controller/CCM path.
CONFIG_TINYCRYPT=y
CONFIG_TINYCRYPT_AES=y

# P4 iteration 29 -- MEASURED, replacing the value inherited unverified from
# the NCS v2.5.1 hci_rpmsg image baseline (8192).  Zephyr's K_HEAP_DEFINE
# statically initialises `_system_heap` as
#     struct sys_heap { struct z_heap *heap; void *init_mem; size_t init_bytes; }
# so the shipped heap size is readable straight out of the shipped `.data`
# image.  The shipped k_aligned_alloc at analysis VA 0x010389a0 loads
# &_system_heap from its literal pool at 0x010389e8 = 0x210008b4, and the
# shipped .data (LMA runtime 0x0103ed24, VMA 0x21000000) holds there:
#     0x210008b4  heap       = 0x00000000
#     0x210008b8  init_mem   = 0x2100a440
#     0x210008bc  init_bytes = 0x00000a00 = 2560
# 8192 wasted 5,632 B of a 64 KiB core, which is what blocked the ESB core
# displacement (the correct CONFIG_ESB_MAX_PAYLOAD_LENGTH=251 needs ~4.6 KiB of
# real .bss for rx_payload/tx_payload/pids/rx+tx_payload_buffer).
CONFIG_HEAP_MEM_POOL_SIZE=2560
# The shipped sys_heap helpers retain the runtime small-vs-big header branch
# (for example chunk_header_bytes() tests h->end_chunk against 0x8000).  The
# default SMALL_ONLY choice constant-folds that branch and does not match.
CONFIG_SYS_HEAP_AUTO=y
# P4 iteration 19 — MEASURED, not inherited.  512 is the NCS v2.5.1
# hci_rpmsg sample's value and was carried over unverified.  As soon as
# FUN_0102fcec was displaced onto the stock hci_raw.c bt_enable_raw (which
# actually calls drv->open(), i.e. the SoftDevice Controller's
# hci_driver_open()/sdc_enable()), the main thread overflowed: a Renode hook
# on this build measured main entering with sp = 0x2100bdc8 in a
# z_main_stack of 0x2100bbe8..0x2100bde8, and z_arm_fault was reached with
# psp = 0x2100bba8 — 0x40 BELOW the stack base — producing
# "MPU FAULT / Instruction Access Violation, pc 0x2100bc74" at t = 0.3426 s.
# The shipped firmware runs the same stock open path from the same main, so
# its own value cannot have been 512 either.
CONFIG_MAIN_STACK_SIZE=1024
CONFIG_SYSTEM_WORKQUEUE_STACK_SIZE=512
CONFIG_BT_MAX_CONN=16
CONFIG_BT_BUF_CMD_TX_COUNT=10

# The shipped net image exposes one RTC system channel plus one user channel.
# This makes CHAN_COUNT=2 in Zephyr's nrf_rtc_timer.c and selects the exact
# rtc_nrf_isr implementation at firmware VA 0x010315f0.
CONFIG_NRF_RTC_TIMER_USER_CHAN_COUNT=1
```

## app.overlay
```dts
/*
 * CPUNET emulator boot-parity FLASH enlargement.
 *
 * DO NOT read this as the real device flash map. The physical nRF5340 network
 * core has 256 KiB of FLASH (0x01000000 + 256K) and the shipped netcore image
 * (225,632 B, loaded at runtime base 0x01008800) fits it with 1,696 B spare.
 *
 * Our cohesive recovered build is ~2.3 KiB larger than the shipped image
 * because it links lean recovered code alongside separately-compiled SDK
 * archives (a recovered<->SDK duplication residual). The physical link is
 * symbol-clean (0 undefined, 0 duplicate) but its image span (~227,961 B)
 * overflows the real usable region (256K - 0x8800 = 227,328 B) by 633 B.
 *
 * The linker derives the FLASH region as
 *   ORIGIN = CONFIG_FLASH_BASE_ADDRESS + CONFIG_FLASH_LOAD_OFFSET  (0x01008800)
 *   LENGTH = CONFIG_FLASH_SIZE*1K - CONFIG_FLASH_LOAD_OFFSET
 * and CONFIG_FLASH_SIZE is derived from this flash1 reg size. Modeling a
 * slightly larger net flash therefore grows LENGTH WITHOUT moving the load
 * base 0x01008800 (which is mandatory: the net image is position-DEPENDENT).
 *
 * 256K -> 260K adds 4 KiB (two 2048 B erase blocks) of usable FLASH:
 *   usable = 260*1024 - 0x8800 = 231,424 B  (was 227,328 B)
 * which fits the cohesive image with headroom. This is a deliberate
 * emulator-vs-device divergence to unblock emulator bring-up. Real-device fit
 * requires eliminating the recovered<->SDK duplication (byte-match endgame),
 * tracked separately, NOT done here. See FLASH_DIVERGENCE.md.
 */

&flash1 {
	reg = <0x01000000 DT_SIZE_K(260)>;
};
```

## src/main.c
```c
/* SPDX-License-Identifier: Apache-2.0 */

/*
 * The recovered network-core implementation is supplied by the generated
 * retained-source manifest.  This entry point exists only to make the image a
 * standalone Zephyr application while ownership/link-map integration is being
 * proved.  HCI-RPMsg and the SoftDevice Controller are selected through
 * prj.conf and their normal pinned NCS module integration.
 */
int main(void)
{
	return 0;
}
```

## src/cfg_boundary_lowerings.c
```c
/* SPDX-License-Identifier: Apache-2.0 */

/*
 * Strong owner for the sole synthetic CFG-boundary call retained by the
 * differential reconstruction harness.  Original CPUNET instructions at
 * 0x0100d4cc are exactly:
 *
 *     movs r0, #0
 *     bx   lr
 *
 * Keeping this as an out-of-line owner preserves the harness's boundary-call
 * model while giving the integrated image the original C semantics.
 */
unsigned int FUN_shadow_default(void)
{
    return 0;
}

#include <stddef.h>
#include <stdint.h>

#include <ipc_rpmsg_static_vrings.h>

/* Compiler-outlined forms of two pinned NCS 2.5.1 static inline helpers. */
size_t ipc_static_vrings_shm_size(unsigned int descriptor_count,
                                  unsigned int buffer_size)
{
    return shm_size(descriptor_count, buffer_size);
}

int rtc_compare_event_clear(int32_t channel)
{
    volatile uint32_t *event =
        (volatile uint32_t *)(0x41016000u + 0x140u +
                              (uint32_t)channel * sizeof(uint32_t));

    *event = 0u;
    (void)*event;
    return 0;
}

/*
 * Ghidra missed this 88-byte function boundary at 0x0101b4f4.  The raw
 * back-map remains in FUN_01018df8.c.  This source is an integration closure,
 * not an archive alias: it follows the complete Thumb body through 0x0101b54a
 * and deliberately leaves the 24-byte call frame uninitialized as firmware
 * does before FUN_0101a38c fills it.
 */
extern int controller_timing_snapshot_build(void *frame, unsigned int,
                                            unsigned int, unsigned int);
extern uint8_t *controller_radio_state_get(void);
extern void controller_radio_event_cleanup(void);
extern void FUN_01022a84(void);
extern int sdc_conn_window_admit(unsigned int, void *frame);
extern void sdc_assertion_fail(unsigned int, unsigned int)
    __attribute__((noreturn));

void sdc_event_publish(unsigned int unused0, unsigned int unused1,
                       unsigned int unused2, unsigned int unused3)
{
    volatile uint8_t *const state = (volatile uint8_t *)0x210010a0u;
    uint8_t frame[24];

    (void)unused0;
    (void)unused1;
    (void)unused2;
    (void)unused3;

    for (;;) {
        if (state[20] == 0u) {
            return;
        }
        if (state[1] == 0u) {
            break;
        }
        if (controller_timing_snapshot_build(frame, 0u, 0u, 0u) == 0) {
            state[2] = 1u;
            continue;
        }
        if (sdc_conn_window_admit(*controller_radio_state_get(), frame) == 0) {
            sdc_assertion_fail(0x21u, 0x7cbu);
        }
    }

    controller_radio_event_cleanup();
    FUN_01022a84();
    state[20] = 0u;
    state[21] = 0u;
}
```

## src/esb_peripherals_g1.h
```c
/* SPDX-License-Identifier: LicenseRef-Nordic-5-Clause
 *
 * P4 iteration 29 -- the ONE line in which the shipped G1 CPUNET firmware
 * diverges from the pinned NCS v2.5.1 `nrf/subsys/esb`.
 *
 * WHY THIS FILE EXISTS
 * --------------------
 * `nrf/subsys/esb/esb_peripherals.h` hardcodes
 *
 *     #define ESB_EVT_IRQ        SWI0_IRQn
 *     #define ESB_EVT_IRQHandler SWI0_IRQHandler
 *
 * but on the nRF5340 network core `nrf/subsys/mpsl/init/mpsl_init.c:38`
 * ALREADY owns SWI0 (`#define MPSL_LOW_PRIO_IRQn SWI0_IRQn`), and this
 * firmware runs ESB and MPSL/SDC on the same core.  The shipped image
 * therefore pends SWI3, not SWI0.  Measured, not assumed: the shipped bytes at
 * 0x01032e1c / 0x01032e30 (inside `on_radio_disabled_tx_noack`) and 0x01032fe0
 * (inside `on_radio_disabled_rx`) hold
 *
 *     f04f 5300   mov.w r3, #0x20000000   -> NVIC->ISPR[0] bit 29 = SWI3_IRQn
 *
 * where a stock SWI0 build emits
 *
 *     f04f 6380   mov.w r3, #0x04000000   -> NVIC->ISPR[0] bit 26 = SWI0_IRQn
 *
 * and those four bytes were the ONLY unmasked difference in the whole
 * 112-byte and 560-byte sections.  With this header (and
 * CONFIG_ESB_MAX_PAYLOAD_LENGTH=251) every esb.c section the shipped image
 * contains is relocation-masked byte-identical to the pinned stock source and
 * the 39 sections TILE 0x01032764..0x01033b18 with no gap and no overlap --
 * see recon/ownership/net_esb_core_singleton_adoption.json.
 *
 * The pinned SDK is NOT modified.  This file is force-included (`-include`)
 * into the `..__nrf__subsys__esb` library only; because it defines the SDK
 * header's own include guard, esb.c/esb_dppi.c/esb_ppi.c pick these
 * definitions up and the SDK body is skipped.
 */

#ifndef ESB_PERIPHERALS_H_
#define ESB_PERIPHERALS_H_

#ifdef __cplusplus
extern "C" {
#endif

#include <nrfx.h>
#include <nrfx_timer.h>

#include <hal/nrf_egu.h>

/** The ESB event IRQ number.  G1: SWI3, because MPSL owns SWI0 on CPUNET. */
#define ESB_EVT_IRQ        SWI3_IRQn
/** The handler for @ref ESB_EVT_IRQ. */
#define ESB_EVT_IRQHandler SWI3_IRQHandler

/** ESB timer instance number. */
#define ESB_TIMER_INSTANCE_NO CONFIG_ESB_SYS_TIMER_INSTANCE

#define ESB_TIMER_IRQ          NRFX_CONCAT_3(TIMER, ESB_TIMER_INSTANCE_NO, _IRQn)
#define ESB_TIMER_IRQ_HANDLER  NRFX_CONCAT_3(nrfx_timer_,		    \
					     ESB_TIMER_INSTANCE_NO, \
					     _irq_handler)

/** ESB nRF Timer instance */
#define ESB_NRF_TIMER_INSTANCE \
	NRFX_CONCAT_2(NRF_TIMER, ESB_TIMER_INSTANCE_NO)

/** ESB nrfx timer instance. */
#define ESB_TIMER_INSTANCE NRFX_TIMER_INSTANCE(ESB_TIMER_INSTANCE_NO)

/** ESB EGU instance, events and tasks configuration. */
#define ESB_EGU       NRF_EGU0
#define ESB_EGU_EVENT NRF_EGU_EVENT_TRIGGERED6
#define ESB_EGU_TASK  NRF_EGU_TASK_TRIGGER6

/** ESB additional EGU event and task for devices with DPPI. */
#define ESB_EGU_DPPI_EVENT NRF_EGU_EVENT_TRIGGERED7
#define ESB_EGU_DPPI_TASK  NRF_EGU_TASK_TRIGGER7

#ifdef __cplusplus
}
#endif

#endif /* ESB_PERIPHERALS_H_ */
```

## src/g1_net_ram_relocs.c
```c
/* GENERATED by recon/application/gen_net_ram_relocs.py (P4 iteration 26) -- do not edit.
 *
 * One storage block per cluster of recovered CPUNET absolute RAM
 * addresses.  `used, retain` is MANDATORY: iteration 10 measured a
 * sibling block being silently discarded by --gc-sections, after
 * which every PROVIDE(x = block + off) resolved against a base of 0
 * (iteration 11 §11.1).
 *
 * Blocks inside the shipped .data window (0x21000000..0x21000c3c)
 * carry their shipped initialiser; blocks above it were .bss in the
 * shipped firmware, so zeroed storage reproduces them exactly.
 */

#define G1_NET_RAM_BLOCK __attribute__((used, retain, aligned(8)))

/* original 0x21000570..0x21000598, 40 B  -- EXCLUDED (atomic): pointer word(s) +0x0=0x0102a527, +0x4=0x0103c780, +0x14=0x0103cf12 do not resolve in this link */
unsigned char g1_net_ram_blk_21000570[40] G1_NET_RAM_BLOCK;

/* original 0x210005e8..0x21000600, 24 B  -- EXCLUDED (atomic): pointer word(s) +0x0=0x01039f1b, +0x14=0x0103bf98 do not resolve in this link */
unsigned char g1_net_ram_blk_210005e8[24] G1_NET_RAM_BLOCK;

/* original 0x21000658..0x21000670, 24 B  -- shipped .data initialiser restored */
unsigned char g1_net_ram_blk_21000658[24] G1_NET_RAM_BLOCK = { 0x00, 0x00, 0x00, 0x00, 0x01, 0x00, 0x00, 0x00, 0x00, 0x00, 0x00, 0x00, 0x00, 0x00, 0x00, 0x00, 0x00, 0x00, 0x00, 0x00, 0x00, 0x00, 0x00, 0x00 };

/* original 0x21000680..0x210006c0, 64 B  -- shipped .data initialiser restored */
unsigned char g1_net_ram_blk_21000680[64] G1_NET_RAM_BLOCK = { 0x0c, 0x00, 0x00, 0x00, 0xe7, 0xe7, 0xe7, 0xe7, 0xc2, 0xc2, 0xc2, 0xc2, 0xe7, 0xc2, 0xc3, 0xc4, 0xc5, 0xc6, 0xc7, 0xc8, 0x08, 0x05, 0xff, 0x02, 0x00, 0x90, 0x01, 0x41, 0x00, 0x08, 0x00, 0x00, 0x3f, 0x00, 0x00, 0x00, 0x00, 0xc0, 0xff, 0xff, 0x00, 0x00, 0x00, 0x00, 0x00, 0x00, 0x00, 0x00, 0x00, 0x00, 0x00, 0x00, 0x00, 0x00, 0x00, 0x00, 0x00, 0x00, 0x00, 0x00, 0x00, 0x00, 0x00, 0x00 };

/* original 0x21000718..0x21000730, 24 B  -- EXCLUDED (atomic): pointer word(s) +0xc=0x0103d5c7, +0x14=0x0103590d do not resolve in this link */
unsigned char g1_net_ram_blk_21000718[24] G1_NET_RAM_BLOCK;

/* original 0x21000750..0x21000768, 24 B  -- shipped .data initialiser restored (4 pointer word(s) relocation-aware) */
unsigned long g1_net_ram_blk_21000750[6] G1_NET_RAM_BLOCK = {
    (unsigned long)((unsigned char *)g1_net_ram_blk_21000750 + 0x0), (unsigned long)((unsigned char *)g1_net_ram_blk_21000750 + 0x0),
    (unsigned long)((unsigned char *)g1_net_ram_blk_21000750 + 0x8), (unsigned long)((unsigned char *)g1_net_ram_blk_21000750 + 0x8),
    0xa3d3e901ul, 0xc9a3a3a3ul,
};

/* original 0x210008c8..0x210008e0, 24 B  -- shipped .data initialiser restored (2 pointer word(s) relocation-aware) */
unsigned long g1_net_ram_blk_210008c8[6] G1_NET_RAM_BLOCK = {
    0x00000000ul, (unsigned long)((unsigned char *)g1_net_ram_blk_210008c8 + 0x4),
    (unsigned long)((unsigned char *)g1_net_ram_blk_210008c8 + 0x4), 0x00000000ul,
    0x00000000ul, 0x0000000eul,
};

/* original 0x210009f8..0x21000a10, 24 B  -- EXCLUDED (atomic): pointer word(s) +0x0=0x2100d1f0 do not resolve in this link */
unsigned char g1_net_ram_blk_210009f8[24] G1_NET_RAM_BLOCK;

/* original 0x21000a30..0x21000a80, 80 B  -- EXCLUDED (atomic): pointer word(s) +0x0=0x0103f758, +0x18=0x01008800 do not resolve in this link */
unsigned char g1_net_ram_blk_21000a30[80] G1_NET_RAM_BLOCK;

/* original 0x21000b70..0x21000b90, 32 B  -- shipped .data initialiser restored */
unsigned char g1_net_ram_blk_21000b70[32] G1_NET_RAM_BLOCK = { 0x5f, 0xe7, 0x74, 0x77, 0xd0, 0xb1, 0x13, 0x8c, 0xbe, 0x68, 0xa8, 0x44, 0x5b, 0xa0, 0x40, 0xa1, 0xd5, 0x8c, 0xfc, 0x78, 0x15, 0x34, 0x3e, 0x94, 0xa0, 0x30, 0x76, 0x49, 0x16, 0x81, 0x9d, 0x78 };

/* original 0x21000ba8..0x21000c10, 104 B  -- shipped .data initialiser restored */
unsigned char g1_net_ram_blk_21000ba8[104] G1_NET_RAM_BLOCK = { 0xb9, 0x74, 0x7e, 0x6a, 0xed, 0x23, 0xb5, 0x79, 0x59, 0x7b, 0xed, 0x53, 0x87, 0x79, 0x6d, 0x5d, 0x1b, 0xbe, 0x5e, 0x8d, 0xca, 0x75, 0xfe, 0xe8, 0xd6, 0xd8, 0x9c, 0x67, 0x87, 0x8c, 0xfb, 0xee, 0x02, 0xc3, 0x58, 0x1c, 0x60, 0x8f, 0xb7, 0x0c, 0xbd, 0x3f, 0x02, 0x52, 0x5b, 0x03, 0xa8, 0x6f, 0x96, 0x88, 0xd2, 0x8e, 0xea, 0x40, 0x11, 0x92, 0xad, 0xe1, 0x1e, 0xa5, 0x1f, 0x47, 0xf2, 0x80, 0x91, 0x25, 0xb9, 0x89, 0x7b, 0x5a, 0xa2, 0xd4, 0x7a, 0xf2, 0x96, 0x3c, 0x0a, 0xdd, 0xe2, 0x06, 0x76, 0xdf, 0x38, 0x56, 0xd8, 0x5a, 0x66, 0xa8, 0x62, 0xe1, 0xb2, 0x5d, 0x1e, 0x69, 0x3f, 0x68, 0x54, 0x43, 0x76, 0x47, 0x03, 0x5a, 0x06, 0x9e };

/* original 0x21000c28..0x21000c60, 56 B */
unsigned char g1_net_ram_blk_21000c28[56] G1_NET_RAM_BLOCK;

/* original 0x21000c68..0x21000c80, 24 B */
unsigned char g1_net_ram_blk_21000c68[24] G1_NET_RAM_BLOCK;

/* original 0x21000c90..0x21000ca8, 24 B */
unsigned char g1_net_ram_blk_21000c90[24] G1_NET_RAM_BLOCK;

/* original 0x21000cc0..0x21000ce8, 40 B */
unsigned char g1_net_ram_blk_21000cc0[40] G1_NET_RAM_BLOCK;

/* original 0x21000cf8..0x21000d30, 56 B */
unsigned char g1_net_ram_blk_21000cf8[56] G1_NET_RAM_BLOCK;

/* original 0x21000db0..0x21000dc8, 24 B */
unsigned char g1_net_ram_blk_21000db0[24] G1_NET_RAM_BLOCK;

/* original 0x21000ea0..0x21000f80, 224 B */
unsigned char g1_net_ram_blk_21000ea0[224] G1_NET_RAM_BLOCK;

/* original 0x21000f90..0x21000fa8, 24 B */
unsigned char g1_net_ram_blk_21000f90[24] G1_NET_RAM_BLOCK;

/* original 0x21000fc0..0x21001030, 112 B */
unsigned char g1_net_ram_blk_21000fc0[112] G1_NET_RAM_BLOCK;

/* original 0x21001048..0x21001070, 40 B */
unsigned char g1_net_ram_blk_21001048[40] G1_NET_RAM_BLOCK;

/* original 0x21001098..0x210010b8, 32 B */
unsigned char g1_net_ram_blk_21001098[32] G1_NET_RAM_BLOCK;

/* original 0x210010f0..0x21001108, 24 B */
unsigned char g1_net_ram_blk_210010f0[24] G1_NET_RAM_BLOCK;

/* original 0x21001118..0x21001158, 64 B */
unsigned char g1_net_ram_blk_21001118[64] G1_NET_RAM_BLOCK;

/* original 0x21001208..0x21001248, 64 B */
unsigned char g1_net_ram_blk_21001208[64] G1_NET_RAM_BLOCK;

/* original 0x21001448..0x21001460, 24 B */
unsigned char g1_net_ram_blk_21001448[24] G1_NET_RAM_BLOCK;

/* original 0x21001498..0x210014c0, 40 B */
unsigned char g1_net_ram_blk_21001498[40] G1_NET_RAM_BLOCK;

/* original 0x210014d8..0x210014f8, 32 B */
unsigned char g1_net_ram_blk_210014d8[32] G1_NET_RAM_BLOCK;

/* original 0x210015f0..0x21001628, 56 B */
unsigned char g1_net_ram_blk_210015f0[56] G1_NET_RAM_BLOCK;

/* original 0x21001638..0x21001650, 24 B */
unsigned char g1_net_ram_blk_21001638[24] G1_NET_RAM_BLOCK;

/* original 0x21001660..0x21001698, 56 B */
unsigned char g1_net_ram_blk_21001660[56] G1_NET_RAM_BLOCK;

/* original 0x210016b0..0x21001708, 88 B */
unsigned char g1_net_ram_blk_210016b0[88] G1_NET_RAM_BLOCK;

/* original 0x21001740..0x21001758, 24 B */
unsigned char g1_net_ram_blk_21001740[24] G1_NET_RAM_BLOCK;

/* original 0x21001bc8..0x21001c38, 112 B */
unsigned char g1_net_ram_blk_21001bc8[112] G1_NET_RAM_BLOCK;

/* original 0x21001c88..0x21001ca0, 24 B */
unsigned char g1_net_ram_blk_21001c88[24] G1_NET_RAM_BLOCK;

/* original 0x21001ce8..0x21001d18, 48 B */
unsigned char g1_net_ram_blk_21001ce8[48] G1_NET_RAM_BLOCK;

/* original 0x21002b60..0x21002b78, 24 B */
unsigned char g1_net_ram_blk_21002b60[24] G1_NET_RAM_BLOCK;

/* original 0x21002b90..0x21002ba8, 24 B */
unsigned char g1_net_ram_blk_21002b90[24] G1_NET_RAM_BLOCK;

/* original 0x21004258..0x21004270, 24 B */
unsigned char g1_net_ram_blk_21004258[24] G1_NET_RAM_BLOCK;

/* original 0x210042f0..0x21004308, 24 B */
unsigned char g1_net_ram_blk_210042f0[24] G1_NET_RAM_BLOCK;

/* original 0x210045b0..0x210045d8, 40 B */
unsigned char g1_net_ram_blk_210045b0[40] G1_NET_RAM_BLOCK;

/* original 0x210045e0..0x21004658, 120 B */
unsigned char g1_net_ram_blk_210045e0[120] G1_NET_RAM_BLOCK;

/* original 0x21004670..0x210046a8, 56 B */
unsigned char g1_net_ram_blk_21004670[56] G1_NET_RAM_BLOCK;

/* original 0x210047f8..0x21004828, 48 B */
unsigned char g1_net_ram_blk_210047f8[48] G1_NET_RAM_BLOCK;

/* original 0x21004830..0x21004848, 24 B */
unsigned char g1_net_ram_blk_21004830[24] G1_NET_RAM_BLOCK;

/* original 0x21004960..0x210049e8, 136 B */
unsigned char g1_net_ram_blk_21004960[136] G1_NET_RAM_BLOCK;

/* original 0x21004a30..0x21004a48, 24 B */
unsigned char g1_net_ram_blk_21004a30[24] G1_NET_RAM_BLOCK;

/* original 0x21004a60..0x21004a78, 24 B */
unsigned char g1_net_ram_blk_21004a60[24] G1_NET_RAM_BLOCK;

/* original 0x21004a88..0x21004ab0, 40 B */
unsigned char g1_net_ram_blk_21004a88[40] G1_NET_RAM_BLOCK;

/* original 0x21004ae8..0x21004b20, 56 B */
unsigned char g1_net_ram_blk_21004ae8[56] G1_NET_RAM_BLOCK;

/* original 0x21004b30..0x21004bb0, 128 B */
unsigned char g1_net_ram_blk_21004b30[128] G1_NET_RAM_BLOCK;

/* original 0x21004c98..0x21004cb8, 32 B */
unsigned char g1_net_ram_blk_21004c98[32] G1_NET_RAM_BLOCK;

/* original 0x21004da0..0x21004db8, 24 B */
unsigned char g1_net_ram_blk_21004da0[24] G1_NET_RAM_BLOCK;

/* original 0x21004ea0..0x21004eb8, 24 B */
unsigned char g1_net_ram_blk_21004ea0[24] G1_NET_RAM_BLOCK;

/* original 0x21004fa0..0x21004fc0, 32 B */
unsigned char g1_net_ram_blk_21004fa0[32] G1_NET_RAM_BLOCK;

/* original 0x210051a8..0x210051c0, 24 B */
unsigned char g1_net_ram_blk_210051a8[24] G1_NET_RAM_BLOCK;

/* original 0x21005250..0x21005268, 24 B */
unsigned char g1_net_ram_blk_21005250[24] G1_NET_RAM_BLOCK;

/* original 0x21005a50..0x21005a68, 24 B */
unsigned char g1_net_ram_blk_21005a50[24] G1_NET_RAM_BLOCK;

/* original 0x21006250..0x21006270, 32 B */
unsigned char g1_net_ram_blk_21006250[32] G1_NET_RAM_BLOCK;

/* original 0x21006358..0x21006370, 24 B */
unsigned char g1_net_ram_blk_21006358[24] G1_NET_RAM_BLOCK;

/* original 0x21006458..0x21006478, 32 B */
unsigned char g1_net_ram_blk_21006458[32] G1_NET_RAM_BLOCK;

/* original 0x21007d80..0x21007d98, 24 B */
unsigned char g1_net_ram_blk_21007d80[24] G1_NET_RAM_BLOCK;

/* original 0x21008a00..0x21008a18, 24 B */
unsigned char g1_net_ram_blk_21008a00[24] G1_NET_RAM_BLOCK;
```

## src/g1_product_endpoints.c
```c
/* Recovered product IPC endpoint ownership.
 *
 * Original initialized-data back-maps:
 *   g1_ipc0_endpoint_config @ 0x21000584
 *   g1_hci_endpoint_config  @ 0x2100059c
 * Callback words remain documented at their shipped runtime Thumb values;
 * this cohesive build expresses them as relocations to the CFG-proven bodies.
 */
#include <stddef.h>
#include <stdint.h>
#include <zephyr/kernel.h>
#include <zephyr/ipc/ipc_service.h>

/* P4 iteration 7 — the two endpoint bind semaphores, relocated.
 *
 * FUN_0102ac00 / FUN_0102ace8 (the `bound` callbacks above) k_sem_give the
 * absolute addresses 0x21000914 and 0x2100092c, and FUN_0102ac0c /
 * g1_hci_rpmsg_tx_thread k_sem_take the same two.  Both are `.data` in the
 * shipped netcore image: its .data load image starts at flash 0x0103ed24
 * (RAM 0x21000000; length 0xc3c, ending exactly at the image end 0x0103f960),
 * and the 24 bytes for each read
 *     0x21000914 -> { 0x21000914, 0x21000914, 0, 1, 0x21000924, 0x21000924 }
 *     0x2100092c -> { 0x2100092c, 0x2100092c, 0, 1, 0x2100093c, 0x2100093c }
 * i.e. self-referential wait_q + poll_events, count 0, limit 1 —
 * K_SEM_DEFINE(<name>, 0, 1).  Nothing in the recovered corpus initialises
 * them, and in the cohesive build those addresses are other live objects.
 *
 * MEASURED (iteration 7 Step A): with the app core finally completing the
 * rpmsg bind, the net core reached its own `bound_cb` -> FUN_0102ac00 ->
 * FUN_01036824 (k_sem_give) and the wait_q at 0x21000914 held a bogus thread,
 * tripping `__ASSERT_NO_MSG(thread->base.pended_on)`
 * (zephyr/kernel/sched.c:722, lr = unpend_thread_no_timeout+0x1e) -> kernel
 * panic -> SYSRESETREQ, which reset the whole emulated machine.  Evidence:
 * recon/emulator/reports/our_boot_bringup.md §Iteration 7 Step A. */
K_SEM_DEFINE(g1_ipc0_bound_sem, 0, 1);
K_SEM_DEFINE(g1_hci_bound_sem, 0, 1);

/* The registered endpoint handle (original 0x210045f8) and the "endpoint is
 * usable" flag (original 0x21004600) that FUN_0102ac0c writes and FUN_0102abac
 * reads.  Both are .bss in the shipped image (above its 0xc3c .data end) but
 * in the cohesive build their pins land inside `sdc_mempool`, the SoftDevice
 * Controller heap, so ipc_service_register_endpoint was writing into it. */
struct ipc_ept g1_ipc0_ept;
volatile uint32_t g1_ipc0_ept_ready;

/* ------------------------------------------------------------------------
 * P4 iteration 18 — the two "HCI rpmsg" threads of FUN_0102afbc.
 *
 * FUN_0102afbc is NCS 2.5.1's samples/bluetooth/hci_rpmsg/src/main.c body: it
 * creates the TX and RX threads, names them, opens the ipc0 instance and
 * registers the "nrf_bt_hci" endpoint.  Its shipped storage is
 *
 *     struct k_thread  RX  0x21001d08   stack 0x21006480  0x800 B
 *     struct k_thread  TX  0x21001da0   stack 0x21006cc0  0x600 B
 *     struct ipc_ept   HCI 0x21004608
 *
 * and in the cohesive link EVERY one of those addresses is inside a live
 * linker-allocated object:
 *
 *     0x21001d08 / 0x21001da0 -> backend_data_0  [0x21001cf8..0x21002090]
 *                                (the ipc_rpmsg_static_vrings instance:
 *                                 rpmsg_inst.endpoint[0..1] and
 *                                 rvdev.rdev, whose `endpoints` metal_list
 *                                 head is at +0xe0)
 *     0x21006480 / 0x21006cc0 -> sdc_mempool     [0x21002990..0x21007c51]
 *     0x21004608              -> sdc_mempool
 *
 * MEASURED (Renode watchpoints, iteration 18 §18.1/§18.2): z_setup_new_thread
 * writing thread+0x74 hit 0x21001e14, which is `rdev.ns_ept.node.next`, and
 * z_add_timeout writing the thread's own `_timeout` (thread+0x18) hit
 * 0x21001d30 = `endpoint[0].ep.node.prev`.  With the endpoint dlist broken,
 * OpenAMP's rpmsg_get_endpoint walked a NULL `next` forever (99.3 % of the net
 * core's instructions), the app core's HCI endpoint never bound, and
 * bt_enable() failed with -ENOENT.
 *
 * Give the three objects real storage.  Sizes and priorities are unchanged;
 * only the addresses move, exactly as for g1_ipc0_ept above.
 * ------------------------------------------------------------------------ */
/* P4 iteration 19 — the +0x40 K_KERNEL_STACK_RESERVED of the SHIPPED build.
 * The recovered z_setup_new_thread (recon/net/src/FUN_01035edc.c) computes
 *     stack_buf_start = stack + 0x40
 *     stack_ptr       = stack + 0x40 + ROUND_UP(size, 8)
 * i.e. the shipped K_KERNEL_STACK_DEFINE reserved 0x40 bytes at the bottom of
 * every stack object (Cortex-M MPU stack guard).  This build's
 * K_THREAD_STACK_DEFINE reserves 0 (nm reports the arrays at exactly their
 * nominal size), so a nominal-size object made every thread run 0x40 bytes
 * past its own array.  Measured on g1-i19c-net with a Renode hook at the two
 * thread entry points: FUN_0102adac entered with sp = 0x21009b88 while
 * g1_hci_rpmsg_tx_stack is 0x21009560..0x21009b60, and FUN_0102acf4 entered
 * with sp = 0x21009588 while g1_hci_rpmsg_rx_stack is 0x21008d60..0x21009560 —
 * both 0x28 past their array end (0x40 reserve minus the 0x18 already pushed
 * at the entry hook).  The TX thread's outermost frames therefore sat on the
 * bottom of _k_thread_stack_mpsl_nonpreemptible_thread_id.  The arrays are
 * sized nominal + 0x40 so the reconstruction's own arithmetic stays inside
 * them. */
#define G1_NET_STACK_RESERVED 0x40
K_THREAD_STACK_DEFINE(g1_hci_rpmsg_tx_stack, 0x600 + G1_NET_STACK_RESERVED);
K_THREAD_STACK_DEFINE(g1_hci_rpmsg_rx_stack, 0x800 + G1_NET_STACK_RESERVED);
struct k_thread g1_hci_rpmsg_tx_thread;
struct k_thread g1_hci_rpmsg_rx_thread;
struct ipc_ept g1_hci_ept;

/* The two k_thread_name_set() arguments.  0x0103d088 / 0x0103d095 are stored
 * pointer VALUES, i.e. CPUNET *runtime* addresses (tools/net_address_space.py);
 * their analysis addresses 0x0103c888 / 0x0103c895 read
 * "HCI rpmsg TX" / "HCI rpmsg RX" out of netcore_image.bin. */
const char g1_hci_rpmsg_tx_name[] = "HCI rpmsg TX";
const char g1_hci_rpmsg_rx_name[] = "HCI rpmsg RX";

/* hci_rpmsg.c's `static K_FIFO_DEFINE(tx_queue);` — shipped at 0x21000978,
 * which in the cohesive link is 0x18 bytes into net_buf_pool_area's third
 * `struct net_buf_pool` (the section runs 0x210008f8..0x21000994).  The RX
 * endpoint callback (FUN_0102adf0) puts into it and the TX thread
 * (FUN_0102adac) does net_buf_get() on it, so unrelocated the two of them
 * treat a net_buf pool as a k_fifo. */
K_FIFO_DEFINE(g1_hci_tx_queue);

/* hci_rpmsg.c's controller->host k_fifo, shipped at 0x2100095c: the argument
 * FUN_0102afbc passes to bt_enable_raw (which stores it in hci_raw.c's
 * `raw_rx`) and the queue FUN_0102acf4 consumes.  In the cohesive link
 * 0x2100095c is 0x14 bytes into the STOCK hci_raw.c `hci_cmd_pool`
 * (0x21000948..0x2100097c), so net_buf_get() ran on a net_buf pool: measured
 * in iteration 19 as an unbounded `Unknown type %u` log loop on the CPUNET
 * (289,729,537 instructions in 8 s) with the app core's first HCI Reset never
 * answered. */
K_FIFO_DEFINE(g1_hci_rx_queue);

/* FUN_0102b1c8's ESB worker thread: shipped object 0x21001e38 (inside
 * backend_data_0 in the cohesive link) and stack 0x21007300 (inside
 * sdc_mempool).  See recon/net/src/FUN_0102b1c8.c for the measurement and for
 * the deferred reconstruction of its entry point (analysis 0x0102b204). */
K_THREAD_STACK_DEFINE(g1_esb_worker_stack, 0x600 + G1_NET_STACK_RESERVED);
struct k_thread g1_esb_worker_thread;

extern void FUN_0102ac00(void *priv); /*=0x0102b401*/
extern void FUN_0102ab14(const uint8_t *data, size_t size, void *priv); /*=0x0102b315*/
extern void FUN_0102ace8(void *priv); /*=0x0102b4e9*/
extern void FUN_0102adf0(uint8_t *data, uint32_t size); /*=0x0102b5f1*/

struct ipc_ept_cfg g1_ipc0_endpoint_config = {
    .name = "ipc0",
    .prio = 0,
    .cb = {
        .bound = FUN_0102ac00,
        .received = (void (*)(const void *, size_t, void *))FUN_0102ab14,
        .error = NULL,
    },
    .priv = NULL,
};

struct ipc_ept_cfg g1_hci_endpoint_config = {
    .name = "nrf_bt_hci",
    .prio = 0,
    .cb = {
        .bound = FUN_0102ace8,
        .received = (void (*)(const void *, size_t, void *))FUN_0102adf0,
        .error = NULL,
    },
    .priv = NULL,
};
```
