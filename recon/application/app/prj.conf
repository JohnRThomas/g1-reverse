## Kconfig
```
mainmenu "Even G1 reconstructed application core"

source "Kconfig.zephyr"
```

## prj.conf
```kconfig
# Reviewed upstream ownership selections for the CPUAPP image.
#
# The broader hardware/subsystem evidence remains in ../../board/prj.conf and
# is loaded first by CMakeLists.txt.  This fragment records only the adoption
# boundary established by recon/ownership/adoption_manifest.json.

# Pinned Zephyr liblc3 (modules/lib/liblc3 @ 448f3de).  Its module CMake owns
# the required -O3 -std=c11 -ffast-math flags; do not compile codec files here.
CONFIG_LIBLC3=y
CONFIG_FPU=y
CONFIG_FP_HARDABI=y
# CONFIG_SW_CODEC_LC3_T2_SOFTWARE is not set

# Confirmed firmware C library/toolchain pairing (GCC 12.2 + newlib-nano).
CONFIG_NEWLIB_LIBC=y
CONFIG_NEWLIB_LIBC_NANO=y
# CONFIG_PICOLIBC is not set
# P4 iteration 22: the shipped image CONTAINS the newlib-nano float-printf
# closure -- `_printf_float` @ 0x0007712c (1128 B), `__cvt` @ 0x00086cda,
# `__exponent` @ 0x00086daa, `_dtoa_r` @ 0x00014b60 (3156 B) and the whole
# mprec support -- each byte-identical to the pinned
# arm-zephyr-eabi 12.2 libc_nano.a (thumb/v8-m.main+fp/hard) over its entire
# upstream section after masking relocations.  newlib-nano only links those
# members when the link carries `-u _printf_float`, which is exactly what this
# Kconfig adds.  Without it, `%f`/`%e`/`%g` in the recovered callers would fall
# through to the integer engine, which the original never did.
CONFIG_NEWLIB_LIBC_FLOAT_PRINTF=y

# The shipped nrfx PDM bodies contain Zephyr's full __ASSERT_NO_MSG lowering
# (including source line metadata).  This is part of the recovered firmware
# configuration, not merely a debug preference: compiling the pinned driver
# without it changes nrfx_pdm_init/start/stop semantics and therefore forbids
# the atomic upstream PDM adoption recorded by the ownership manifest.
CONFIG_ASSERT=y
CONFIG_ASSERT_LEVEL=2
# These three values are a single recovered kernel-layout/configuration fact.
# Spin validation accounts for the shipped lock-owner checks.  TLS-off plus
# custom thread data reproduces the firmware's thread/member offsets exactly.
CONFIG_SPIN_VALIDATE=y
# Exact bt_conn_send_cb bytes prove that current-thread lookup is the stock
# z_current_get() call, not the z_tls_current fast path.
# CONFIG_THREAD_LOCAL_STORAGE is not set
# CONFIG_ERRNO_IN_TLS is not set
CONFIG_MAIN_STACK_SIZE=16384
CONFIG_THREAD_CUSTOM_DATA=y

# Public SDK residue promotion is machine-gated by
# recon/catalogs/app_sdk_public_ownership.json.  IPC_SERVICE and the Bluetooth
# feature owners are selected in ../../board/prj.conf; make the OpenAMP and
# libmetal source owners explicit here because their public exports now satisfy
# recovered calls directly.  Kernel timer/sys-clock symbols are promptless or
# core defaults and are therefore verified in the generated .config, not
# assigned illegally in this fragment.
CONFIG_OPENAMP=y
CONFIG_LIBMETAL=y

# Pinned TinyCrypt primitive set (modules/crypto/tinycrypt @ 3e9a49d).
CONFIG_TINYCRYPT=y
CONFIG_TINYCRYPT_AES=y
CONFIG_TINYCRYPT_AES_CMAC=y
CONFIG_TINYCRYPT_SHA256=y
CONFIG_TINYCRYPT_SHA256_HMAC=y
CONFIG_TINYCRYPT_SHA256_HMAC_PRNG=y

# Zephyr Bluetooth host crypto implementations adopted by the manifest.
# BT_HCI_HOST and BT_HOST_CRYPTO are derived from CONFIG_BT; BT_CRYPTO is
# selected by BT_SMP.  They are intentionally not assigned here because all
# three are promptless symbols in Zephyr 3.4.99.
CONFIG_BT_SMP=y

# Exact Bluetooth host fingerprint.  These values jointly reproduce the
# shipped hci_core/att/l2cap/gatt/conn/keys source units from Zephyr
# v3.4.99-ncs1-1.  Pool cardinalities and structure offsets are observable in
# the firmware; role/config choices are additionally instruction-exact at the
# public owner boundaries recorded by the adoption receipt.
CONFIG_BT_PERIPHERAL=y
# CONFIG_BT_CENTRAL is not set
CONFIG_BT_GATT_CLIENT=y
CONFIG_BT_GATT_DYNAMIC_DB=y
CONFIG_BT_SETTINGS=y
CONFIG_BT_MAX_PAIRED=2
CONFIG_BT_ID_MAX=1
# CONFIG_BT_PRIVACY is not set
CONFIG_BT_L2CAP_DYNAMIC_CHANNEL=y
CONFIG_BT_CONN_TX_MAX=10
CONFIG_BT_ATT_PREPARE_COUNT=1
# CONFIG_BT_L2CAP_SEG_RECV is not set
# Exact hci_tx_thread bytes and bt_dev field offsets prove that tracing is
# disabled.  Enabling it appends tracking fields to k_sem/k_queue and shifts
# bt_dev.ncmd_sem, sent_cmd, cmd_tx_queue, and drv away from firmware offsets.
# CONFIG_TRACING is not set
# CONFIG_THREAD_MONITOR is not set
# CONFIG_THREAD_NAME is not set

# Normal NCS nRF Security/CC312 integration.  These symbols select the correct
# Cortex-M33 hard-float/no-interrupts archive through nrfxlib; no archive path
# or individual vendor source is added to target_sources().
CONFIG_NRF_SECURITY=y
CONFIG_MBEDTLS_LIBRARY_NRF_SECURITY=y
CONFIG_MBEDTLS_PSA_CRYPTO_C=y
CONFIG_PSA_CORE_OBERON=y
CONFIG_PSA_CRYPTO_DRIVER_CC3XX=y
CONFIG_NRF_CC3XX_PLATFORM=y

# Binary-derived root topology (recon/catalogs/app_root_inventory.json).
# These selections reproduce stock SYS_INIT/device/ISR owners present in the
# shipped image; they are not generic feature guesses.
CONFIG_POSIX_API=y
CONFIG_PM_DEVICE=y
CONFIG_BOARD_ENABLE_CPUNET=y
CONFIG_BT_RPMSG=y
CONFIG_BT_LONG_WQ=y
CONFIG_ENTROPY_DEVICE_RANDOM_GENERATOR=y
# The original PRE_KERNEL_2 table contains only nrf_rtc_timer; xoshiro would
# add a second initializer.
# CONFIG_XOSHIRO_RANDOM_GENERATOR is not set

# Projector SPIM3/SPIM4 are direct nrfx users.  Their two vector veneers are
# present, while no Zephyr SPI device descriptor exists.
CONFIG_NRFX_SPIM3=y
CONFIG_NRFX_SPIM4=y

# Exact nPM1300/ALS/PDM stock device closure from the 26-entry descriptor table.
CONFIG_MFD_NPM1300=y
CONFIG_GPIO_NPM1300=y
CONFIG_WDT_NPM1300=y
CONFIG_REGULATOR=y
CONFIG_REGULATOR_NPM1300=y
CONFIG_NPM1300_CHARGER=y
CONFIG_OPT3001=y
CONFIG_AUDIO_DMIC_NRFX_PDM=y
# The firmware carries an LSM6DSO-shaped descriptor with a NULL init pointer;
# enabling Zephyr's driver would add the non-matching lsm6dso_init SYS_INIT.
# CONFIG_LSM6DSO is not set

# The two APPLICATION init entries are mcumgr_handlers_init and smp_init.
# Recovered img_mgmt owners and the Bluetooth transport identify the handler
# and transport closure.  Stack/prio are exact values from the original SMP
# workqueue creation site.
CONFIG_MCUMGR=y
CONFIG_ZCBOR=y
CONFIG_ZCBOR_STOP_ON_ERROR=y
CONFIG_STREAM_FLASH=y
CONFIG_IMG_MANAGER=y
CONFIG_BOOTLOADER_MCUBOOT=y
CONFIG_MCUMGR_GRP_IMG=y
CONFIG_MCUMGR_TRANSPORT_BT=y
CONFIG_MCUMGR_TRANSPORT_WORKQUEUE_STACK_SIZE=2048
CONFIG_MCUMGR_TRANSPORT_WORKQUEUE_THREAD_PRIO=3
CONFIG_MCUMGR_TRANSPORT_BT_REASSEMBLY=y
CONFIG_MCUMGR_TRANSPORT_NETBUF_SIZE=2475
CONFIG_MCUMGR_GRP_IMG_UPDATABLE_IMAGE_NUMBER=2
CONFIG_IMG_ERASE_PROGRESSIVELY=y
CONFIG_UPDATEABLE_IMAGE_NUMBER=2
CONFIG_NRF53_UPGRADE_NETWORK_CORE=y
CONFIG_PM_EXTERNAL_FLASH_MCUBOOT_SECONDARY=y
```

## src/device_info.h
```c
/*
 * Recovered global device state block for the Even G1 app core.
 *
 * The firmware keeps almost all cross-module state in one large struct at a
 * fixed RAM address; individual reconstructed functions currently reference its
 * fields via absolute addresses (see the parity-proof convention). This header
 * is the consolidated, named view recovered from reverse engineering
 * (mods.txt / result.h). Offsets are authoritative; names are best-effort.
 *
 * sizeof == 0x18E0
 */
#ifndef G1_DEVICE_INFO_H
#define G1_DEVICE_INFO_H

#include <stdint.h>

struct projector_controller_t;  /* forward: per-projector (L/R) control block */

struct device_info_t {
	uint8_t  device_type;          /* 0x000  L/R role, DFU switch reads this   */
	uint8_t  work_mode;            /* 0x001                                    */
	uint8_t  esb_channel_number;   /* 0x002  Nordic ESB sync channel (L<->R)   */
	uint8_t  gap_0003[198];
	uint8_t  dfu_soc_flag_1;       /* 0x0C9  set 0x83 to enter DFU             */
	uint8_t  dfu_soc_flag_2;       /* 0x0CA  set 1                             */
	uint8_t  last_battery_soc;     /* 0x0CB                                    */
	uint8_t  reserved_cc;
	uint8_t  onboarding_state;     /* 0x0CD                                    */
	uint8_t  reserved_ce[6];
	uint8_t  display_command;      /* 0x0D4                                    */
	uint8_t  current_app_id;       /* 0x0D5  current running application id    */
	uint8_t  reserved_d6[15];
	uint8_t  sync_command_type;    /* 0x0E5                                    */
	uint8_t  sync_sub_command;     /* 0x0E6                                    */
	uint8_t  sync_param1;          /* 0x0E7                                    */
	uint8_t  sync_param2;          /* 0x0E8                                    */
	uint8_t  reserved_e9[3];
	uint8_t  next_screen_id;       /* 0x0EC                                    */
	uint8_t  gap_00ED[1671];
	void    *system_function_ptr;  /* 0x778                                    */
	uint8_t  gap_0778[564];
	void    *settings_save_address_ptr;
	uint8_t  gap_09B0[4];
	uint32_t system_status_value;
	uint8_t  gap_09B8[299];
	uint8_t  system_status_flag;
	uint8_t  gap_0AE4[16];
	void    *display_control_ptr;
	uint8_t  gap_0AF8[20];
	uint8_t  display_mode_flag;
	uint8_t  gap_0B0D[75];
	uint8_t  is_debug;             /* 0xB58                                    */
	uint8_t  gap_b59[19];
	uint8_t  projector_controller[888]; /* 0xB6C struct projector_controller_t */
	uint8_t  gap_0EE4[16];
	uint8_t  wakeup_angle_level;   /* IMU wear/wake tuning                     */
	uint8_t  wakeup_angle_offset;
	uint8_t  gap_0EF6[106];
	uint8_t  anti_shake_enable;
	uint8_t  gap_0F61[8];
	uint8_t  current_battery_soc;  /* 0xF69                                    */
	uint8_t  reserved_ed6;
	uint8_t  battery_soc_display;
	uint8_t  gap_ed8[12];
	uint8_t  display_state;        /* 0xF78                                    */
	uint8_t  gap_0F79[31];
	uint8_t  auto_brightness_flag;
	uint8_t  gap_0F99[39];
	uint8_t  device_status_byte_1;
	uint8_t  device_status_byte_2;
	uint8_t  device_status_flag;
	uint8_t  gap_0FC3;
	uint8_t  device_info_byte_3;
	uint8_t  device_info_byte_4;
	uint8_t  device_info_byte_5;
	uint8_t  gap_0FC7[19];
	uint8_t  mac_addresses[12];    /* Master / Node / Slave BLE MACs           */
	uint8_t  gap_0FDB[14];
	uint8_t  display_setting_mode; /* 3 = always-on                            */
	uint8_t  display_silent_mode;  /* 10 normal, 11 always-on, 12 DND          */
	uint8_t  gap_0FEB;
	void    *schedule_checksum_ptr;
	void    *countdown_timer_ptr;
	void    *schedule_task_data_ptr;
	uint8_t  gap_0FF8[4];
	void    *teleprompter_data_ptr;
	void    *flash_storage_interface_ptr;
	void    *reset_type_1_ptr;
	void    *reset_type_2_ptr;
	void    *factory_reset_ptr;
	uint8_t  gap_1010[8];
	void    *raster_config_ptr;
	uint8_t  gap_101C[16];
	void    *dfu_function_ptr;
	uint8_t  gap_1030[28];
	uint32_t settings_save_command_id;
	uint8_t  gap_1050[4];
	void    *task_status_ptr;
	uint8_t  gap_1058[51];
	uint8_t  sync_mode;            /* 0x108B                                   */
	uint8_t  initial_flag;
	uint8_t  gap_fe8[2];
	uint8_t  wear_detection_mode;
	uint8_t  gap_feb[21];
	uint8_t  gap_10A5[11];
	uint8_t  gap_1008[8];
	uint8_t  gap_10B8[4];
	uint8_t  gap_10BC[10];
	uint8_t  buried_point_data[192]; /* usage analytics                        */
	uint8_t  gap_10C7[17];
	uint8_t  gap_10D8[8];
	uint8_t  gap_10E0[368];
	uint8_t  phone_connection_type;  /* 1 = iOS, 2 = Android                    */
	uint8_t  gap_1251[7];
	uint8_t  ancs_enable_flag;       /* Apple Notification Center Service       */
	uint8_t  gap_1259[30];
	uint8_t  message_stay_time_mode;
	uint8_t  gap_1278[1452];
	uint8_t  display_raster_height_gear;
	uint8_t  display_canvas_distance_gear;
	uint8_t  gap_1826[186];
};

#endif /* G1_DEVICE_INFO_H */
```

## src/g1_adc_channel_cfg.c
```c
/* ---------------------------------------------------------------------------
 * BRING-UP WIRING TU (P4 iteration 38) — the SAADC `struct adc_channel_cfg`
 * that `adc_nfc_init` hands to `adc_channel_setup`.
 *
 * `adc_nfc_init` (original 0x24b98) does
 *
 *     api->channel_setup(&rodata_87c20, &rodata_88a2a);
 *
 * where `rodata_87c20` is the "adc@e000" struct device.
 *
 * `rodata_87c20` was rebound onto the real DT device in iteration 11, but
 * `rodata_88a2a` — the channel configuration it points at — was left as a bare
 * `PROVIDE(rodata_88a2a = 0x00088a2a)`, i.e. an ORIGINAL-image flash address.
 * In the rebuilt image those seven bytes hold unrelated content, so
 * `adc_channel_setup` configured a wrong (or out-of-range) channel and
 * `adc_nfc_run`'s `adc_read` — which selects `channels = BIT(3)` — then bailed
 * out with the driver's own diagnostic.
 *
 * MEASURED FAILURE (build g1-i37a-app, Renode `run.out`): our `saadc` register
 * stream stops after `CH0/CH1/CH2.PSELP <- 0`.  All three writes come from PC
 * 0x5EED6 = `adc_nrfx_read+0xd6`, the per-channel deselect store of the
 * driver's channel loop, i.e. it walked the channel mask and gave up the moment
 * it reached channel 3 -- the "Channel 3 not configured" path.  The shipped
 * firmware instead goes on to program `CH3.PSELP <- 4`, `CH3.PSELN <- 0`,
 * `CH3.CONFIG <- 0x00020000` and run the conversion.  Whole-run access count:
 * ours 95 vs the oracle's 998.
 *
 * The shipped configuration, read straight out of app_update.bin at 0x88a2a
 * (tools/extract.py):
 *
 *     00 04 00 00 03 04 00
 *     ^^ gain             = 0 = ADC_GAIN_1_6
 *        ^^ reference     = 4 = ADC_REF_INTERNAL
 *           ^^^^^ acquisition_time = 0 = ADC_ACQ_TIME_DEFAULT
 *                 ^^ channel_id = 3, differential = 0
 *                    ^^ input_positive = 4 = NRF_SAADC_INPUT_AIN3
 *                       ^^ input_negative = 0 = NRF_SAADC_INPUT_DISABLED
 *
 * The shipped image packs `struct adc_channel_cfg` with 1-byte enums — the
 * object is only 2-byte aligned at 0x88a2a, which a 4-byte-enum layout could
 * not be — and so does this build (`-fshort-enums` is the arm-eabi default).
 * VERIFIED: the object this TU emits is `00 04 00 00 03 04 00`, BYTE-IDENTICAL
 * to the shipped seven bytes, so the pin is byte-exact and not merely
 * semantically equivalent.
 *
 * Cross-check against `display_sensor_parity.md` §4.5, which decodes the
 * shipped SAADC register writes independently: TACQ = 10 us (the driver's
 * default for ADC_ACQ_TIME_DEFAULT), GAIN = 1/6, REF = internal, 12-bit, no
 * oversampling, CH3/AIN3 only.
 *
 * `recon/symbols/g1_app_globals.ld` binds the `rodata_88a2a` pin onto this
 * object.  No canonical parity body is changed.
 * ------------------------------------------------------------------------- */

#include <zephyr/drivers/adc.h>
#include <hal/nrf_saadc.h>

/* was rodata_88a2a (original 0x00088a2a) */
/* `retain`: the rodata_88a2a binding is a lazy linker-script PROVIDE, which
 * does not root the section against --gc-sections. */
const struct adc_channel_cfg g1_adc_nfc_channel_cfg __attribute__((used, retain)) = {
	.gain             = ADC_GAIN_1_6,
	.reference        = ADC_REF_INTERNAL,
	.acquisition_time = ADC_ACQ_TIME_DEFAULT,
	.channel_id       = 3,
	.differential     = 0,
	.input_positive   = NRF_SAADC_INPUT_AIN3,
	.input_negative   = NRF_SAADC_INPUT_DISABLED,
};
```

## src/g1_app_ram_relocs.c
```c
/* ---------------------------------------------------------------------------
 * BRING-UP WIRING TU (P4 iteration 6) — relocated ABSOLUTE RAM globals.
 *
 * The recon convention pins every recovered global to its ORIGINAL absolute
 * address (`PROVIDE(name = 0x2000xxxx)` in recon/symbols/g1_app_globals.ld).
 * The original image's globals cover essentially the whole 512 KiB SRAM
 * (0x20000000 .. 0x2007fc70), so those addresses cannot be reserved away from
 * Zephyr — our build's kernel objects necessarily overlap them.  Where a pin
 * happens to land inside an object OUR build actually uses, the recovered code
 * silently corrupts that object.
 *
 * This TU gives real, linker-allocated storage to the pins that were MEASURED
 * to corrupt a live object, and `g1_app_globals.ld` rebinds those pin names
 * here.  Canonical parity bodies in recon/app/src are untouched: the recovered
 * code takes `&name`, so a linker rebind is sufficient and no source changes.
 *
 * GROUP 1 — `logging_stack` (our ELF: 0x20006d58, 2048 B, the Zephyr log
 * thread's stack).  Five pins land in its TOP 68 bytes:
 *
 *   0x20007514 g_bonded_count       u32
 *   0x20007518 g_ancs_conn          u32 (struct bt_conn *)
 *   0x2000751c g_debug_msg_pipe     struct k_msgq (52 B: next pin is +0x34;
 *                                   debug_log_queue_init does
 *                                   k_msgq_alloc_init(&it, 200, 0x14) and
 *                                   enqueue_debug reads used_msgs at +0x24)
 *   0x20007550 g_ring_log_pending   u32
 *   0x20007554 g_log_use_alt_sink   u32  (ends exactly at 0x20007558 =
 *                                   logging_stack end)
 *
 * MEASURED FAILURE (iteration 6, before this fix): the log thread is created
 * at instruction 613,974 with entry z_thread_entry; arch_new_thread writes its
 * initial exception frame to 0x20007538..0x20007558, i.e. the TOP of
 * logging_stack, which is exactly where these pins sit.  At instruction
 * 4,978,573 the (newly reachable) `debug_print` path runs and
 * `debug_print+0x4a` executes `str r2,[r3]` with r3 = 0x20007550 — the
 * frame's stacked PC slot — writing 1 over z_thread_entry.  Proven with a
 * Renode write-watchpoint on 0x20007550:
 *     WROTE_PC_SLOT pc=0x0004e0bc val=0x00077a8e   (arch_new_thread, correct)
 *     WROTE_PC_SLOT pc=0x00017aea val=0x00000001   (debug_print, corruption)
 * and with a hook on z_arm_pendsv's exception return:
 *     BADSWITCH th=0x20003420 psp=0x20007538 stackedpc=0x00000001
 * The next context switch to the log thread therefore resumed at PC=1, slid
 * through the unmapped 0..0xC200 MCUboot window, and took a usage fault ->
 * z_fatal_error -> SYSRESETREQ.
 *
 * See recon/emulator/reports/our_boot_bringup.md, Iteration 6.
 * ------------------------------------------------------------------------- */
#include <zephyr/kernel.h>
#include <zephyr/device.h>
#include <zephyr/devicetree.h>
#include <zephyr/drivers/i2c.h>

/* --- group 1: pins that overlapped `logging_stack` -------------------- */
volatile unsigned int g1_bonded_count;
volatile unsigned int g1_ancs_conn;
struct k_msgq         g1_debug_msg_pipe;
volatile unsigned int g1_ring_log_pending;
volatile unsigned int g1_log_use_alt_sink;

/* --- group 2 (P4 iteration 7): the Application Event Manager state ------
 *
 * `app_event_manager_submit` (original 0x4f770) submits the k_work pinned at
 * 0x20002838 after linking the event onto the slist at 0x2000a2c8 under the
 * spinlock at 0x2000a2c4.  In OUR build:
 *   0x20002838 lands inside nrfx_gpiote's `.data.m_cb` (0x200027ec, 0x7c B)
 *   0x2000a2c4/0x2000a2c8 land inside `z_main_stack` (0x20008dd0, 16 KiB)
 *
 * The k_work is `.data` in the shipped image: its load image (flash
 * 0xf6d64 + 0x2838 = 0xf959c) reads
 *     { .node.next = 0, .handler = 0x0004f5b1, .queue = 0, .flags = 0 }
 * and 0x4f5b0 is the durable-map identity `app_event_manager_process_events`.
 * Nothing in the recovered corpus writes that handler, so with the pin the
 * work item's handler word was simply whatever nrfx_gpiote had at that offset.
 *
 * MEASURED (iteration 7 Step A, first build /private/tmp/g1-i7a-app): the
 * 64 bytes of RAM this iteration added shifted every object by 0x30-0x40, so
 * 0x20002838 moved from m_cb+0x30 to m_cb+0x4c.  The handler word stopped
 * reading a nonzero value, `work_queue_main` hit its
 * `__ASSERT(handler != NULL)` at instruction 4,669,670 and the boot took an
 * _oops -> z_fatal_error -> SYSRESETREQ.  The collision itself is NOT new; it
 * was latent in iterations 5-6 only because the garbage flags word happened to
 * make k_work_submit believe the item was already queued.
 *
 * Emitting the work item also relocates the handler, which pulls the (until
 * now garbage-collected) recovered `app_event_manager_process_events` into the
 * link — i.e. the event manager actually runs for the first time. */
extern void app_event_manager_process_events(void);

K_WORK_DEFINE(g1_app_event_processor_work, app_event_manager_process_events);

struct k_spinlock g1_notify_pending_lock;
sys_slist_t       g1_notify_pending_slist;
/* Bitmap indexed by (event_type_index >> 5); the shipped event-type section
 * 0xfa9b4..0xfaa14 holds (0x60 / 24) = 4 descriptors, so one word is enough.
 * Four are allocated so the index cannot leave the object if the section
 * bounds are ever relocated. */
volatile unsigned int g1_notify_pending_flags_bitmap[4];

/* --- group 3 (P4 iteration 10): the 20-slot message pool -----------------
 *
 * `msg_queue_init` (original 0x33c5c) clears the message pool with
 *
 *     iVar2 = g_message_pool;                     /- 0x20007dac -/
 *     do { iVar2 = memset_bytes(iVar2, 0, 0x1b4, ...); iVar2 += 0x1b4; }
 *     while (++iVar3 != 0x14);
 *
 * i.e. it zeroes 20 x 436 = 8720 bytes spanning the ORIGINAL absolute range
 * 0x20007dac .. 0x20009fbc.  That range is confirmed exactly by the pin
 * ledger: the next pinned global after the pool is g_whitelist_app_parse_buf
 * at 0x20009fbc, and the only three other pins inside it are the pool's own
 * interior views (g_notif_app_pkg_table_buf = pool+0x10,
 * g_message_table_mirror = pool+0x1108 = slot 10, and
 * g_message_table_mirror_ovfl_slot = pool+0x205c = slot 19).
 *
 * In OUR build that 8.5 KiB window covers SIX live Zephyr objects:
 *   smp_work_queue_stack (0x20007610), bt_lw_stack_area (0x20007e10),
 *   _k_mem_slab_buf_chan_slab (0x20008328), z_interrupt_stacks (0x200084c0),
 *   z_idle_stacks (0x20008cc0) and z_main_stack (0x20008e00).
 *
 * MEASURED FAILURE (iteration 9's blocker, diagnosed in iteration 10): with
 * the pin, `msg_queue_init` zeroed the idle thread's stack.  Renode
 * instrumentation on /private/tmp/g1-i9g-app:
 *     TCREATE/SETUP  thread=20004870 (z_idle_threads[0]) stack=20008cc0 320 B
 *     arch_new_thread wrote its initial frame: r0 slot 0x20008de0 = 0x0006d1b9
 *                     (idle entry), PC slot 0x20008df8 = 0x00077468
 *                     (z_thread_entry), callee_saved.psp = 0x20008de0
 *     byte watchpoint on 0x20008de8 -> "B pc=0007f22c val=00"  (memset+0xa)
 *     memset hook     -> "MEMSET dst=20008d00 len=436 val=0 lr=0002d479"
 *                        (= msg_queue_init+0x1c, pool slot 9)
 *     at the fault the whole window 0x20008dc0..0x20008e00 reads zero, so
 *     z_arm_pendsv restored the idle thread with a stacked PC of 0 ->
 *     "Attempt to execute undefined instruction" -> SYSRESETREQ at 0.048 s.
 *
 * The pool is above the shipped .data end (0x20003e29), so it is .bss in the
 * original too: plain zero-initialised storage reproduces it exactly.  All
 * four pins are rebound onto this one object at their original relative
 * offsets, so every recovered accessor keeps the original layout. */
/* `retain` (SHF_GNU_RETAIN): the four bindings are lazy linker-script
 * PROVIDE expressions, not relocations, so they do not root the section.
 * Iteration 10 measured a sibling block being silently discarded by
 * --gc-sections, after which every PROVIDE resolved against a base of 0. */
unsigned char g1_message_pool[20 * 436] __aligned(4)
	__attribute__((used, retain));

/* --- group 4 (P4 iteration 11): the STRUCTURAL RAM-pin arena ------------
 *
 * Iterations 6-10 retired absolute-RAM-pin collisions ONE AT A TIME.  That
 * does not converge: every fix changes RAM sizes, the linker re-lays out its
 * own objects, and a DIFFERENT pin moves into a live object.  Iteration 10
 * measured the loop twice in a row (759 -> 603 -> 331 unique functions for
 * three individually-correct fixes) and quantified the residue: 476 of the
 * 649 still-absolute SRAM pins landed inside a linked object, 117 of them
 * inside a thread stack.
 *
 * This object closes the class structurally.  The LINKED RAM region of this
 * build is 0x20002000 .. 0x20070000 (zephyr.map "Memory region RAM"), and
 * every recovered RAM pin below 0x20029000 is rebound in
 * recon/symbols/g1_app_globals.ld to
 *
 *     PROVIDE(name = g1_ram_arena + (original_address - 0x20002000))
 *
 * so that
 *   - no recovered global can overlap a Zephyr/driver object ever again: the
 *     whole recovered RAM image lives inside ONE linker-allocated object;
 *   - all ORIGINAL RELATIVE DISTANCES are preserved exactly, so interior
 *     views (pool slot N, struct field +off) and multi-object memsets such as
 *     msg_queue_init's 20 x 436 sweep stay inside the arena;
 *   - a later RAM shift is harmless: the pins move WITH the arena.
 *
 * Extent: the highest recovered RAM pin below the region end is
 * g_display_thread_stack_buf at 0x20028e68, so the arena covers
 * 0x20002000 .. 0x20029000.  Sizing is deliberately the FULL original span
 * rather than a per-object estimate (over-sizing is the safe direction: a
 * hole is dead .bss, an under-size is a corruption).  Alignment 32 with an
 * arena base congruent to 0 mod 32 preserves every original offset's
 * alignment up to 32 bytes.
 *
 * Original .bss/.data note: the shipped image's .data ends at 0x20003e29, so
 * all pins at or above that are .bss in the original too and zero-initialised
 * storage reproduces them exactly.  The few pins BELOW it that carry a
 * non-trivial initialiser the recovered code never writes are emitted as
 * their own objects (see g1_st25dv_i2c_dev below) and bound out of the arena;
 * their arena slot is simply left unused.
 *
 * Pins OUTSIDE the linked RAM region are intentionally left literal: 0x20000000
 * and 0x20000800 are below the region start and 0x20070000 / 0x2007fc00..
 * 0x2007fc70 are at or above its end, so no linked object can ever occupy
 * them.
 *
 * `used, retain`: iteration 10 measured that PROVIDE(x = block + off) does NOT
 * root `block` against --gc-sections; the block was discarded and every pin
 * resolved against a base of 0.
 */
#define G1_RAM_ARENA_ORIGIN 0x20002000u
#define G1_RAM_ARENA_LIMIT  0x20029000u

unsigned char g1_ram_arena[G1_RAM_ARENA_LIMIT - G1_RAM_ARENA_ORIGIN]
	__aligned(32) __attribute__((used, retain));

/* --- group 4b: the ST25DV i2c_dt_spec (original 0x200023cc) --------------
 *
 * `g_st25dv_i2c_dev` is `.data` in the shipped image.  Its load image is at
 * flash 0xf6d64 + 0x23cc = 0xf9130 and reads { .bus = 0x00087c68,
 * .addr = 0x53 }; the name string at 0x00087c68 is "i2c@9000" and its config
 * word 0 is 0x50009000, i.e. the bus is i2c1 (which also matches
 * armemul/platforms/nrf5340.repl, where st25dv sits on twim1 at 0x53).
 * No recovered function ever writes word 0, so the pointer must come from the
 * initialiser -- a zeroed arena slot would reproduce iteration 10's
 * measured usage fault at ipc_transport_ops_dispatch+0xc (bx ip, ip = 0),
 * which is exactly the current first divergence (iteration 10 §A.5/§A.7).
 */
struct i2c_dt_spec g1_st25dv_i2c_dev __attribute__((used, retain)) = {
	.bus = DEVICE_DT_GET(DT_NODELABEL(i2c1)),
	.addr = 0x53,
};
```

## src/g1_bt_conn_cb_objects.c
```c
/* ---------------------------------------------------------------------------
 * BRING-UP WIRING TU (P4 iteration 23) — the application's own
 * `struct bt_conn_cb` entry in the `bt_conn_cb` ITERABLE SECTION.
 *
 * SYMPTOM (iteration 22 §22.7 / §22.11 item 2, measured, not guessed):
 * the virtual central connects (`vcentral Connected` True, 1 CONNECT_IND, 530
 * data events answered) yet the app keeps printing
 *
 *     low_speed_peripheral_dispatch_thread(): Global Working Mode: 10
 *         get_glasses_ble_status 0 ble_is_connected 0
 *
 * ROOT CAUSE (byte evidence below).  The `ble_is_connected` field of that line
 * is `low_speed_peripheral_dispatch_thread`'s local `side`, which can only
 * become 1 when `get_ancs_conn_handle() != 0`
 * (recon/symbolized/app/low_speed_peripheral_dispatch_thread.c:119,144,160).
 * `get_ancs_conn_handle` (FUN_00019b2c) is a one-liner:
 *
 *     return *(volatile unsigned int *)0x20007518;      // g_ancs_conn
 *
 * and `g_ancs_conn` has exactly ONE writer in the whole image —
 * `ancs_connected` (FUN_0001861c @ 0x1861c), its last statement.  So
 * `ble_is_connected 0` says precisely: **`ancs_connected` never ran**.
 *
 * `ancs_connected` is a `struct bt_conn_cb::connected` callback.  In the
 * SHIPPED image it is reached through the `bt_conn_cb` ITERABLE SECTION, whose
 * bounds are the two rodata pins the recovered Zephyr notifiers still carry:
 *
 *     rodata_87fec  = _bt_conn_cb_list_start   (0x00087fec)
 *     rodata_88058  = _bt_conn_cb_list_end     (0x00088058)
 *
 * The stride is proven by the recovered notifier itself —
 * recon/symbolized/app/ble_notify_remote_info_available.c (identity
 * FUN_00056da8, Zephyr's `bt_conn_security_changed`) walks the section with
 * `uVar4 = uVar4 + 0x24`, and follows the registered-list `_next` at `+0x20`.
 * So sizeof(struct bt_conn_cb) = 0x24 = 36 B in the shipped build and the
 * section holds exactly (0x88058 - 0x87fec) / 0x24 = 3 entries.
 *
 * Shipped section contents (read with tools/extract.py's VA mapping; every
 * word below is a literal read of app_update.bin):
 *
 *   0x87fec  0001861d 00018add 00000000 00000000 00000000 000184f1
 *            00000000 00000000 00000000
 *            -> { .connected       = 0x1861c ancs_connected,
 *                 .disconnected    = 0x18adc ancs_disconnected,
 *                 .security_changed= 0x184f0 ancs_security_changed }
 *   0x88010  000220cd 00022079 0 0 0 0 0 0 0
 *   0x88034  00052989 00052a0d 0 0 0 0 0 0 0
 *
 * The member INDEX of each recovered notifier confirms the layout is stock
 * zephyr/include/zephyr/bluetooth/conn.h order (offset -> index -> member):
 *   +0x08 -> 2 -> le_param_req        (ble_notify_disconnected.c, misnamed)
 *   +0x0c -> 3 -> le_param_updated    (ble_notify_le_param_updated.c)
 *   +0x10 -> 4 -> identity_resolved   (ble_notify_identity_resolved.c)
 *   +0x14 -> 5 -> security_changed    (ble_notify_remote_info_available.c,
 *                                      misnamed; it calls the slot with
 *                                      (conn, conn[9] = sec_level, err))
 * i.e. connected[0], disconnected[1], le_param_req[2], le_param_updated[3],
 * identity_resolved[4], security_changed[5], then two more slots and _next[8].
 *
 * IN OUR BUILD the section is real but holds ONE entry, the SDK's own:
 *     000847f4 R _bt_conn_cb_list_start
 *     000847f4 r bt_conn_cb_mcumgr_bt_callbacks
 *     00084810 R _bt_conn_cb_list_end            (0x1c = 28 B = 7 pointers)
 * — CONFIG_BT_SMP=y only, so our `struct bt_conn_cb` is connected,
 * disconnected, le_param_req, le_param_updated, identity_resolved,
 * security_changed, _next.  connected/disconnected/security_changed keep
 * indices 0/1/5 in BOTH layouts (the two shipped extras, CONFIG_BT_REMOTE_INFO
 * and CONFIG_BT_USER_PHY_UPDATE, sit at indices 6/7, AFTER security_changed),
 * so the app entry maps across without ambiguity.
 *
 * The app entry was never emitted: `rodata_87fec` / `rodata_88058` are plain
 * `PROVIDE(... = 0x000879ec/0x00088058)` identity pins into the ORIGINAL
 * image, which our relocated build does not reproduce, and nothing else
 * referenced `ancs_connected`, so --gc-sections dropped all three callbacks
 * (nm on /private/tmp/g1-i22b-app/zephyr/zephyr.elf: no `ancs_connected`,
 * `ancs_disconnected` or `ancs_security_changed` symbol at all).
 *
 * FIX, the documented way (same mechanism as g1_bt_adv_objects.c §22.6): a
 * linker rebind cannot express an object whose CONTENTS are pointers, so the
 * object is EMITTED — here into the genuine iterable section via the stock
 * BT_CONN_CB_DEFINE macro, which is exactly what the shipped firmware used.
 * No canonical parity body is touched; the three callbacks are the recovered,
 * parity-proven bodies.
 * ------------------------------------------------------------------------- */

#include <zephyr/bluetooth/bluetooth.h>
#include <zephyr/bluetooth/conn.h>

/* The recovered bodies.  Their reconstructed C prototypes use plain integer
 * words (recon/symbolized/app/ancs_connected.c:38,
 * ancs_disconnected.c:32, recon/named/ancs_security_changed.c:44); the AAPCS
 * argument registers are identical to the bt_conn_cb prototypes, so the
 * addresses are placed through a cast rather than by editing a proven body. */
extern void ancs_connected(int conn, int err);
extern void ancs_disconnected(uint32_t conn, uint32_t reason);
extern void ancs_security_changed(uint32_t conn, uint32_t level, int32_t err);

BT_CONN_CB_DEFINE(g1_ancs_conn_callbacks) = {
	.connected        = (void (*)(struct bt_conn *, uint8_t))ancs_connected,
	.disconnected     = (void (*)(struct bt_conn *, uint8_t))ancs_disconnected,
	.security_changed = (void (*)(struct bt_conn *, bt_security_t,
				      enum bt_security_err))ancs_security_changed,
};
```

## src/g1_bt_nus_service.c
```c
/* ---------------------------------------------------------------------------
 * BRING-UP WIRING TU (P4 iteration 31) — the application's own GATT service,
 * the third entry of the shipped `bt_gatt_service_static` iterable section.
 *
 * MEASURED MOTIVATION.  With `g1-i23a-app` + `g1-i30e-net` the virtual phone
 * connects over the modeled radio and sweeps an ATT write of the real G1 frame
 * `0a 06 00 00 00 00` across handles 0x0F..0x15, exactly as the oracle run
 * does — and a Renode block hook at OUR `ble_process_req_dispatch`
 * (0x0001ee80) fires **0 times** over the whole 20 s capture, while
 * `now_has_persist_task` (0x00028d48) runs 398 times and returns 0 every time.
 * `process_for_new_task` therefore never leaves its `CASE0` poll, never issues
 * `trigger_screen_state_change(reason, ctx, 1)`, `device_info[0xfe8]` stays 0
 * and no pixel is ever blitted.
 *
 * ROOT CAUSE.  The shipped `bt_gatt_service_static` section holds THREE
 * services (app_update.bin, read through tools/extract.py):
 *
 *     0x88058  { attrs = 0x0008b3b4, count = 8 }   Zephyr GATT service
 *     0x88060  { attrs = 0x0008b454, count = 7 }   Zephyr GAP service
 *     0x88068  { attrs = 0x0008ad18, count = 6 }   <-- THIS ONE
 *
 * Our link's `bt_gatt_service_static_area` is 0x10 bytes — only the two Zephyr
 * services (`attr__1_gatt_svc`, `attr__2_gap_svc`).  The 128-bit NUS UUID
 * body `9e ca dc 24 0e e5 a9 e0 93 f3 a3 b5` occurs 5 times in
 * app_update.bin and 0 times in our zephyr.bin, so the application's transport
 * service is simply absent and the phone has nothing to write to.
 *
 * WHAT THE SHIPPED SERVICE IS.  The six attributes at 0x8ad18 (stride 20 =
 * sizeof(struct bt_gatt_attr)) decode as:
 *
 *   #  VA        uuid        read        write       user_data   handle|perm
 *   0  0x8ad18   0x2000357b  0x00082989  --          0x2000357b  0x0000|0x0001
 *                (6E400001-B5A3-F393-E0A9-E50E24DCCA9E, bt_gatt_attr_read_service)
 *   1  0x8ad2c   0x20002f70  0x00082c49  --          0x20002830  |0x0001
 *                (0x2803 characteristic declaration, bt_gatt_attr_read_chrc)
 *   2  0x8ad40   0x20003559  --          --          --          |0x0001
 *                (6E400003.. TX value, BT_GATT_PERM_READ)
 *   3  0x8ad54   0x20002f6c  0x0008295b  0x0005a465  0x20002818  |0x0003
 *                (0x2902 CCC, read/write_ccc, READ|WRITE)
 *   4  0x8ad68   0x20002f68  0x00082c49  --          0x20002810  |0x0001
 *   5  0x8ad7c   0x20003537  --          0x0004f4d9  --          |0x0003
 *                (6E400002.. RX value, on_receive, READ|WRITE)
 *
 * That is byte-for-byte the expansion of stock NCS
 * `nrf/subsys/bluetooth/services/nus.c`'s `BT_GATT_SERVICE_DEFINE(nus_svc, …)`
 * with `CONFIG_BT_NUS_AUTHEN` UNSET (the TX value permission is 0x0001 =
 * BT_GATT_PERM_READ, not BT_GATT_PERM_READ_AUTHEN = 0x0010).  The corroborating
 * detail is placement: the `bt_uuid_128`, `bt_gatt_chrc` and `_bt_gatt_ccc`
 * objects the attributes point at live in `.data` (0x20002810, 0x20002818,
 * 0x20002830 and the seven packed `bt_uuid_128` at 0x20003537..0x200035ad),
 * which is exactly where GCC puts the NON-const compound literals inside the
 * `BT_GATT_CHARACTERISTIC` / `BT_GATT_CCC` / `BT_UUID_DECLARE_128` macros while
 * the attribute array itself is `const` in rodata.  A hand-rolled table would
 * not split that way.
 *
 * WHY THIS FILE AND NOT `CONFIG_BT_NUS=y`.  nus.c owns a file-static
 * `struct bt_nus_cb nus_cb` singleton.  The recovered corpus already owns that
 * singleton at the shipped address 0x2000a2b8 (pinned `g_2000a2b8 =
 * g1_ram_arena + 0x82b8`): `FUN_0004f500` (`bt_nus_init`, retained, parity
 * PROVEN) copies the three callbacks into it, and `FUN_000181f0`
 * (`ancs_notify_sync_init`, called from `ancs_main` line 173) is its only
 * caller, passing the shipped `.data` object at 0x20002310 whose restored
 * initialiser is { received = FUN_00017f70, sent = NULL,
 * send_enabled = FUN_00017e3c }.  Compiling stock nus.c as well would create a
 * SECOND, always-NULL `nus_cb` and the write would be delivered to it — the
 * duplicate-singleton / displacement-fallout class this project has now hit
 * five times (iterations 26, 28, 29, 30 §30.3).  So the service definition is
 * emitted here and its three callbacks read the ONE recovered singleton.
 *
 * The two pins the recovered `bt_nus_send` (`FUN_0004f518` /
 * `gatt_notify_config_change`) spells — `rodata_8ad40` (&attrs[2], the TX value
 * attribute handed to `bt_gatt_notify_cb`) and `rodata_4f4f1` (`on_sent`) —
 * were still ABSOLUTE original-image addresses in
 * recon/symbols/g1_app_globals.ld.  They are bound onto this service here, the
 * same way g1_bt_adv_objects.c binds rodata_8839c / g_20002350 / g_20002358.
 *
 * Integration-only: no canonical parity body changes.
 * ---------------------------------------------------------------------------
 */
#include <zephyr/kernel.h>
#include <zephyr/bluetooth/bluetooth.h>
#include <zephyr/bluetooth/conn.h>
#include <zephyr/bluetooth/uuid.h>
#include <zephyr/bluetooth/gatt.h>
#include <bluetooth/services/nus.h>

/* The recovered `nus_cb` singleton: shipped 0x2000a2b8, pinned in
 * recon/symbols/g1_app_globals.ld onto the recovered RAM arena.  Only
 * FUN_0004f500 writes it; only these three callbacks read it. */
extern volatile unsigned int g_2000a2b8;
#define G1_NUS_CB ((const volatile struct bt_nus_cb *)(const void *)&g_2000a2b8)

/* The shipped attribute stride is 20 bytes (0x8ad18, 0x8ad2c, 0x8ad40,
 * 0x8ad54, 0x8ad68, 0x8ad7c).  The rodata_8ad40 rebind below adds 2 * 20, so
 * fail the build loudly rather than silently if the SDK struct ever changes. */
BUILD_ASSERT(sizeof(struct bt_gatt_attr) == 20,
	     "bt_gatt_attr stride must match the shipped 20-byte attributes");

static void g1_nus_ccc_cfg_changed(const struct bt_gatt_attr *attr,
				   uint16_t value)
{
	void (*send_enabled)(enum bt_nus_send_status status) =
		G1_NUS_CB->send_enabled;

	ARG_UNUSED(attr);

	if (send_enabled != NULL) {
		send_enabled(value == BT_GATT_CCC_NOTIFY ?
				     BT_NUS_SEND_STATUS_ENABLED :
				     BT_NUS_SEND_STATUS_DISABLED);
	}
}

static ssize_t g1_nus_on_receive(struct bt_conn *conn,
				 const struct bt_gatt_attr *attr,
				 const void *buf, uint16_t len,
				 uint16_t offset, uint8_t flags)
{
	void (*received)(struct bt_conn *conn, const uint8_t *const data,
			 uint16_t len) = G1_NUS_CB->received;

	ARG_UNUSED(attr);
	ARG_UNUSED(offset);
	ARG_UNUSED(flags);

	if (received != NULL) {
		received(conn, (const uint8_t *)buf, len);
	}

	return len;
}

/* Shipped 0x0004f4f0 (`rodata_4f4f1` is its Thumb pointer): the
 * `bt_gatt_notify_params.func` the recovered bt_nus_send installs. */
__attribute__((used, retain))
void g1_nus_on_sent(struct bt_conn *conn, void *user_data)
{
	void (*sent)(struct bt_conn *conn) = G1_NUS_CB->sent;

	ARG_UNUSED(user_data);

	if (sent != NULL) {
		sent(conn);
	}
}

/* Shipped 0x8ad18..0x8ad90, 6 attributes.  `BT_GATT_SERVICE_DEFINE` emits the
 * global `attr_g1_nus_svc[]` array plus the `bt_gatt_service_static` iterable
 * entry; the section is SORT_BY_NAME, so `g1_nus_svc` lands after Zephyr's
 * `_1_gatt_svc` (8 attrs) and `_2_gap_svc` (7 attrs) — the same order, and
 * therefore the same ATT handles 0x10..0x15, as the shipped image. */
BT_GATT_SERVICE_DEFINE(g1_nus_svc,
	BT_GATT_PRIMARY_SERVICE(BT_UUID_NUS_SERVICE),
	BT_GATT_CHARACTERISTIC(BT_UUID_NUS_TX,
			       BT_GATT_CHRC_NOTIFY,
			       BT_GATT_PERM_READ,
			       NULL, NULL, NULL),
	BT_GATT_CCC(g1_nus_ccc_cfg_changed,
		    BT_GATT_PERM_READ | BT_GATT_PERM_WRITE),
	BT_GATT_CHARACTERISTIC(BT_UUID_NUS_RX,
			       BT_GATT_CHRC_WRITE |
			       BT_GATT_CHRC_WRITE_WITHOUT_RESP,
			       BT_GATT_PERM_READ | BT_GATT_PERM_WRITE,
			       NULL, g1_nus_on_receive, NULL),
);
```

## src/g1_gpio_dt_specs.c
```c
/* ---------------------------------------------------------------------------
 * BRING-UP WIRING TU (P4 iteration 5) — relocated `struct gpio_dt_spec` tables.
 *
 * button_init (and nfc_field_event_signal_sem) originally read their GPIO
 * descriptors straight out of the shipped image's rodata at the ABSOLUTE
 * addresses 0x88340 / 0x889d0 / 0x889e0.  Those pins (`rodata_88340`,
 * `rodata_889d0`, `rodata_889e0` in recon/symbols/g1_app_globals.ld) are
 * unrelocated, and two things are wrong with them in our build:
 *   (1) our relocated image holds completely different rodata at those
 *       addresses (nm: `00088340 R rodata_15f40`), and
 *   (2) the entries THEMSELVES embed an absolute `struct device *`
 *       (0x87b60 = gpio0, 0x87b48 = gpio1), so even a correct table address
 *       would still hand gpio_pin_configure_dt() a bogus port pointer.
 * A linker rebind cannot express (2): the tables have to be emitted by the
 * build so both the table address and the device pointers inside them are
 * relocated.  Contents are transcribed from app_update.bin (verified with
 * tools/extract.py); `g1_app_globals.ld` binds the recovered `rodata_*` pin
 * names to these definitions so every consumer picks them up.
 *
 * Original bytes (8 B per entry: device* @0, u8 pin @4, u16 dt_flags @6):
 *   0x88340: 9 x { 0x00087b60 (gpio0), pin, 0 }
 *            pins = 26, 25, 28, 27, 24, 19, 21, 30, 23
 *   0x889d0: { 0x00087b48 (gpio1), pin  9, dt_flags 0x0011 }
 *   0x889e0: { 0x00087b48 (gpio1), pin 10, dt_flags 0x0011 }
 *   (0x0011 = GPIO_ACTIVE_LOW | GPIO_PULL_UP)
 *
 * ITERATION 13 adds the panel-power descriptor that the same class had left
 * behind.  `power_for_panel` -> `gpio_dt_spec_activate` (0x179ec) and
 * `panel_pwr_gpio_deassert` (0x179f8) both `ldr r0,=0x000889f8 ; movs r1,#1/0 ;
 * b.w gpio_pin_set_dt`, and 0x889f8 was still a raw flash literal, so
 * gpio_pin_set_checked() received a bogus port pointer and asserted
 * (ZEPHYR FATAL ERROR 4 at 0.0477 s).  Transcribed from the image, the three
 * consecutive descriptors there are
 *   0x889e8: { 0x00087b60 (gpio0), pin 30, dt_flags 0 }
 *   0x889f0: { 0x00087b60 (gpio0), pin 21, dt_flags 0 }
 *   0x889f8: { 0x00087b60 (gpio0), pin 24, dt_flags 0 }
 * (0x87b60's name string is "gpio@842500" = gpio0; 0x87b48 is "gpio@842800"
 * = gpio1).
 *
 * The canonical parity bodies in recon/app/src/ are untouched.
 * See recon/emulator/reports/our_boot_bringup.md §Iteration 5.
 * ------------------------------------------------------------------------- */
#include <zephyr/device.h>
#include <zephyr/devicetree.h>

/* Layout-identical to Zephyr's `struct gpio_dt_spec`
 * ({ const struct device *port; gpio_pin_t pin; gpio_dt_flags_t dt_flags; },
 * i.e. port@0, pin@4 (u8), dt_flags@6 (u16), sizeof = 8).  Spelled out locally
 * so this TU does not have to pull in <zephyr/drivers/gpio.h>, whose static
 * inlines collide with the recovered `gpio_pin_configure` reconstruction. */
struct g1_gpio_dt_spec {
	const struct device *port;
	unsigned char pin;
	unsigned short dt_flags;
};

#define G1_GPIO0 DEVICE_DT_GET(DT_NODELABEL(gpio0))
#define G1_GPIO1 DEVICE_DT_GET(DT_NODELABEL(gpio1))

/* was rodata_88340 (original 0x00088340) */
const struct g1_gpio_dt_spec g1_button_gpio_specs[9] = {
	{ .port = G1_GPIO0, .pin = 26, .dt_flags = 0 },
	{ .port = G1_GPIO0, .pin = 25, .dt_flags = 0 },
	{ .port = G1_GPIO0, .pin = 28, .dt_flags = 0 },
	{ .port = G1_GPIO0, .pin = 27, .dt_flags = 0 },
	{ .port = G1_GPIO0, .pin = 24, .dt_flags = 0 },
	{ .port = G1_GPIO0, .pin = 19, .dt_flags = 0 },
	{ .port = G1_GPIO0, .pin = 21, .dt_flags = 0 },
	{ .port = G1_GPIO0, .pin = 30, .dt_flags = 0 },
	{ .port = G1_GPIO0, .pin = 23, .dt_flags = 0 },
};

/* was rodata_889d0 (original 0x000889d0) */
const struct g1_gpio_dt_spec g1_gpio1_pin9_spec = {
	.port = G1_GPIO1, .pin = 9, .dt_flags = 0x0011
};

/* iteration 14: was rodata_889d8 (original 0x000889d8) -- { gpio0, pin 23,
 * dt_flags 0 }, the descriptor touch_pmic_reset_assert / _deassert use. */
const struct g1_gpio_dt_spec g1_gpio0_pin23_spec = {
	.port = G1_GPIO0, .pin = 23, .dt_flags = 0
};

/* was rodata_889e0 (original 0x000889e0) */
const struct g1_gpio_dt_spec g1_gpio1_pin10_spec = {
	.port = G1_GPIO1, .pin = 10, .dt_flags = 0x0011
};

/* was rodata_889e8 (original 0x000889e8) */
const struct g1_gpio_dt_spec g1_gpio0_pin30_spec = {
	.port = G1_GPIO0, .pin = 30, .dt_flags = 0
};

/* was rodata_889f0 (original 0x000889f0) */
const struct g1_gpio_dt_spec g1_gpio0_pin21_spec = {
	.port = G1_GPIO0, .pin = 21, .dt_flags = 0
};

/* was rodata_889f8 (original 0x000889f8) -- the panel power-enable line */
const struct g1_gpio_dt_spec g1_gpio0_pin24_spec = {
	.port = G1_GPIO0, .pin = 24, .dt_flags = 0
};
```

## src/g1_gpio_header_bridges.c
```c
/* ---------------------------------------------------------------------------
 * LIBRARY DISPLACEMENT — Batch 0 (goal G2, P4 iteration 7 Step B).
 *
 * `recon/ownership/library_displacement_report.md` §3a/§4 identifies four
 * out-lined `zephyr/include/zephyr/drivers/gpio.h` static inlines as the
 * highest-value displacement candidates:
 *
 *   VA         current symbol              real gpio.h identity
 *   0x00017688 gpio_pin_configure_17688    gpio_pin_configure_dt
 *   0x00017858 gpio_pin_configure          gpio_pin_interrupt_configure_dt
 *   0x000177c4 gpio_pin_get_raw_checked    gpio_pin_get_raw
 *   0x00017980 gpio_pin_get_checked        gpio_pin_get   (on the gpio0 port)
 *
 * Identity evidence is the `__ASSERT` file literal
 * "WEST_TOPDIR/zephyr/include/zephyr/drivers/gpio.h" in each literal pool —
 * that text exists ONLY inside those header inline bodies.  Their four
 * reconstruction TUs are excluded in `recon/ownership/adoption_manifest.json`
 * and therefore no longer appear in `recon/generated/app_retained_sources.cmake`.
 *
 * A header `static inline` has no external symbol to bind to, so displacement
 * cannot be a linker rebind: the recovered CALLERS still emit a `BL` to the
 * out-lined identity.  This TU re-expresses each historical identity as a thin
 * bridge over the real API, so the compiler re-inlines the genuine gpio.h body
 * here and every caller gets the upstream semantics with no source change to
 * the recovered bodies (`button_init`, `read_sw0_pin`,
 * `nfc_field_event_signal_sem`).
 *
 * Why this is the right displacement (per identity, from the recovered bodies
 * and the original image bytes):
 *  * 0x17688 reads spec->port / spec->pin / spec->dt_flags, ORs `dt_flags`
 *    with the caller's flags and tail-calls `api->pin_configure` — i.e.
 *    `gpio_pin_configure_dt(spec, extra_flags)`.
 *  * 0x17858 masks GPIO_INT_{DISABLE,ENABLE,EDGE} (0x1600000) and
 *    GPIO_INT_{LOW_0,HIGH_1} (0x6000000), flips the trigger when
 *    GPIO_INT_LEVELS_LOGICAL (0x800000) and `data->invert` disagree, and
 *    dispatches `api + 0x18` (`pin_interrupt_configure`) — i.e.
 *    `gpio_pin_interrupt_configure_dt(spec, flags)`.  The candidate JSON
 *    records the coarser `gpio_pin_configure`; the byte-level dispatch slot
 *    and the flag masks pin it to the interrupt variant.
 *  * 0x177c4 dispatches `api + 4` (`port_get_raw`) and returns
 *    `(value & BIT(pin)) != 0` — `gpio_pin_get_raw(port, pin)`.
 *  * 0x17980 does the same but XORs `data->invert` first, and hard-codes the
 *    gpio0 device — `gpio_pin_get(gpio0, pin)`.
 *
 * The recovered callers declare these with loose `unsigned int` prototypes;
 * that is ABI-compatible on AAPCS (pointer and u32 both travel in r0/r1) and
 * needs no change on their side.  `gpio_pin_get_checked`'s reconstruction took
 * two extra junk arguments that the original never used; `button_init` already
 * calls it with one.
 *
 * See recon/emulator/reports/our_boot_bringup.md §Iteration 7 Step B.
 * ------------------------------------------------------------------------- */
#include <zephyr/kernel.h>
#include <zephyr/device.h>
#include <zephyr/devicetree.h>
#include <zephyr/drivers/gpio.h>

/* 0x00017688 */
int gpio_pin_configure_17688(const struct gpio_dt_spec *spec,
			     gpio_flags_t extra_flags)
{
	return gpio_pin_configure_dt(spec, extra_flags);
}

/* 0x00017858.  The historical identity is spelled `gpio_pin_configure`, which
 * collides with gpio.h's own inline of that name, so the symbol is attached
 * with an `__asm__` label — the same conflict-free mechanism
 * recon/emulator/reports/pointer_rebind.md uses for function-pointer aliases. */
int g1_gpio_pin_interrupt_configure_bridge(const struct gpio_dt_spec *spec,
					   gpio_flags_t flags)
	__asm__("gpio_pin_configure");

int g1_gpio_pin_interrupt_configure_bridge(const struct gpio_dt_spec *spec,
					   gpio_flags_t flags)
{
	return gpio_pin_interrupt_configure_dt(spec, flags);
}

/* 0x000177c4 */
int gpio_pin_get_raw_checked(const struct device *port, gpio_pin_t pin)
{
	return gpio_pin_get_raw(port, pin);
}

/* 0x00017980 */
int gpio_pin_get_checked(gpio_pin_t pin)
{
	return gpio_pin_get(DEVICE_DT_GET(DT_NODELABEL(gpio0)), pin);
}
```
