/* GENERATED by recon/application/gen_app_rodata_sources.py -- DO NOT EDIT.
 *
 * Interior-pin re-pins for the decoded `.rodata` runs.  Each run is emitted as
 * ONE C object so the shipped adjacency survives the link; the pins that fall
 * inside a run are re-pinned onto it here, the same way
 * `PROVIDE(rodata_883b0 = rodata_0x88340 + 0x70)` already is in
 * recon/symbols/g1_app_globals.ld.
 *
 * NOT INSTALLED THIS PASS.  Wiring it means DELETING the matching
 * `PROVIDE(<name> = 0x<hex>)` line from g1_app_globals.ld first -- two PROVIDEs
 * for one symbol is a conflict, not an override.
 */

PROVIDE(rodata_103c1d4 = rodata_103c1bc + 0x18);
PROVIDE(rodata_103c1f8 = rodata_103c1bc + 0x3c);
PROVIDE(rodata_103cef6 = rodata_103ced0 + 0x26);
PROVIDE(rodata_103cf0a = rodata_103ced0 + 0x3a);
PROVIDE(rodata_103d710 = rodata_103d6e1 + 0x2f);
PROVIDE(rodata_103e6e2 = rodata_103e6ad + 0x35);
PROVIDE(rodata_103e6f2 = rodata_103e6ad + 0x45);
PROVIDE(rodata_103e850 = rodata_103e73b + 0x115);
PROVIDE(rodata_103e852 = rodata_103e73b + 0x117);
