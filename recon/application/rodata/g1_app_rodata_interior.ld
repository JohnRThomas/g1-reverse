/* GENERATED by recon/application/gen_app_rodata_sources.py -- DO NOT EDIT.
 *
 * Interior-pin re-pins for the decoded `.rodata` runs.  Each run is emitted as
 * ONE C object so the shipped adjacency survives the link; the pins that fall
 * inside a run are re-pinned onto it here, the same way
 * `PROVIDE(rodata_883b0 = rodata_0x88340 + 0x70)` already is in
 * recon/symbols/g1_app_globals.ld.
 *
 * NOT INSTALLED THIS PASS.  Wiring it means DELETING the matching
 * `PROVIDE(<name> = 0x<hex>)` line from g1_app_globals.ld first -- two PROVIDEs
 * for one symbol is a conflict, not an override.
 */

PROVIDE(rodata_87fec = rodata_87fc8 + 0x24);
PROVIDE(rodata_883c8 = rodata_88388 + 0x40);
PROVIDE(rodata_883ec = rodata_88388 + 0x64);
PROVIDE(rodata_88410 = rodata_88388 + 0x88);
PROVIDE(rodata_88697 = rodata_88694 + 0x3);
PROVIDE(rodata_887c8 = rodata_887b7 + 0x11);
PROVIDE(rodata_887d9 = rodata_887b7 + 0x22);
PROVIDE(rodata_887ea = rodata_887b7 + 0x33);
PROVIDE(rodata_88848 = rodata_887b7 + 0x91);
PROVIDE(rodata_88858 = rodata_887b7 + 0xa1);
PROVIDE(rodata_88868 = rodata_887b7 + 0xb1);
PROVIDE(rodata_88878 = rodata_887b7 + 0xc1);
PROVIDE(rodata_88888 = rodata_887b7 + 0xd1);
PROVIDE(rodata_888a8 = rodata_887b7 + 0xf1);
PROVIDE(rodata_888e0 = rodata_887b7 + 0x129);
PROVIDE(rodata_88908 = rodata_887b7 + 0x151);
PROVIDE(rodata_8af4c = rodata_8af10 + 0x3c);
PROVIDE(rodata_98690 = rodata_98684 + 0xc);
PROVIDE(rodata_9869c = rodata_98684 + 0x18);
PROVIDE(rodata_986a4 = rodata_98684 + 0x20);
PROVIDE(rodata_986ac = rodata_98684 + 0x28);
PROVIDE(rodata_99ef2 = rodata_99ec7 + 0x2b);
PROVIDE(rodata_a8ea0 = rodata_a8e98 + 0x8);
PROVIDE(rodata_bc181 = rodata_bc097 + 0xea);
PROVIDE(rodata_bc26b = rodata_bc097 + 0x1d4);
PROVIDE(rodata_bc355 = rodata_bc097 + 0x2be);
PROVIDE(rodata_bc43f = rodata_bc097 + 0x3a8);
PROVIDE(rodata_bc529 = rodata_bc097 + 0x492);
PROVIDE(rodata_bc613 = rodata_bc097 + 0x57c);
PROVIDE(rodata_bc6fd = rodata_bc097 + 0x666);
PROVIDE(rodata_bc7ca = rodata_bc097 + 0x733);
PROVIDE(rodata_bc7e0 = rodata_bc097 + 0x749);
PROVIDE(rodata_bc7f1 = rodata_bc097 + 0x75a);
PROVIDE(rodata_bccd3 = rodata_bc097 + 0xc3c);
PROVIDE(rodata_bd1b5 = rodata_bc097 + 0x111e);
PROVIDE(rodata_bd697 = rodata_bc097 + 0x1600);
PROVIDE(rodata_bdb79 = rodata_bc097 + 0x1ae2);
PROVIDE(rodata_be05b = rodata_bc097 + 0x1fc4);
PROVIDE(rodata_be53d = rodata_bc097 + 0x24a6);
PROVIDE(rodata_bea1f = rodata_bc097 + 0x2988);
PROVIDE(rodata_bef01 = rodata_bc097 + 0x2e6a);
PROVIDE(rodata_bf3e3 = rodata_bc097 + 0x334c);
PROVIDE(rodata_bf8c5 = rodata_bc097 + 0x382e);
PROVIDE(rodata_bfda7 = rodata_bc097 + 0x3d10);
PROVIDE(rodata_c0289 = rodata_bc097 + 0x41f2);
PROVIDE(rodata_c076b = rodata_bc097 + 0x46d4);
PROVIDE(rodata_c0c4d = rodata_bc097 + 0x4bb6);
PROVIDE(rodata_c112f = rodata_bc097 + 0x5098);
PROVIDE(rodata_c1611 = rodata_bc097 + 0x557a);
PROVIDE(rodata_c1af3 = rodata_bc097 + 0x5a5c);
PROVIDE(rodata_c1fd5 = rodata_bc097 + 0x5f3e);
PROVIDE(rodata_c24b7 = rodata_bc097 + 0x6420);
PROVIDE(rodata_c2999 = rodata_bc097 + 0x6902);
PROVIDE(rodata_c2e7b = rodata_bc097 + 0x6de4);
PROVIDE(rodata_c335d = rodata_bc097 + 0x72c6);
PROVIDE(rodata_c383f = rodata_bc097 + 0x77a8);
PROVIDE(rodata_c3d21 = rodata_bc097 + 0x7c8a);
PROVIDE(rodata_c4203 = rodata_bc097 + 0x816c);
PROVIDE(rodata_c46e5 = rodata_bc097 + 0x864e);
PROVIDE(rodata_c4bc7 = rodata_bc097 + 0x8b30);
PROVIDE(rodata_c50a9 = rodata_bc097 + 0x9012);
PROVIDE(rodata_c558b = rodata_bc097 + 0x94f4);
PROVIDE(rodata_c5a6d = rodata_bc097 + 0x99d6);
PROVIDE(rodata_c5f4f = rodata_bc097 + 0x9eb8);
PROVIDE(rodata_c6431 = rodata_bc097 + 0xa39a);
PROVIDE(rodata_c6913 = rodata_bc097 + 0xa87c);
PROVIDE(rodata_c6df5 = rodata_bc097 + 0xad5e);
PROVIDE(rodata_c72d7 = rodata_bc097 + 0xb240);
PROVIDE(rodata_c73fa = rodata_c739f + 0x5b);
PROVIDE(rodata_c74c2 = rodata_c739f + 0x123);
PROVIDE(rodata_c758a = rodata_c739f + 0x1eb);
PROVIDE(rodata_c760a = rodata_c739f + 0x26b);
PROVIDE(rodata_c7a90 = rodata_c7956 + 0x13a);
PROVIDE(rodata_c7c22 = rodata_c7956 + 0x2cc);
PROVIDE(rodata_c7e92 = rodata_c7956 + 0x53c);
PROVIDE(rodata_c7f5a = rodata_c7956 + 0x604);
PROVIDE(rodata_c805e = rodata_c7956 + 0x708);
PROVIDE(rodata_c8162 = rodata_c7956 + 0x80c);
PROVIDE(rodata_c81a3 = rodata_c7956 + 0x84d);
PROVIDE(rodata_c82db = rodata_c7956 + 0x985);
PROVIDE(rodata_c83a3 = rodata_c7956 + 0xa4d);
PROVIDE(rodata_c846b = rodata_c7956 + 0xb15);
PROVIDE(rodata_c8533 = rodata_c7956 + 0xbdd);
PROVIDE(rodata_c85fb = rodata_c7956 + 0xca5);
PROVIDE(rodata_c86c3 = rodata_c7956 + 0xd6d);
PROVIDE(rodata_c87c7 = rodata_c7956 + 0xe71);
PROVIDE(rodata_c88cb = rodata_c7956 + 0xf75);
PROVIDE(rodata_c89cf = rodata_c7956 + 0x1079);
PROVIDE(rodata_c8a97 = rodata_c7956 + 0x1141);
PROVIDE(rodata_c8b5f = rodata_c7956 + 0x1209);
PROVIDE(rodata_c8c27 = rodata_c7956 + 0x12d1);
PROVIDE(rodata_c8cef = rodata_c7956 + 0x1399);
PROVIDE(rodata_c8db7 = rodata_c7956 + 0x1461);
PROVIDE(rodata_c8e7f = rodata_c7956 + 0x1529);
PROVIDE(rodata_c8f47 = rodata_c7956 + 0x15f1);
PROVIDE(rodata_c900f = rodata_c7956 + 0x16b9);
PROVIDE(rodata_c9113 = rodata_c7956 + 0x17bd);
PROVIDE(rodata_c9217 = rodata_c7956 + 0x18c1);
PROVIDE(rodata_c931b = rodata_c7956 + 0x19c5);
PROVIDE(rodata_c941f = rodata_c7956 + 0x1ac9);
PROVIDE(rodata_c9523 = rodata_c7956 + 0x1bcd);
PROVIDE(rodata_c9627 = rodata_c7956 + 0x1cd1);
PROVIDE(rodata_c972b = rodata_c7956 + 0x1dd5);
PROVIDE(rodata_c982f = rodata_c7956 + 0x1ed9);
PROVIDE(rodata_c9933 = rodata_c7956 + 0x1fdd);
PROVIDE(rodata_c9a37 = rodata_c7956 + 0x20e1);
PROVIDE(rodata_c9b3b = rodata_c7956 + 0x21e5);
PROVIDE(rodata_c9c3f = rodata_c7956 + 0x22e9);
PROVIDE(rodata_c9d43 = rodata_c7956 + 0x23ed);
PROVIDE(rodata_c9e47 = rodata_c7956 + 0x24f1);
PROVIDE(rodata_c9f4b = rodata_c7956 + 0x25f5);
PROVIDE(rodata_ca04f = rodata_c7956 + 0x26f9);
PROVIDE(rodata_ca153 = rodata_c7956 + 0x27fd);
PROVIDE(rodata_cb7fb = rodata_c7956 + 0x3ea5);
PROVIDE(rodata_cc863 = rodata_c7956 + 0x4f0d);
PROVIDE(rodata_cd5ab = rodata_c7956 + 0x5c55);
PROVIDE(rodata_ce483 = rodata_c7956 + 0x6b2d);
PROVIDE(rodata_cff13 = rodata_c7956 + 0x85bd);
PROVIDE(rodata_d06cf = rodata_c7956 + 0x8d79);
PROVIDE(rodata_d0e9f = rodata_c7956 + 0x9549);
PROVIDE(rodata_d15a7 = rodata_c7956 + 0x9c51);
PROVIDE(rodata_d215f = rodata_c7956 + 0xa809);
PROVIDE(rodata_d328f = rodata_c7956 + 0xb939);
PROVIDE(rodata_d43bf = rodata_c7956 + 0xca69);
PROVIDE(rodata_e123a = rodata_d753a + 0x9d00);
PROVIDE(rodata_e17da = rodata_d753a + 0xa2a0);
PROVIDE(rodata_e4408 = rodata_d753a + 0xcece);
PROVIDE(rodata_e5248 = rodata_d753a + 0xdd0e);
PROVIDE(rodata_f0ed2 = rodata_f0e73 + 0x5f);
PROVIDE(rodata_f0f29 = rodata_f0f26 + 0x3);
PROVIDE(rodata_f0f45 = rodata_f0f26 + 0x1f);
PROVIDE(rodata_f0ff1 = rodata_f0fed + 0x4);
PROVIDE(rodata_f1015 = rodata_f0fed + 0x28);
PROVIDE(rodata_f211b = rodata_f20f7 + 0x24);
PROVIDE(rodata_f270e = rodata_f26e7 + 0x27);
PROVIDE(rodata_f27cc = rodata_f2772 + 0x5a);
PROVIDE(rodata_f27cf = rodata_f2772 + 0x5d);
PROVIDE(rodata_f2b3a = rodata_f2b33 + 0x7);
PROVIDE(rodata_f2b41 = rodata_f2b33 + 0xe);
PROVIDE(rodata_f2b47 = rodata_f2b33 + 0x14);
PROVIDE(rodata_f3615 = rodata_f35e4 + 0x31);
PROVIDE(rodata_f3b4d = rodata_f3b2f + 0x1e);
PROVIDE(rodata_f3be1 = rodata_f3bd2 + 0xf);
PROVIDE(rodata_f3e4e = rodata_f3e24 + 0x2a);
PROVIDE(rodata_f4223 = rodata_f4207 + 0x1c);
PROVIDE(rodata_f4ddd = rodata_f4db4 + 0x29);
PROVIDE(rodata_f505e = rodata_f503c + 0x22);
PROVIDE(rodata_f5220 = rodata_f520f + 0x11);
PROVIDE(rodata_f5248 = rodata_f520f + 0x39);
PROVIDE(rodata_f541c = rodata_f540e + 0xe);
PROVIDE(rodata_f542d = rodata_f540e + 0x1f);
PROVIDE(rodata_f694f = rodata_f693a + 0x15);
PROVIDE(rodata_f6bb7 = rodata_f6ba7 + 0x10);
PROVIDE(rodata_f6d5e = rodata_f6d26 + 0x38);
