/* P4 iteration 26/27 - STRUCTURAL PASS.  174 pins below are bound to a
   recon/application/net/src/g1_net_ram_relocs.c storage block plus the
   original offset instead of to a raw 0x21xxxxxx literal, so no recovered
   CPUNET global can land inside a live linker-allocated object (54 of them
   were inside sdc_mempool).
   A further 30 pins are bound to `__data_start + <shipped .data offset>`:
   their storage is NOT recovered-owned RAM but the `.data` of the stock
   SoftDevice Controller / MPSL front-end-module archives, which this link
   places at exactly the shipped addresses (iteration 27; proven by
   recon/application/verify_net_stock_data_window.py).  Relocating those
   away from the live library object is what zeroed the MPSL FEM API
   pointer word at 0x21000530 in iteration 26.
   Generated by recon/application/gen_net_ram_relocs.py;
   ledger recon/application/net_ram_reloc_ledger.json. */
/* Auto-generated: pin reconstructed net-core symbols to their original
 * addresses so &name resolves to the real VA (whole-image byte-match).
 * 459 symbols. Include via: INSERT or -T with the main linker script. */

PROVIDE(rodata_100f805 = 0x0100f805);
PROVIDE(rodata_10100a1 = 0x010100a1);
PROVIDE(rodata_10101cd = 0x010101cd);
PROVIDE(rodata_10102c1 = 0x010102c1);
PROVIDE(rodata_101113d = 0x0101113d);
PROVIDE(rodata_1011869 = 0x01011869);
PROVIDE(rodata_1011add = 0x01011add);
PROVIDE(rodata_1011f29 = 0x01011f29);
PROVIDE(rodata_101205d = 0x0101205d);
PROVIDE(rodata_1016591 = 0x01016591);
PROVIDE(rodata_1017579 = 0x01017579);
PROVIDE(rodata_101b321 = 0x0101b321);
PROVIDE(rodata_101ca79 = 0x0101ca79);
PROVIDE(rodata_101e0e9 = 0x0101e0e9);
PROVIDE(rodata_101e879 = 0x0101e879);
PROVIDE(rodata_101e961 = 0x0101e961);
PROVIDE(rodata_101e9e1 = 0x0101e9e1);
PROVIDE(rodata_101ec69 = 0x0101ec69);
PROVIDE(rodata_10203c9 = 0x010203c9);
PROVIDE(rodata_10208e1 = 0x010208e1);
PROVIDE(rodata_1029e3d = 0x01029e3d);
PROVIDE(rodata_102a0f1 = 0x0102a0f1);
PROVIDE(rodata_102a1bf = 0x0102a1bf);
PROVIDE(rodata_102a2c1 = 0x0102a2c1);
PROVIDE(rodata_102a3b5 = 0x0102a3b5);
PROVIDE(rodata_102a3b9 = 0x0102a3b9);
PROVIDE(rodata_102a665 = 0x0102a665);
PROVIDE(rodata_102b351 = 0x0102b351);
PROVIDE(rodata_102b3ad = 0x0102b3ad);
PROVIDE(rodata_102b4f5 = 0x0102b4f5);
PROVIDE(rodata_102b5ad = 0x0102b5ad);
PROVIDE(rodata_102b95d = 0x0102b95d);
PROVIDE(rodata_102b9c9 = 0x0102b9c9);
PROVIDE(rodata_102ba05 = 0x0102ba05);
PROVIDE(rodata_102d22d = 0x0102d22d);
PROVIDE(rodata_102eca1 = 0x0102eca1);
PROVIDE(rodata_103024d = 0x0103024d);
PROVIDE(rodata_1031555 = 0x01031555);
PROVIDE(rodata_10320d9 = 0x010320d9);
/* P4 iteration 26 - SUPERSEDED.  0x01032e41 is a *code* pointer wearing a
   `rodata_` name (the THIRD such, after 0x010335e5 / 0x01033655 in iteration
   25): runtime->analysis is -0x800, so it is (0x01032640 | 1) = hci_ecdh.c's
   `ecdh_thread`, which FUN_01032680 (= hci_ecdh_init) passes to
   k_thread_create.  Rather than reconstruct a duplicate of a singleton the
   stock NCS unit already owns (ecdh_thread 0x01034fc4, hci_ecdh_init
   0x01035004, ecdh_thread_stack 0x388 B are all in this link), the
   reconstruction is DISPLACED -- see recon/application/net/src/
   stock_call_aliases.ld and recon/ownership/
   net_hci_ecdh_singleton_adoption.json -- so this pin has no referrer and
   must not survive as a raw original-image code address. */
PROVIDE(rodata_1032fbd = 0x01032fbd);
PROVIDE(rodata_1032fd9 = 0x01032fd9);
PROVIDE(rodata_103309d = 0x0103309d);
PROVIDE(rodata_10333a5 = 0x010333a5);
/* P4 iteration 25 - SUPERSEDED.  0x010335e5 is a *code* pointer wearing a
   `rodata_` name: runtime->analysis -0x800 makes it (0x01032de4 | 1), the
   ESB radio state-machine entry now reconstructed as FUN_01032de4.  It is
   rebound through ADDR_FUN_01032de4_THUMB in recon/symbols/g1_net_symbols.h. */
/* P4 iteration 25 - SUPERSEDED.  0x01033655 is a *code* pointer:
   (0x01032e54 | 1) = FUN_01032e54, the ESB "frame received" state.  Rebound
   through ADDR_FUN_01032e54_THUMB. */
PROVIDE(rodata_1035f6d = 0x01035f6d);
PROVIDE(rodata_103704c = 0x0103704c);
PROVIDE(rodata_1037050 = 0x01037050);
PROVIDE(rodata_1037054 = 0x01037054);
PROVIDE(rodata_1037058 = 0x01037058);
PROVIDE(rodata_103a749 = 0x0103a749);
PROVIDE(rodata_103aacd = 0x0103aacd);
PROVIDE(rodata_103b6b3 = 0x0103b6b3);
PROVIDE(rodata_103b6c1 = 0x0103b6c1);
PROVIDE(rodata_103b6d3 = 0x0103b6d3);
PROVIDE(rodata_103b7ad = 0x0103b7ad);
PROVIDE(rodata_103b7f3 = 0x0103b7f3);
/* FUNCTION-POINTER REBIND (iteration 18) — CPUNET `z_thread_timeout`.
 * 0x0103bac9 is a Thumb pointer VALUE stored in the shipped image, i.e. a
 * RUNTIME address (tools/net_address_space.py); its ANALYSIS address is
 * 0x0103bac9 - 0x800 = 0x0103b2c9.  Disassembling netcore_image.bin at
 * analysis 0x0103b2c8 gives
 *     2101       movs r1, #1
 *     3818       subs r0, #24
 *     f7fc bafa  b.w  0x010378c4
 * i.e. exactly Zephyr's kernel/sched.c
 *     void z_thread_timeout(struct _timeout *t)
 *     { z_sched_wake_thread(CONTAINER_OF(t, struct k_thread, base.timeout),
 *                           true); }
 * (`base.timeout` is at +0x18, which is also the offset FUN_01035fa0 =
 * z_impl_k_thread_create passes to z_add_timeout).  Analysis 0x0103bac8 is
 * plain data (`0a 00 05 00 02 00 01 00 ...`), so the identity pin was reading
 * the WRONG coordinate space and handed the kernel a data address as a
 * timeout callback.  Bind it to the linked owner instead; `| 1` re-sets the
 * Thumb bit whatever the ELF symbol value carries. */
PROVIDE(rodata_103bac9 = z_thread_timeout | 1);
PROVIDE(rodata_103be3f = 0x0103be3f);
PROVIDE(rodata_103bf70 = 0x0103bf70);
/* DATA-POINTER REBIND (iteration 6) — CPUNET `struct device` "ipc0".
 * Shipped netcore_image.bin at runtime VA 0x0103bfac is a struct device whose
 * word0 (0x0103cf12) is the C string "ipc0"; api = 0x0103c8a8.  It is passed
 * as the `instance` argument of ipc_service_open_instance() and
 * ipc_service_register_endpoint() by FUN_0102ac0c.  Left unrelocated our build
 * has plain text there (nm: 0x0103bf82 t ept_cb), so instance->api read back 0
 * and BOTH calls returned -EIO with the net UART printing
 *     <err> ipc_service: Invalid backend configuration
 * (captured with sysbus.uart_net CreateFileBackend, iteration 6) — which is
 * exactly why the app-core rpmsg endpoint bind never completed.
 * Our net DT: ipc0 = ordinal 22 (DT_N_S_ipc_S_ipc0_ORD in this build's
 * devicetree_generated.h); __device_dts_ord_22 @0x0103d500, name reads back
 * "ipc0", api 0x0103dd08. */
PROVIDE(rodata_103bfac = __device_dts_ord_22);
PROVIDE(rodata_103bfc0 = 0x0103bfc0);
PROVIDE(rodata_103bfec = 0x0103bfec);
PROVIDE(rodata_103c024 = 0x0103c024);
PROVIDE(rodata_103c044 = 0x0103c044);
PROVIDE(rodata_103c04c = 0x0103c04c);
PROVIDE(rodata_103c05c = 0x0103c05c);
PROVIDE(rodata_103c064 = 0x0103c064);
PROVIDE(rodata_103c074 = 0x0103c074);
PROVIDE(rodata_103c07c = 0x0103c07c);
PROVIDE(rodata_103c094 = 0x0103c094);
PROVIDE(rodata_103c0c4 = 0x0103c0c4);
PROVIDE(rodata_103c0ec = 0x0103c0ec);
PROVIDE(rodata_103c0fc = 0x0103c0fc);
PROVIDE(rodata_103c11c = 0x0103c11c);
PROVIDE(rodata_103c190 = 0x0103c190);
PROVIDE(rodata_103c1bc = 0x0103c1bc);
PROVIDE(rodata_103c1d4 = 0x0103c1d4);
PROVIDE(rodata_103c1f8 = 0x0103c1f8);
PROVIDE(rodata_103c24c = 0x0103c24c);
PROVIDE(rodata_103c254 = 0x0103c254);
PROVIDE(rodata_103c290 = 0x0103c290);
PROVIDE(rodata_103c3b0 = 0x0103c3b0);
PROVIDE(rodata_103c4cc = 0x0103c4cc);
PROVIDE(rodata_103c4d0 = 0x0103c4d0);
PROVIDE(rodata_103c578 = 0x0103c578);
PROVIDE(rodata_103c5b0 = 0x0103c5b0);
PROVIDE(rodata_103c5c4 = 0x0103c5c4);
PROVIDE(rodata_103c798 = 0x0103c798);
PROVIDE(rodata_103c900 = 0x0103c900);
PROVIDE(rodata_103c924 = 0x0103c924);
PROVIDE(rodata_103c938 = 0x0103c938);
PROVIDE(rodata_103cad0 = 0x0103cad0);
PROVIDE(rodata_103cae8 = 0x0103cae8);
PROVIDE(rodata_103cafc = 0x0103cafc);
PROVIDE(rodata_103cb30 = 0x0103cb30);
PROVIDE(rodata_103cc60 = 0x0103cc60);
PROVIDE(rodata_103cd20 = 0x0103cd20);
PROVIDE(rodata_103cd46 = 0x0103cd46);
PROVIDE(rodata_103ce92 = 0x0103ce92);
PROVIDE(rodata_103ceac = 0x0103ceac);
PROVIDE(rodata_103cec3 = 0x0103cec3);
PROVIDE(rodata_103ced0 = 0x0103ced0);
PROVIDE(rodata_103cef6 = 0x0103cef6);
PROVIDE(rodata_103cf0a = 0x0103cf0a);
PROVIDE(rodata_103cf0b = 0x0103cf0b);
PROVIDE(rodata_103d088 = 0x0103d088);
PROVIDE(rodata_103d095 = 0x0103d095);
PROVIDE(rodata_103d0a2 = 0x0103d0a2);
PROVIDE(rodata_103d0bf = 0x0103d0bf);
PROVIDE(rodata_103d0db = 0x0103d0db);
PROVIDE(rodata_103d0f9 = 0x0103d0f9);
PROVIDE(rodata_103d11b = 0x0103d11b);
PROVIDE(rodata_103d13e = 0x0103d13e);
PROVIDE(rodata_103d14a = 0x0103d14a);
PROVIDE(rodata_103d18c = 0x0103d18c);
PROVIDE(rodata_103d19e = 0x0103d19e);
PROVIDE(rodata_103d1b8 = 0x0103d1b8);
PROVIDE(rodata_103d23b = 0x0103d23b);
PROVIDE(rodata_103d279 = 0x0103d279);
PROVIDE(rodata_103d2a7 = 0x0103d2a7);
PROVIDE(rodata_103d2bf = 0x0103d2bf);
PROVIDE(rodata_103d373 = 0x0103d373);
PROVIDE(rodata_103d394 = 0x0103d394);
PROVIDE(rodata_103d3b6 = 0x0103d3b6);
PROVIDE(rodata_103d3e3 = 0x0103d3e3);
PROVIDE(rodata_103d406 = 0x0103d406);
PROVIDE(rodata_103d42c = 0x0103d42c);
PROVIDE(rodata_103d53d = 0x0103d53d);
PROVIDE(rodata_103d55b = 0x0103d55b);
PROVIDE(rodata_103d5d7 = 0x0103d5d7);
PROVIDE(rodata_103d635 = 0x0103d635);
PROVIDE(rodata_103d676 = 0x0103d676);
PROVIDE(rodata_103d6b5 = 0x0103d6b5);
PROVIDE(rodata_103d6e1 = 0x0103d6e1);
PROVIDE(rodata_103d710 = 0x0103d710);
PROVIDE(rodata_103d715 = 0x0103d715);
PROVIDE(rodata_103d719 = 0x0103d719);
PROVIDE(rodata_103d722 = 0x0103d722);
PROVIDE(rodata_103d73e = 0x0103d73e);
PROVIDE(rodata_103d741 = 0x0103d741);
PROVIDE(rodata_103d747 = 0x0103d747);
PROVIDE(rodata_103d74b = 0x0103d74b);
PROVIDE(rodata_103d750 = 0x0103d750);
PROVIDE(rodata_103d756 = 0x0103d756);
PROVIDE(rodata_103d758 = 0x0103d758);
PROVIDE(rodata_103d7fb = 0x0103d7fb);
PROVIDE(rodata_103d82a = 0x0103d82a);
PROVIDE(rodata_103d859 = 0x0103d859);
PROVIDE(rodata_103d888 = 0x0103d888);
PROVIDE(rodata_103d897 = 0x0103d897);
PROVIDE(rodata_103d8c5 = 0x0103d8c5);
PROVIDE(rodata_103d8fb = 0x0103d8fb);
PROVIDE(rodata_103d911 = 0x0103d911);
PROVIDE(rodata_103d922 = 0x0103d922);
PROVIDE(rodata_103d935 = 0x0103d935);
PROVIDE(rodata_103d94e = 0x0103d94e);
PROVIDE(rodata_103d963 = 0x0103d963);
PROVIDE(rodata_103d97e = 0x0103d97e);
PROVIDE(rodata_103da8d = 0x0103da8d);
PROVIDE(rodata_103daa3 = 0x0103daa3);
PROVIDE(rodata_103dad6 = 0x0103dad6);
PROVIDE(rodata_103daee = 0x0103daee);
PROVIDE(rodata_103db04 = 0x0103db04);
PROVIDE(rodata_103db23 = 0x0103db23);
PROVIDE(rodata_103ddb9 = 0x0103ddb9);
PROVIDE(rodata_103ddcd = 0x0103ddcd);
PROVIDE(rodata_103dde1 = 0x0103dde1);
PROVIDE(rodata_103ddfa = 0x0103ddfa);
PROVIDE(rodata_103de16 = 0x0103de16);
PROVIDE(rodata_103de3f = 0x0103de3f);
PROVIDE(rodata_103de6b = 0x0103de6b);
PROVIDE(rodata_103df89 = 0x0103df89);
PROVIDE(rodata_103dfbc = 0x0103dfbc);
PROVIDE(rodata_103e004 = 0x0103e004);
PROVIDE(rodata_103e030 = 0x0103e030);
PROVIDE(rodata_103e16a = 0x0103e16a);
PROVIDE(rodata_103e187 = 0x0103e187);
PROVIDE(rodata_103e1f4 = 0x0103e1f4);
PROVIDE(rodata_103e216 = 0x0103e216);
PROVIDE(rodata_103e23d = 0x0103e23d);
PROVIDE(rodata_103e25d = 0x0103e25d);
PROVIDE(rodata_103e386 = 0x0103e386);
PROVIDE(rodata_103e3bf = 0x0103e3bf);
PROVIDE(rodata_103e3e0 = 0x0103e3e0);
PROVIDE(rodata_103e414 = 0x0103e414);
PROVIDE(rodata_103e43d = 0x0103e43d);
PROVIDE(rodata_103e463 = 0x0103e463);
PROVIDE(rodata_103e47c = 0x0103e47c);
PROVIDE(rodata_103e4af = 0x0103e4af);
PROVIDE(rodata_103e4d1 = 0x0103e4d1);
PROVIDE(rodata_103e4f5 = 0x0103e4f5);
PROVIDE(rodata_103e628 = 0x0103e628);
PROVIDE(rodata_103e66f = 0x0103e66f);
PROVIDE(rodata_103e6ad = 0x0103e6ad);
PROVIDE(rodata_103e6e2 = 0x0103e6e2);
PROVIDE(rodata_103e6f2 = 0x0103e6f2);
PROVIDE(rodata_103e700 = 0x0103e700);
PROVIDE(rodata_103e73b = 0x0103e73b);
PROVIDE(rodata_103e850 = 0x0103e850);
PROVIDE(rodata_103e852 = 0x0103e852);
PROVIDE(rodata_103e867 = 0x0103e867);
PROVIDE(rodata_103e889 = 0x0103e889);
PROVIDE(rodata_103e8cc = 0x0103e8cc);
PROVIDE(rodata_103e8d2 = 0x0103e8d2);
PROVIDE(rodata_103e921 = 0x0103e921);
PROVIDE(rodata_103e929 = 0x0103e929);
PROVIDE(rodata_103e951 = 0x0103e951);
PROVIDE(rodata_103e972 = 0x0103e972);
PROVIDE(rodata_103e98a = 0x0103e98a);
PROVIDE(rodata_103e9fe = 0x0103e9fe);
PROVIDE(rodata_103ea45 = 0x0103ea45);
PROVIDE(rodata_103ea89 = 0x0103ea89);
PROVIDE(rodata_103eaab = 0x0103eaab);
PROVIDE(rodata_103eacd = 0x0103eacd);
PROVIDE(rodata_103eaed = 0x0103eaed);
PROVIDE(rodata_103eb0e = 0x0103eb0e);
PROVIDE(rodata_103eb30 = 0x0103eb30);
PROVIDE(rodata_103eb5b = 0x0103eb5b);
PROVIDE(rodata_103eb7f = 0x0103eb7f);
PROVIDE(rodata_103eba0 = 0x0103eba0);
PROVIDE(rodata_103ebf5 = 0x0103ebf5);
PROVIDE(rodata_103ec0a = 0x0103ec0a);
PROVIDE(rodata_103ec11 = 0x0103ec11);
PROVIDE(rodata_103ed11 = 0x0103ed11);
PROVIDE(rodata_103ed18 = 0x0103ed18);
PROVIDE(g_net_fault_canary_flag = 0x20070000);
PROVIDE(g_net_esb_own_addr = __data_start + 0x10);
PROVIDE(g_net_ble_pending_channel_idx = __data_start + 0x1c);
PROVIDE(g_net_flags_bitmap64 = __data_start + 0x20);
PROVIDE(g_net_clk_conv_cache_key = __data_start + 0x3c);
PROVIDE(g_net_clk_conv_cache_ext = __data_start + 0x40);
PROVIDE(g_net_sdc_optfeat_fp_a = __data_start + 0x44);
PROVIDE(g_net_sdc_optfeat_fp_c = __data_start + 0x48);
PROVIDE(g_net_sdc_optfeat_fp_b = __data_start + 0x4c);
PROVIDE(g_21000050 = __data_start + 0x50);
PROVIDE(g_21000054 = __data_start + 0x54);
PROVIDE(g_21000058 = __data_start + 0x58);
PROVIDE(g_2100005c = __data_start + 0x5c);
PROVIDE(g_210001d4 = __data_start + 0x1d4);
PROVIDE(g_210001e0 = __data_start + 0x1e0);
PROVIDE(g_210001e4 = __data_start + 0x1e4);
PROVIDE(g_210001e8 = __data_start + 0x1e8);
PROVIDE(g_210001ec = __data_start + 0x1ec);
PROVIDE(g_net_link_ctx_a_close_cb = __data_start + 0x1f4);
PROVIDE(g_21000208 = 0x21000208);
PROVIDE(g_21000210 = 0x21000210);
PROVIDE(g_net_conn_event_cb = __data_start + 0x214);
PROVIDE(g_sdc_ll_ctx_field_308 = __data_start + 0x308);
PROVIDE(g_210004ac = __data_start + 0x4ac);
PROVIDE(g_210004b0 = __data_start + 0x4b0);
PROVIDE(g_210004b4 = __data_start + 0x4b4);
PROVIDE(g_210004bc = 0x210004bc);
PROVIDE(g_210004c8 = __data_start + 0x4c8);
PROVIDE(g_net_link_ctx_b_close_cb = __data_start + 0x4d0);
PROVIDE(g_net_ble_conn_setup_err_cb = __data_start + 0x4d8);
PROVIDE(g_net_ble_conn_setup_ok_cb = __data_start + 0x4dc);
PROVIDE(g_net_cb_handler_fn = __data_start + 0x528);
PROVIDE(g_net_cb_registered_flag = __data_start + 0x52c);
/* P4 iteration 26 - NAMED LEAD, NOT ADOPTED.  This word is the pointer to the
   radio-arbitration ops table; the shipped .data holds 0x21000534, and
   0x21000534 in this link is sym_NIQMZN22R7GGCSNM3BZ25GTCR6D457XB3DIUGWA, a
   0x40-byte library .data object that no repository source defines.  Binding
   the word to that owner by name was BUILT AND MEASURED (g1-i26e-net): the
   recovered accessors then enter the arbitration path and the machine resets
   inside 6 s (both cores halted) while radio TransmittedFrames stays 0, so the
   change was REVERTED rather than kept for a hypothesis.  See our_boot_bringup.md
   §26.8.  Until the accessors' expectations are proven the word stays in its
   relocation block, whose shipped .data is atomically excluded (15 unresolved
   pointer words), i.e. it reads 0 and the path is skipped. */
PROVIDE(g_net_radio_ops_table_ptr = __data_start + 0x530);
PROVIDE(g_net_driver_api_ptr = g1_net_ram_blk_21000570 + 0x4);
PROVIDE(g_net_last_fault_code = g1_net_ram_blk_21000570 + 0xc);
PROVIDE(g_zephyr_log_level = g1_net_ram_blk_21000570 + 0x10);
/* P4 iteration 21: g_net_radio_op_state is now a REAL object emitted by
   recon/application/net/src/timeslot_owner.c with its shipped initialiser
   (1).  The absolute pin 0x210005b4 landed inside the emitted
   g1_timeslot_request_earliest and corrupted its request_type. */
/* PROVIDE(g_net_radio_op_state = 0x210005b4); -- superseded, see above */
PROVIDE(g_210005ec = g1_net_ram_blk_210005e8 + 0x4);
PROVIDE(g_net_radio_crc_scratch = g1_net_ram_blk_21000680 + 0x4);
/* P4 iteration 24: g_net_log_msg_ctx (really the ESB radio's `nrfx_timer_t`
   instance for TIMER2, see recon/symbols/g1_net_symbols.h) is now a REAL
   8-byte object emitted by recon/application/net/src/timeslot_owner.c with its
   shipped .data initialiser { 0x41019000, 0x00000800 }.  As a bare pin the
   address held whatever the cohesive linker put there, so nrfx_timer_init's
   `p_reg` assertion failed, nrfx_timer_extended_compare returned 0x0BAD0004
   and FUN_010333b4 bailed with -EFAULT before enabling ESB. */
/* PROVIDE(g_net_log_msg_ctx = 0x21000698); -- superseded, see above */
/* P4 iteration 24: superseded -- g_sdc_res_pool_free_bitmap (and the
   unnamed group pool at 0x210006a0, now g_net_dppi_group_pool) are REAL
   objects emitted by recon/application/net/src/timeslot_owner.c with their
   shipped .data initialisers 0xffffc000 / 0x0000003f. */
/* PROVIDE(g_sdc_res_pool_free_bitmap = 0x210006a4); -- superseded */
PROVIDE(g_sdc_res_pool_slot_tbl = g1_net_ram_blk_21000680 + 0x28);
PROVIDE(g_net_conn_teardown_ctx_b = g1_net_ram_blk_21000718 + 0x4);
/* P4 iteration 24: four ESB peer-sync objects named so the reconstructions
   recovered this iteration carry symbols rather than raw literals. */
PROVIDE(g_esb_sync_message = g1_net_ram_blk_210045e0 + 0x38);
PROVIDE(g_esb_rx_payload = g1_net_ram_blk_21004da0 + 0x1);
PROVIDE(g_esb_sync_response_packet = g1_net_ram_blk_21004ea0 + 0x1);
PROVIDE(g_esb_sync_pending_flag = g1_net_ram_blk_21004fa0 + 0x3);
PROVIDE(g_net_kernel_timeout_dlist_head = g1_net_ram_blk_21000750 + 0x0);
/* P4 iteration 20: these three are interior views of ONE recovered 12-byte
 * .data object at 0x21000760..0x2100076c (the ESB pipe-address block; the
 * shipped _sw_isr_table began at 0x2100076c, iteration 19).  In the cohesive
 * link the raw addresses fall inside the LINKER's own _sw_isr_table
 * (0x21000704, 30 entries) at +0x5d/+0x5f/+0x63, i.e. entries 11 and 12.
 * Bind them onto the emitted object with their original relative offsets. */
PROVIDE(g_net_radio_sched_param_a = g1_esb_pipe_addr_block + 0x1);
PROVIDE(g_net_radio_sched_param_b = g1_esb_pipe_addr_block + 0x3);
PROVIDE(g_net_radio_sched_param_c = g1_esb_pipe_addr_block + 0x7);
PROVIDE(g_net_periodic_work_obj = 0x2100086c);
PROVIDE(g_net_layout_count_table = g1_net_ram_blk_21000a30 + 0x0);
PROVIDE(g_net_mac_pib_ext = g1_net_ram_blk_21000a30 + 0x10);
PROVIDE(g_21000a58 = g1_net_ram_blk_21000a30 + 0x28);
PROVIDE(g_21000a5c = 0x21000a5c);
PROVIDE(g_net_addr_record = g1_net_ram_blk_21000a30 + 0x30);
PROVIDE(g_21000a64 = g1_net_ram_blk_21000a30 + 0x34);
PROVIDE(g_21000a68 = g1_net_ram_blk_21000a30 + 0x38);
PROVIDE(g_21000b78 = g1_net_ram_blk_21000b70 + 0x8);
PROVIDE(g_net_bump_alloc_state = g1_net_ram_blk_21000ba8 + 0x0);
PROVIDE(g_net_bump_alloc_cursor = g1_net_ram_blk_21000ba8 + 0x4);
PROVIDE(g_net_bump_alloc_offset = g1_net_ram_blk_21000ba8 + 0x8);
PROVIDE(g_net_obj_table_root_ptr = g1_net_ram_blk_21000ba8 + 0xc);
PROVIDE(g_net_bufpool_slot_cnt = g1_net_ram_blk_21000ba8 + 0x10);
PROVIDE(g_net_bufpool_base_ptr = g1_net_ram_blk_21000ba8 + 0x14);
PROVIDE(g_net_storage_area_id = g1_net_ram_blk_21000ba8 + 0x18);
PROVIDE(g_net_retry_handle = g1_net_ram_blk_21000ba8 + 0x1c);
PROVIDE(g_net_retry_param2 = g1_net_ram_blk_21000ba8 + 0x20);
PROVIDE(g_sdc_last_cfg_param3 = g1_net_ram_blk_21000ba8 + 0x21);
PROVIDE(g_21000be4 = g1_net_ram_blk_21000ba8 + 0x3c);
PROVIDE(g_21000be8 = g1_net_ram_blk_21000ba8 + 0x40);
PROVIDE(g_net_pool_blk_cnt = g1_net_ram_blk_21000ba8 + 0x44);
PROVIDE(g_net_pool_blk_size = g1_net_ram_blk_21000ba8 + 0x48);
PROVIDE(g_net_ctrl_pending_req_busy_flag = g1_net_ram_blk_21000c28 + 0x2);
PROVIDE(g_net_ctrl_pending_req_id = g1_net_ram_blk_21000c28 + 0x4);
PROVIDE(g_21000c2e = g1_net_ram_blk_21000c28 + 0x6);
PROVIDE(g_net_ctrl_pending_req_target_id = g1_net_ram_blk_21000c28 + 0x8);
PROVIDE(g_net_addr_cache_pair = g1_net_ram_blk_21000c28 + 0xc);
PROVIDE(g_net_radio_drv_ctx = g1_net_ram_blk_21000c28 + 0x20);
PROVIDE(g_net_link_drv_ctx_0x24 = g1_net_ram_blk_21000c68 + 0x4);
PROVIDE(g_ll_conn_empty_pdu_buf = g1_net_ram_blk_21000c90 + 0x0);
PROVIDE(g_ll_conn_tx_ctx_addr = g1_net_ram_blk_21000cc0 + 0x4);
PROVIDE(g_ll_conn_trace_ctx_addr = g1_net_ram_blk_21000cc0 + 0x10);
PROVIDE(g_ll_conn_pdu_hdr_ptr = g1_net_ram_blk_21000cf8 + 0x4);
PROVIDE(g_net_radio_addr_match_tbl = g1_net_ram_blk_21000cf8 + 0x20);
PROVIDE(g_net_rssi_cal_offset = g1_net_ram_blk_21000ea0 + 0x6);
PROVIDE(g_21000ea7 = g1_net_ram_blk_21000ea0 + 0x7);
PROVIDE(g_net_esb_own_addr_valid = g1_net_ram_blk_21000ea0 + 0x8);
PROVIDE(g_net_ble_conn_create_ctx = g1_net_ram_blk_21000ea0 + 0xc);
PROVIDE(g_sdc_max_frag_len = g1_net_ram_blk_21000ea0 + 0xe);
PROVIDE(g_net_pending_work_list = g1_net_ram_blk_21000ea0 + 0x28);
PROVIDE(g_net_ctrl_timeout_node_addr = g1_net_ram_blk_21000ea0 + 0x40);
PROVIDE(g_21000ef2 = g1_net_ram_blk_21000ea0 + 0x52);
PROVIDE(g_net_prng_state = g1_net_ram_blk_21000ea0 + 0x54);
PROVIDE(g_net_prng_state_s1 = g1_net_ram_blk_21000ea0 + 0x58);
PROVIDE(g_net_esb_prng_state_hi = g1_net_ram_blk_21000ea0 + 0x5c);
PROVIDE(g_net_esb_prng_state_lo = g1_net_ram_blk_21000ea0 + 0x60);
PROVIDE(g_sdc_rssi_filter_cfg = g1_net_ram_blk_21000ea0 + 0x64);
PROVIDE(g_net_lookup_table_desc = g1_net_ram_blk_21000ea0 + 0x74);
PROVIDE(g_net_own_addr_info = g1_net_ram_blk_21000ea0 + 0x80);
PROVIDE(g_21000f24 = g1_net_ram_blk_21000ea0 + 0x84);
PROVIDE(g_net_selected_peer_addr = g1_net_ram_blk_21000ea0 + 0xa1);
PROVIDE(g_net_selected_peer_id = g1_net_ram_blk_21000ea0 + 0xa5);
PROVIDE(g_net_radio_ack_pending_flag = g1_net_ram_blk_21000ea0 + 0xb4);
PROVIDE(g_21000f58 = g1_net_ram_blk_21000ea0 + 0xb8);
PROVIDE(g_21000f5c = g1_net_ram_blk_21000ea0 + 0xbc);
PROVIDE(g_net_txbuf_alloc_idx = g1_net_ram_blk_21000ea0 + 0xc0);
PROVIDE(g_21000f64 = g1_net_ram_blk_21000ea0 + 0xc4);
PROVIDE(g_21000f66 = g1_net_ram_blk_21000ea0 + 0xc6);
PROVIDE(g_net_link_ctx_a = g1_net_ram_blk_21000ea0 + 0xc8);
PROVIDE(g_net_link_ctx_field_buf = g1_net_ram_blk_21000fc0 + 0x2c);
PROVIDE(g_net_ctrlblk_chan_field = g1_net_ram_blk_21000fc0 + 0x48);
PROVIDE(g_sdc_ll_ctx_param = g1_net_ram_blk_21000fc0 + 0x59);
PROVIDE(g_net_radio_pending_proc_flag = g1_net_ram_blk_21001048 + 0x2);
PROVIDE(g_2100104c = g1_net_ram_blk_21001048 + 0x4);
PROVIDE(g_ll_conn_default_ctx = g1_net_ram_blk_21001048 + 0x10);
PROVIDE(g_2100109c = g1_net_ram_blk_21001098 + 0x4);
PROVIDE(g_net_session_state_block = g1_net_ram_blk_21001098 + 0x8);
PROVIDE(g_net_session_queue_obj = g1_net_ram_blk_210010f0 + 0x0);
PROVIDE(g_net_conn_teardown_busy_flag = g1_net_ram_blk_21001118 + 0x4);
PROVIDE(g_2100111d = g1_net_ram_blk_21001118 + 0x5);
PROVIDE(g_21001120 = g1_net_ram_blk_21001118 + 0x8);
PROVIDE(g_net_link_ctx_b = g1_net_ram_blk_21001118 + 0xc);
PROVIDE(g_timeout_list = g1_net_ram_blk_21001118 + 0x24);
PROVIDE(g_21001140 = g1_net_ram_blk_21001118 + 0x28);
PROVIDE(g_net_ble_conn_role_cfg = g1_net_ram_blk_21001208 + 0x0);
PROVIDE(g_net_bufpool_id_tag = g1_net_ram_blk_21001208 + 0x1d);
PROVIDE(g_net_radio_tx_power_level = g1_net_ram_blk_21001448 + 0x2);
PROVIDE(g_210014a8 = g1_net_ram_blk_21001498 + 0x10);
PROVIDE(g_net_ccm_op_status = g1_net_ram_blk_210014d8 + 0x0);
PROVIDE(g_net_radio_pending_reset_flag = g1_net_ram_blk_210014d8 + 0x4);
PROVIDE(g_210015f7 = g1_net_ram_blk_210015f0 + 0x7);
PROVIDE(g_21001609 = g1_net_ram_blk_210015f0 + 0x19);
PROVIDE(g_2100160a = g1_net_ram_blk_210015f0 + 0x1a);
PROVIDE(g_21001614 = g1_net_ram_blk_210015f0 + 0x24);
PROVIDE(g_net_ble_session_key_buf = g1_net_ram_blk_21001638 + 0x4);
PROVIDE(g_net_radio_frame_desc = g1_net_ram_blk_21001660 + 0x4);
PROVIDE(g_2100167c = g1_net_ram_blk_21001660 + 0x1c);
PROVIDE(g_21001680 = g1_net_ram_blk_21001660 + 0x20);
PROVIDE(g_net_res_reg_key = g1_net_ram_blk_210016b0 + 0x4);
PROVIDE(g_net_res_reg_handle = g1_net_ram_blk_210016b0 + 0xc);
PROVIDE(g_net_res_reg_param16 = g1_net_ram_blk_210016b0 + 0x10);
PROVIDE(g_210016dc = g1_net_ram_blk_210016b0 + 0x2c);
PROVIDE(g_net_deferred_cb_fn = g1_net_ram_blk_210016b0 + 0x30);
PROVIDE(g_210016e8 = g1_net_ram_blk_210016b0 + 0x38);
PROVIDE(g_libc_tz_calc_state = g1_net_ram_blk_210016b0 + 0x40);
PROVIDE(g_net_deferred_irq_num = g1_net_ram_blk_21001bc8 + 0x2);
PROVIDE(g_net_link_state = g1_net_ram_blk_21001bc8 + 0x4);
PROVIDE(g_21001bce = g1_net_ram_blk_21001bc8 + 0x6);
PROVIDE(g_154_critical_section_nest_cnt = g1_net_ram_blk_21001bc8 + 0x8);
PROVIDE(g_21001bd2 = g1_net_ram_blk_21001bc8 + 0xa);
PROVIDE(g_21001bd4 = g1_net_ram_blk_21001bc8 + 0xc);
PROVIDE(g_net_irq_lock_nest_cnt = g1_net_ram_blk_21001bc8 + 0xe);
PROVIDE(g_net_irq_lock_suppress_flag = g1_net_ram_blk_21001bc8 + 0x17);
PROVIDE(g_net_radio_timer_active_flag = g1_net_ram_blk_21001bc8 + 0x2f);
PROVIDE(g_net_radio_timer_sync_state = g1_net_ram_blk_21001bc8 + 0x30);
PROVIDE(g_21001c08 = g1_net_ram_blk_21001bc8 + 0x40);
PROVIDE(g_21001c18 = g1_net_ram_blk_21001bc8 + 0x50);
PROVIDE(g_net_task_state_struct = g1_net_ram_blk_21001c88 + 0x0);
PROVIDE(g_net_uptime_ms_lo = 0x21002788);
PROVIDE(g_net_uptime_ms_hi = 0x2100278c);
PROVIDE(g_21002b80 = 0x21002b80);
PROVIDE(g_sdc_rtc_wrap_limit = 0x21002b88);
PROVIDE(g_net_kernel_curr_tick = 0x210044f0);
PROVIDE(g_net_ctrl_report_len = g1_net_ram_blk_210045e0 + 0x4);
PROVIDE(g_net_ctrl_report_field0 = g1_net_ram_blk_210045e0 + 0x8);
PROVIDE(g_net_ctrl_report_field1 = g1_net_ram_blk_210045e0 + 0xc);
PROVIDE(g_net_ctrl_report_field2 = g1_net_ram_blk_210045e0 + 0x10);
PROVIDE(g_sdc_hci_transport_obj = g1_net_ram_blk_210045e0 + 0x14);
PROVIDE(g_net_radio_dev_ready_flag = 0x21004600);
PROVIDE(g_net_flag_21004604 = g1_net_ram_blk_210045e0 + 0x24);
PROVIDE(g_net_fault_record_ptr = g1_net_ram_blk_210045e0 + 0x30);
PROVIDE(g_net_ipc_msg_data = g1_net_ram_blk_210045e0 + 0x48);
PROVIDE(g_net_evt_callback_fn = g1_net_ram_blk_210045e0 + 0x5c);
PROVIDE(g_net_periodic_work_ptr = 0x2100465c);
PROVIDE(g_net_current_thread_field_cache = 0x21004660);
PROVIDE(g_net_tick_correction_pending = 0x21004664);
PROVIDE(g_net_tick_pending_cnt = 0x21004668);
PROVIDE(g_21004670 = g1_net_ram_blk_21004670 + 0x0);
PROVIDE(g_21004674 = g1_net_ram_blk_21004670 + 0x4);
PROVIDE(g_21004690 = g1_net_ram_blk_21004670 + 0x20);
PROVIDE(g_210047f8 = 0x210047f8);
PROVIDE(g_net_047fc = g1_net_ram_blk_210047f8 + 0x4);
PROVIDE(g_rtc_overflow_cnt = 0x21004970);
PROVIDE(g_esb_event_handler_fn = g1_net_ram_blk_21004960 + 0x3c);
PROVIDE(g_net_radio_irq_continuation_ptr = g1_net_ram_blk_21004960 + 0x40);
PROVIDE(g_net_radio_op_status = g1_net_ram_blk_21004960 + 0x44);
PROVIDE(g_esb_tx_busy_flag = g1_net_ram_blk_21004960 + 0x48);
PROVIDE(g_esb_pipe_cfg_field = g1_net_ram_blk_21004960 + 0x4c);
PROVIDE(g_210049b0 = g1_net_ram_blk_21004960 + 0x50);
PROVIDE(g_esb_tx_buf_pool = g1_net_ram_blk_21004960 + 0x74);
PROVIDE(g_net_queue_stats_block_b = g1_net_ram_blk_21004a30 + 0x4);
PROVIDE(g_net_rf_cur_frame_ptr = g1_net_ram_blk_21004a88 + 0x4);
PROVIDE(g_21004a90 = g1_net_ram_blk_21004a88 + 0x8);
PROVIDE(g_esb_state = g1_net_ram_blk_21004a88 + 0xc);
PROVIDE(g_net_radio_mode_state = g1_net_ram_blk_21004a88 + 0x14);
PROVIDE(g_sdc_radio_context_area = g1_net_ram_blk_21004ae8 + 0x4);
PROVIDE(g_net_gpiote_evt_handler_table = g1_net_ram_blk_21004ae8 + 0x10);
PROVIDE(g_net_debug_trace_level = g1_net_ram_blk_21004ae8 + 0x1c);
PROVIDE(g_net_debug_trace_cb = g1_net_ram_blk_21004ae8 + 0x20);
PROVIDE(g_net_ipc_shm_pool_desc_ptr = g1_net_ram_blk_21004b30 + 0x0);
PROVIDE(g_21004b38 = 0x21004b38);
PROVIDE(g_zephyr_sched_thread_field = 0x21004b40);
PROVIDE(g_net_workq_pending_sync_list = 0x21004b50);
PROVIDE(g_zephyr_sched_swap_tmp = 0x21004b5c);
PROVIDE(g_net_pipe_index_limit = 0x21004b60);
PROVIDE(g_net_ctx_active_count = 0x21004b64);
PROVIDE(announce_remaining = g1_net_ram_blk_21004b30 + 0x3c);
PROVIDE(g_net_radio_temp_raw = g1_net_ram_blk_21004b30 + 0x6e);
PROVIDE(g_net_ctrl_rx_ready_flag = g1_net_ram_blk_21004c98 + 0x4);
PROVIDE(g_net_ctrl_status_byte = g1_net_ram_blk_21004c98 + 0x7);
PROVIDE(g_net_ipc_msg_type = g1_net_ram_blk_21004fa0 + 0x2);
PROVIDE(g_net_evt_notify_disabled_flag = g1_net_ram_blk_21004fa0 + 0x5);
PROVIDE(g_net_evt_last_notified_state = g1_net_ram_blk_21004fa0 + 0x6);
PROVIDE(g_sdc_clock_recalc_flag = g1_net_ram_blk_21004fa0 + 0x7);
PROVIDE(g_sdc_clock_history_idx = g1_net_ram_blk_21004fa0 + 0x8);
PROVIDE(g_net_rtc_timer_sync_valid = g1_net_ram_blk_21004fa0 + 0x9);
PROVIDE(g_sdc_clock_calc_valid = g1_net_ram_blk_21004fa0 + 0xa);
PROVIDE(g_sdc_clock_calc_lock = g1_net_ram_blk_21004fa0 + 0xb);
PROVIDE(g_net_tick_handler_enable_flag = 0x21004fac);
PROVIDE(g_net_dev_init_done_flag = 0x21004fad);
PROVIDE(g_net_pending_tx_pkt = g1_net_ram_blk_210051a8 + 0x6);
PROVIDE(g_esb_pipe_pid_cnt = g1_net_ram_blk_21006250 + 0x6);
PROVIDE(g_2100625a = g1_net_ram_blk_21006250 + 0xa);
PROVIDE(g_net_rf_ack_hdr_buf = g1_net_ram_blk_21006358 + 0x3);
PROVIDE(g_net_radio_busy_flag = g1_net_ram_blk_21006458 + 0x0);
PROVIDE(g_esb_enabled_flag = g1_net_ram_blk_21006458 + 0x1);
PROVIDE(g_net_radio_trx_ppi_ch_a = g1_net_ram_blk_21006458 + 0x2);
PROVIDE(g_esb_ppi_ch_id_1 = g1_net_ram_blk_21006458 + 0x3);
PROVIDE(g_154_dppi_channel_ack = g1_net_ram_blk_21006458 + 0x4);
PROVIDE(g_esb_ppi_ch_id_3 = g1_net_ram_blk_21006458 + 0x5);
PROVIDE(g_net_radio_trx_ppi_ch_e = g1_net_ram_blk_21006458 + 0x6);
PROVIDE(g_esb_ppi_ch_id_5 = g1_net_ram_blk_21006458 + 0x7);
PROVIDE(g_esb_ppi_ch_id_6 = g1_net_ram_blk_21006458 + 0x8);
