/* FUN_/TAIL/THUNK reference -> reconstructed definition aliases */
PROVIDE(FUN_0000ef12__impl = strlen);
PROVIDE(FUN_000167a8__impl = get_device_info);
PROVIDE(FUN_00019c70__impl = debug_print);
PROVIDE(FUN_00023ee0__impl = get_ui_mode_flag_byte1);
PROVIDE(FUN_00033cf8__impl = msg_content_recalc_unread);
PROVIDE(FUN_00037060__impl = sync_dashboard_default_language);
PROVIDE(FUN_000370bc__impl = getStocksIndex);
PROVIDE(FUN_0003719c__impl = getNewsIndex);
PROVIDE(FUN_0003ae6c__impl = send_dashboard_status_sync);
PROVIDE(FUN_0003b78c__impl = dmic_record_start);
PROVIDE(FUN_0003b800__impl = consume_pending_event_and_refresh_flag);
PROVIDE(FUN_0003be18__impl = draw_status_icon_by_state);
PROVIDE(FUN_000431b4__impl = gui_set_active_canvas);
PROVIDE(FUN_000431c0__impl = gui_screen_clear);
PROVIDE(FUN_000432d0__impl = gui_canvas_flags_set_bit1);
PROVIDE(FUN_000432ec__impl = gui_canvas_flags_clear_bit1);
PROVIDE(FUN_00043308__impl = gui_reset_dynamic_bitmap_frame_state);
PROVIDE(FUN_0004334c__impl = gui_bmp_dynamic_bitmap_draw);
PROVIDE(FUN_00043484__impl = gui_bmp_bitmap_draw);
PROVIDE(FUN_000436f8__impl = imu_pitch_task_reset_render_state);
PROVIDE(FUN_00043e90__impl = gui_utf_draw);
PROVIDE(FUN_00044bd8__impl = gui_utf_draw_middle);
PROVIDE(FUN_00045764__impl = get_clock_digit_glyph_offset_large);
PROVIDE(FUN_000457b0__impl = get_clock_digit_glyph_offset_small);
PROVIDE(FUN_000457f4__impl = get_font_style3_glyph_offset);
PROVIDE(FUN_00045840__impl = get_default_font_glyph_offset);
PROVIDE(FUN_00047260__impl = reflash_fb_data_to_lcd);
PROVIDE(FUN_00047b1c__impl = send_response_data_to_msgqueue);
PROVIDE(FUN_00047ba8__impl = send_response_data_to_ble);
PROVIDE(FUN_00048b44__impl = set_dashboard_display_level_clamped);
PROVIDE(FUN_00049040__impl = getDelayExitValue);
PROVIDE(FUN_0004a9ec__impl = enter_dashboard_burial_point);
PROVIDE(FUN_0004aab0__impl = exit_dashboard_burial_point);
PROVIDE(FUN_0004bb64__impl = extract_decimal);
PROVIDE(FUN_00069468__impl = lc3_ltpf_interpolate);
PROVIDE(FUN_0006954c__impl = lc3_ltpf_resample);
PROVIDE(FUN_000720d0_i = k_msgq_put);
PROVIDE(FUN_000723b8__impl = k_mutex_lock);
PROVIDE(FUN_00072558__impl = k_mutex_unlock);
PROVIDE(FUN_0007d1d0__impl = dashboard_read_word);
PROVIDE(FUN_0007d3dc__impl = gui_utf_adv_draw_configure);
PROVIDE(FUN_0007d3dc_tail = gui_utf_adv_draw_configure);
PROVIDE(FUN_0007d3ee__impl = device_info_text_width_get);
PROVIDE(FUN_0007d446__impl = device_info_text_height_get_clamped);
PROVIDE(FUN_0007e260__impl = _ldiv5);
PROVIDE(FUN_0007e290__impl = _get_digit);
PROVIDE(FUN_0007e2fa_1 = printk);
PROVIDE(FUN_00086c1e__impl = safe_memcpy_checked);
PROVIDE(FUN_00086c78__impl = memset_bytes);
PROVIDE(THUNK868b4 = g1_recon_k_free);
