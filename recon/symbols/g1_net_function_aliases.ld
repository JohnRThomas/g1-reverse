/* Generated from defined/undefined symbols + reversible manifest.
 * Do not add SDK, pseudo-op, interior-tail, or guessed aliases here. */

PROVIDE(FUN_01008d00 = sdc_assertion_fail); /* 0x01008d00 */
PROVIDE(FUN_01009d18 = controller_typed_handle_lookup); /* 0x01009d18 */
PROVIDE(FUN_0100efc8 = controller_work_update_or_enqueue); /* 0x0100efc8 */
PROVIDE(FUN_010270d2 = sdc_buffer_payload_get); /* 0x010270d2 */
PROVIDE(FUN_0102714a = sdc_buffer_descriptor_resolve); /* 0x0102714a */
