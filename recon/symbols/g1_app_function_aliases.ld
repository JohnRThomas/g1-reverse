/* Generated from defined/undefined symbols + reversible manifest.
 * Do not add SDK, pseudo-op, interior-tail, or guessed aliases here. */

PROVIDE(FUN_00019c70 = debug_print); /* 0x00019c70 */
PROVIDE(get_task_signal_mode = get_ui_mode_flag2); /* 0x00023eec */
PROVIDE(is_task_transport_blocked = check_charging_and_touch_flags); /* 0x00026c28 */
PROVIDE(reset_task_transition_state = check_pending_messages_flag); /* 0x0002c1fc */
PROVIDE(publish_task_transition = clear_pending_message_flag); /* 0x0002c214 */
PROVIDE(prepare_new_task = wait_touch_key_release_or_timeout); /* 0x0002c2b0 */
PROVIDE(process_task_state_five = process_for_new_message_come_on); /* 0x0002c498 */
PROVIDE(process_task_state_four = process_for_message_show); /* 0x0002c714 */
PROVIDE(task_transition_pending = check_ancs_inbox_flag_change); /* 0x0002eb40 */
PROVIDE(finish_task_media = mark_master_or_low_battery_flag); /* 0x0002efc0 */
PROVIDE(should_finish_task_wait = msg_content_used_count); /* 0x00033cdc */
PROVIDE(read_task_mode = msg_content_recalc_unread); /* 0x00033cf8 */
PROVIDE(FUN_00034390 = get_message_pool_index); /* 0x00034390 */
PROVIDE(finalize_task_transition = push_message_3439c); /* 0x0003439c */
PROVIDE(is_task_transition_ready = get_message_pending_state); /* 0x00034410 */
PROVIDE(set_task_display_mode = set_message_pending_state); /* 0x0003443c */
PROVIDE(can_begin_task_transition = check_message_expired_or_timeout); /* 0x00034808 */
PROVIDE(clear_active_task = set_new_message_pending_flag); /* 0x00036030 */
PROVIDE(finish_task_audio = clear_notification_display_buffer); /* 0x0003cf34 */
PROVIDE(get_display_atomic_state = atomic_get_3_0); /* 0x000431a8 */
PROVIDE(get_glyph_pair_spacing = count_chars_in_default_font_table); /* 0x00043e58 */
PROVIDE(FUN_00051c38 = img_mgmt_get_opposite_slot); /* 0x00051c38 */
PROVIDE(bt_att_chan_send = att_chan_send); /* 0x00058a54 */
PROVIDE(net_buf_add = net_buf_simple_add); /* 0x0005f5d0 */
PROVIDE(tail_61200 = flash_nrf_read_invalid_address); /* 0x00061200 */
PROVIDE(compare_int_unlock = gpio_arm_pin_interrupt); /* 0x00063524 */
PROVIDE(FUN_00071358 = rpmsg_virtqueue_channel_init); /* 0x00071358 */
PROVIDE(FUN_00072040 = z_spin_lock_valid); /* 0x00072040 */
PROVIDE(FUN_0007205c = z_spin_unlock_valid); /* 0x0007205c */
PROVIDE(FUN_00072078 = z_spin_lock_set_owner); /* 0x00072078 */
PROVIDE(net_buf_get_impl = net_buf_pool_get_727ac); /* 0x000727ac */
PROVIDE(submit_task_work = k_sem_give); /* 0x00072880 */
PROVIDE(mutex_lock_syscall_handler = z_impl_k_sem_take); /* 0x00072908 */
PROVIDE(update_cache = sched_update_cache); /* 0x000737d8 */
PROVIDE(k_timer_start = z_impl_k_timer_start); /* 0x00075174 */
PROVIDE(FUN_00076cc8 = fprintf_stream); /* 0x00076cc8 */
PROVIDE(FUN_00077914 = snprintf); /* 0x00077914 */
PROVIDE(svfprintf_reentrant = printf_parse_format); /* 0x00078d90 */
PROVIDE(peer_address_is_uninitialized = device_addr_is_default); /* 0x0007c132 */
PROVIDE(wait_for_persist_task_status_lock = signal_persist_task_event); /* 0x0007cdf8 */
PROVIDE(set_task_wake_state = reset_esb_sync_state); /* 0x0007ce60 */
PROVIDE(FUN_0007d3ee = device_info_text_width_get); /* 0x0007d3ee */
PROVIDE(FUN_0007d446 = device_info_text_height_get_clamped); /* 0x0007d446 */
PROVIDE(classify_text_character = index_in_range32_mask); /* 0x0007d860 */
PROVIDE(next_free_chunk = chunk_field); /* 0x0007ddec */
PROVIDE(set_chunk_size = chunk_set_used_flag); /* 0x0007de54 */
PROVIDE(bytes_to_chunksz = log_msg_compute_wlen); /* 0x0007de70 */
PROVIDE(bucket_idx = heap_bucket_index); /* 0x0007de82 */
PROVIDE(FUN_0007e2fa = printk); /* 0x0007e2fa */
PROVIDE(FUN_00080a46 = img_mgmt_active_slot); /* 0x00080a46 */
PROVIDE(FUN_000836d4 = thunk_FUN_00064134); /* 0x000836d4 */
PROVIDE(net_buf_alloc = bt_conn_alloc_pdu_buf); /* 0x000836de */
PROVIDE(k_fifo_put = net_pkt_skip); /* 0x00086502 */
PROVIDE(FUN_00086778 = add_event); /* 0x00086778 */
PROVIDE(checked_bitmap_copy = safe_memcpy_checked); /* 0x00086c1e */
PROVIDE(FUN_00086c78 = memset_bytes); /* 0x00086c78 */
PROVIDE(FUN_00086f00 = vdprintf_to_fd); /* 0x00086f00 */
PROVIDE(FUN_00086fee = strcpy); /* 0x00086fee */
