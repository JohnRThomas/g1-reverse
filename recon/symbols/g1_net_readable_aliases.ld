/* Generated from net_readable_alias_resolutions.json.
 * Every alias has a canonical raw-VA back-map and retained target. */
PROVIDE(alloc_chunk = FUN_01039874); /* 0x01039874 */
PROVIDE(assert_panic = FUN_01039bb0); /* 0x01039bb0 */
PROVIDE(assert_post_action = FUN_01039bb0); /* 0x01039bb0 */
PROVIDE(assert_report = assert_print); /* 0x01039bbe */
PROVIDE(atomic_inc = FUN_0103a294); /* 0x0103a294 */
PROVIDE(bytes_to_chunksz = FUN_010397c0); /* 0x010397c0 */
PROVIDE(chunk_size = FUN_01039768); /* 0x01039768 */
PROVIDE(controller_connection_config_get = FUN_010282a6); /* 0x010282a6 */
PROVIDE(controller_handle_lookup = FUN_0100cfc0); /* 0x0100cfc0 */
PROVIDE(controller_object_get = FUN_010282a2); /* 0x010282a2 */
PROVIDE(free_list_add = FUN_01039972); /* 0x01039972 */
PROVIDE(k_heap_aligned_alloc = FUN_01035d18); /* 0x01035d18 */
PROVIDE(k_sem_give = FUN_01036824); /* 0x01036824 */
PROVIDE(k_timer_start = FUN_01038448); /* 0x01038448 */
PROVIDE(log_process = FUN_0102df2c); /* 0x0102df2c */
PROVIDE(net_buf_free_get = FUN_01036774); /* 0x01036774 */
PROVIDE(prepare_thread_swap = FUN_01037398); /* 0x01037398 */
PROVIDE(queue_insert = FUN_01036660); /* 0x01036660 */
PROVIDE(ready_remove = FUN_0103735c); /* 0x0103735c */
PROVIDE(set_chunk_used = FUN_01039774); /* 0x01039774 */
PROVIDE(spin_lock = FUN_01036144); /* 0x01036144 */
PROVIDE(spin_lock_acquire = FUN_01036144); /* 0x01036144 */
PROVIDE(spin_lock_valid = FUN_0103610c); /* 0x0103610c */
PROVIDE(spin_unlock = FUN_01036128); /* 0x01036128 */
PROVIDE(spin_unlock_valid = FUN_01036128); /* 0x01036128 */
PROVIDE(spin_validate = FUN_0103610c); /* 0x0103610c */
PROVIDE(spinlock_acquire = FUN_01036144); /* 0x01036144 */
PROVIDE(spinlock_release = FUN_01036128); /* 0x01036128 */
PROVIDE(spinlock_validate = FUN_0103610c); /* 0x0103610c */
PROVIDE(split_chunks = FUN_010398e8); /* 0x010398e8 */
PROVIDE(strlen = FUN_0102a268); /* 0x0102a268 */
PROVIDE(swap_current = FUN_01036f24); /* 0x01036f24 */
PROVIDE(sys_heap_free = FUN_0102c470); /* 0x0102c470 */
PROVIDE(thread_can_swap = FUN_01036e90); /* 0x01036e90 */
PROVIDE(thread_ready = FUN_0103705c); /* 0x0103705c */
PROVIDE(thread_unpend = FUN_01037850); /* 0x01037850 */
PROVIDE(timeout_abort = FUN_010380d8); /* 0x010380d8 */
PROVIDE(trace_sched_unlock = FUN_0103b2b4); /* 0x0103b2b4 */
PROVIDE(update_cache = FUN_01036f74); /* 0x01036f74 */
PROVIDE(work_submit_to_queue = FUN_01036c2c); /* 0x01036c2c */
PROVIDE(z_heap_aligned_alloc = FUN_01038958); /* 0x01038958 */
PROVIDE(z_reschedule = FUN_01037130); /* 0x01037130 */
