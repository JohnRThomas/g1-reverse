/* Generated by tools/build_app_veneer_resolutions.py.
 * Only reviewed exact-entry and four-byte Thumb tail aliases. */

PROVIDE(thunk_FUN_000723b8 = k_mutex_lock); /* 0x000723b8 -> 0x000723b8 */
PROVIDE(thunk_FUN_00072558 = k_mutex_unlock); /* 0x00072558 -> 0x00072558 */
PROVIDE(FUN_0007c010 = k_sem_give); /* 0x0007c010 -> 0x00072880 */
PROVIDE(FUN_0007c0a4 = FUN_00074844); /* 0x0007c0a4 -> 0x00074844 */
PROVIDE(FUN_0007c872 = k_mutex_lock); /* 0x0007c872 -> 0x000723b8 */
PROVIDE(FUN_0007c876 = k_mutex_unlock); /* 0x0007c876 -> 0x00072558 */
PROVIDE(FUN_0007ca72 = FUN_00074844); /* 0x0007ca72 -> 0x00074844 */
PROVIDE(process_touch_event = mutex_unlock_syscall_handler); /* 0x0007cb50 -> 0x000745c8 */
PROVIDE(wait_for_event = FUN_00074844); /* 0x0007cb8a -> 0x00074844 */
PROVIDE(FUN_0007ce5c = FUN_00074844); /* 0x0007ce5c -> 0x00074844 */
PROVIDE(FUN_0007d376 = k_mutex_lock); /* 0x0007d376 -> 0x000723b8 */
PROVIDE(FUN_0007d37a = k_mutex_unlock); /* 0x0007d37a -> 0x00072558 */
PROVIDE(thunk_FUN_00043308 = gui_reset_dynamic_bitmap_frame_state); /* 0x0007d3be -> 0x00043308 */
PROVIDE(thunk_FUN_0007d77c = projector_send_cmd_immediate); /* 0x0007d63e -> 0x0007d77c */
PROVIDE(thunk_FUN_000868b4 = g1_recon_k_free); /* 0x0007f978 -> 0x000868b4 */
PROVIDE(FUN_00080294_i = tc_cmac_final); /* 0x00080294 -> 0x00080294 */
PROVIDE(FUN_000859b2 = k_sem_give); /* 0x000859b2 -> 0x00072880 */
PROVIDE(thunk_FUN_00085cf2 = FUN_00085cf2); /* 0x00085cf2 -> 0x00085cf2 */
PROVIDE(FUN_000861aa = FUN_00085cf2); /* 0x000861aa -> 0x00085cf2 */
PROVIDE(FUN_0008641c = sched_thread_ready); /* 0x0008641c -> 0x00073a78 */
