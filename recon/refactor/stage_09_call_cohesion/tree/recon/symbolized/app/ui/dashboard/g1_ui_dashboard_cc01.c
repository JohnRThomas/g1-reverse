/*
 * Call-cohesive translation unit for the `ui/dashboard' module.
 *
 * GENERATED by recon/refactor/transforms/t09_call_cohesion.py.  Do
 * not edit: a stage tree is regenerated, never hand-patched
 * (recon/refactor/README.md C4).
 *
 * The 3 translation units below were grouped because they CALL ONE
 * ANOTHER, not because they were adjacent in the generated source
 * list.  Each member's text is reproduced VERBATIM.  Every member was
 * checked pairwise against every other member already in this unit by
 * stage 04's seven refusal rules, unchanged: no symbol is declared
 * here with two types, no identifier has internal linkage in one
 * member and is named by another, and no local typedef, macro, struct
 * tag or enum constant of one member is visible to a member that
 * names it.
 *
 * members, in generated-source-list order:
 *   g1_ui_dashboard_01.c
 *   g1_ui_dashboard_03.c
 *   g1_ui_dashboard_04.c
 *
 * call edges inside this unit (caller -> callee): 2
 *   g1_ui_dashboard_03.c -> g1_ui_dashboard_01.c
 *   g1_ui_dashboard_03.c -> g1_ui_dashboard_04.c
 */

/* File-scope forward declarations for every struct/union tag this
 * unit names.  Without them a tag whose only appearance in a member
 * is inside a parameter list has PARAMETER-LIST scope, so two
 * textually IDENTICAL declarations in two members declare two
 * different incomplete types and the second is a conflicting
 * redeclaration (C11 6.2.1p7).  Incomplete-type forward
 * declarations emit no code. */
struct device;
/* ================================================================ */
/* member unit: g1_ui_dashboard_01.c */
/* ================================================================ */
/*
 * Cohesive translation unit for the `ui/dashboard' module.
 *
 * GENERATED by recon/refactor/transforms/t04_cohesive_tu.py.  Do not
 * edit: a stage tree is regenerated, never hand-patched
 * (recon/refactor/README.md C4).
 *
 * The 6 functions below were 6 separate translation units until this
 * stage.  Each one's text is reproduced VERBATIM and in the order the
 * generated source list gave it, and they were CONSECUTIVE in that list.
 * They were proven able to share a translation unit: no symbol is
 * declared here with two types, no identifier has internal linkage in one
 * member and is named by another, and no local typedef, macro, struct tag
 * or enum constant of one member is visible to a member that names it.
 *
 * members, in link order:
 *   store_dashboard_startup_mode_defaults.c
 *   get_dashboard_startup_mode_field63.c
 *   set_dashboard_startup_mode_field63.c
 *   dashboard_startup_info_write_magic.c
 *   uarte_nrfx_irq_rx_ready.c
 *   init_dashboard_startup_mode_info_defaults.c
 */
/* ---- store_dashboard_startup_mode_defaults.c ---- */
#include "g1_app_symbols.h"
/* readable reconstruction; identity: FUN_00016574 @ 0x00016574
 * public-name: store_dashboard_startup_mode_defaults
 * durable-map: recon/catalogs/function_names_app.json
 * callees (readable <= raw @ address):
 *   store_dashboard_startup_mode_defaults    <= FUN_00016574 @ 0x00016574
 * address symbols (name @ address):
 *   g_dashboard_startup_mode_info_defaults   @ 0x2007fc00
 */
/* Reconstructed FUN_00016574 @ 0x16574 (uncatalogued exact leaf entry). */

#include <stdint.h>

uint32_t store_dashboard_startup_mode_defaults(uint32_t value)
{
    *(volatile uint32_t *)((unsigned long)&g_dashboard_startup_mode_info_defaults) /*=0x2007fc00*/ = value;
    return value;
}

/* ---- get_dashboard_startup_mode_field63.c ---- */
/* readable reconstruction; identity: FUN_00016580 @ 0x00016580
 * public-name: get_dashboard_startup_mode_field63
 * durable-map: recon/catalogs/function_names_app.json
 * callees (readable <= raw @ address):
 *   get_dashboard_startup_mode_field63       <= FUN_00016580 @ 0x00016580
 * address symbols (name @ address):
 *   g_dashboard_startup_mode_info_defaults   @ 0x2007fc00
 */
/* Reconstructed FUN_00016580 @ 0x16580  (parity: 300/300 trials, PROVEN) */

unsigned char get_dashboard_startup_mode_field63(void)
{
  return *(volatile unsigned char *)(((unsigned long)&g_dashboard_startup_mode_info_defaults) /*=0x2007fc00*/ + 0x63);
}

/* ---- set_dashboard_startup_mode_field63.c ---- */
/* readable reconstruction; identity: FUN_0001658c @ 0x0001658c
 * public-name: set_dashboard_startup_mode_field63
 * durable-map: recon/catalogs/function_names_app.json
 * callees (readable <= raw @ address):
 *   set_dashboard_startup_mode_field63       <= FUN_0001658c @ 0x0001658c
 * address symbols (name @ address):
 *   g_dashboard_startup_mode_info_defaults   @ 0x2007fc00
 */
/* Reconstructed FUN_0001658c @ 0x1658c  (parity: 300/300 trials, PROVEN) */

void set_dashboard_startup_mode_field63(unsigned char param_1)
{
  *(volatile unsigned char *)(((unsigned long)&g_dashboard_startup_mode_info_defaults) /*=0x2007fc00*/ + 0x63) = param_1;
}

/* ---- dashboard_startup_info_write_magic.c ---- */
/* readable reconstruction; identity: FUN_000165a4 @ 0x000165a4
 * public-name: dashboard_startup_info_write_magic
 * durable-map: recon/catalogs/function_names_app.json
 * callees (readable <= raw @ address):
 *   dashboard_startup_info_write_magic       <= FUN_000165a4 @ 0x000165a4
 * address symbols (name @ address):
 *   g_dashboard_startup_mode_info_defaults   @ 0x2007fc00
 */
/* Reconstructed FUN_000165a4 @ 0x165a4  (parity: 300/300 trials, PROVEN) */

void dashboard_startup_info_write_magic(void)
{
  *(volatile unsigned int *)(((unsigned long)&g_dashboard_startup_mode_info_defaults) /*=0x2007fc00*/ + 0x64) = 0x12345678UL;
}

/* ---- uarte_nrfx_irq_rx_ready.c ---- */
/* readable reconstruction; identity: FUN_000165b4 @ 0x000165b4
 * public-name: uarte_nrfx_irq_rx_ready
 * durable-map: recon/catalogs/function_names_app.json
 * callees (readable <= raw @ address):
 *   uarte_nrfx_irq_rx_ready                  <= FUN_000165b4 @ 0x000165b4
 * address symbols (name @ address):
 *   g_dashboard_startup_mode_info_defaults   @ 0x2007fc00
 */
/* Reconstructed FUN_000165b4 @ 0x165b4  (parity: 300/300 trials, PROVEN) */

int uarte_nrfx_irq_rx_ready(void) {
  int a = *(volatile int *)(((unsigned long)&g_dashboard_startup_mode_info_defaults) /*=0x2007fc00*/ + 0x64);
  /* iteration 37: 0x165b8 `ldr r3,[pc,#12]` loads the literal-pool CONSTANT
   * 0x12345678 (the retained-block validity magic) into r3; 0x165ba then does
   * `subs r0,r0,r3`.  It is NOT a memory read.  Dereferencing it made a cold
   * boot look like a VALID retained block, so init_dashboard_info skipped the
   * branch that seeds the RTC record with 0x65920080 (2024-01-01). */
  int b = 0x12345678;
  int r = a - b;
  if (r != 0) r = -1;
  return r;
}

/* ---- init_dashboard_startup_mode_info_defaults.c ---- */
/* readable reconstruction; identity: FUN_00016658 @ 0x00016658
 * public-name: init_dashboard_startup_mode_info_defaults
 * durable-map: recon/catalogs/function_names_app.json
 * callees (readable <= raw @ address):
 *   init_dashboard_startup_mode_info_defaults <= FUN_00016658 @ 0x00016658
 * address symbols (name @ address):
 *   device_info                              @ 0x200069fc
 *   g_widget0_index_raw                      @ 0x2001b816
 *   g_dashboard_startup_mode_info_defaults   @ 0x2007fc00
 *   g_all_static_info_fc04                   @ 0x2007fc04
 *   g_dashboard_startup_mode_info_field_05   @ 0x2007fc05
 *   g_all_static_info_fc08                   @ 0x2007fc08
 *   g_all_static_info_fc0c                   @ 0x2007fc0c
 *   g_all_static_info                        @ 0x2007fc10
 *   g_dashboard_startup_mode_info_field_14   @ 0x2007fc14
 *   g_dashboard_startup_mode_info_field_18   @ 0x2007fc18
 *   g_dashboard_startup_mode_info_field_1c   @ 0x2007fc1c
 *   g_all_static_info_fc35                   @ 0x2007fc35
 *   g_dashboard_startup_mode_info_field_39   @ 0x2007fc39
 *   g_all_static_info_fc5f                   @ 0x2007fc5f
 *   g_all_static_info_fc60                   @ 0x2007fc60
 *   g_dashboard_startup_mode_info_field_61   @ 0x2007fc61
 *   g_all_static_info_fc62                   @ 0x2007fc62
 *   g_all_static_info_fc68                   @ 0x2007fc68
 *   g_dashboard_default_widget0_index        @ 0x2007fc69
 */
/* Reconstructed FUN_00016658 @ 0x16658  (parity: 300/300 trials, PROVEN) */
void init_dashboard_startup_mode_info_defaults(void){
  int iVar7 = *(volatile int *)((unsigned long)&device_info) /*=0x200069fc*/;
  int dst = *(volatile int *)(iVar7+0xfec);
  *(volatile int *)dst = *(volatile int *)((unsigned long)&g_dashboard_startup_mode_info_defaults) /*=0x2007fc00*/ + 1;
  *(volatile unsigned char *)(dst+4) = *(volatile unsigned char *)((unsigned long)&g_all_static_info_fc04) /*=0x2007fc04*/;
  *(volatile unsigned char *)(dst+5) = *(volatile unsigned char *)((unsigned long)&g_dashboard_startup_mode_info_field_05) /*=0x2007fc05*/;
  *(volatile int *)(dst+6) = *(volatile int *)((unsigned long)&g_all_static_info_fc08) /*=0x2007fc08*/;
  *(volatile int *)(dst+0xa) = *(volatile int *)((unsigned long)&g_all_static_info_fc0c) /*=0x2007fc0c*/;
  *(volatile unsigned char *)(dst+0x5d) = *(volatile unsigned char *)((unsigned long)&g_all_static_info_fc5f) /*=0x2007fc5f*/;
  *(volatile unsigned char *)(dst+0x5e) = *(volatile unsigned char *)((unsigned long)&g_all_static_info_fc60) /*=0x2007fc60*/;
  *(volatile unsigned char *)(dst+0x61) = *(volatile unsigned char *)((unsigned long)&g_all_static_info_fc62) /*=0x2007fc62*/;
  *(volatile unsigned char *)(dst+0x60) = *(volatile unsigned char *)((unsigned long)&g_dashboard_startup_mode_info_field_61) /*=0x2007fc61*/;
  *(volatile unsigned char *)(dst+0x63) = *(volatile unsigned char *)((unsigned long)&g_all_static_info_fc68) /*=0x2007fc68*/;
  { unsigned char b = *(volatile unsigned char *)((unsigned long)&g_dashboard_default_widget0_index) /*=0x2007fc69*/;
    if (b <= 3) *(volatile unsigned char *)((unsigned long)&g_widget0_index_raw) /*=0x2001b816*/ = b; }
  *(volatile int *)(dst+0x0e) = *(volatile int *)((unsigned long)&g_all_static_info) /*=0x2007fc10*/;
  *(volatile int *)(dst+0x12) = *(volatile int *)((unsigned long)&g_dashboard_startup_mode_info_field_14) /*=0x2007fc14*/;
  *(volatile int *)(dst+0x16) = *(volatile int *)((unsigned long)&g_dashboard_startup_mode_info_field_18) /*=0x2007fc18*/;
  *(volatile int *)(dst+0x1a) = *(volatile int *)((unsigned long)&g_dashboard_startup_mode_info_field_1c) /*=0x2007fc1c*/;
  *(volatile int *)(dst+0x1e) = *(volatile int *)0x2007fc20UL;
  *(volatile int *)(dst+0x22) = *(volatile int *)0x2007fc24UL;
  *(volatile int *)(dst+0x26) = *(volatile int *)0x2007fc28UL;
  *(volatile int *)(dst+0x2a) = *(volatile int *)0x2007fc2cUL;
  *(volatile int *)(dst+0x2e) = *(volatile int *)0x2007fc30UL;
  *(volatile unsigned char *)(dst+0x32) = *(volatile unsigned char *)0x2007fc34UL;
  *(volatile int *)(dst+0x33) = *(volatile int *)((unsigned long)&g_all_static_info_fc35) /*=0x2007fc35*/;
  *(volatile int *)(dst+0x37) = *(volatile int *)((unsigned long)&g_dashboard_startup_mode_info_field_39) /*=0x2007fc39*/;
  *(volatile int *)(dst+0x3b) = *(volatile int *)0x2007fc3dUL;
  *(volatile int *)(dst+0x3f) = *(volatile int *)0x2007fc41UL;
  *(volatile int *)(dst+0x43) = *(volatile int *)0x2007fc45UL;
  *(volatile int *)(dst+0x47) = *(volatile int *)0x2007fc49UL;
  *(volatile int *)(dst+0x4b) = *(volatile int *)0x2007fc4dUL;
  *(volatile int *)(dst+0x4f) = *(volatile int *)0x2007fc51UL;
  *(volatile int *)(dst+0x53) = *(volatile int *)0x2007fc55UL;
  *(volatile int *)(dst+0x57) = *(volatile int *)0x2007fc59UL;
  *(volatile unsigned short *)(dst+0x5b) = *(volatile unsigned short *)0x2007fc5dUL;
}

/* ================================================================ */
/* member unit: g1_ui_dashboard_03.c */
/* ================================================================ */
/*
 * Cohesive translation unit for the `ui/dashboard' module.
 *
 * GENERATED by recon/refactor/transforms/t04_cohesive_tu.py.  Do not
 * edit: a stage tree is regenerated, never hand-patched
 * (recon/refactor/README.md C4).
 *
 * The 6 functions below were 6 separate translation units until this
 * stage.  Each one's text is reproduced VERBATIM and in the order the
 * generated source list gave it, and they were CONSECUTIVE in that list.
 * They were proven able to share a translation unit: no symbol is
 * declared here with two types, no identifier has internal linkage in one
 * member and is named by another, and no local typedef, macro, struct tag
 * or enum constant of one member is visible to a member that names it.
 *
 * members, in link order:
 *   getDashboardStartUpModeInfofromFlash.c
 *   SendDashboardLockInfoToApp.c
 *   set_dashboard_close_pending_flag.c
 *   init_dashboard_info.c
 *   get_dashboard_disp_mode.c
 *   handle_dashboard_action.c
 */

/* File-scope forward declarations for every struct/union tag this
 * unit names.  Without them a tag whose only appearance in a member
 * is inside a parameter list has PARAMETER-LIST scope, so two
 * textually IDENTICAL declarations in two members declare two
 * different incomplete types and the second is a conflicting
 * redeclaration (C11 6.2.1p7).  Incomplete-type forward
 * declarations emit no code. */
struct device;
/* ---- getDashboardStartUpModeInfofromFlash.c ---- */
#include "g1_app_symbols.h"
/* readable reconstruction; identity: FUN_00023df4 @ 0x00023df4
 * public-name: getDashboardStartUpModeInfofromFlash
 * durable-map: recon/catalogs/function_names_app.json
 * callees (readable <= raw @ address):
 *   get_device_info                          <= FUN_000167a8 @ 0x000167a8
 *   debug_print                              <= FUN_00019c70 @ 0x00019c70
 *   z_device_is_ready                        <= FUN_0008638c @ 0x0008638c
 * address symbols (name @ address):
 *   rodata_87bf0                             @ 0x00087bf0
 *   rodata_9e9bf                             @ 0x0009e9bf   [INLINED -- G6 literal batch]
 *   rodata_9e9ea                             @ 0x0009e9ea
 *   rodata_9ea0a                             @ 0x0009ea0a
 *   rodata_9ea58                             @ 0x0009ea58   [INLINED -- G6 literal batch]
 *   rodata_9ed09                             @ 0x0009ed09   [INLINED -- G6 literal batch]
 *   g_log_level                              @ 0x2000230c
 *   g_log_use_alt_sink                       @ 0x20007554
 *   g_ui_mode_flag                           @ 0x20018462
 */
/* Reconstructed getDashboardStartUpModeInfofromFlash @ 0x23df4  (parity: 100/100 trials, PROVEN) */
#include <stdint.h>
#include "../../../../headers/g1_log.h"
#include "../../../../headers/g1_dedupe.h"
extern int get_device_info(void);
extern _Bool z_device_is_ready(const struct device *);

unsigned char getDashboardStartUpModeInfofromFlash(unsigned int param_1, unsigned int param_2, unsigned int param_3)
{
    volatile int *piVar1;
    volatile unsigned int *puVar2;
    unsigned char uVar3;
    int iVar4;
    unsigned int uVar5;
    int iVar6;
    int iVar7;

    piVar1 = (volatile int*)((unsigned long)&g_log_level) /*=0x2000230c*/;
    volatile unsigned int local_14 = param_2;

    if (2 < *piVar1) {
        G1_LOG_ROUTE(*(volatile int *)((unsigned long)&g_log_use_alt_sink) /*=0x20007554*/ == 0, ((unsigned long)"%s(): read setting flash data to ram...\r\n\n") /*=0x9e9bf*/, ((unsigned long)"getDashboardStartUpModeInfofromFlash") /*=0x9ed09*/, param_3,
                        *(volatile unsigned int *)((unsigned long)&g_log_use_alt_sink) /*=0x20007554*/);
    }
    puVar2 = (volatile unsigned int*)((unsigned long)&rodata_87bf0) /*=0x87bf0*/;
    iVar4 = z_device_is_ready(((unsigned long)&rodata_87bf0) /*=0x87bf0*/);
    if (iVar4 == 0) {
        if (0 < *piVar1) {
            G1_LOG_ROUTE(*(volatile int *)((unsigned long)&g_log_use_alt_sink) /*=0x20007554*/ == 0, ((unsigned long)&rodata_9e9ea) /*=0x9e9ea*/, ((unsigned long)"getDashboardStartUpModeInfofromFlash") /*=0x9ed09*/, *puVar2,
                            *(volatile unsigned int *)((unsigned long)&g_log_use_alt_sink) /*=0x20007554*/);
        }
        uVar3 = 0xff;
    } else {
        local_14 = local_14 & 0xff000000UL;
        char *p1 = (char*)get_device_info();
        void *pcVar8 = *(void**)(p1 + 0x1030);
        void *r1arg = get_device_info();
        int (*fn)(void*, unsigned int, void*, int) = (int(*)(void*, unsigned int, void*, int))pcVar8;
        iVar6 = fn(r1arg, 0x13e000, (void *)&local_14, 3);
        iVar4 = ((unsigned long)&g_ui_mode_flag) /*=0x20018462*/;
        iVar7 = *piVar1;
        if (iVar6 == 0) {
            if (((unsigned char)local_14 == 0xaa) &&
                ((unsigned char)(local_14 >> 16) != 0xff)) {
                *(unsigned char*)(intptr_t)(((unsigned long)&g_ui_mode_flag) /*=0x20018462*/ + 2) = (unsigned char)(local_14 >> 16);
            } else {
                *(unsigned char*)(intptr_t)(((unsigned long)&g_ui_mode_flag) /*=0x20018462*/ + 2) = 0;
            }
            if (0 < iVar7) {
                G1_LOG_ROUTE(*(volatile int *)((unsigned long)&g_log_use_alt_sink) /*=0x20007554*/ == 0, ((unsigned long)"%s(): dashboard startup mode = %d\n") /*=0x9ea58*/, ((unsigned long)"getDashboardStartUpModeInfofromFlash") /*=0x9ed09*/, (unsigned int)*(unsigned char*)(intptr_t)(iVar4 + 2),
                                *(volatile unsigned int *)((unsigned long)&g_log_use_alt_sink) /*=0x20007554*/);
            }
            uVar3 = *(unsigned char*)(intptr_t)(iVar4 + 2);
        } else {
            if (0 < iVar7) {
                G1_LOG_ROUTE(*(volatile int *)((unsigned long)&g_log_use_alt_sink) /*=0x20007554*/ == 0, ((unsigned long)&rodata_9ea0a) /*=0x9ea0a*/, ((unsigned long)"getDashboardStartUpModeInfofromFlash") /*=0x9ed09*/, 0x13e000UL,
                                *(volatile unsigned int *)((unsigned long)&g_log_use_alt_sink) /*=0x20007554*/);
            }
            uVar3 = 0;
        }
    }
    return uVar3;
}

/* ---- SendDashboardLockInfoToApp.c ---- */
/* readable reconstruction; identity: FUN_00025e2c @ 0x00025e2c
 * public-name: SendDashboardLockInfoToApp
 * durable-map: recon/catalogs/function_names_app.json
 * callees (readable <= raw @ address):
 *   debug_print                              <= FUN_00019c70 @ 0x00019c70
 *   send_response_data_to_msgqueue           <= FUN_00047b1c @ 0x00047b1c
 *   send_response_data_to_ble                <= FUN_00047ba8 @ 0x00047ba8
 *   read_volatile_u32_a                      <= FUN_0007ca4e @ 0x0007ca4e
 * address symbols (name @ address):
 *   rodata_9f73d                             @ 0x0009f73d   [INLINED -- G6 literal batch]
 *   rodata_9fa9c                             @ 0x0009fa9c   [INLINED -- G6 literal batch]
 *   g_log_level                              @ 0x2000230c
 *   g_log_use_alt_sink                       @ 0x20007554
 *   g_dashboard_lock_sent_flags              @ 0x2000756c
 *   g_dashboard_lock_ready_flags             @ 0x20007570
 *   g_dashboard_reset_pending_flags          @ 0x20007aa0
 */
/* Reconstructed SendDashboardLockInfoToApp @ 0x25e2c  (parity: 300/300 trials, PROVEN) */

#include "g1_dashboard.h"
extern unsigned int send_response_data_to_msgqueue(void*, unsigned int);
extern int read_volatile_u32_a(int,...);
void SendDashboardLockInfoToApp(unsigned p1, unsigned p2, unsigned p3){
  volatile unsigned buf[3];
  buf[0]=p1; buf[1]=p2; buf[2]=p3;
  int iVar1 = read_volatile_u32_a(((unsigned long)&g_dashboard_lock_ready_flags) /*=0x20007570*/);
  if((iVar1<<0x1e)<0){
    iVar1 = read_volatile_u32_a(((unsigned long)&g_dashboard_reset_pending_flags) /*=0x20007aa0*/);
    if(-1 < (iVar1<<0x1e)){
      iVar1 = read_volatile_u32_a(((unsigned long)&g_dashboard_lock_sent_flags) /*=0x2000756c*/);
      unsigned bit = (unsigned)(iVar1>>1)&1u;
      if(-1 < (iVar1<<0x1e)){
        iVar1 = read_volatile_u32_a(((unsigned long)&g_dashboard_lock_ready_flags) /*=0x20007570*/);
        if((iVar1<<0x1e)<0){
          buf[0]=bit;
          *(volatile uint16_t *)&buf[0] = 0x650;
          *(volatile uint16_t *)((char*)&buf[1]) = 0x101;
          if(*(volatile int *)((unsigned long)&g_log_level) /*=0x2000230c*/ > 2){
            G1_LOG_ROUTE(*(volatile int *)((unsigned long)&g_log_use_alt_sink) /*=0x20007554*/==0, ((unsigned long)"%s(): send dashboard lock info to app ,status = %d\n \n") /*=0x9f73d*/,((unsigned long)"SendDashboardLockInfoToApp") /*=0x9fa9c*/,1);
          }
          send_response_data_to_msgqueue((void*)buf,6);
          send_response_data_to_ble();
          *(volatile uint32_t *)((unsigned long)&g_dashboard_lock_sent_flags) /*=0x2000756c*/ |= 2u;
        }
      }
    }
  }
}

/* ---- set_dashboard_close_pending_flag.c ---- */
/* readable reconstruction; identity: FUN_00036024 @ 0x00036024
 * public-name: set_dashboard_close_pending_flag
 * durable-map: recon/catalogs/function_names_app.json
 * callees (readable <= raw @ address):
 *   set_dashboard_close_pending_flag         <= FUN_00036024 @ 0x00036024
 * address symbols (name @ address):
 *   g_dashboard_close_pending                @ 0x2001b80f
 */
/* Reconstructed FUN_00036024 @ 0x36024  (parity: 300/300 trials, PROVEN) */

void set_dashboard_close_pending_flag(void)
{
    *(volatile unsigned char *)((unsigned long)&g_dashboard_close_pending) /*=0x2001b80f*/ = 1;
}

/* ---- init_dashboard_info.c ---- */
/* readable reconstruction; identity: FUN_00036ed8 @ 0x00036ed8
 * public-name: init_dashboard_info
 * durable-map: recon/catalogs/function_names_app.json
 * callees (readable <= raw @ address):
 *   uarte_nrfx_irq_rx_ready                  <= FUN_000165b4 @ 0x000165b4
 *   init_dashboard_startup_mode_info_defaults <= FUN_00016658 @ 0x00016658
 *   get_device_info                          <= FUN_000167a8 @ 0x000167a8
 *   debug_print                              <= FUN_00019c70 @ 0x00019c70
 *   getQuickNoteDataFromFlash                <= FUN_00024534 @ 0x00024534
 *   record_dashboard_startup_snapshot        <= FUN_0004a4b4 @ 0x0004a4b4
 * address symbols (name @ address):
 *   rodata_a8eee                             @ 0x000a8eee   [INLINED -- G6 literal batch]
 *   rodata_a8f19                             @ 0x000a8f19   [INLINED -- G6 literal batch]
 *   rodata_a8f46                             @ 0x000a8f46   [INLINED -- G6 literal batch]
 *   rodata_a8fb7                             @ 0x000a8fb7   [INLINED -- G6 literal batch]
 *   rodata_a95f9                             @ 0x000a95f9   [INLINED -- G6 literal batch]
 *   g_log_level                              @ 0x2000230c
 *   g_log_use_alt_sink                       @ 0x20007554
 */
/* Reconstructed init_dashboard_info @ 0x36ed8  (parity: 300/300 trials, PROVEN) */

extern int uarte_nrfx_irq_rx_ready(void);
extern void init_dashboard_startup_mode_info_defaults(void);
extern int getQuickNoteDataFromFlash(int,int,int,int,int);
extern void record_dashboard_startup_snapshot(unsigned int, unsigned int);
#define VB(a) (*(volatile unsigned char *)(a))
#define VI(a) (*(volatile int *)(a))

void init_dashboard_info(void){
  volatile int *p40 = (volatile int*)((unsigned long)&g_log_level) /*=0x2000230c*/;
  volatile int *p44 = (volatile int*)((unsigned long)&g_log_use_alt_sink) /*=0x20007554*/;
  int iVar3, iVar4, iVar5, iVar7;
  iVar3 = uarte_nrfx_irq_rx_ready();
  if (iVar3 == 0) {
    if (2 < *p40) {
      G1_LOG_ROUTE(*p44 == 0, ((unsigned long)"%s(): system startup ,NCS memory is vaild\n") /*=0xa8eee*/, ((unsigned long)"init_dashboard_info") /*=0xa95f9*/);
    }
    init_dashboard_startup_mode_info_defaults();
  } else {
    if (2 < *p40) {
      G1_LOG_ROUTE(*p44 == 0, ((unsigned long)"%s(): system startup ,NCS memory is invaild\n") /*=0xa8f19*/, ((unsigned long)"init_dashboard_info") /*=0xa95f9*/);
    }
    iVar3 = get_device_info();
    { unsigned int pb = VI(iVar3 + 0xfec);
      VB(pb) = 0x80; VB(pb+2) = 0x92; VB(pb+1) = 0; VB(pb+3) = 0x65; }
    iVar3 = get_device_info();
    iVar3 = VI(iVar3 + 0xfec);
    VB(iVar3+6)=0; VB(iVar3+7)=0xf4; VB(iVar3+8)=0x51; VB(iVar3+9)=0xc2;
    VB(iVar3+10)=0x8c; VB(iVar3+0xc)=0; VB(iVar3+0xb)=1; VB(iVar3+0xd)=0;
    iVar3 = get_device_info();
    { int q = VI(iVar3+0xfec); record_dashboard_startup_snapshot(VI(q+6), VI(q+10)); }
  }
  iVar7 = 4;
  iVar3 = 0;
  do {
    iVar4 = get_device_info();
    iVar5 = VI(iVar4 + 0x1020);
    iVar4 = get_device_info();
    iVar4 = getQuickNoteDataFromFlash(iVar3, iVar5+iVar7, 0x29, iVar7+0x29+VI(iVar4+0x1020), 0x119);
    if (iVar4 == -1) {
      iVar4 = get_device_info();
      VB(iVar3*0x143 + VI(iVar4+0x1020) + 3) = 0;
      if (2 < *p40) {
        if (*p44 == 0) log_message(((unsigned long)"%s(): QuickNote %d is invaild,don't export\n") /*=0xa8f46*/, ((unsigned long)"init_dashboard_info") /*=0xa95f9*/, iVar3);
        else debug_print(((unsigned long)"%s(): QuickNote %d is invaild,don't export\n") /*=0xa8f46*/, ((unsigned long)"init_dashboard_info") /*=0xa95f9*/, iVar3);
      }
    } else if (iVar4 == 0) {
      iVar4 = get_device_info();
      VB(iVar3*0x143 + VI(iVar4+0x1020) + 3) = 1;
      if (2 < *p40) {
        if (*p44 == 0) log_message(0x000a8f72, ((unsigned long)"init_dashboard_info") /*=0xa95f9*/, iVar3);
        else debug_print(0x000a8f72, ((unsigned long)"init_dashboard_info") /*=0xa95f9*/, iVar3);
      }
    } else if (0 < *p40) {
      if (*p44 == 0) log_message(((unsigned long)"%s(): !!!! getQuickNoteDataFromFlash return unknown value.\n") /*=0xa8fb7*/, ((unsigned long)"init_dashboard_info") /*=0xa95f9*/);
      else debug_print(((unsigned long)"%s(): !!!! getQuickNoteDataFromFlash return unknown value.\n") /*=0xa8fb7*/, ((unsigned long)"init_dashboard_info") /*=0xa95f9*/);
    }
    iVar3++;
    iVar7 += 0x143;
    if (iVar3 == 4) return;
  } while (1);
}

/* ---- get_dashboard_disp_mode.c ---- */
/* readable reconstruction; identity: FUN_000370b0 @ 0x000370b0
 * public-name: get_dashboard_disp_mode
 * durable-map: recon/catalogs/function_names_app.json
 * callees (readable <= raw @ address):
 *   get_dashboard_disp_mode                  <= FUN_000370b0 @ 0x000370b0
 * address symbols (name @ address):
 *   g_dashboard_disp_mode                    @ 0x2000496a
 */
/* Reconstructed FUN_000370b0 @ 0x370b0  (parity: 300/300 trials, PROVEN) */

uint8_t get_dashboard_disp_mode(void) {
    return *(volatile uint8_t *)((unsigned long)&g_dashboard_disp_mode) /*=0x2000496a*/;
}

/* ---- handle_dashboard_action.c ---- */
/* readable reconstruction; identity: FUN_00037108 @ 0x00037108
 * public-name: handle_dashboard_action
 * durable-map: recon/catalogs/function_names_app.json
 * callees (readable <= raw @ address):
 *   debug_print                              <= FUN_00019c70 @ 0x00019c70
 * address symbols (name @ address):
 *   rodata_a8ff3                             @ 0x000a8ff3   [INLINED -- G6 literal batch]
 *   rodata_a95c9                             @ 0x000a95c9   [INLINED -- G6 literal batch]
 *   g_log_level                              @ 0x2000230c
 *   g_dashboard_widget_state                 @ 0x20004950
 *   g_log_use_alt_sink                       @ 0x20007554
 *   g_stocks_widget_index_raw                @ 0x2001b815
 */
/* Reconstructed handle_dashboard_action @ 0x37108  (parity: 300/300 trials, PROVEN) */

unsigned int handle_dashboard_action(unsigned int param_1, unsigned int param_2,
                                     unsigned int param_3, unsigned int param_4){
    unsigned int action = param_1 & 0xffu;
    *(volatile unsigned char *)(((unsigned long)&g_dashboard_widget_state) /*=0x20004950*/+3) = (unsigned char)action;
    *(volatile unsigned char *)((unsigned long)&g_stocks_widget_index_raw) /*=0x2001b815*/ = (unsigned char)action;
    if(*(volatile int *)((unsigned long)&g_log_level) /*=0x2000230c*/ > 2){
        G1_LOG_ROUTE(*(volatile unsigned int *)((unsigned long)&g_log_use_alt_sink) /*=0x20007554*/ == 0, ((unsigned long)"%s():  %s index = %d\n") /*=0xa8ff3*/, ((unsigned long)"setStocksIndex") /*=0xa95c9*/, ((unsigned long)"setStocksIndex") /*=0xa95c9*/,
                         action);
    }
    return 0;
}

/* ================================================================ */
/* member unit: g1_ui_dashboard_04.c */
/* ================================================================ */
/*
 * Cohesive translation unit for the `ui/dashboard' module.
 *
 * GENERATED by recon/refactor/transforms/t04_cohesive_tu.py.  Do not
 * edit: a stage tree is regenerated, never hand-patched
 * (recon/refactor/README.md C4).
 *
 * The 6 functions below were 6 separate translation units until this
 * stage.  Each one's text is reproduced VERBATIM and in the order the
 * generated source list gave it, and they were CONSECUTIVE in that list.
 * They were proven able to share a translation unit: no symbol is
 * declared here with two types, no identifier has internal linkage in one
 * member and is named by another, and no local typedef, macro, struct tag
 * or enum constant of one member is visible to a member that names it.
 *
 * members, in link order:
 *   set_dashboard_display_level_clamped.c
 *   record_dashboard_startup_snapshot.c
 *   get_dashboard_sum_time.c
 *   dashboard_read_word.c
 *   check_dashboard_device_status_range.c
 *   compute_day_of_week.c
 */
/* ---- set_dashboard_display_level_clamped.c ---- */
#include "g1_app_symbols.h"
#include "../../../../headers/g1_log.h"
#include "../../../../headers/g1_dedupe.h"
#include <stdint.h>
/* readable reconstruction; identity: FUN_00048b44 @ 0x00048b44
 * public-name: set_dashboard_display_level_clamped
 * durable-map: recon/catalogs/function_names_app.json
 * callees (readable <= raw @ address):
 *   set_dashboard_display_level_clamped      <= FUN_00048b44 @ 0x00048b44
 * address symbols (name @ address):
 *   g_dashboard_display_level                @ 0x20002544
 */
/* Reconstructed FUN_00048b44 @ 0x48b44  (parity: 300/300 trials, PROVEN) */

unsigned int set_dashboard_display_level_clamped(int param_1)
{
    if (param_1 >= 0x7d) {
        param_1 = 0x7d;
    }
    if (param_1 < 0x21) {
        param_1 = 0x21;
    }
    *(volatile unsigned int *)((unsigned long)&g_dashboard_display_level) /*=0x20002544*/ = param_1;
    return 0;
}

/* ---- record_dashboard_startup_snapshot.c ---- */
/* readable reconstruction; identity: FUN_0004a4b4 @ 0x0004a4b4
 * public-name: record_dashboard_startup_snapshot
 * durable-map: recon/catalogs/function_names_app.json
 * callees (readable <= raw @ address):
 *   record_dashboard_startup_snapshot        <= FUN_0004a4b4 @ 0x0004a4b4
 *   k_uptime_get_9                           <= FUN_0007d9a4 @ 0x0007d9a4
 * address symbols (name @ address):
 *   g_dashboard_startup_snapshot             @ 0x20004df0
 *   g_dashboard_dwell_base_hi                @ 0x20004df4
 *   g_sync_baseline_timestamp                @ 0x20004df8
 *   g_dashboard_dwell_start_ts_hi            @ 0x20004dfc
 */
/* Reconstructed FUN_0004a4b4 @ 0x4a4b4  (parity: 300/300 trials, PROVEN) */

extern unsigned long long k_uptime_get_9(void);

void record_dashboard_startup_snapshot(unsigned int param_1, unsigned int param_2)
{
    *(volatile unsigned int *)((unsigned long)&g_dashboard_startup_snapshot) /*=0x20004df0*/ = param_1;
    *(volatile unsigned int *)((unsigned long)&g_dashboard_dwell_base_hi) /*=0x20004df4*/ = param_2;
    unsigned long long uVar2 = k_uptime_get_9();
    *(volatile unsigned int *)((unsigned long)&g_sync_baseline_timestamp) /*=0x20004df8*/ = (unsigned int)uVar2;
    *(volatile unsigned int *)((unsigned long)&g_dashboard_dwell_start_ts_hi) /*=0x20004dfc*/ = (unsigned int)(uVar2 >> 32);
}

/* ---- get_dashboard_sum_time.c ---- */
/* readable reconstruction; identity: FUN_0004a960 @ 0x0004a960
 * public-name: get_dashboard_sum_time
 * durable-map: recon/catalogs/function_names_app.json
 * callees (readable <= raw @ address):
 *   get_device_info                          <= FUN_000167a8 @ 0x000167a8
 *   debug_print                              <= FUN_00019c70 @ 0x00019c70
 *   k_uptime_get_10                          <= FUN_0007daa4 @ 0x0007daa4
 * address symbols (name @ address):
 *   rodata_f0369                             @ 0x000f0369   [INLINED -- G6 literal batch]
 *   rodata_f0492                             @ 0x000f0492   [INLINED -- G6 literal batch]
 *   g_log_level                              @ 0x2000230c
 *   g_log_use_alt_sink                       @ 0x20007554
 */
/* Reconstructed get_dashboard_sum_time @ 0x4a960  (parity: 300/300 trials, PROVEN) */

extern unsigned long long k_uptime_get_10(void);
extern int get_device_info(void);

long long get_dashboard_sum_time(void)
{
    unsigned long long uVar7;
    unsigned int iVar1;
    unsigned long long field;
    long long lVar8;

    uVar7 = k_uptime_get_10();
    iVar1 = get_device_info();
    field = *(volatile unsigned long long *)(iVar1 + 0x1094);
    if ((long long)field >= (long long)uVar7) {
        iVar1 = get_device_info();
        field = *(volatile unsigned long long *)(iVar1 + 0x1094);
        uVar7 = k_uptime_get_10();
        lVar8 = (long long)(field - uVar7);
    } else {
        uVar7 = k_uptime_get_10();
        iVar1 = get_device_info();
        field = *(volatile unsigned long long *)(iVar1 + 0x1094);
        lVar8 = (long long)(uVar7 - field);
    }
    if (1 < *(volatile int *)((unsigned long)&g_log_level) /*=0x2000230c*/) {
        unsigned int loP = (unsigned int)lVar8;
        unsigned int hiP = (unsigned int)((unsigned long long)lVar8 >> 32);
        G1_LOG_ROUTE(*(volatile unsigned int *)((unsigned long)&g_log_use_alt_sink) /*=0x20007554*/ == 0, ((unsigned long)"%s(): get_dashboard_sum_time is %d\n") /*=0xf0369*/, ((unsigned long)"get_dashboard_sum_time") /*=0xf0492*/, loP, hiP);
    }
    return lVar8;
}

/* ---- dashboard_read_word.c ---- */
/* readable reconstruction; identity: FUN_0007d1d0 @ 0x0007d1d0
 * public-name: dashboard_read_word
 * durable-map: recon/catalogs/function_names_app.json
 * callees (readable <= raw @ address):
 *   dashboard_read_word                      <= FUN_0007d1d0 @ 0x0007d1d0
 */
/* Reconstructed FUN_0007d1d0 @ 0x7d1d0  (parity: 300/300 trials, PROVEN) */

unsigned int dashboard_read_word(volatile unsigned int *p)
{
    return *p;
}

/* ---- check_dashboard_device_status_range.c ---- */
/* readable reconstruction; identity: FUN_0007d248 @ 0x0007d248
 * public-name: check_dashboard_device_status_range
 * durable-map: recon/catalogs/function_names_app.json
 * callees (readable <= raw @ address):
 *   get_device_info                          <= FUN_000167a8 @ 0x000167a8
 *   check_dashboard_device_status_range      <= FUN_0007d248 @ 0x0007d248
 */
/* Reconstructed FUN_0007d248 @ 0x7d248  (parity: 300/300 trials, PROVEN) */


int check_dashboard_device_status_range(void)
{
  char *iVar1;
  int uVar2;
  iVar1 = get_device_info();
  if ((unsigned char)iVar1[0xfc0] < 0x15) {
    uVar2 = 0;
  } else {
    iVar1 = get_device_info();
    if ((unsigned char)iVar1[0xfc1] < 0x15) {
      iVar1 = get_device_info();
      uVar2 = -1;
      if (2 < (unsigned char)iVar1[0xfc1]) uVar2 = 0;
    } else {
      uVar2 = -1;
    }
  }
  return uVar2;
}

/* ---- compute_day_of_week.c ---- */
/* readable reconstruction; identity: FUN_0007d280 @ 0x0007d280
 * public-name: compute_day_of_week
 * durable-map: recon/catalogs/function_names_app.json
 * callees (readable <= raw @ address):
 *   compute_day_of_week                      <= FUN_0007d280 @ 0x0007d280
 */
/* Reconstructed FUN_0007d280 @ 0x7d280  (parity: 300/300 trials, PROVEN) */
int compute_day_of_week(int param_1, int param_2, int param_3){
  uint32_t uVar2 = (uint32_t)param_2 - 1;
  if(uVar2 < 2) param_2 = param_2 + 0xc;
  if(uVar2 < 2) param_1 = param_1 - 1;
  int iVar1 = param_1;
  if(param_1 < 0) iVar1 = param_1 + 3;
  return (((param_2 + 1) * 3) / 5 + param_3 + param_2 * 2 + param_1 + (iVar1 >> 2)
          + param_1 / -100 + param_1 / 400 + 1) % 7;
}

