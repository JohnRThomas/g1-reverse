/*
 * Cohesive translation unit for the `ui/translate' module.
 *
 * GENERATED by recon/refactor/transforms/t04_cohesive_tu.py.  Do not
 * edit: a stage tree is regenerated, never hand-patched
 * (recon/refactor/README.md C4).
 *
 * The 2 functions below were 2 separate translation units until this
 * stage.  Each one's text is reproduced VERBATIM and in the order the
 * generated source list gave it, and they were CONSECUTIVE in that list.
 * They were proven able to share a translation unit: no symbol is
 * declared here with two types, no identifier has internal linkage in one
 * member and is named by another, and no local typedef, macro, struct tag
 * or enum constant of one member is visible to a member that names it.
 *
 * members, in link order:
 *   upgradeAppLanguageInfoToFlash.c
 *   cleanAppLanguageInfo.c
 */

/* File-scope forward declarations for every struct/union tag this
 * unit names.  Without them a tag whose only appearance in a member
 * is inside a parameter list has PARAMETER-LIST scope, so two
 * textually IDENTICAL declarations in two members declare two
 * different incomplete types and the second is a conflicting
 * redeclaration (C11 6.2.1p7).  Incomplete-type forward
 * declarations emit no code. */
struct k_msgq;
struct k_sem;
/* ---- upgradeAppLanguageInfoToFlash.c ---- */
#include "g1_app_symbols.h"
#include <zephyr/sys_clock.h>
struct k_sem;
#include "../../../../headers/g1_log.h"
/* readable reconstruction; identity: FUN_00023af0 @ 0x00023af0
 * public-name: upgradeAppLanguageInfoToFlash
 * durable-map: recon/catalogs/function_names_app.json
 * callees (readable <= raw @ address):
 *   debug_print                              <= FUN_00019c70 @ 0x00019c70
 *   k_msgq_put                               <= FUN_000720d0 @ 0x000720d0
 *   k_sem_give                               <= FUN_00072880 @ 0x00072880
 * address symbols (name @ address):
 *   rodata_9e903                             @ 0x0009e903   [INLINED -- G6 literal batch]
 *   rodata_9e932                             @ 0x0009e932   [INLINED -- G6 literal batch]
 *   rodata_9eda4                             @ 0x0009eda4   [INLINED -- G6 literal batch]
 *   g_log_level                              @ 0x2000230c
 *   g_flash_store_cmd_msgq                   @ 0x20003994
 *   g_log_use_alt_sink                       @ 0x20007554
 *   g_app_language_msgq                      @ 0x200079e4
 */
/* Reconstructed upgradeAppLanguageInfoToFlash @ 0x23af0  (parity: 300/300 trials, PROVEN) */
extern int k_msgq_put(struct k_msgq *, const void *, k_timeout_t);
extern void k_sem_give(struct k_sem *);

unsigned int upgradeAppLanguageInfoToFlash(unsigned int param_1, unsigned int param_2, unsigned int param_3)
{
    unsigned int buf[3];
    int iVar1;
    unsigned int uVar2;
    buf[0] = 0x10001UL;
    /* The shipped frame reuses the saved second argument for this word,
       clears its low halfword, then publishes the language byte. */
    buf[1] = (param_2 & 0xffff0000UL) | (unsigned int)(unsigned char)param_1;
    buf[2] = param_3;
    iVar1 = k_msgq_put(((unsigned long)&g_flash_store_cmd_msgq) /*=0x20003994*/, buf, (k_timeout_t){ .ticks = 0LL });
    if (iVar1 == 0) {
        if (2 < *(volatile int *)((unsigned long)&g_log_level) /*=0x2000230c*/) {
            unsigned int sink = *(volatile unsigned int *)((unsigned long)&g_log_use_alt_sink) /*=0x20007554*/;
            if (sink == 0)
                log_message(((unsigned long)"%s(): send app language store Command, language = %d\n") /*=0x9e932*/, ((unsigned long)"upgradeAppLanguageInfoToFlash") /*=0x9eda4*/, param_1, sink);
            else
                debug_print(((unsigned long)"%s(): send app language store Command, language = %d\n") /*=0x9e932*/, ((unsigned long)"upgradeAppLanguageInfoToFlash") /*=0x9eda4*/, param_1, sink);
        }
        k_sem_give(((unsigned long)&g_app_language_msgq) /*=0x200079e4*/);
        uVar2 = 0;
    } else {
        if (0 < *(volatile int *)((unsigned long)&g_log_level) /*=0x2000230c*/) {
            unsigned int sink = *(volatile unsigned int *)((unsigned long)&g_log_use_alt_sink) /*=0x20007554*/;
            if (sink == 0)
                log_message(((unsigned long)"%s(): setting flash store queue fill failed\r\n\n") /*=0x9e903*/, ((unsigned long)"upgradeAppLanguageInfoToFlash") /*=0x9eda4*/, 0UL, sink);
            else
                debug_print(((unsigned long)"%s(): setting flash store queue fill failed\r\n\n") /*=0x9e903*/, ((unsigned long)"upgradeAppLanguageInfoToFlash") /*=0x9eda4*/, 0UL, sink);
        }
        uVar2 = 0xffffffffUL;
    }
    return uVar2;
}

/* ---- cleanAppLanguageInfo.c ---- */
#include "../../../../headers/g1_dedupe.h"
struct k_sem;
/* readable reconstruction; identity: FUN_00023b78 @ 0x00023b78
 * public-name: cleanAppLanguageInfo
 * durable-map: recon/catalogs/function_names_app.json
 * callees (readable <= raw @ address):
 *   debug_print                              <= FUN_00019c70 @ 0x00019c70
 *   k_msgq_put                               <= FUN_000720d0 @ 0x000720d0
 *   k_sem_give                               <= FUN_00072880 @ 0x00072880
 * address symbols (name @ address):
 *   rodata_9e903                             @ 0x0009e903   [INLINED -- G6 literal batch]
 *   rodata_9e968                             @ 0x0009e968   [INLINED -- G6 literal batch]
 *   rodata_9ed8f                             @ 0x0009ed8f   [INLINED -- G6 literal batch]
 *   g_log_level                              @ 0x2000230c
 *   g_flash_store_cmd_msgq                   @ 0x20003994
 *   g_log_use_alt_sink                       @ 0x20007554
 *   g_app_language_msgq                      @ 0x200079e4
 */
/* Reconstructed cleanAppLanguageInfo @ 0x23b78  (parity: 300/300 trials, PROVEN) */


int cleanAppLanguageInfo(unsigned int param_1, unsigned int param_2)
{
  int iVar1;
  int uVar2;
  unsigned char buf[8];

  buf[0] = 2;
  *(unsigned int*)&buf[1] = 0;
  buf[5] = 0;
  iVar1 = k_msgq_put((void*)((unsigned long)&g_flash_store_cmd_msgq) /*=0x20003994*/, buf, (k_timeout_t){ .ticks = 0LL });
  if (iVar1 == 0) {
    if (*(int*)((unsigned long)&g_log_level) /*=0x2000230c*/ > 2) {
      G1_LOG_ROUTE(*(int*)((unsigned long)&g_log_use_alt_sink) /*=0x20007554*/ == 0, ((unsigned long)"%s(): SEND APP Language Command...\n") /*=0x9e968*/, ((unsigned long)"cleanAppLanguageInfo") /*=0x9ed8f*/);
    }
    k_sem_give((void*)((unsigned long)&g_app_language_msgq) /*=0x200079e4*/);
    uVar2 = 0;
  } else {
    if (*(int*)((unsigned long)&g_log_level) /*=0x2000230c*/ > 0) {
      G1_LOG_ROUTE(*(int*)((unsigned long)&g_log_use_alt_sink) /*=0x20007554*/ == 0, ((unsigned long)"%s(): setting flash store queue fill failed\r\n\n") /*=0x9e903*/, ((unsigned long)"cleanAppLanguageInfo") /*=0x9ed8f*/);
    }
    uVar2 = -1;
  }
  return uVar2;
}

