/*
 * Cohesive translation unit for the `ui/dashboard' module.
 *
 * GENERATED by recon/refactor/transforms/t04_cohesive_tu.py.  Do not
 * edit: a stage tree is regenerated, never hand-patched
 * (recon/refactor/README.md C4).
 *
 * The 2 functions below were 2 separate translation units until this
 * stage.  Each one's text is reproduced VERBATIM and in the order the
 * generated source list gave it, and they were CONSECUTIVE in that list.
 * They were proven able to share a translation unit: no symbol is
 * declared here with two types, no identifier has internal linkage in one
 * member and is named by another, and no local typedef, macro, struct tag
 * or enum constant of one member is visible to a member that names it.
 *
 * members, in link order:
 *   upgradeDashboardStartupModeInfoToFlash.c
 *   cleanDashBoardStartUpModeInfo.c
 */

/* File-scope forward declarations for every struct/union tag this
 * unit names.  Without them a tag whose only appearance in a member
 * is inside a parameter list has PARAMETER-LIST scope, so two
 * textually IDENTICAL declarations in two members declare two
 * different incomplete types and the second is a conflicting
 * redeclaration (C11 6.2.1p7).  Incomplete-type forward
 * declarations emit no code. */
struct k_msgq;
struct k_sem;
struct startup_request;
/* ---- upgradeDashboardStartupModeInfoToFlash.c ---- */
#include "g1_app_symbols.h"
#include <zephyr/sys_clock.h>
struct k_sem;
#include "../../../../headers/g1_log.h"
/* readable reconstruction; identity: FUN_00023bfc @ 0x00023bfc
 * public-name: upgradeDashboardStartupModeInfoToFlash
 * durable-map: recon/catalogs/function_names_app.json
 * callees (readable <= raw @ address):
 *   debug_print                              <= FUN_00019c70 @ 0x00019c70
 *   k_msgq_put                               <= FUN_000720d0 @ 0x000720d0
 *   k_sem_give                               <= FUN_00072880 @ 0x00072880
 * address symbols (name @ address):
 *   rodata_9e903                             @ 0x0009e903   [INLINED -- G6 literal batch]
 *   rodata_9e98c                             @ 0x0009e98c   [INLINED -- G6 literal batch]
 *   rodata_9ed68                             @ 0x0009ed68   [INLINED -- G6 literal batch]
 *   g_log_level                              @ 0x2000230c
 *   g_flash_store_cmd_msgq                   @ 0x20003994
 *   g_log_use_alt_sink                       @ 0x20007554
 *   g_app_language_msgq                      @ 0x200079e4
 */
/* Reconstructed upgradeDashboardStartupModeInfoToFlash @ 0x23bfc  (parity: 300/300 trials, PROVEN) */
extern int k_msgq_put(struct k_msgq *, const void *, k_timeout_t);
extern void k_sem_give(struct k_sem *);

unsigned int upgradeDashboardStartupModeInfoToFlash(unsigned int param_1, unsigned int param_2, unsigned int param_3)
{
    unsigned int buf[3];
    int iVar1;
    unsigned int uVar2;
    buf[0] = 0x00010003UL;
    buf[1] = (param_2 & 0xffff0000UL) | (param_1 & 0xffUL);
    buf[2] = param_3;
    iVar1 = k_msgq_put(((unsigned long)&g_flash_store_cmd_msgq) /*=0x20003994*/, buf, (k_timeout_t){ .ticks = 0LL });
    if (iVar1 == 0) {
        if (2 < *(volatile int *)((unsigned long)&g_log_level) /*=0x2000230c*/) {
            if (*(volatile int *)((unsigned long)&g_log_use_alt_sink) /*=0x20007554*/ == 0)
                log_message(((unsigned long)"%s(): send startup mode  store Command, mode = %d\n") /*=0x9e98c*/, ((unsigned long)"upgradeDashboardStartupModeInfoToFlash") /*=0x9ed68*/, param_1);
            else
                debug_print(((unsigned long)"%s(): send startup mode  store Command, mode = %d\n") /*=0x9e98c*/, ((unsigned long)"upgradeDashboardStartupModeInfoToFlash") /*=0x9ed68*/, param_1);
        }
        k_sem_give(((unsigned long)&g_app_language_msgq) /*=0x200079e4*/);
        uVar2 = 0;
    } else {
        if (0 < *(volatile int *)((unsigned long)&g_log_level) /*=0x2000230c*/) {
            if (*(volatile int *)((unsigned long)&g_log_use_alt_sink) /*=0x20007554*/ == 0)
                log_message(((unsigned long)"%s(): setting flash store queue fill failed\r\n\n") /*=0x9e903*/, ((unsigned long)"upgradeDashboardStartupModeInfoToFlash") /*=0x9ed68*/);
            else
                debug_print(((unsigned long)"%s(): setting flash store queue fill failed\r\n\n") /*=0x9e903*/, ((unsigned long)"upgradeDashboardStartupModeInfoToFlash") /*=0x9ed68*/);
        }
        uVar2 = 0xffffffffUL;
    }
    return uVar2;
}

/* ---- cleanDashBoardStartUpModeInfo.c ---- */
#include "../../../../headers/g1_dedupe.h"
struct k_sem;
/* readable reconstruction; identity: FUN_00023c88 @ 0x00023c88
 * public-name: cleanDashBoardStartUpModeInfo
 * durable-map: recon/catalogs/function_names_app.json
 * callees (readable <= raw @ address):
 *   debug_print                              <= FUN_00019c70 @ 0x00019c70
 *   k_msgq_put                               <= FUN_000720d0 @ 0x000720d0
 *   k_sem_give                               <= FUN_00072880 @ 0x00072880
 * address symbols (name @ address):
 *   rodata_9e903                             @ 0x0009e903   [INLINED -- G6 literal batch]
 *   rodata_9e968                             @ 0x0009e968   [INLINED -- G6 literal batch]
 *   rodata_9ed4a                             @ 0x0009ed4a   [INLINED -- G6 literal batch]
 *   g_log_level                              @ 0x2000230c
 *   g_flash_store_cmd_msgq                   @ 0x20003994
 *   g_log_use_alt_sink                       @ 0x20007554
 *   g_app_language_msgq                      @ 0x200079e4
 */
/* Reconstructed cleanDashBoardStartUpModeInfo @ 0x23c88 */
#include <stdint.h>


struct startup_request {
  uint8_t opcode;
  uint8_t reserved[5];
};

int cleanDashBoardStartUpModeInfo(void)
{
  const struct startup_request request = { .opcode = 4 };
  if (k_msgq_put(((unsigned long)&g_flash_store_cmd_msgq) /*=0x20003994*/, &request, (k_timeout_t){ .ticks = 0LL }) != 0) {
    if (*(volatile int32_t *)((unsigned long)&g_log_level) /*=0x2000230c*/ > 0) {
      G1_LOG_ROUTE(*(volatile uint32_t *)((unsigned long)&g_log_use_alt_sink) /*=0x20007554*/ == 0, ((unsigned long)"%s(): setting flash store queue fill failed\r\n\n") /*=0x9e903*/, ((unsigned long)"cleanDashBoardStartUpModeInfo") /*=0x9ed4a*/);
    }
    return -1;
  }

  if (*(volatile int32_t *)((unsigned long)&g_log_level) /*=0x2000230c*/ > 2) {
    G1_LOG_ROUTE(*(volatile uint32_t *)((unsigned long)&g_log_use_alt_sink) /*=0x20007554*/ == 0, ((unsigned long)"%s(): SEND APP Language Command...\n") /*=0x9e968*/, ((unsigned long)"cleanDashBoardStartUpModeInfo") /*=0x9ed4a*/);
  }
  k_sem_give(((unsigned long)&g_app_language_msgq) /*=0x200079e4*/);
  return 0;
}

