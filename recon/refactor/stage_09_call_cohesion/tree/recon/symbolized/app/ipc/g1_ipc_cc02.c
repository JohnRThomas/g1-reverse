/*
 * Call-cohesive translation unit for the `ipc' module.
 *
 * GENERATED by recon/refactor/transforms/t09_call_cohesion.py.  Do
 * not edit: a stage tree is regenerated, never hand-patched
 * (recon/refactor/README.md C4).
 *
 * The 2 translation units below were grouped because they CALL ONE
 * ANOTHER, not because they were adjacent in the generated source
 * list.  Each member's text is reproduced VERBATIM.  Every member was
 * checked pairwise against every other member already in this unit by
 * stage 04's seven refusal rules, unchanged: no symbol is declared
 * here with two types, no identifier has internal linkage in one
 * member and is named by another, and no local typedef, macro, struct
 * tag or enum constant of one member is visible to a member that
 * names it.
 *
 * members, in generated-source-list order:
 *   st25dv_mailbox_send_message.c
 *   ipc_ept_op_a_locked_retry.c
 *
 * call edges inside this unit (caller -> callee): 1
 *   st25dv_mailbox_send_message.c -> ipc_ept_op_a_locked_retry.c
 */

/* File-scope forward declarations for every struct/union tag this
 * unit names.  Without them a tag whose only appearance in a member
 * is inside a parameter list has PARAMETER-LIST scope, so two
 * textually IDENTICAL declarations in two members declare two
 * different incomplete types and the second is a conflicting
 * redeclaration (C11 6.2.1p7).  Incomplete-type forward
 * declarations emit no code. */
struct transport_probe_frame;
/* ================================================================ */
/* member unit: st25dv_mailbox_send_message.c */
/* ================================================================ */
#include "g1_app_symbols.h"
/* readable reconstruction; identity: FUN_00024f78 @ 0x00024f78
 * public-name: st25dv_mailbox_send_message
 * durable-map: recon/catalogs/function_names_app.json
 * callees (readable <= raw @ address):
 *   st25dv_write_reg_pair                    <= FUN_00024f08 @ 0x00024f08
 *   st25dv_mailbox_send_message              <= FUN_00024f78 @ 0x00024f78
 *   ipc_ept_op_a_locked_retry                <= FUN_000256dc @ 0x000256dc
 * address symbols (name @ address):
 *   g_st25dv_mailbox_msg                     @ 0x20007a14
 *   g_st25dv_dev                             @ 0x20007a44
 */
/* Reconstructed FUN_00024f78 @ 0x24f78 */
#include <stdint.h>

extern int st25dv_write_reg_pair(int, unsigned int, unsigned int, unsigned int);
extern int ipc_ept_op_a_locked_retry(int, unsigned int, unsigned int, int);

struct transport_probe_frame {
    uint8_t reserved[7];
    uint8_t command;
    uint32_t header;
    uint16_t reserved_halfword;
    uint16_t swapped_length;
};

int st25dv_mailbox_send_message(uint32_t inherited_r0, uint32_t inherited_r1,
                 uint32_t inherited_r2, uint32_t inherited_r3)
{
    volatile uint8_t *state = (volatile uint8_t *)((unsigned long)&g_st25dv_mailbox_msg) /*=0x20007a14*/;
    volatile uint32_t *state_words = (volatile uint32_t *)state;
    volatile uint32_t *controller = (volatile uint32_t *)((unsigned long)&g_st25dv_dev) /*=0x20007a44*/;
    struct transport_probe_frame frame;

    frame.header = state_words[0];
    state_words[3] = 4;
    if (state[2] == 0) {
        uint16_t length = *(volatile uint16_t *)(state + 6);
        frame.swapped_length = (uint16_t)((length << 8) | (length >> 8));
        state_words[3] = 8;
    }

    int status = (int16_t)st25dv_write_reg_pair(&frame.header, inherited_r1, 4,
                                       state[2]);
    if (status != 0)
        return status;

    frame.command = 3;
    status = ipc_ept_op_a_locked_retry(*controller, state_words[3], &frame.command, 1);
    if (status != 0)
        return -1;

    frame.command = 0;
    status = ipc_ept_op_a_locked_retry(*controller, state_words[3] + 1,
                          &frame.command, 1);
    (void)inherited_r0;
    (void)inherited_r2;
    (void)inherited_r3;
    return status == 0 ? 0 : -1;
}

/* ================================================================ */
/* member unit: ipc_ept_op_a_locked_retry.c */
/* ================================================================ */
#include "g1_app_symbols.h"
#include "../../../headers/g1_log.h"
#include "g1_ipc.h"
/* readable reconstruction; identity: FUN_000256dc @ 0x000256dc
 * public-name: ipc_ept_op_a_locked_retry
 * durable-map: recon/catalogs/function_names_app.json
 * callees (readable <= raw @ address):
 *   dev_send_cmd16_payload                   <= FUN_00025670 @ 0x00025670
 *   ipc_ept_op_a_locked_retry                <= FUN_000256dc @ 0x000256dc
 *   sleep_fixed_33_ticks                     <= FUN_0007c87a @ 0x0007c87a
 * address symbols (name @ address):
 *   rodata_9f203                             @ 0x0009f203   [INLINED -- G6 literal batch]
 */
/* Reconstructed FUN_000256dc @ 0x256dc  (parity: 300/300 trials, PROVEN) */
extern int dev_send_cmd16_payload(unsigned long*, unsigned long, unsigned long, unsigned long, unsigned long);
extern unsigned long long sleep_fixed_33_ticks(void);
int ipc_ept_op_a_locked_retry(int param_1, unsigned param_2, unsigned param_3, int param_4){
    int iVar1;
    if (param_4 == 0){ iVar1 = 0; }
    else {
        int iVar4 = 0x14;
        int iVar3 = *(int*)(param_1 + 4);
        unsigned uVar5 = *(unsigned*)(param_1 + 0x10);
        unsigned lock_arg = param_2;
        while (1){
            thunk_FUN_000723b8(uVar5, lock_arg, 0xffffffff, 0xffffffff, param_1, param_2);
            iVar1 = dev_send_cmd16_payload(iVar3, *(unsigned short*)(iVar3 + 8), param_2, param_3, param_4);
            thunk_FUN_00072558(uVar5);
            if (iVar1 == 0) break;
            iVar4 = iVar4 - 1;
            if (iVar4 == 0){
                log_message(((unsigned long)"eeprom_st25dv_write addr %04X offset %04X failed %d\r\n") /*=0x9f203*/, *(unsigned short*)(iVar3 + 8), param_2, iVar1);
                return iVar1;
            }
            lock_arg = (unsigned)(sleep_fixed_33_ticks() >> 32);
        }
    }
    return iVar1;
}

