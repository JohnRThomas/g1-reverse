/*
 * Call-cohesive translation unit for the `ipc' module.
 *
 * GENERATED by recon/refactor/transforms/t09_call_cohesion.py.  Do
 * not edit: a stage tree is regenerated, never hand-patched
 * (recon/refactor/README.md C4).
 *
 * The 2 translation units below were grouped because they CALL ONE
 * ANOTHER, not because they were adjacent in the generated source
 * list.  Each member's text is reproduced VERBATIM.  Every member was
 * checked pairwise against every other member already in this unit by
 * stage 04's seven refusal rules, unchanged: no symbol is declared
 * here with two types, no identifier has internal linkage in one
 * member and is named by another, and no local typedef, macro, struct
 * tag or enum constant of one member is visible to a member that
 * names it.
 *
 * members, in generated-source-list order:
 *   g1_ipc_04.c
 *   g1_ipc_07.c
 *
 * call edges inside this unit (caller -> callee): 1
 *   g1_ipc_07.c -> g1_ipc_04.c
 */
/* ================================================================ */
/* member unit: g1_ipc_04.c */
/* ================================================================ */
/*
 * Cohesive translation unit for the `ipc' module.
 *
 * GENERATED by recon/refactor/transforms/t04_cohesive_tu.py.  Do not
 * edit: a stage tree is regenerated, never hand-patched
 * (recon/refactor/README.md C4).
 *
 * The 9 functions below were 9 separate translation units until this
 * stage.  Each one's text is reproduced VERBATIM and in the order the
 * generated source list gave it, and they were CONSECUTIVE in that list.
 * They were proven able to share a translation unit: no symbol is
 * declared here with two types, no identifier has internal linkage in one
 * member and is named by another, and no local typedef, macro, struct tag
 * or enum constant of one member is visible to a member that names it.
 *
 * members, in link order:
 *   ipc_send_len_prefixed_packet_locked_retry.c
 *   ipc_ept_op_b_locked_retry.c
 *   ipc_ept_op_c_locked_retry.c
 *   ipc0_ept_recv.c
 *   global_ipc_service_send.c
 *   register_ipc_service_context.c
 *   pt_comm_transport_write.c
 *   getStocksIndex.c
 *   getNewsIndex.c
 */
/* ---- ipc_send_len_prefixed_packet_locked_retry.c ---- */
#include "g1_app_symbols.h"
#include "../../../headers/g1_log.h"
#include "g1_ipc.h"
#include "../../../headers/g1_dedupe.h"
#include <stdint.h>
extern void FUN_0007c872(unsigned,unsigned,unsigned,unsigned);
extern void FUN_0007c876(unsigned);
/* readable reconstruction; identity: FUN_00025788 @ 0x00025788
 * public-name: ipc_send_len_prefixed_packet_locked_retry
 * durable-map: recon/catalogs/function_names_app.json
 * callees (readable <= raw @ address):
 *   ipc_send_len_prefixed_packet             <= FUN_00025740 @ 0x00025740
 *   ipc_send_len_prefixed_packet_locked_retry <= FUN_00025788 @ 0x00025788
 *   sleep_fixed_33_ticks                     <= FUN_0007c87a @ 0x0007c87a
 * address symbols (name @ address):
 *   rodata_9f250                             @ 0x0009f250   [INLINED -- G6 literal batch]
 */
/* Reconstructed FUN_00025788 @ 0x25788  (parity: 300/300 trials, PROVEN) */
extern int ipc_send_len_prefixed_packet(int, int, unsigned int, int, int);
extern unsigned long long sleep_fixed_33_ticks(void);
int ipc_send_len_prefixed_packet_locked_retry(unsigned long param_1, unsigned long param_2, void*param_3, unsigned long param_4) {
    int iVar1;
    if (param_4 == 0){ iVar1 = 0; }
    else {
        int iVar4 = 0x14;
        int iVar3 = *(int*)(param_1 + 4);
        unsigned uVar5 = *(unsigned*)(param_1 + 0x10);
        unsigned lock_arg = param_2;
        while (1){
            thunk_FUN_000723b8(uVar5, lock_arg, 0xffffffff, 0xffffffff, param_1, param_2);
            iVar1 = ipc_send_len_prefixed_packet(*(int*)iVar3, *(unsigned short*)(iVar3 + 8), param_2, param_3, param_4);
            thunk_FUN_00072558(uVar5);
            if (iVar1 == 0) break;
            iVar4 = iVar4 - 1;
            if (iVar4 == 0){
                log_message(((unsigned long)"eeprom_st25dv_read addr %04X offset %04X failed %d\r\n") /*=0x9f250*/, *(unsigned short*)(iVar3 + 8), param_2, iVar1);
                return iVar1;
            }
            lock_arg = (unsigned)(sleep_fixed_33_ticks() >> 32);
        }
    }
    return iVar1;
}

/* ---- ipc_ept_op_b_locked_retry.c ---- */
/* readable reconstruction; identity: FUN_000257ec @ 0x000257ec
 * public-name: ipc_ept_op_b_locked_retry
 * durable-map: recon/catalogs/function_names_app.json
 * callees (readable <= raw @ address):
 *   ipc_ept_op_b_locked_retry                <= FUN_000257ec @ 0x000257ec
 *   sleep_fixed_33_ticks                     <= FUN_0007c87a @ 0x0007c87a
 *   json_arr_encode                          <= FUN_0007c898 @ 0x0007c898
 * address symbols (name @ address):
 *   rodata_9f285                             @ 0x0009f285   [INLINED -- G6 literal batch]
 */
/* Reconstructed FUN_000257ec @ 0x257ec  (parity: 300/300 trials, PROVEN) */
extern int json_arr_encode(int,unsigned,unsigned,int);
int ipc_ept_op_b_locked_retry(int param_1, unsigned param_2, unsigned param_3, int param_4){
    int iVar1;
    if (param_4 == 0){ iVar1 = 0; }
    else {
        int iVar3 = 0x14;
        int iVar4 = *(int*)(param_1 + 4);
        unsigned uVar5 = *(unsigned*)(param_1 + 0x10);
        unsigned lock_arg = param_2;
        while (1){
            FUN_0007c872(uVar5, lock_arg, 0xffffffff, 0xffffffff);
            iVar1 = json_arr_encode(iVar4, param_2, param_3, param_4);
            FUN_0007c876(uVar5);
            if (iVar1 == 0) break;
            iVar3 = iVar3 - 1;
            if (iVar3 == 0){
                log_message(((unsigned long)"eeprom_st25dv_read_sys addr %04X offset %04X failed %d\r\n") /*=0x9f285*/, (*(unsigned short*)(iVar4 + 8)) | 4, param_2, iVar1);
                return iVar1;
            }
            lock_arg = (unsigned)(sleep_fixed_33_ticks() >> 32);
        }
    }
    return iVar1;
}

/* ---- ipc_ept_op_c_locked_retry.c ---- */
/* readable reconstruction; identity: FUN_00025850 @ 0x00025850
 * public-name: ipc_ept_op_c_locked_retry
 * durable-map: recon/catalogs/function_names_app.json
 * callees (readable <= raw @ address):
 *   ipc_ept_op_c_locked_retry                <= FUN_00025850 @ 0x00025850
 *   sleep_fixed_33_ticks                     <= FUN_0007c87a @ 0x0007c87a
 *   set_uart_line_ctrl_dtr                   <= FUN_0007c882 @ 0x0007c882
 * address symbols (name @ address):
 *   rodata_9f2be                             @ 0x0009f2be   [INLINED -- G6 literal batch]
 */
/* Reconstructed FUN_00025850 @ 0x25850  (parity: 300/300 trials, PROVEN) */
extern int set_uart_line_ctrl_dtr(int,unsigned,unsigned,int);
int ipc_ept_op_c_locked_retry(int param_1, unsigned param_2, unsigned param_3, int param_4){
    int iVar1;
    if (param_4 == 0){ iVar1 = 0; }
    else {
        int iVar3 = 0x14;
        int iVar4 = *(int*)(param_1 + 4);
        unsigned uVar5 = *(unsigned*)(param_1 + 0x10);
        unsigned lock_arg = param_2;
        while (1){
            FUN_0007c872(uVar5, lock_arg, 0xffffffff, 0xffffffff);
            iVar1 = set_uart_line_ctrl_dtr(iVar4, param_2, param_3, param_4);
            FUN_0007c876(uVar5);
            if (iVar1 == 0) break;
            iVar3 = iVar3 - 1;
            if (iVar3 == 0){
                log_message(((unsigned long)"eeprom_st25dv_write_sys addr %04X offset %04X failed %d\r\n") /*=0x9f2be*/, (*(unsigned short*)(iVar4 + 8)) | 4, param_2, iVar1);
                return iVar1;
            }
            lock_arg = (unsigned)(sleep_fixed_33_ticks() >> 32);
        }
    }
    return iVar1;
}

/* ---- ipc0_ept_recv.c ---- */
/* readable reconstruction; identity: FUN_00025a48 @ 0x00025a48
 * public-name: ipc0_ept_recv
 * durable-map: recon/catalogs/function_names_app.json
 * callees (readable <= raw @ address):
 *   debug_print                              <= FUN_00019c70 @ 0x00019c70
 * address symbols (name @ address):
 *   rodata_9f4a1                             @ 0x0009f4a1   [INLINED -- G6 literal batch]
 *   rodata_9f6e3                             @ 0x0009f6e3   [INLINED -- G6 literal batch]
 *   g_log_level                              @ 0x2000230c
 *   g_log_use_alt_sink                       @ 0x20007554
 *   g_ipc0_endpoint                          @ 0x20007a84
 */
/* Reconstructed ipc0_ept_recv @ 0x25a48  (parity: 300/300 trials, PROVEN) */

void ipc0_ept_recv(unsigned char *param_1,int param_2){
  int iVar4=0;
  unsigned uVar1=*param_1;
  int *piVar3=(int*)(*(volatile int *)((unsigned long)&g_ipc0_endpoint) /*=0x20007a84*/ + 4);
  int iVar2=*piVar3;
  unsigned char *pbVar5;
  while(1){
    if(iVar2<=iVar4){
      if(1 < *(volatile int *)((unsigned long)&g_log_level) /*=0x2000230c*/){
        G1_LOG_ROUTE(*(volatile int *)((unsigned long)&g_log_use_alt_sink) /*=0x20007554*/ == 0, ((unsigned long)"%s(): NOT MATCH(cmd=%x)! ipc_receiver_index: %d, len:%d, received_data: %02x,%02x,%02x,%02x,%02x,%02x,%02x,%02x\n") /*=0x9f4a1*/,((unsigned long)"ipc0_ept_recv") /*=0x9f6e3*/,uVar1,iVar2,param_2,uVar1,(unsigned)param_1[1],(unsigned)param_1[2],(unsigned)param_1[3],(unsigned)param_1[4],(unsigned)param_1[5],(unsigned)param_1[6],(unsigned)param_1[7]);
      }
      return;
    }
    piVar3++;
    pbVar5=(unsigned char*)*piVar3;
    if(pbVar5!=0 && *pbVar5==uVar1) break;
    iVar4++;
  }
  (*(void(*)(int,int,int))*(void**)(pbVar5+8))(*(volatile int *)((unsigned long)&g_ipc0_endpoint) /*=0x20007a84*/ - 0x714, (int)(param_1+1), param_2-1);
}

/* ---- global_ipc_service_send.c ---- */
/* readable reconstruction; identity: FUN_00025b78 @ 0x00025b78
 * public-name: global_ipc_service_send
 * durable-map: recon/catalogs/function_names_app.json
 * callees (readable <= raw @ address):
 *   get_device_info                          <= FUN_000167a8 @ 0x000167a8
 *   debug_print                              <= FUN_00019c70 @ 0x00019c70
 *   sys_reboot                               <= FUN_0004c0a8 @ 0x0004c0a8
 *   ipc_service_send                         <= FUN_0004cc50 @ 0x0004cc50
 *   k_sleep                                  <= FUN_00074844 @ 0x00074844
 * address symbols (name @ address):
 *   rodata_9f576                             @ 0x0009f576   [INLINED -- G6 literal batch]
 *   rodata_9f5a9                             @ 0x0009f5a9   [INLINED -- G6 literal batch]
 *   rodata_9f5ce                             @ 0x0009f5ce   [INLINED -- G6 literal batch]
 *   rodata_9f704                             @ 0x0009f704   [INLINED -- G6 literal batch]
 *   g_log_level                              @ 0x2000230c
 *   g_log_use_alt_sink                       @ 0x20007554
 *   g_ipc_send_fail_cnt                      @ 0x20007a74
 *   g_serialization_ipc_ept                  @ 0x20007a78
 *   g_serialization_ipc_ready                @ 0x20007a80
 */
/* Reconstructed global_ipc_service_send @ 0x25b78  (parity: 300/300 trials, PROVEN) */
extern unsigned long sys_reboot(long);
extern int ipc_service_send(uint32_t, uint32_t, uint32_t);
extern void k_sleep(int, int);

int global_ipc_service_send(unsigned int param_1, unsigned int param_2)
{
    volatile int *piVar1;
    volatile int *piVar2;
    int iVar3;
    int iVar4;

    if ((*(volatile int *)((unsigned long)&g_serialization_ipc_ready) /*=0x20007a80*/ == 1)) {
        char *r0 = (char*)get_device_info();
        if (r0[1] != 8) {
            r0 = (char*)get_device_info();
            if (r0[1] != 9) {
                iVar3 = ipc_service_send(((unsigned long)&g_serialization_ipc_ept) /*=0x20007a78*/, param_1, param_2);
                piVar2 = (volatile int*)((unsigned long)&g_log_level) /*=0x2000230c*/;
                piVar1 = (volatile int*)((unsigned long)&g_ipc_send_fail_cnt) /*=0x20007a74*/;
                if (iVar3 < 0) {
                    if (0 < *piVar2) {
                        if (*(volatile int *)((unsigned long)&g_log_use_alt_sink) /*=0x20007554*/ == 0) {
                            goto lab_debug_1;
                        }
                        debug_print(((unsigned long)"%s(): ipc_service_send data failed with ret %d %d\n") /*=0x9f576*/, ((unsigned long)"global_ipc_service_send") /*=0x9f704*/, iVar3, *piVar1);
                    }
                    while (iVar4 = *piVar1 + 1, *piVar1 = iVar4, 2 < iVar4) {
                        if (0 < *piVar2) {
                            G1_LOG_ROUTE(*(volatile int *)((unsigned long)&g_log_use_alt_sink) /*=0x20007554*/ == 0, ((unsigned long)"%s(): sys reboot because ipc failed\n") /*=0x9f5a9*/, ((unsigned long)"global_ipc_service_send") /*=0x9f704*/);
                        }
                        k_sleep(0x4000, 0);
                        sys_reboot(1);
lab_debug_1:
                        log_message(((unsigned long)"%s(): ipc_service_send data failed with ret %d %d\n") /*=0x9f576*/, ((unsigned long)"global_ipc_service_send") /*=0x9f704*/, iVar3);
                    }
                    return iVar3;
                }
                *piVar1 = 0;
                return iVar3;
            }
        }
    }
    if (0 < *(volatile int *)((unsigned long)&g_log_level) /*=0x2000230c*/) {
        G1_LOG_ROUTE(*(volatile int *)((unsigned long)&g_log_use_alt_sink) /*=0x20007554*/ == 0, ((unsigned long)"%s(): ipc_service not ready!\n") /*=0x9f5ce*/, ((unsigned long)"global_ipc_service_send") /*=0x9f704*/);
    }
    return -1;
}

/* ---- register_ipc_service_context.c ---- */
/* readable reconstruction; identity: FUN_00025d40 @ 0x00025d40
 * public-name: register_ipc_service_context
 * durable-map: recon/catalogs/function_names_app.json
 * callees (readable <= raw @ address):
 *   debug_print                              <= FUN_00019c70 @ 0x00019c70
 * address symbols (name @ address):
 *   rodata_25ae9                             @ 0x00025ae9
 *   ADDR_global_ipc_service_send_THUMB       @ 0x00025b79
 *   rodata_9af2e                             @ 0x0009af2e   [INLINED -- G6 literal batch]
 *   rodata_9f6c6                             @ 0x0009f6c6   [INLINED -- G6 literal batch]
 *   g_log_level                              @ 0x2000230c
 *   g_log_use_alt_sink                       @ 0x20007554
 *   g_ipc0_endpoint                          @ 0x20007a84
 */
/* Reconstructed register_ipc_service_context @ 0x25d40  (parity: 300/300 trials, PROVEN) */

unsigned int register_ipc_service_context(int param_1,unsigned int param_2,unsigned int param_3,unsigned int param_4){
    *(unsigned int*)(param_1+0x60) = ADDR_global_ipc_service_send_THUMB /*=0x25b79*/;
    /* iteration 4: was ((unsigned long)&rodata_25ae9), the pinned 0x25ae9 --
     * an unrelocated original-image code pointer.  0x25ae8 is the IPC-service
     * registrar, now reconstructed as register_ipc_service_recv_callback and
     * bound through the pointer_rebind.md __asm__-alias so the reference is a
     * real R_ARM_ABS32 (gc-retention is relocation-backed, like the sibling
     * slot above). */
    *(unsigned int*)(param_1+0x64) = ADDR_register_ipc_service_recv_callback_THUMB /*=0x25ae9*/;
    *(volatile unsigned int *)((unsigned long)&g_ipc0_endpoint) /*=0x20007a84*/ = (unsigned int)param_1;
    if(*(volatile int *)((unsigned long)&g_log_level) /*=0x2000230c*/ > 1){
        unsigned int sink=*(volatile unsigned int *)((unsigned long)&g_log_use_alt_sink) /*=0x20007554*/;
        G1_LOG_ROUTE(sink==0, ((unsigned long)"%s(): exit\n\n") /*=0x9af2e*/,((unsigned long)"register_ipc_service_context") /*=0x9f6c6*/,param_3,sink,param_4);
    }
    return 0;
}

/* ---- pt_comm_transport_write.c ---- */
/* readable reconstruction; identity: FUN_00030cd0 @ 0x00030cd0
 * public-name: pt_comm_transport_write
 * durable-map: recon/catalogs/function_names_app.json
 * callees (readable <= raw @ address):
 *   transport_parameters_write               <= FUN_00025950 @ 0x00025950
 *   pt_comm_transport_write                  <= FUN_00030cd0 @ 0x00030cd0
 *   packet_transport_send_byte               <= FUN_0003364c @ 0x0003364c
 * address symbols (name @ address):
 *   rodata_a6589                             @ 0x000a6589
 */
/* Reconstructed FUN_00030cd0 @ 0x30cd0  true code extent: 0x3a bytes */

extern uint32_t transport_parameters_write(int, uint8_t *, int, int);
extern uint32_t packet_transport_send_byte(int, uint8_t *, int, int);

uint32_t pt_comm_transport_write(int operation, int context, uint8_t *buffer, int length)
{
    if (context == 0 || buffer == 0 || length == 0 || operation == 2) {
        log_message(((unsigned long)&rodata_a6589) /*=0xa6589*/);
        return UINT32_MAX;
    }

    if (operation == 0)
        return transport_parameters_write(context, buffer, length, length);
    if (operation == 1)
        return packet_transport_send_byte(context, buffer, length, length);
    return 0;
}

/* ---- getStocksIndex.c ---- */
/* readable reconstruction; identity: FUN_000370bc @ 0x000370bc
 * public-name: getStocksIndex
 * durable-map: recon/catalogs/function_names_app.json
 * callees (readable <= raw @ address):
 *   debug_print                              <= FUN_00019c70 @ 0x00019c70
 * address symbols (name @ address):
 *   rodata_a8ff3                             @ 0x000a8ff3   [INLINED -- G6 literal batch]
 *   rodata_a95d8                             @ 0x000a95d8   [INLINED -- G6 literal batch]
 *   g_log_level                              @ 0x2000230c
 *   g_dashboard_widget_state                 @ 0x20004950
 *   g_log_use_alt_sink                       @ 0x20007554
 *   g_stocks_widget_index_raw                @ 0x2001b815
 */
/* Reconstructed getStocksIndex @ 0x370bc  (parity: 300/300 trials, PROVEN) */


unsigned long getStocksIndex(void) {
    volatile unsigned char *base = (volatile unsigned char*)((unsigned long)&g_dashboard_widget_state) /*=0x20004950*/;
    int iVar2 = *(volatile int *)((unsigned long)&g_log_level) /*=0x2000230c*/;
    unsigned char b = *(volatile unsigned char *)((unsigned long)&g_stocks_widget_index_raw) /*=0x2001b815*/;
    base[3] = b;
    if (iVar2 > 2) {
        G1_LOG_ROUTE(*(volatile int *)((unsigned long)&g_log_use_alt_sink) /*=0x20007554*/ == 0, ((unsigned long)"%s():  %s index = %d\n") /*=0xa8ff3*/, ((unsigned long)"getStocksIndex") /*=0xa95d8*/, ((unsigned long)"getStocksIndex") /*=0xa95d8*/, b);
    }
    return base[3];
}

/* ---- getNewsIndex.c ---- */
/* readable reconstruction; identity: FUN_0003719c @ 0x0003719c
 * public-name: getNewsIndex
 * durable-map: recon/catalogs/function_names_app.json
 * callees (readable <= raw @ address):
 *   debug_print                              <= FUN_00019c70 @ 0x00019c70
 * address symbols (name @ address):
 *   rodata_a8ff3                             @ 0x000a8ff3   [INLINED -- G6 literal batch]
 *   rodata_a95ab                             @ 0x000a95ab   [INLINED -- G6 literal batch]
 *   g_log_level                              @ 0x2000230c
 *   g_dashboard_widget_state                 @ 0x20004950
 *   g_log_use_alt_sink                       @ 0x20007554
 *   g_news_widget_index_raw                  @ 0x2001b814
 */
/* Reconstructed getNewsIndex @ 0x3719c  (parity: 300/300 trials, PROVEN) */


unsigned long getNewsIndex(void) {
    volatile unsigned char *base = (volatile unsigned char*)((unsigned long)&g_dashboard_widget_state) /*=0x20004950*/;
    int iVar2 = *(volatile int *)((unsigned long)&g_log_level) /*=0x2000230c*/;
    unsigned char b = *(volatile unsigned char *)((unsigned long)&g_news_widget_index_raw) /*=0x2001b814*/;
    base[5] = b;
    if (iVar2 > 2) {
        G1_LOG_ROUTE(*(volatile int *)((unsigned long)&g_log_use_alt_sink) /*=0x20007554*/ == 0, ((unsigned long)"%s():  %s index = %d\n") /*=0xa8ff3*/, ((unsigned long)"getNewsIndex") /*=0xa95ab*/, ((unsigned long)"getNewsIndex") /*=0xa95ab*/, b);
    }
    return base[5];
}

/* ================================================================ */
/* member unit: g1_ipc_07.c */
/* ================================================================ */
/*
 * Cohesive translation unit for the `ipc' module.
 *
 * GENERATED by recon/refactor/transforms/t04_cohesive_tu.py.  Do not
 * edit: a stage tree is regenerated, never hand-patched
 * (recon/refactor/README.md C4).
 *
 * The 8 functions below were 8 separate translation units until this
 * stage.  Each one's text is reproduced VERBATIM and in the order the
 * generated source list gave it, and they were CONSECUTIVE in that list.
 * They were proven able to share a translation unit: no symbol is
 * declared here with two types, no identifier has internal linkage in one
 * member and is named by another, and no local typedef, macro, struct tag
 * or enum constant of one member is visible to a member that names it.
 *
 * members, in link order:
 *   st25dv_ipc_request_chip_ids.c
 *   nfc_ipc_send_op20.c
 *   st25dv_ipc_request.c
 *   ipc_read_u16_field.c
 *   st25dv_mailbox_send_id_pair.c
 *   send_box_event_ipc.c
 *   ipc_send_byte_cmd2002.c
 *   ipc_send_packet_ch2005.c
 */
/* ---- st25dv_ipc_request_chip_ids.c ---- */
#include "g1_app_symbols.h"
#include <stdint.h>
#include "g1_ipc.h"
/* readable reconstruction; identity: FUN_0007c932 @ 0x0007c932
 * public-name: st25dv_ipc_request_chip_ids
 * durable-map: recon/catalogs/function_names_app.json
 * callees (readable <= raw @ address):
 *   ipc_ept_op_b_locked_retry                <= FUN_000257ec @ 0x000257ec
 *   st25dv_ipc_request_chip_ids              <= FUN_0007c932 @ 0x0007c932
 */
/* Reconstructed FUN_0007c932 @ 0x7c932  (parity: 300/300 trials, PROVEN) */

extern int ipc_ept_op_b_locked_retry(int, unsigned int, unsigned int, int);

unsigned int st25dv_ipc_request_chip_ids(unsigned int param_1, int param_2)
{
    if (param_2 != 0) {
        return ipc_ept_op_b_locked_retry(param_1, 0x18, param_2, 8);
    }
    return 0xffffffea;
}

/* ---- nfc_ipc_send_op20.c ---- */
/* readable reconstruction; identity: FUN_0007c944 @ 0x0007c944
 * public-name: nfc_ipc_send_op20
 * durable-map: recon/catalogs/function_names_app.json
 * callees (readable <= raw @ address):
 *   ipc_ept_op_b_locked_retry                <= FUN_000257ec @ 0x000257ec
 *   nfc_ipc_send_op20                        <= FUN_0007c944 @ 0x0007c944
 */
/* Reconstructed FUN_0007c944 @ 0x7c944  (parity: 300/300 trials, PROVEN) */


unsigned int nfc_ipc_send_op20(unsigned int param_1, int param_2)
{
    if (param_2 != 0) {
        return ipc_ept_op_b_locked_retry(param_1, 0x20, param_2, 1);
    }
    return 0xffffffea;
}

/* ---- st25dv_ipc_request.c ---- */
/* readable reconstruction; identity: FUN_0007c956 @ 0x0007c956
 * public-name: st25dv_ipc_request
 * durable-map: recon/catalogs/function_names_app.json
 * callees (readable <= raw @ address):
 *   ipc_ept_op_b_locked_retry                <= FUN_000257ec @ 0x000257ec
 *   st25dv_ipc_request                       <= FUN_0007c956 @ 0x0007c956
 */
/* Reconstructed FUN_0007c956 @ 0x7c956  (parity: 300/300 trials, PROVEN) */


unsigned int st25dv_ipc_request(unsigned int param_1, int param_2)
{
    if (param_2 != 0) {
        return ipc_ept_op_b_locked_retry(param_1, 0x17, param_2, 1);
    }
    return 0xffffffea;
}

/* ---- ipc_read_u16_field.c ---- */
/* readable reconstruction; identity: FUN_0007c968 @ 0x0007c968
 * public-name: ipc_read_u16_field
 * durable-map: recon/catalogs/function_names_app.json
 * callees (readable <= raw @ address):
 *   ipc_ept_op_b_locked_retry                <= FUN_000257ec @ 0x000257ec
 *   ipc_read_u16_field                       <= FUN_0007c968 @ 0x0007c968
 */
/* Reconstructed FUN_0007c968 @ 0x7c968  (parity: 300/300 trials, PROVEN) */


int ipc_read_u16_field(unsigned int param_1, unsigned int *param_2, unsigned int param_3)
{
  int iVar1;
  unsigned short local_14 = 0;
  if (param_2 == 0) {
    iVar1 = -0x16;
  } else {
    iVar1 = ipc_ept_op_b_locked_retry(param_1, 0x14, &local_14, 2);
    if (iVar1 == 0) {
      *(unsigned short *)((char *)param_2 + 2) = local_14;
      iVar1 = ipc_ept_op_b_locked_retry(param_1, 0x16, (void *)param_2, 1);
    }
  }
  return iVar1;
}

/* ---- st25dv_mailbox_send_id_pair.c ---- */
/* readable reconstruction; identity: FUN_0007c99e @ 0x0007c99e
 * public-name: st25dv_mailbox_send_id_pair
 * durable-map: recon/catalogs/function_names_app.json
 * callees (readable <= raw @ address):
 *   ipc_ept_op_c_locked_retry                <= FUN_00025850 @ 0x00025850
 *   st25dv_mailbox_send_id_pair              <= FUN_0007c99e @ 0x0007c99e
 *   memset_bytes                             <= FUN_00086c78 @ 0x00086c78
 */
/* Reconstructed FUN_0007c99e @ 0x7c99e  (parity: 300/300 trials, PROVEN) */
extern int ipc_ept_op_c_locked_retry(int, unsigned int, unsigned int, int);
void st25dv_mailbox_send_id_pair(int param_1, uint32_t *param_2){
  uint8_t s[28];
  *(volatile uint32_t *)(s+0) = 0;
  memset_bytes(s+4, 0, 0xd);
  uint32_t uVar6 = param_2[0];
  uint32_t uVar5 = param_2[1];
  s[8] = 9;
  uint32_t shift = 0x18;
  int k=0;
  do {
    uint8_t A = (uint8_t)(uVar6 >> shift);
    uint8_t B = (uint8_t)(uVar5 >> shift);
    s[k]    = A;
    s[k+4]  = B;
    s[k+9]  = A;
    s[k+13] = B;
    shift -= 8;
    k++;
  } while(shift != 0xfffffff8);
  ipc_ept_op_c_locked_retry(param_1, 0x900, s, 0x11);
}

/* ---- send_box_event_ipc.c ---- */
/* readable reconstruction; identity: FUN_0007c9f2 @ 0x0007c9f2
 * public-name: send_box_event_ipc
 * durable-map: recon/catalogs/function_names_app.json
 * callees (readable <= raw @ address):
 *   ipc_send_len_prefixed_packet_locked_retry <= FUN_00025788 @ 0x00025788
 *   send_box_event_ipc                       <= FUN_0007c9f2 @ 0x0007c9f2
 */
/* Reconstructed FUN_0007c9f2 @ 0x7c9f2  (parity: 300/300 trials, PROVEN) */

extern int ipc_send_len_prefixed_packet_locked_retry(unsigned long, unsigned long, void*, unsigned long);
void send_box_event_ipc(unsigned int param_1,unsigned int param_2)
{
  ipc_send_len_prefixed_packet_locked_retry(param_1,0x2002,param_2,1);
  return;
}

/* ---- ipc_send_byte_cmd2002.c ---- */
/* readable reconstruction; identity: FUN_0007c9fe @ 0x0007c9fe
 * public-name: ipc_send_byte_cmd2002
 * durable-map: recon/catalogs/function_names_app.json
 * callees (readable <= raw @ address):
 *   ipc_ept_op_a_locked_retry                <= FUN_000256dc @ 0x000256dc
 *   ipc_send_byte_cmd2002                    <= FUN_0007c9fe @ 0x0007c9fe
 */
/* Reconstructed FUN_0007c9fe @ 0x7c9fe  (parity: 300/300 trials, PROVEN) */

extern void ipc_ept_op_a_locked_retry(unsigned int,unsigned int,void*,unsigned int,unsigned int,unsigned int);
void ipc_send_byte_cmd2002(unsigned int param_1,unsigned int param_2)
{
  unsigned char b = (unsigned char)param_2;
  ipc_ept_op_a_locked_retry(param_1,0x2002,&b,1,param_1,param_2);
}

/* ---- ipc_send_packet_ch2005.c ---- */
/* readable reconstruction; identity: FUN_0007ca18 @ 0x0007ca18
 * public-name: ipc_send_packet_ch2005
 * durable-map: recon/catalogs/function_names_app.json
 * callees (readable <= raw @ address):
 *   ipc_send_len_prefixed_packet_locked_retry <= FUN_00025788 @ 0x00025788
 *   ipc_send_packet_ch2005                   <= FUN_0007ca18 @ 0x0007ca18
 */
/* Reconstructed FUN_0007ca18 @ 0x7ca18  (parity: 300/300 trials, PROVEN) */

void ipc_send_packet_ch2005(unsigned int param_1,unsigned int param_2)
{
  ipc_send_len_prefixed_packet_locked_retry(param_1,0x2005,param_2,1);
  return;
}

