/*
 * Cohesive translation unit for the `ipc' module.
 *
 * GENERATED by recon/refactor/transforms/t04_cohesive_tu.py.  Do not
 * edit: a stage tree is regenerated, never hand-patched
 * (recon/refactor/README.md C4).
 *
 * The 10 functions below were 10 separate translation units until this
 * stage.  Each one's text is reproduced VERBATIM and in the order the
 * generated source list gave it, and they were CONSECUTIVE in that list.
 * They were proven able to share a translation unit: no symbol is
 * declared here with two types, no identifier has internal linkage in one
 * member and is named by another, and no local typedef, macro, struct tag
 * or enum constant of one member is visible to a member that names it.
 *
 * members, in link order:
 *   serialization_register_endpoint.c
 *   ipc_rpmsg_backend_register.c
 *   mbox_nrf_send.c
 *   pt_write_frame_type3.c
 *   ipc_transport_ops_dispatch.c
 *   sleep_fixed_33_ticks.c
 *   set_uart_line_ctrl_dtr.c
 *   json_arr_encode.c
 *   st25dv_ipc_send_byte.c
 *   ipc_ept_op_b_guarded.c
 */

/* File-scope forward declarations for every struct/union tag this
 * unit names.  Without them a tag whose only appearance in a member
 * is inside a parameter list has PARAMETER-LIST scope, so two
 * textually IDENTICAL declarations in two members declare two
 * different incomplete types and the second is a conflicting
 * redeclaration (C11 6.2.1p7).  Incomplete-type forward
 * declarations emit no code. */
struct k_work;
struct k_work_q;
/* ---- serialization_register_endpoint.c ---- */
#include "g1_app_symbols.h"
/* readable reconstruction; identity: FUN_0004cbec @ 0x0004cbec
 * public-name: serialization_register_endpoint
 * durable-map: recon/catalogs/function_names_app.json
 * callees (readable <= raw @ address):
 *   serialization_register_endpoint          <= FUN_0004cbec @ 0x0004cbec
 *   ipc_log_forward                          <= FUN_0007e9ea @ 0x0007e9ea
 * address symbols (name @ address):
 *   rodata_881d8                             @ 0x000881d8
 *   rodata_f0c14                             @ 0x000f0c14
 *   rodata_f0c32                             @ 0x000f0c32
 */
/* Reconstructed FUN_0004cbec @ 0x4cbec  (parity: 300/300 trials, PROVEN) */
#include <stdint.h>
extern int ipc_log_forward(int,int,void*);
uint32_t serialization_register_endpoint(int param_1, int *param_2, int param_3){
  uint32_t local[2];
  if(param_1==0 || param_2==0 || param_3==0){
    local[1] = ((unsigned long)&rodata_f0c32) /*=0xf0c32*/;
    local[0] = 2;
    ipc_log_forward(((unsigned long)&rodata_881d8) /*=0x881d8*/, 0x1040, local);
    return 0xffffffea;
  }
  int iVar2 = *(volatile int *)(param_1+8);
  if(iVar2 != 0 && *(volatile int *)(iVar2+0xc) != 0){
    *param_2 = param_1;
    uint32_t fp = *(volatile uint32_t *)(iVar2+0xc);
    /* DEFECT FIX (P4 iteration 7) — the third argument was dropped.
     * This is `ipc_service_register_endpoint(instance, ept, cfg)`; the backend
     * vtable slot at +0xc is `register_endpoint(instance, &ept->token, cfg)`.
     * ORIGINAL bytes (app_update.bin @0x4cc34, r2 never written since entry):
     *     4cc34: str.w r0,[r1],#4          ; ept->instance = instance
     *     4cc38: ldr   r3,[r4,#12]         ; backend->register_endpoint
     *     4cc3a: add   sp,#28
     *     4cc3c: ldmia.w sp!,{r4,r5,lr}
     *     4cc40: bx    r3                  ; r0=instance r1=&ept->token r2=cfg
     * The recovered form called it with two arguments, so r2 carried whatever
     * the caller happened to leave there and `cfg` was garbage.  tools/parity
     * and cfg_verify cannot see this class (callees are order-keyed oracles
     * that ignore arguments) — same family as iteration 5 §3(b) and the net
     * core's FUN_0102d558 in iteration 6 §4. */
    return ((uint32_t(*)(int,int*,int))(uintptr_t)fp)(param_1, param_2+1, param_3);
  }
  local[1] = ((unsigned long)&rodata_f0c14) /*=0xf0c14*/;
  local[0] = 2;
  ipc_log_forward(((unsigned long)&rodata_881d8) /*=0x881d8*/, 0x1040, local);
  return 0xfffffffb;
}

/* ---- ipc_rpmsg_backend_register.c ---- */
struct k_work_q;
struct k_work;
/* readable reconstruction; identity: FUN_0004cd4c @ 0x0004cd4c
 * public-name: ipc_rpmsg_backend_register
 * durable-map: recon/catalogs/function_names_app.json
 * callees (readable <= raw @ address):
 *   ipc_rpmsg_backend_register               <= FUN_0004cd4c @ 0x0004cd4c
 *   rpmsg_virtio_init_vdev                   <= FUN_0004d100 @ 0x0004d100
 *   ipc_static_vrings_init                   <= FUN_0004d170 @ 0x0004d170
 *   sync_buffer_available_space              <= FUN_00071314 @ 0x00071314
 *   k_work_init                              <= FUN_00072e50 @ 0x00072e50
 *   k_work_queue_init                        <= FUN_000730b4 @ 0x000730b4
 *   k_work_queue_start                       <= FUN_000730e8 @ 0x000730e8
 *   atomic_set                               <= FUN_0007eb4e @ 0x0007eb4e
 *   shm_size                                 <= FUN_0007ebee @ 0x0007ebee
 * address symbols (name @ address):
 *   ADDR_bound_cb_THUMB                      @ 0x0004cefd
 *   rodata_7eb11                             @ 0x0007eb11
 *   rodata_7eb1d                             @ 0x0007eb1d
 *   rodata_7eb37                             @ 0x0007eb37
 *   ADDR_FUN_0007eb7e_THUMB                  @ 0x0007eb7f
 *   ADDR_ept_cb_THUMB                        @ 0x0007ecc5
 */
/* Full reconstruction of FUN_0004cd4c @ 0x4cd4c (404 bytes). */

extern uint64_t shm_size(uint32_t, uint32_t);
extern int32_t ipc_static_vrings_init(uintptr_t, uint32_t);
extern void k_work_queue_init(struct k_work_q *);
extern void k_work_queue_start(uintptr_t, uintptr_t, uint32_t, uint32_t, uint32_t);
extern void k_work_init(struct k_work *, void (*)(struct k_work *));
extern int32_t rpmsg_virtio_init_vdev(uintptr_t, uint32_t, uint32_t, uint32_t,
                           uintptr_t, uint32_t, uint32_t, uintptr_t);
extern int32_t sync_buffer_available_space(uintptr_t);
extern void atomic_set(volatile uint32_t *, uint32_t);

typedef int32_t (*open_fn)(uintptr_t, uint32_t, uintptr_t, uintptr_t);
typedef int32_t (*enable_fn)(uintptr_t, uint32_t, uint32_t);

static int32_t ipc_rpmsg_backend_register(uintptr_t context)
{
    uintptr_t runtime = *(volatile uintptr_t *)(context + 0x10);
    uintptr_t config = *(volatile uintptr_t *)(context + 4);
    volatile uint32_t *busy = (volatile uint32_t *)(runtime + 0x3bc);
    uint32_t expected = 0;
    if (!__atomic_compare_exchange_n(busy, &expected, 1, 0,
                                     __ATOMIC_ACQ_REL, __ATOMIC_ACQUIRE))
        return -120;

    uint32_t slots = 1;
    uint32_t available = *(volatile uint32_t *)(config + 8) - 4u;
    uint32_t quantum = *(volatile uint32_t *)(config + 0x28);
    while ((uint32_t)shm_size(slots, quantum) < available)
        ++slots;

    int32_t result;
    if (slots == 1) {
        result = -12;
    } else {
        uint32_t lanes = 0x80000000u >> __builtin_clz(slots - 1u);
        uint32_t header = (*(volatile uint32_t *)(config + 4) + 7u) & ~3u;
        *(volatile uint32_t *)(runtime + 0x260) = header;
        *(volatile uint32_t *)(runtime + 0x264) = (uint32_t)shm_size(lanes, quantum);
        uint32_t payload = header + (((lanes * quantum + 3u) & ~3u) << 1);
        *(volatile uint32_t *)(runtime + 0x258) = payload;
        *(volatile uint32_t *)(runtime + 0x254) =
            payload + ((lanes * 18u + 9u) & ~3u) + lanes * 8u + 8u;
        *(volatile uint32_t *)(runtime + 0x25c) = lanes;
        *(volatile uint32_t *)(runtime + 0x250) = *(volatile uint32_t *)(config + 4);
        *(volatile uintptr_t *)(runtime + 0x2a4) = config;
        *(volatile uintptr_t *)(runtime + 0x2a8) = ((unsigned long)&rodata_7eb37) /*=0x7eb37*/;

        result = ipc_static_vrings_init(runtime + 0x1c8, *(volatile uint32_t *)config);
        if (result == 0) {
            uint32_t buffer_size = *(volatile uint32_t *)(config + 0x20);
            if (*(volatile uint32_t *)(config + 0x1c) == 1)
                buffer_size -= 0x10;
            k_work_queue_init(runtime + 0x2c0);
            k_work_queue_start(runtime + 0x2c0,
                         0x2002a268u + (*(volatile uint32_t *)(config + 0x24) << 10),
                         0x400, buffer_size, 0);
            k_work_init(runtime + 0x2b0, ((unsigned long)&rodata_7eb1d) /*=0x7eb1d*/);

            uintptr_t device = *(volatile uintptr_t *)(config + 0x14);
            uintptr_t ops = *(volatile uintptr_t *)(device + 8);
            open_fn open = *(open_fn *)(ops + 4);
            if (!open) {
                result = -88;
            } else {
                result = open(device, *(volatile uint32_t *)(config + 0x18),
                              ((unsigned long)&rodata_7eb11) /*=0x7eb11*/, runtime);
                if (result == 0) {
                    enable_fn enable = *(enable_fn *)(ops + 0x10);
                    if (!enable) {
                        result = -88;
                    } else {
                        result = enable(device, *(volatile uint32_t *)(config + 0x18), 1);
                        if (result == 0) {
                            *(volatile uintptr_t *)(runtime + 0x1a8) = ADDR_bound_cb_THUMB /*=0x4cefd*/;
                            *(volatile uintptr_t *)(runtime + 0x1ac) = ADDR_ept_cb_THUMB /*=0x7ecc5*/;
                            result = rpmsg_virtio_init_vdev(runtime,
                                *(volatile uint32_t *)(runtime + 0x3b8), quantum,
                                *(volatile uint32_t *)(runtime + 0x268), runtime + 0x1c8,
                                *(volatile uint32_t *)(runtime + 0x208),
                                *(volatile uint32_t *)(runtime + 0x210), ADDR_FUN_0007eb7e_THUMB /*=0x7eb7f*/);
                            if (result == 0) {
                                int32_t handle = sync_buffer_available_space(runtime + 0xe0);
                                *(volatile int32_t *)(runtime + 0x3c0) = handle;
                                result = handle < 0 ? -22 : 0;
                            }
                        }
                    }
                }
            }
        }
    }
    atomic_set(busy, result == 0 ? 2u : 0u);
    return result;
}

/* ---- mbox_nrf_send.c ---- */
#include "g1_ipc.h"
/* readable reconstruction; identity: FUN_00061c40 @ 0x00061c40
 * public-name: mbox_nrf_send
 * durable-map: recon/catalogs/function_names_app.json
 * callees (readable <= raw @ address):
 *   z_log_msg_runtime_create                 <= FUN_0004d944 @ 0x0004d944
 *   mbox_nrf_send                            <= FUN_00061c40 @ 0x00061c40
 * address symbols (name @ address):
 *   rodata_881f8                             @ 0x000881f8
 *   rodata_f60c5                             @ 0x000f60c5
 */
/* Reconstructed FUN_00061c40 @ 0x61c40  (parity: 300/300 trials, PROVEN) */


unsigned int mbox_nrf_send(int param_1, unsigned int param_2, int param_3)
{
  unsigned int uVar1;

  if (param_3 != 0) {
    struct {
      unsigned int severity;
      unsigned int message;
    } diagnostic = {2, ((unsigned long)&rodata_f60c5) /*=0xf60c5*/};
    z_log_msg_runtime_create((void*)((unsigned long)&rodata_881f8) /*=0x881f8*/, 0x1080, &diagnostic, 0);
  }
  if (param_2 < 0x10 && ((int)((*(unsigned int*)(*(int*)(param_1+4)+4) >> (param_2 & 0xff)) << 0x1f) < 0)) {
    uVar1 = 0;
    *(volatile unsigned int *)(0x5002a000UL + ((param_2 & 0x3f)*4)) = 1;
  } else {
    uVar1 = 0xffffffea;
  }
  return uVar1;
}

/* ---- pt_write_frame_type3.c ---- */
/* readable reconstruction; identity: FUN_0007c3d0 @ 0x0007c3d0
 * public-name: pt_write_frame_type3
 * durable-map: recon/catalogs/function_names_app.json
 * callees (readable <= raw @ address):
 *   packet_transport_write_frame             <= FUN_00024e60 @ 0x00024e60
 *   pt_write_frame_type3                     <= FUN_0007c3d0 @ 0x0007c3d0
 */
/* Reconstructed FUN_0007c3d0 @ 0x7c3d0.
 * Complete ten-byte argument-shuffling tail wrapper; 0x7c3da starts the next
 * function.  Bit zero in 0x24e61 selects Thumb state for the 0x24e60 target. */
extern int packet_transport_write_frame(unsigned type, unsigned first, unsigned second);

int pt_write_frame_type3(unsigned first, unsigned second)
{
    return packet_transport_write_frame(3, first, second);
}

/* ---- ipc_transport_ops_dispatch.c ---- */
/* readable reconstruction; identity: FUN_0007c85e @ 0x0007c85e
 * public-name: ipc_transport_ops_dispatch
 * durable-map: recon/catalogs/function_names_app.json
 * callees (readable <= raw @ address):
 *   ipc_transport_ops_dispatch               <= FUN_0007c85e @ 0x0007c85e
 */
/* Full reconstruction FUN_0007c85e @ 0x7c85e (exact extent 14 bytes). */
typedef int (*transfer_callback_t)(uint8_t *, void *, uint32_t, uint32_t);

int ipc_transport_ops_dispatch(unsigned char*object, void*parts, unsigned int count, unsigned int operation) {
    uint8_t *vtable = *(uint8_t **)(object + 8);
    transfer_callback_t callback = *(transfer_callback_t *)(vtable + 8);
    return callback(object, parts, count, operation);
}

/* ---- sleep_fixed_33_ticks.c ---- */
/* readable reconstruction; identity: FUN_0007c87a @ 0x0007c87a
 * public-name: sleep_fixed_33_ticks
 * durable-map: recon/catalogs/function_names_app.json
 * callees (readable <= raw @ address):
 *   k_sleep                                  <= FUN_00074844 @ 0x00074844
 *   sleep_fixed_33_ticks                     <= FUN_0007c87a @ 0x0007c87a
 */
/* Reconstructed FUN_0007c87a @ 0x7c87a  (parity: 300/300 trials, PROVEN) */

extern int32_t k_sleep(k_timeout_t);
void sleep_fixed_33_ticks(void)
{
    k_sleep(0x21, 0);
}

/* ---- set_uart_line_ctrl_dtr.c ---- */
/* readable reconstruction; identity: FUN_0007c882 @ 0x0007c882
 * public-name: set_uart_line_ctrl_dtr
 * durable-map: recon/catalogs/function_names_app.json
 * callees (readable <= raw @ address):
 *   dev_send_cmd16_payload                   <= FUN_00025670 @ 0x00025670
 *   set_uart_line_ctrl_dtr                   <= FUN_0007c882 @ 0x0007c882
 */
/* Reconstructed FUN_0007c882 @ 0x7c882  (parity: 300/300 trials, PROVEN) */

extern void dev_send_cmd16_payload(void*, unsigned int, unsigned int, unsigned int, unsigned int, unsigned int);

void set_uart_line_ctrl_dtr(void *param_1, unsigned int param_2, unsigned int param_3, unsigned int param_4)
{
    dev_send_cmd16_payload(param_1, (*(volatile unsigned short *)((char*)param_1 + 8)) | 4, param_2, param_3, param_4, param_2);
}

/* ---- json_arr_encode.c ---- */
/* readable reconstruction; identity: FUN_0007c898 @ 0x0007c898
 * public-name: json_arr_encode
 * durable-map: recon/catalogs/function_names_app.json
 * callees (readable <= raw @ address):
 *   ipc_send_len_prefixed_packet             <= FUN_00025740 @ 0x00025740
 *   json_arr_encode                          <= FUN_0007c898 @ 0x0007c898
 */
/* Reconstructed FUN_0007c898 @ 0x7c898  (parity: 300/300 trials, PROVEN) */

extern int ipc_send_len_prefixed_packet(int a, int b, int c, int d, int e, int f);
void json_arr_encode(unsigned int *param_1, int param_2, int param_3, int param_4) {
    unsigned short h = *(unsigned short*)((char*)param_1 + 8);
    ipc_send_len_prefixed_packet(*param_1, (int)(h | 4), param_2, param_3, param_4, param_2);
}

/* ---- st25dv_ipc_send_byte.c ---- */
/* readable reconstruction; identity: FUN_0007c8d0 @ 0x0007c8d0
 * public-name: st25dv_ipc_send_byte
 * durable-map: recon/catalogs/function_names_app.json
 * callees (readable <= raw @ address):
 *   ipc_ept_op_c_locked_retry                <= FUN_00025850 @ 0x00025850
 *   st25dv_ipc_send_byte                     <= FUN_0007c8d0 @ 0x0007c8d0
 */
/* Reconstructed FUN_0007c8d0 @ 0x7c8d0  (parity: 300/300 trials, PROVEN) */

extern int ipc_ept_op_c_locked_retry(int a,int b,void*c,int d,int e,int f);
void st25dv_ipc_send_byte(int param_1, int param_2) {
    unsigned char local = (unsigned char)param_2;
    ipc_ept_op_c_locked_retry(param_1, 0, &local, 1, param_1, param_2);
}

/* ---- ipc_ept_op_b_guarded.c ---- */
/* readable reconstruction; identity: FUN_0007c8e8 @ 0x0007c8e8
 * public-name: ipc_ept_op_b_guarded
 * durable-map: recon/catalogs/function_names_app.json
 * callees (readable <= raw @ address):
 *   ipc_ept_op_b_locked_retry                <= FUN_000257ec @ 0x000257ec
 *   ipc_ept_op_b_guarded                     <= FUN_0007c8e8 @ 0x0007c8e8
 */
/* Reconstructed FUN_0007c8e8 @ 0x7c8e8  (parity: 300/300 trials, PROVEN) */

/* BRING-UP WIRING FIX (P4 iteration 32) -- dropped register argument.  The
 * shipped body at 0x7c8e8 is `mov r2,r1 ; cbz r1 ; movs r3,#1 ; mov r1,r3 ;
 * b.w 0x257ec`, i.e. a FOUR-argument tail call whose r3 = 1 is the read
 * LENGTH that FUN_000257ec forwards to FUN_00025740 as i2c_msg[1].len.  The
 * reconstruction declared three parameters and dropped r3; the resulting
 * garbage length tripped NRFX_ASSERT(TWIM_LENGTH_VALIDATE) at
 * nrfx_twim.c:593 on the ST25DV system-port register-1 read.  The parity
 * harness cannot see this: the callee is an order-keyed oracle. */
extern int ipc_ept_op_b_locked_retry(int, unsigned int, unsigned int, int);

unsigned int ipc_ept_op_b_guarded(unsigned int param_1, int param_2)
{
    if (param_2 != 0) {
        return ipc_ept_op_b_locked_retry(param_1, 1, param_2, 1);
    }
    return 0xffffffea;
}

