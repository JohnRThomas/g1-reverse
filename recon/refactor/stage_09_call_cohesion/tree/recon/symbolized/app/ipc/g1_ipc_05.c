/*
 * Cohesive translation unit for the `ipc' module.
 *
 * GENERATED by recon/refactor/transforms/t04_cohesive_tu.py.  Do not
 * edit: a stage tree is regenerated, never hand-patched
 * (recon/refactor/README.md C4).
 *
 * The 2 functions below were 2 separate translation units until this
 * stage.  Each one's text is reproduced VERBATIM and in the order the
 * generated source list gave it, and they were CONSECUTIVE in that list.
 * They were proven able to share a translation unit: no symbol is
 * declared here with two types, no identifier has internal linkage in one
 * member and is named by another, and no local typedef, macro, struct tag
 * or enum constant of one member is visible to a member that names it.
 *
 * members, in link order:
 *   send_response_data_to_msgqueue.c
 *   send_response_data_to_ble.c
 */

/* File-scope forward declarations for every struct/union tag this
 * unit names.  Without them a tag whose only appearance in a member
 * is inside a parameter list has PARAMETER-LIST scope, so two
 * textually IDENTICAL declarations in two members declare two
 * different incomplete types and the second is a conflicting
 * redeclaration (C11 6.2.1p7).  Incomplete-type forward
 * declarations emit no code. */
struct k_msgq;
/* ---- send_response_data_to_msgqueue.c ---- */
#include "g1_app_symbols.h"
#include <zephyr/sys_clock.h>
#include "../../../headers/g1_log.h"
#include "../../../headers/g1_dedupe.h"
#include "g1_ipc.h"
/* readable reconstruction; identity: FUN_00047b1c @ 0x00047b1c
 * public-name: send_response_data_to_msgqueue
 * durable-map: recon/catalogs/function_names_app.json
 * callees (readable <= raw @ address):
 *   get_device_info                          <= FUN_000167a8 @ 0x000167a8
 *   debug_print                              <= FUN_00019c70 @ 0x00019c70
 *   k_msgq_put                               <= FUN_000720d0 @ 0x000720d0
 *   memcpy                                   <= FUN_00086c04 @ 0x00086c04
 *   memset_bytes                             <= FUN_00086c78 @ 0x00086c78
 * address symbols (name @ address):
 *   rodata_ef01c                             @ 0x000ef01c   [INLINED -- G6 literal batch]
 *   rodata_ef058                             @ 0x000ef058   [INLINED -- G6 literal batch]
 *   rodata_ef750                             @ 0x000ef750   [INLINED -- G6 literal batch]
 *   g_log_level                              @ 0x2000230c
 *   g_dashboard_response_msgq                @ 0x2000392c
 *   g_log_use_alt_sink                       @ 0x20007554
 */
/* Reconstructed send_response_data_to_msgqueue @ 0x47b1c  (parity: 300/300 trials, PROVEN) */

extern void memcpy(int, int, int);
extern int k_msgq_put(struct k_msgq *, const void *, k_timeout_t);

unsigned int send_response_data_to_msgqueue(void *param_1, unsigned int param_2)
{
    unsigned char *pcVar1;
    unsigned int uVar2;
    int iVar3;
    unsigned char stackbuf[28];

    pcVar1 = (unsigned char*)get_device_info();
    if (*pcVar1 == 2) {
        uVar2 = 0;
        return uVar2;
    }
    memset_bytes(stackbuf, 0, 0x18);
    if (param_2 < 0x15) {
        if (param_1 != 0) {
            memcpy(stackbuf + 4, param_1, param_2);
            *(unsigned short*)(stackbuf + 2) = (unsigned short)param_2;
        }
        iVar3 = k_msgq_put(((unsigned long)&g_dashboard_response_msgq) /*=0x2000392c*/, stackbuf, (k_timeout_t){ .ticks = 0LL });
        if (iVar3 == 0) {
            return 0;
        }
        log_message(((unsigned long)"message queue send failed %s\r\n") /*=0xef058*/, ((unsigned long)"send_response_data_to_msgqueue") /*=0xef750*/);
    } else {
        if (0 < *(volatile int *)((unsigned long)&g_log_level) /*=0x2000230c*/) {
            G1_LOG_ROUTE(*(volatile unsigned int *)((unsigned long)&g_log_use_alt_sink) /*=0x20007554*/ == 0, ((unsigned long)"%s(): send data length more than %d,can't load it,exit ...\n") /*=0xef01c*/, ((unsigned long)"send_response_data_to_msgqueue") /*=0xef750*/, 0x14);
        }
    }
    uVar2 = 0xffffffff;
    return uVar2;
}

/* ---- send_response_data_to_ble.c ---- */
/* readable reconstruction; identity: FUN_00047ba8 @ 0x00047ba8
 * public-name: send_response_data_to_ble
 * durable-map: recon/catalogs/function_names_app.json
 * callees (readable <= raw @ address):
 *   get_device_info                          <= FUN_000167a8 @ 0x000167a8
 *   send_response_data_to_ble                <= FUN_00047ba8 @ 0x00047ba8
 *   k_msgq_put                               <= FUN_000720d0 @ 0x000720d0
 *   memset_bytes                             <= FUN_00086c78 @ 0x00086c78
 * address symbols (name @ address):
 *   rodata_ef058                             @ 0x000ef058   [INLINED -- G6 literal batch]
 *   rodata_ef736                             @ 0x000ef736   [INLINED -- G6 literal batch]
 *   g_dashboard_response_msgq                @ 0x2000392c
 */
/* Reconstructed FUN_00047ba8 @ 0x47ba8  (parity: 300/300 trials, PROVEN) */


/* P4 iteration 33 -- UNDERSIZED STACK FRAME FIXED (instance 18 of the class the
 * parity harness is structurally blind to).  Shipped bytes @ 0x47ba8:
 *
 *   push {r0,r1,r2,r3,r4,r5,r6,lr}   ; 32-BYTE frame, 24-byte msg at sp+0
 *   bl get_device_info ; ldrb r3,[r0] ; cmp r3,#2 ; beq -> return 0
 *   movs r2,#23 ; movs r1,#0 ; add r0,sp,#1 ; bl memset_bytes
 *   movs r3,#1 ; strb.w r3,[sp]                       ; msg[0] = 1, msg[1..23] = 0
 *   mov r1,sp ; ldr r0,=0x2000392c ; bl k_msgq_put
 *   add sp,#28 ; ldr.w pc,[sp],#4
 *
 * The previous spelling used four `unsigned int` locals seeded from the four
 * parameters; GCC packed them into a 16-byte `push {r0,r1,r2,lr}` frame, so the
 * 23-byte memset overran to sp+27 and destroyed the saved LR at sp+12.  Once
 * `g_display_msgq` started working and `ui_navigation_task` actually ran, that
 * popped PC = 0 -> UsageFault K_ERR_ARM_USAGE_ILLEGAL_EPSR (reason 35) at our
 * 0x41ffe and rebooted the SoC.  It also leaked param_1's upper three bytes
 * into msg[1..3]; the shipped code zeroes them.  Every caller already declares
 * this function with no parameters (the shipped prologue's r0-r3 are pure spill
 * space that nothing reads), so the signature is `void`. */
unsigned int send_response_data_to_ble(void)
{
  unsigned char msg[24];
  char *pcVar1 = get_device_info();
  if (*pcVar1 != 2) {
    memset_bytes(msg + 1, 0, 0x17);
    msg[0] = 1;
    int iVar2 = k_msgq_put(((unsigned long)&g_dashboard_response_msgq) /*=0x2000392c*/, msg, (k_timeout_t){ .ticks = 0LL });
    if (iVar2 != 0) {
      log_message(((unsigned long)"message queue send failed %s\r\n") /*=0xef058*/, ((unsigned long)"send_response_data_to_ble") /*=0xef736*/);
      return 0xffffffff;
    }
  }
  return 0;
}

