/*
 * Cohesive translation unit for the `core' module.
 *
 * GENERATED by recon/refactor/transforms/t04_cohesive_tu.py.  Do not
 * edit: a stage tree is regenerated, never hand-patched
 * (recon/refactor/README.md C4).
 *
 * The 2 functions below were 2 separate translation units until this
 * stage.  Each one's text is reproduced VERBATIM and in the order the
 * generated source list gave it, and they were CONSECUTIVE in that list.
 * They were proven able to share a translation unit: no symbol is
 * declared here with two types, no identifier has internal linkage in one
 * member and is named by another, and no local typedef, macro, struct tag
 * or enum constant of one member is visible to a member that names it.
 *
 * members, in link order:
 *   build_and_send_device_status_report.c
 *   reset_usr_setting.c
 */
/* ---- build_and_send_device_status_report.c ---- */
#include "g1_app_symbols.h"
/* readable reconstruction; identity: FUN_00022b00 @ 0x00022b00
 * public-name: build_and_send_device_status_report
 * durable-map: recon/catalogs/function_names_app.json
 * callees (readable <= raw @ address):
 *   flash_settings_write_and_verify          <= FUN_00022658 @ 0x00022658
 *   build_and_send_device_status_report      <= FUN_00022b00 @ 0x00022b00
 *   memset_bytes                             <= FUN_00086c78 @ 0x00086c78
 * address symbols (name @ address):
 *   g_product_code_buf                       @ 0x20002fe3
 *   g_device_serial_buf                      @ 0x20003003
 */
/* Full reconstruction FUN_00022b00 @ 0x22b00. */
#include <stdint.h>
#include "../../../headers/g1_log.h"
#include "../../../headers/g1_dedupe.h"

extern void memset_bytes(void *destination, int value, unsigned int size);
extern void flash_settings_write_and_verify(unsigned int channel, const void *packet,
                         unsigned int size, unsigned int footer);

static void put_u16(uint8_t *destination, uint16_t value)
{
    destination[0] = (uint8_t)value;
    destination[1] = (uint8_t)(value >> 8);
}

static void put_u32(uint8_t *destination, uint32_t value)
{
    destination[0] = (uint8_t)value;
    destination[1] = (uint8_t)(value >> 8);
    destination[2] = (uint8_t)(value >> 16);
    destination[3] = (uint8_t)(value >> 24);
}

int build_and_send_device_status_report(const uint8_t *state)
{
    uint8_t packet[0x84];
    const volatile uint8_t *identity_a =
        (const volatile uint8_t *)((unsigned long)&g_device_serial_buf) /*=0x20003003*/;
    const volatile uint8_t *identity_b =
        (const volatile uint8_t *)((unsigned long)&g_product_code_buf) /*=0x20002fe3*/;
    unsigned int i;

    /* The firmware clears bytes 4..123, then fills the complete 132-byte
     * telemetry record from the application state and two identity blocks. */
    memset_bytes(packet + 4, 0, 0x78);
    put_u32(packet + 0, 1);
    packet[8] = state[2];
    put_u32(packet + 12, *(const uint32_t *)(state + 0xf64));
    put_u32(packet + 16, *(const uint32_t *)(state + 0xf94));
    packet[20] = state[0xed4];

    for (i = 0; i < 16; ++i)
        packet[21 + i] = identity_a[i];
    for (i = 0; i < 16; ++i)
        packet[53 + i] = identity_b[i];

    packet[85] = state[3];
    packet[86] = state[4];
    put_u16(packet + 96, *(const uint16_t *)(state + 0x1072));
    put_u16(packet + 98, *(const uint16_t *)(state + 0x1074));
    put_u32(packet + 100, *(const uint32_t *)(state + 0xfa4));
    put_u32(packet + 104, *(const uint32_t *)(state + 0xfa0));
    put_u32(packet + 108, *(const uint32_t *)(state + 0xfa8));
    put_u32(packet + 112, *(const uint32_t *)(state + 0xfac));
    put_u16(packet + 116, *(const uint16_t *)(state + 0xeda));
    put_u16(packet + 118, *(const uint16_t *)(state + 0xedc));
    put_u16(packet + 120, *(const uint16_t *)(state + 0xede));
    put_u32(packet + 124, *(const uint32_t *)(state + 0xfb0));
    put_u32(packet + 128, *(const uint32_t *)(state + 0xfb4));

    /* r3 carries the final 16-bit footer as well as its copy in the packet. */
    flash_settings_write_and_verify(0x130000, packet, sizeof(packet),
                 *(const uint16_t *)(state + 0xede));
    return 0;
}

/* ---- reset_usr_setting.c ---- */
/* readable reconstruction; identity: FUN_00022ddc @ 0x00022ddc
 * public-name: reset_usr_setting
 * durable-map: recon/catalogs/function_names_app.json
 * callees (readable <= raw @ address):
 *   debug_print                              <= FUN_00019c70 @ 0x00019c70
 *   set_test_mode                            <= FUN_00032ef0 @ 0x00032ef0
 *   save_usr_setting                         <= FUN_0007c28e @ 0x0007c28e
 * address symbols (name @ address):
 *   rodata_9e5f3                             @ 0x0009e5f3   [INLINED -- G6 literal batch]
 *   rodata_9e7b7                             @ 0x0009e7b7   [INLINED -- G6 literal batch]
 *   g_log_level                              @ 0x2000230c
 *   g_log_use_alt_sink                       @ 0x20007554
 */
/* Reconstructed reset_usr_setting @ 0x22ddc */


extern void set_test_mode(unsigned int);
extern void save_usr_setting(void *settings, uint32_t value);

uint32_t reset_usr_setting(uint8_t *settings)
{
    if (*(volatile int32_t *)((unsigned long)&g_log_level) /*=0x2000230c*/ > 2) {
        G1_LOG_ROUTE(*(volatile uint32_t *)((unsigned long)&g_log_use_alt_sink) /*=0x20007554*/ == 0, ((unsigned long)"%s(): reset_usr_setting\n") /*=0x9e5f3*/, ((unsigned long)"reset_usr_setting") /*=0x9e7b7*/);
    }

    *(volatile uint8_t *)(settings + 0xfea) = 10;
    *(volatile uint8_t *)(settings + 0xed5) = 0x15;
    *(volatile uint32_t *)(settings + 0xf6c) = 400;
    *(volatile uint8_t *)(settings + 0xf60) = 1;
    *(volatile uint8_t *)(settings + 0xf98) = 1;
    *(volatile uint8_t *)(settings + 0x108d) = 1;
    *(volatile uint8_t *)(settings + 0x1070) = 0;
    *(volatile uint8_t *)(settings + 0xec0) = 3;
    *(volatile uint32_t *)(settings + 0x1069) = UINT32_MAX;
    *(volatile uint32_t *)(settings + 0x106c) = UINT32_MAX;
    *(volatile uint16_t *)(settings + 0xef4) = 0x114;
    *(volatile uint8_t *)(settings + 0x108f) = 0;
    *(volatile uint16_t *)(settings + 0x1090) = 0;

    set_test_mode(0);
    *(volatile uint8_t *)(settings + 0xec1) = 3;
    *(volatile uint32_t *)(settings + 0xf68) = 0;
    save_usr_setting(settings, 0);
    return 0;
}

