/*
 * Call-cohesive translation unit for the `core' module.
 *
 * GENERATED by recon/refactor/transforms/t09_call_cohesion.py.  Do
 * not edit: a stage tree is regenerated, never hand-patched
 * (recon/refactor/README.md C4).
 *
 * The 2 translation units below were grouped because they CALL ONE
 * ANOTHER, not because they were adjacent in the generated source
 * list.  Each member's text is reproduced VERBATIM.  Every member was
 * checked pairwise against every other member already in this unit by
 * stage 04's seven refusal rules, unchanged: no symbol is declared
 * here with two types, no identifier has internal linkage in one
 * member and is named by another, and no local typedef, macro, struct
 * tag or enum constant of one member is visible to a member that
 * names it.
 *
 * members, in generated-source-list order:
 *   g1_core_19.c
 *   regulator_set_voltage_range.c
 *
 * call edges inside this unit (caller -> callee): 1
 *   regulator_set_voltage_range.c -> g1_core_19.c
 */
/* ================================================================ */
/* member unit: g1_core_19.c */
/* ================================================================ */
/*
 * Cohesive translation unit for the `core' module.
 *
 * GENERATED by recon/refactor/transforms/t04_cohesive_tu.py.  Do not
 * edit: a stage tree is regenerated, never hand-patched
 * (recon/refactor/README.md C4).
 *
 * The 2 functions below were 2 separate translation units until this
 * stage.  Each one's text is reproduced VERBATIM and in the order the
 * generated source list gave it, and they were CONSECUTIVE in that list.
 * They were proven able to share a translation unit: no symbol is
 * declared here with two types, no identifier has internal linkage in one
 * member and is named by another, and no local typedef, macro, struct tag
 * or enum constant of one member is visible to a member that names it.
 *
 * members, in link order:
 *   clock_control_nrf_init.c
 *   regulator_uv_to_reg_selector.c
 */
/* ---- clock_control_nrf_init.c ---- */
#include "g1_app_symbols.h"
/* readable reconstruction; identity: FUN_0006058c @ 0x0006058c
 * public-name: clock_control_nrf_init
 * durable-map: recon/catalogs/function_names_app.json
 * callees (readable <= raw @ address):
 *   arch_irq_priority_set                    <= FUN_0005010c @ 0x0005010c
 *   clock_control_nrf_init                   <= FUN_0006058c @ 0x0006058c
 *   nrfx_clock_init                          <= FUN_00065190 @ 0x00065190
 *   nrfx_clock_enable                        <= FUN_000651d8 @ 0x000651d8
 *   onoff_manager_init                       <= FUN_0007e212 @ 0x0007e212
 * address symbols (name @ address):
 *   rodata_60635                             @ 0x00060635
 *   rodata_8b5fc                             @ 0x0008b5fc
 *   REG_5000555c                             @ 0x5000555c
 */
/* Reconstructed FUN_0006058c @ 0x6058c  (parity: 300/300 trials, PROVEN) */

extern void arch_irq_priority_set(int,int,int,unsigned,unsigned);
extern int nrfx_clock_init(unsigned);
extern void nrfx_clock_enable(void);
extern int onoff_manager_init(int,unsigned);
static int clock_control_nrf_init(int param_1,unsigned param_2,unsigned param_3,unsigned param_4){
  unsigned uVar1; int iVar2,iVar3,iVar4;
  arch_irq_priority_set(5,1,0,param_4,param_4);
  iVar2=nrfx_clock_init(((unsigned long)&rodata_60635) /*=0x60635*/);
  if(iVar2==0x0bad0000){
    *(volatile unsigned int *)REG_5000555c /*=0x5000555c*/=0x9ba5;
    nrfx_clock_enable();
    uVar1=((unsigned long)&rodata_8b5fc) /*=0x8b5fc*/; iVar2=0;
    do{
      iVar4=*(int*)(param_1+0x10);
      iVar3=onoff_manager_init(iVar4+iVar2*0x20,uVar1);
      if(iVar3<0) return iVar3;
      iVar3=iVar2*0xc; iVar2=iVar2+1;
      *(unsigned*)(iVar3+iVar4+0x88)=1;
    } while(iVar2!=4);
    iVar2=0;
  } else { iVar2=-5; }
  return iVar2;
}

/* ---- regulator_uv_to_reg_selector.c ---- */
/* readable reconstruction; identity: FUN_00062070 @ 0x00062070
 * public-name: regulator_uv_to_reg_selector
 * durable-map: recon/catalogs/function_names_app.json
 * callees (readable <= raw @ address):
 *   regulator_uv_to_reg_selector             <= FUN_00062070 @ 0x00062070
 * address symbols (name @ address):
 *   rodata_f4240                             @ 0x000f4240
 */
/* Reconstructed FUN_00062070 @ 0x62070  (parity: 300/300 trials, PROVEN) */

unsigned int regulator_uv_to_reg_selector(int param_1, int param_2, unsigned short *param_3)
{
  unsigned int uVar1 = 0x186a0;
  unsigned int uVar3;

  if ((param_2 <= 0xf423f) || (param_1 > 0x325aa0)) {
    return 0xffffffea;
  }
  if (param_1 <= 0xf423f) {
    *param_3 = 0;
    return 0xffffffde;
  }
  if (param_2 <= 0x325aa0) {
    uVar3 = ((unsigned int)param_1 - 0xdbba1U) / uVar1;
    *param_3 = (unsigned short)uVar3;
    if ((uVar1 * uVar3 + ((unsigned long)&rodata_f4240) /*=0xf4240*/) <= (unsigned int)param_2) {
      return 0;
    }
    return 0xffffffea;
  }
  *param_3 = 0x17;
  return 0xffffffde;
}

/* ================================================================ */
/* member unit: regulator_set_voltage_range.c */
/* ================================================================ */
#include "g1_app_symbols.h"
#include "g1_core.h"
/* readable reconstruction; identity: FUN_00084300 @ 0x00084300
 * public-name: regulator_set_voltage_range
 * durable-map: recon/catalogs/function_names_app.json
 * callees (readable <= raw @ address):
 *   regulator_uv_to_reg_selector             <= FUN_00062070 @ 0x00062070
 *   dev_write_reg3                           <= FUN_00083dc8 @ 0x00083dc8
 *   dev_reg_modify_bits                      <= FUN_00083e0e @ 0x00083e0e
 *   regulator_set_voltage_range              <= FUN_00084300 @ 0x00084300
 */
/* Reconstructed FUN_00084300 @ 0x84300  (parity: 300/300 trials, PROVEN) */

extern unsigned int regulator_uv_to_reg_selector(int, int, unsigned short*);
extern int dev_write_reg3(unsigned int, unsigned int, unsigned int, unsigned int);

void regulator_set_voltage_range(int param_1, unsigned int param_2, unsigned int param_3, unsigned int param_4)
{
  unsigned char stk[0x14];
  int iVar1;
  unsigned int uVar2;

  iVar1 = regulator_uv_to_reg_selector(param_3, param_4, stk+0xe);
  if (iVar1 != -0x16) {
    iVar1 = dev_write_reg3(*(unsigned int*)(param_1+0x1c), 4, ((param_2+4)*2) & 0xfe, stk[0xe]);
    if (iVar1 >= 0) {
      uVar2 = (1u << (param_2 & 0xff)) & 0xff;
      dev_reg_modify_bits(*(unsigned int*)(param_1+0x1c), 4, 0xf, uVar2, uVar2);
    }
  }
  return;
}

