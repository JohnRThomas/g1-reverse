/*
 * Call-cohesive translation unit for the `core' module.
 *
 * GENERATED by recon/refactor/transforms/t09_call_cohesion.py.  Do
 * not edit: a stage tree is regenerated, never hand-patched
 * (recon/refactor/README.md C4).
 *
 * The 2 translation units below were grouped because they CALL ONE
 * ANOTHER, not because they were adjacent in the generated source
 * list.  Each member's text is reproduced VERBATIM.  Every member was
 * checked pairwise against every other member already in this unit by
 * stage 04's seven refusal rules, unchanged: no symbol is declared
 * here with two types, no identifier has internal linkage in one
 * member and is named by another, and no local typedef, macro, struct
 * tag or enum constant of one member is visible to a member that
 * names it.
 *
 * members, in generated-source-list order:
 *   g1_core_06.c
 *   g1_core_10.c
 *
 * call edges inside this unit (caller -> callee): 1
 *   g1_core_06.c -> g1_core_10.c
 */
/* ================================================================ */
/* member unit: g1_core_06.c */
/* ================================================================ */
/*
 * Cohesive translation unit for the `core' module.
 *
 * GENERATED by recon/refactor/transforms/t04_cohesive_tu.py.  Do not
 * edit: a stage tree is regenerated, never hand-patched
 * (recon/refactor/README.md C4).
 *
 * The 7 functions below were 7 separate translation units until this
 * stage.  Each one's text is reproduced VERBATIM and in the order the
 * generated source list gave it, and they were CONSECUTIVE in that list.
 * They were proven able to share a translation unit: no symbol is
 * declared here with two types, no identifier has internal linkage in one
 * member and is named by another, and no local typedef, macro, struct tag
 * or enum constant of one member is visible to a member that names it.
 *
 * members, in link order:
 *   set_time_mark.c
 *   st25dv_read_chip_ids.c
 *   update_box_presence_flag.c
 *   handle_box_placement_event.c
 *   init_nfc_comm.c
 *   serialization_ipc_ept_register.c
 *   serialization_init.c
 */
#include "g1_app_symbols.h"
#include "../../../headers/g1_log.h"
#include <stdint.h>
#include "g1_core.h"
#include "../../../headers/g1_dedupe.h"
/* ---- set_time_mark.c ---- */
/* readable reconstruction; identity: FUN_00024d40 @ 0x00024d40
 * public-name: set_time_mark
 * durable-map: recon/catalogs/function_names_app.json
 * callees (readable <= raw @ address):
 *   set_time_mark                            <= FUN_00024d40 @ 0x00024d40
 * address symbols (name @ address):
 *   g_elapsed_time_mark                      @ 0x20007a28
 */
/* Reconstructed FUN_00024d40 @ 0x24d40  (parity: 300/300 trials, PROVEN) */

extern unsigned int thunk_FUN_00074f68(void);
void set_time_mark(void)
{
  unsigned int uVar1 = thunk_FUN_00074f68();
  *(volatile unsigned int *)((unsigned long)&g_elapsed_time_mark) /*=0x20007a28*/ = uVar1;
}

/* ---- update_box_presence_flag.c ---- */
/* readable reconstruction; identity: FUN_000254a0 @ 0x000254a0
 * public-name: update_box_presence_flag
 * durable-map: recon/catalogs/function_names_app.json
 * callees (readable <= raw @ address):
 *   update_box_field_debounce                <= FUN_00025474 @ 0x00025474
 *   update_box_presence_flag                 <= FUN_000254a0 @ 0x000254a0
 * address symbols (name @ address):
 *   g_box_present_flag                       @ 0x20018c68
 */
/* Reconstructed FUN_000254a0 @ 0x254a0  (parity: 300/300 trials, PROVEN) */

extern int update_box_field_debounce(void);

void update_box_presence_flag(int param_1, unsigned char *param_2)
{
    int iVar1 = update_box_field_debounce();
    *param_2 = (iVar1 != 0);
    volatile unsigned char *flagp = (volatile unsigned char*)((unsigned long)&g_box_present_flag) /*=0x20018c68*/;
    if (iVar1 != 0) {
        if (*flagp == 0) {
            *flagp = 1;
        }
    } else {
        if (*flagp != 0) {
            *flagp = 0;
            if (*(volatile char *)((char*)param_1+2) == 0) {
                *(volatile unsigned char *)((char*)param_1+5) = 1;
            }
        }
    }
}

/* ---- handle_box_placement_event.c ---- */
/* readable reconstruction; identity: FUN_00025528 @ 0x00025528
 * public-name: handle_box_placement_event
 * durable-map: recon/catalogs/function_names_app.json
 * callees (readable <= raw @ address):
 *   box_placement_animation_step             <= FUN_0000fcf0 @ 0x0000fcf0
 *   get_device_info                          <= FUN_000167a8 @ 0x000167a8
 *   st25dv_mailbox_set_enabled               <= FUN_00024cc8 @ 0x00024cc8
 *   st25dv_write_control_and_ack             <= FUN_00024f40 @ 0x00024f40
 *   process_box_event                        <= FUN_000254d8 @ 0x000254d8
 *   handle_box_placement_event               <= FUN_00025528 @ 0x00025528
 *   periodic_check_run                       <= FUN_0003271c @ 0x0003271c
 *   is_battery_critical                      <= FUN_00032ee4 @ 0x00032ee4
 *   send_box_event_ipc                       <= FUN_0007c9f2 @ 0x0007c9f2
 *   ipc_send_byte_cmd2002                    <= FUN_0007c9fe @ 0x0007c9fe
 * address symbols (name @ address):
 *   rodata_50100                             @ 0x00050100
 *   g_box_event_state_buf                    @ 0x20002380
 *   g_box_mailbox_synced_flag                @ 0x200079fc
 *   g_box_field_timer_cfg_buf                @ 0x20007a2c
 *   g_st25dv_dev                             @ 0x20007a44
 */
/* Reconstructed FUN_00025528 @ 0x25528  (parity: 300/300 trials, PROVEN) */

extern void box_placement_animation_step(unsigned char*);
extern int get_device_info(void);
extern int st25dv_mailbox_set_enabled(int);
extern int st25dv_write_control_and_ack(int);
extern int process_box_event(volatile void*, volatile void*, int, volatile void*, uint32_t, uint32_t);
extern int is_battery_critical(void);
extern int send_box_event_ipc(uint32_t, void*);
extern int ipc_send_byte_cmd2002(uint32_t, uint32_t);

uint32_t handle_box_placement_event(uint32_t param_1, uint32_t param_2) {
    volatile int *piVar1 = (volatile int*)((unsigned long)&g_box_mailbox_synced_flag) /*=0x200079fc*/;
    volatile uint32_t *g_a44 = (volatile uint32_t*)((unsigned long)&g_st25dv_dev) /*=0x20007a44*/;
    volatile uint8_t *b = (volatile uint8_t*)((unsigned long)&g_box_event_state_buf) /*=0x20002380*/;
    uint8_t local7 = 0;
    uint32_t uVar6 = param_2;
    int iVar4;
    int8_t cVar5;
    periodic_check_run();
    if (*piVar1 == 0) {
        iVar4 = st25dv_mailbox_set_enabled(1);
        if (iVar4 < 0) return 0;
        iVar4 = send_box_event_ipc(*g_a44, (void*)&local7);
        if (iVar4 == 0) {
            local7 = local7 & 0xfe;
            ipc_send_byte_cmd2002(*g_a44, local7);
        }
        st25dv_write_control_and_ack(0xff);
        iVar4 = st25dv_mailbox_set_enabled(0);
        if (iVar4 < 0) return 0;
        *piVar1 = 1;
    }
    cVar5 = *(volatile int8_t *)(b+5);
    if (cVar5 == 1) {
        *(volatile uint32_t *)(b+0) = 1;
        *(volatile uint8_t *)(b+4) = 1;
        cVar5 = 0;
        *(volatile uint32_t *)(b+8) = 0x09010000UL;
        *(volatile uint32_t *)(b+0xc) = 0x0a031e09UL;
        *(volatile uint16_t *)(b+6) = 0;
        *(volatile uint32_t *)(b+0x10) = ((unsigned long)&rodata_50100) /*=0x50100*/;
        *(volatile uint32_t *)(b+0x14) = 0;
        *(volatile uint16_t *)(b+0x1c) = 0x200;
        *(volatile uint16_t *)(b+0x2e) = 0x101;
        *(volatile uint32_t *)(b+0x30) = 0xa0a;
        *(volatile uint32_t *)(b+0x34) = 0x0f000000UL;
        *(volatile uint16_t *)(b+0x18) = 0;
        *(volatile uint8_t *)(b+0x1e) = 0;
        *(volatile uint8_t *)(b+0x25) = 0;
        *(volatile uint8_t *)(b+0x27) = 0;
        *(volatile uint32_t *)(b+0x28) = 0;
        *(volatile uint8_t *)(b+0x2c) = 0;
        *(volatile uint8_t *)(b+0x38) = 0;
        *(volatile uint8_t *)(b+0x3a) = 0;
    }
    process_box_event((volatile void*)((unsigned long)&g_box_field_timer_cfg_buf) /*=0x20007a2c*/, b, cVar5, b, param_1, uVar6);
    iVar4 = is_battery_critical();
    if ((iVar4 != 0) || (iVar4 = get_device_info(), 0x1d < *(volatile uint8_t *)(iVar4 + 0xfc0))) {
        box_placement_animation_step(b);
    }
    return 0;
}

/* ---- init_nfc_comm.c ---- */
/* readable reconstruction; identity: FUN_0002560c @ 0x0002560c
 * public-name: init_nfc_comm
 * durable-map: recon/catalogs/function_names_app.json
 * callees (readable <= raw @ address):
 *   init_nfc_comm                            <= FUN_0002560c @ 0x0002560c
 *   pt_comm_bind_device                      <= FUN_000330a8 @ 0x000330a8
 *   process_pt_data                          <= FUN_000330ec @ 0x000330ec
 * address symbols (name @ address):
 *   rodata_9f196                             @ 0x0009f196   [INLINED -- G6 literal batch]
 *   g_st25dv_dev                             @ 0x20007a44
 */
/* Reconstructed FUN_0002560c @ 0x2560c  (parity: 300/300 trials, PROVEN) */

extern unsigned int pt_comm_bind_device(unsigned int);
extern int process_pt_data(void);

int init_nfc_comm(void)
{
  int iVar1;
  volatile unsigned int *volatile state = (volatile unsigned int *)((unsigned long)&g_st25dv_dev) /*=0x20007a44*/;
  iVar1 = pt_comm_bind_device(*state);
  if (iVar1 == 0) {
    iVar1 = process_pt_data();
    if (iVar1 != 0) { iVar1 = -2; }
  } else {
    log_message(((unsigned long)"init_nfc_comm is failed\n") /*=0x9f196*/);
    iVar1 = -1;
  }
  return iVar1;
}

/* ---- serialization_ipc_ept_register.c ---- */
/* readable reconstruction; identity: FUN_000259d4 @ 0x000259d4
 * public-name: serialization_ipc_ept_register
 * durable-map: recon/catalogs/function_names_app.json
 * callees (readable <= raw @ address):
 *   serialization_ipc_ept_register           <= FUN_000259d4 @ 0x000259d4
 *   z_device_is_ready                        <= FUN_0008638c @ 0x0008638c
 *   kmutex_dlist_init                        <= FUN_000864c2 @ 0x000864c2
 * address symbols (name @ address):
 *   rodata_88a38                             @ 0x00088a38
 *   rodata_9f3fa                             @ 0x0009f3fa   [INLINED -- G6 literal batch]
 *   rodata_9f418                             @ 0x0009f418   [INLINED -- G6 literal batch]
 *   rodata_9f433                             @ 0x0009f433   [INLINED -- G6 literal batch]
 *   rodata_9f487                             @ 0x0009f487   [INLINED -- G6 literal batch]
 *   g_st25dv_i2c_dev                         @ 0x200023cc
 *   g_st25dv_i2c_cfg                         @ 0x20007a48
 *   g_eeprom_comm_mutex                      @ 0x20007a60
 */
/* Reconstructed FUN_000259d4 @ 0x259d4 */

extern uint64_t z_device_is_ready(uint32_t);
extern void kmutex_dlist_init(uint32_t);

int serialization_ipc_ept_register(void)
{
    volatile uint8_t *descriptor = (volatile uint8_t *)((unsigned long)&g_st25dv_i2c_cfg) /*=0x20007a48*/;
    volatile uint8_t *config = (volatile uint8_t *)((unsigned long)&g_st25dv_i2c_dev) /*=0x200023cc*/;

    *(volatile uint32_t *)(descriptor + 8) = ((unsigned long)&rodata_88a38) /*=0x88a38*/;
    *(volatile uint16_t *)(config + 4) = 0x53;
    *(volatile uint16_t *)(config + 8) = 0x53;
    *(volatile uint32_t *)(config + 12) = 0x1000;
    *(volatile uint32_t *)(descriptor + 16) = ((unsigned long)&g_eeprom_comm_mutex) /*=0x20007a60*/;
    *(volatile uint32_t *)(descriptor + 4) = ((unsigned long)&g_st25dv_i2c_dev) /*=0x200023cc*/;

    kmutex_dlist_init(((unsigned long)&g_eeprom_comm_mutex) /*=0x20007a60*/);
    uint64_t status = z_device_is_ready(*(volatile uint32_t *)config);
    uint32_t format = (int32_t)status == 0 ? ((unsigned long)"parent bus device not ready\r\n") /*=0x9f3fa*/ : ((unsigned long)"eeprom_st25dv_init ready\r\n") /*=0x9f418*/;
    log_message(format, (uint32_t)(status >> 32), 0x1000u, ((unsigned long)&g_st25dv_i2c_cfg) /*=0x20007a48*/);

    status = z_device_is_ready(*(volatile uint32_t *)config);
    if ((int32_t)status == 0) {
        uint32_t base = *(volatile uint32_t *)config;
        log_message(((unsigned long)"\nError: Device \"%s\" is not ready; check the driver initialization logs for errors.\n") /*=0x9f433*/, *(volatile uint32_t *)(uintptr_t)base,
                    0x1000u, ((unsigned long)&g_st25dv_i2c_cfg) /*=0x20007a48*/);
        return 0;
    }
    log_message(((unsigned long)"update_eeprom_interface\r\n") /*=0x9f487*/, (uint32_t)(status >> 32),
                0x1000u, ((unsigned long)&g_st25dv_i2c_cfg) /*=0x20007a48*/);
    return ((unsigned long)&g_st25dv_i2c_cfg) /*=0x20007a48*/;
}

/* ---- st25dv_read_chip_ids.c ---- */
/* readable reconstruction; identity: FUN_00025290 @ 0x00025290
 * public-name: st25dv_read_chip_ids
 * durable-map: recon/catalogs/function_names_app.json
 * callees (readable <= raw @ address):
 *   adc_nfc_init                             <= FUN_00024b98 @ 0x00024b98
 *   st25dv_read_chip_ids                     <= FUN_00025290 @ 0x00025290
 *   serialization_ipc_ept_register           <= FUN_000259d4 @ 0x000259d4
 *   clear_pending_state_flags                <= FUN_0002ebc8 @ 0x0002ebc8
 *   k_sleep                                  <= FUN_00074844 @ 0x00074844
 *   st25dv_ipc_request_chip_ids              <= FUN_0007c932 @ 0x0007c932
 *   nfc_ipc_send_op20                        <= FUN_0007c944 @ 0x0007c944
 *   st25dv_ipc_request                       <= FUN_0007c956 @ 0x0007c956
 * address symbols (name @ address):
 *   rodata_9f145                             @ 0x0009f145   [INLINED -- G6 literal batch]
 *   rodata_9f176                             @ 0x0009f176   [INLINED -- G6 literal batch]
 *   rodata_9f186                             @ 0x0009f186   [INLINED -- G6 literal batch]
 *   g_st25dv_dev                             @ 0x20007a44
 *   g_board_rev_flag                         @ 0x20018c69
 */
/* Reconstructed FUN_00025290 @ 0x25290  (parity: 300/300 trials, PROVEN) */
extern int serialization_ipc_ept_register(void);
extern int32_t k_sleep(k_timeout_t);
extern void st25dv_ipc_request_chip_ids(int,void*);
extern void nfc_ipc_send_op20(int,void*);
extern void st25dv_ipc_request(int,void*);
extern void adc_nfc_init(void);
extern void clear_pending_state_flags(void);
unsigned int st25dv_read_chip_ids(void) {
  unsigned local_10=0, local_c=0;
  unsigned char local_12=0, local_11;
  int iVar2;
  volatile int *piVar1 = (volatile int*)((unsigned long)&g_st25dv_dev) /*=0x20007a44*/;
  iVar2 = serialization_ipc_ept_register();
  *piVar1 = iVar2;
  if (iVar2!=0 && *(volatile int *)(iVar2+4)!=0 && *(volatile int *)(iVar2+0x10)!=0 && *(volatile int *)(iVar2+8)!=0){
    unsigned uVar4; unsigned char uVar3; unsigned puVar5; unsigned char *puVar6;
    k_sleep(0x290,0);
    (*(void(**)(void))((*(volatile int *)((*piVar1)+8))+8))();
    st25dv_ipc_request_chip_ids(*piVar1,&local_10);
    uVar4 = (local_10>>8)&0xff;
    log_message(((unsigned long)"UUID = %02X %02X %02X %02X %02X %02X %02X %02X.\n") /*=0x9f145*/, local_10&0xff, uVar4, (local_10>>0x10)&0xff, local_10>>0x18, local_c&0xff, (local_c>>8)&0xff, (local_c>>0x10)&0xff, local_c>>0x18);
    uVar3 = (unsigned char)uVar4;
    puVar5 = ((local_c>>8)&0xff) - 0x50;
    puVar6 = (unsigned char*)puVar5;
    if (puVar5 < 2){ uVar3=1; puVar6=(unsigned char*)((unsigned long)&g_board_rev_flag) /*=0x20018c69*/; }
    iVar2 = *piVar1;
    if (puVar5 < 2){ *(volatile unsigned char *)puVar6 = uVar3; }
    nfc_ipc_send_op20(iVar2,&local_12);
    log_message(((unsigned long)"REV_IC = %02X.\n") /*=0x9f176*/,(unsigned)local_12);
    st25dv_ipc_request(*piVar1,&local_11);
    log_message(((unsigned long)"REF_IC = %02X.\n") /*=0x9f186*/,(unsigned)local_11);
    adc_nfc_init();
    clear_pending_state_flags();
  }
  return 0;
}

/* ---- serialization_init.c ---- */
/* readable reconstruction; identity: FUN_00025c54 @ 0x00025c54
 * public-name: serialization_init
 * durable-map: recon/catalogs/function_names_app.json
 * callees (readable <= raw @ address):
 *   debug_print                              <= FUN_00019c70 @ 0x00019c70
 *   ipc_service_open_instance                <= FUN_0004cb90 @ 0x0004cb90
 *   serialization_register_endpoint          <= FUN_0004cbec @ 0x0004cbec
 *   z_impl_k_sem_take                        <= FUN_00072908 @ 0x00072908
 * address symbols (name @ address):
 *   rodata_87c08                             @ 0x00087c08
 *   rodata_9f5ec                             @ 0x0009f5ec   [INLINED -- G6 literal batch]
 *   rodata_9f611                             @ 0x0009f611   [INLINED -- G6 literal batch]
 *   rodata_9f63c                             @ 0x0009f63c   [INLINED -- G6 literal batch]
 *   rodata_9f67e                             @ 0x0009f67e   [INLINED -- G6 literal batch]
 *   rodata_9f6f1                             @ 0x0009f6f1   [INLINED -- G6 literal batch]
 *   g_log_level                              @ 0x2000230c
 *   g_serialization_ipc_ept_ctx              @ 0x200023dc
 *   g_serialization_ipc_mutex                @ 0x200039c8
 *   g_log_use_alt_sink                       @ 0x20007554
 *   g_serialization_ipc_ept                  @ 0x20007a78
 *   g_serialization_ipc_ready                @ 0x20007a80
 */
/* Reconstructed serialization_init @ 0x25c54  (parity: 300/300 trials, PROVEN) */
extern int ipc_service_open_instance(uint32_t);
extern unsigned long long serialization_register_endpoint(uint32_t, uint32_t, uint32_t);
extern void z_impl_k_sem_take(uint32_t, int, int, int);

unsigned int serialization_init(void)
{
    volatile int *piVar1 = (volatile int*)((unsigned long)&g_log_level) /*=0x2000230c*/;
    int iVar2;
    unsigned int format_string;
    unsigned long long uVar3;

    if (2 < *piVar1) {
        G1_LOG_ROUTE(*(volatile int *)((unsigned long)&g_log_use_alt_sink) /*=0x20007554*/ == 0, ((unsigned long)"%s(): IPC-service HOST init started\n") /*=0x9f5ec*/, ((unsigned long)"serialization_init") /*=0x9f6f1*/);
    }
    iVar2 = ipc_service_open_instance(((unsigned long)&rodata_87c08) /*=0x87c08*/);
    if ((iVar2 < 0) && (iVar2 != -0x78)) {
        if (*piVar1 < 1) {
            return 0xffffffffUL;
        }
        iVar2 = *(volatile int *)((unsigned long)&g_log_use_alt_sink) /*=0x20007554*/;
        format_string = ((unsigned long)"%s(): ipc_service_open_instance() failure\n") /*=0x9f611*/;
    } else {
        if (2 < *piVar1) {
            G1_LOG_ROUTE(*(volatile int *)((unsigned long)&g_log_use_alt_sink) /*=0x20007554*/ == 0, ((unsigned long)"%s(): ipc open %d\n") /*=0x9f63c*/, ((unsigned long)"serialization_init") /*=0x9f6f1*/);
        }
        uVar3 = serialization_register_endpoint(((unsigned long)&rodata_87c08) /*=0x87c08*/, ((unsigned long)&g_serialization_ipc_ept) /*=0x20007a78*/, ((unsigned long)&g_serialization_ipc_ept_ctx) /*=0x200023dc*/);
        if (-1 < (int)uVar3) {
            z_impl_k_sem_take(((unsigned long)&g_serialization_ipc_mutex) /*=0x200039c8*/, (int)(uVar3 >> 32), -1, -1);
            *(volatile int *)((unsigned long)&g_serialization_ipc_ready) /*=0x20007a80*/ = 1;
            if (1 < *piVar1) {
                G1_LOG_ROUTE(*(volatile int *)((unsigned long)&g_log_use_alt_sink) /*=0x20007554*/ == 0, ((unsigned long)"%s(): ipc_service[HOST] has ready!\n\n") /*=0x9f67e*/, ((unsigned long)"serialization_init") /*=0x9f6f1*/);
            }
            return 0;
        }
        if (*piVar1 < 1) {
            return 0xffffffffUL;
        }
        iVar2 = *(volatile int *)((unsigned long)&g_log_use_alt_sink) /*=0x20007554*/;
        format_string = 0x0009f64fUL;
    }
    G1_LOG_ROUTE(iVar2 == 0, format_string, ((unsigned long)"serialization_init") /*=0x9f6f1*/);
    return 0xffffffffUL;
}

/* ================================================================ */
/* member unit: g1_core_10.c */
/* ================================================================ */
/*
 * Cohesive translation unit for the `core' module.
 *
 * GENERATED by recon/refactor/transforms/t04_cohesive_tu.py.  Do not
 * edit: a stage tree is regenerated, never hand-patched
 * (recon/refactor/README.md C4).
 *
 * The 17 functions below were 17 separate translation units until this
 * stage.  Each one's text is reproduced VERBATIM and in the order the
 * generated source list gave it, and they were CONSECUTIVE in that list.
 * They were proven able to share a translation unit: no symbol is
 * declared here with two types, no identifier has internal linkage in one
 * member and is named by another, and no local typedef, macro, struct tag
 * or enum constant of one member is visible to a member that names it.
 *
 * members, in link order:
 *   watchdog_feed_retry.c
 *   disable_watchdog.c
 *   global_system_suspend.c
 *   process_for_message_show.c
 *   device_reg3_init_config.c
 *   dev_read_status_bit_reg34.c
 *   set_pending_state_flag.c
 *   debounce_read_pending_flag_1.c
 *   debounce_read_pending_flag_2.c
 *   clear_pending_state_flags.c
 *   attr_store_init_sequence.c
 *   pt_nfc_eeprom_link_init.c
 *   pt_nfc_eeprom_link_start.c
 *   nfc_eeprom_comm_lock.c
 *   nfc_eeprom_comm_unlock.c
 *   build_device_info_response.c
 *   test_mode_apply_base_status_cmd.c
 */
/* ---- watchdog_feed_retry.c ---- */
#include "g1_app_symbols.h"
/* readable reconstruction; identity: FUN_0002ae84 @ 0x0002ae84
 * public-name: watchdog_feed_retry
 * durable-map: recon/catalogs/function_names_app.json
 * callees (readable <= raw @ address):
 *   watchdog_feed_retry                      <= FUN_0002ae84 @ 0x0002ae84
 *   k_sleep                                  <= FUN_00074844 @ 0x00074844
 * address symbols (name @ address):
 *   g_watchdog_device                        @ 0x00087cc8
 *   g_wdt_channel_id                         @ 0x20007b50
 */
/* Reconstructed FUN_0002ae84 @ 0x2ae84  (parity: 300/300 trials, PROVEN) */

#include <stdint.h>
#include "../../../headers/g1_log.h"
#include "../../../headers/g1_dedupe.h"
#include "g1_core.h"
extern int32_t k_sleep(k_timeout_t);
typedef int (*fnptr)(unsigned int,unsigned int,unsigned int,unsigned int,unsigned int);

int watchdog_feed_retry(unsigned int param_1, unsigned int param_2, unsigned int param_3, unsigned int param_4)
{
  (void)param_1; (void)param_2;
  volatile unsigned int *puVar1 = (volatile unsigned int *)((unsigned long)&g_wdt_channel_id) /*=0x20007b50*/;
  int iVar4 = 5;
  int iVar5 = *(volatile int *)(((unsigned long)&g_watchdog_device) /*=0x87cc8*/ + 8);
  int iVar2;
  for (;;) {
    fnptr pcVar3 = *(volatile fnptr *)(iVar5 + 0xc);
    iVar2 = pcVar3(((unsigned long)&g_watchdog_device) /*=0x87cc8*/, *puVar1, param_3, (unsigned int)(uintptr_t)pcVar3, param_4);
    if (iVar2 == 0) return 0;
    k_sleep(0x667, 0);
    iVar4 = iVar4 - 1;
    if (iVar4 == 0) break;
  }
  return iVar2;
}

/* ---- disable_watchdog.c ---- */
/* readable reconstruction; identity: FUN_0002aeb4 @ 0x0002aeb4
 * public-name: disable_watchdog
 * durable-map: recon/catalogs/function_names_app.json
 * callees (readable <= raw @ address):
 *   debug_print                              <= FUN_00019c70 @ 0x00019c70
 *   k_sleep                                  <= FUN_00074844 @ 0x00074844
 * address symbols (name @ address):
 *   g_watchdog_device                        @ 0x00087cc8
 *   rodata_a1c4e                             @ 0x000a1c4e   [INLINED -- G6 literal batch]
 *   rodata_a1c6a                             @ 0x000a1c6a   [INLINED -- G6 literal batch]
 *   rodata_a1c85                             @ 0x000a1c85   [INLINED -- G6 literal batch]
 *   g_log_level                              @ 0x2000230c
 *   g_log_use_alt_sink                       @ 0x20007554
 *   g_wdt_channel_id                         @ 0x20007b50
 */
/* Reconstructed disable_watchdog @ 0x2aeb4  (parity: 151/300 trials, PROVEN) */


typedef int (*fp_t)(unsigned int);

int disable_watchdog(void)
{
    volatile int *piVar1 = (volatile int*)((unsigned long)&g_wdt_channel_id) /*=0x20007b50*/;
    int iVar5;

    if (*piVar1 < 0) {
        if (3 < *(volatile int *)((unsigned long)&g_log_level) /*=0x2000230c*/) {
            G1_LOG_ROUTE(*(volatile unsigned int *)((unsigned long)&g_log_use_alt_sink) /*=0x20007554*/ == 0, ((unsigned long)"%s(): watchdog is disabled\n") /*=0xa1c4e*/, ((unsigned long)"disable_watchdog") /*=0xa1c85*/, *piVar1);
        }
        iVar5 = 0;
    } else {
        int iVar6 = 5;
        do {
            if (3 < *(volatile int *)((unsigned long)&g_log_level) /*=0x2000230c*/) {
                G1_LOG_ROUTE(*(volatile unsigned int *)((unsigned long)&g_log_use_alt_sink) /*=0x20007554*/ == 0, ((unsigned long)"%s(): disable watchdog...\n") /*=0xa1c6a*/, ((unsigned long)"disable_watchdog") /*=0xa1c85*/, 0,
                                *(volatile unsigned int *)((unsigned long)&g_log_use_alt_sink) /*=0x20007554*/);
            }
            fp_t f = *(fp_t*)(*(int*)(((unsigned long)&g_watchdog_device) /*=0x87cc8*/ + 8) + 4);
            iVar5 = f(((unsigned long)&g_watchdog_device) /*=0x87cc8*/);
            if (iVar5 == 0) {
                *piVar1 = -0x10;
                iVar5 = 0;
                break;
            }
            k_sleep(0x667, 0);
            iVar6 = iVar6 - 1;
        } while (iVar6 != 0);
    }
    return iVar5;
}

/* ---- global_system_suspend.c ---- */
/* readable reconstruction; identity: FUN_0002bd7c @ 0x0002bd7c
 * public-name: global_system_suspend
 * durable-map: recon/catalogs/function_names_app.json
 * callees (readable <= raw @ address):
 *   debug_print                              <= FUN_00019c70 @ 0x00019c70
 * address symbols (name @ address):
 *   rodata_a24eb                             @ 0x000a24eb   [INLINED -- G6 literal batch]
 *   rodata_a24f9                             @ 0x000a24f9   [INLINED -- G6 literal batch]
 *   rodata_a251a                             @ 0x000a251a   [INLINED -- G6 literal batch]
 *   g_log_level                              @ 0x2000230c
 *   g_log_use_alt_sink                       @ 0x20007554
 */
/* Reconstructed global_system_suspend @ 0x2bd7c  (parity: 296/300 trials, PROVEN) */

typedef void (*fn2_t)(unsigned int);

unsigned int global_system_suspend(void *param_1, unsigned int param_2, unsigned int param_3, unsigned int param_4)
{
    volatile unsigned char *base = (volatile unsigned char *)param_1;
    if ((*(base + 0xfe6) & 0xfb) == 0) {
        *(base + 0xfe6) = 2;
        if (*(volatile int *)((unsigned long)&g_log_level) /*=0x2000230c*/ > 1) {
            G1_LOG_ROUTE(*(volatile int *)((unsigned long)&g_log_use_alt_sink) /*=0x20007554*/ == 0, ((unsigned long)"%s(): begin.\n") /*=0xa24eb*/, ((unsigned long)"global_system_suspend") /*=0xa251a*/, param_3, 0U);
        }
        fn2_t fn = *(fn2_t *)(base + 0xb70);
        fn((unsigned int)((unsigned char *)param_1 + 0xb6c));
        if (*(volatile int *)((unsigned long)&g_log_level) /*=0x2000230c*/ > 1) {
            G1_LOG_ROUTE(*(volatile int *)((unsigned long)&g_log_use_alt_sink) /*=0x20007554*/ == 0, ((unsigned long)"%s(): end.\n") /*=0xa24f9*/, ((unsigned long)"global_system_suspend") /*=0xa251a*/, param_3, 0U);
        }
        *(base + 0xfe6) = 1;
    }
    return 0;
}

/* ---- process_for_message_show.c ---- */
/* readable reconstruction; identity: FUN_0002c714 @ 0x0002c714
 * public-name: process_for_message_show
 * durable-map: recon/catalogs/function_names_app.json
 * callees (readable <= raw @ address):
 *   get_device_info                          <= FUN_000167a8 @ 0x000167a8
 *   debug_print                              <= FUN_00019c70 @ 0x00019c70
 *   update_temp_task_status                  <= FUN_0002bffc @ 0x0002bffc
 *   update_persist_task_status_to_idle       <= FUN_0002c0e8 @ 0x0002c0e8
 *   get_message_type_param                   <= FUN_0002c30c @ 0x0002c30c
 *   process_for_message_show                 <= FUN_0002c714 @ 0x0002c714
 *   message_pool_read_byte_0xd               <= FUN_00033c04 @ 0x00033c04
 *   get_message_pending_state                <= FUN_00034410 @ 0x00034410
 *   set_message_pending_state                <= FUN_0003443c @ 0x0003443c
 *   is_msg_expiration                        <= FUN_0003444c @ 0x0003444c
 * address symbols (name @ address):
 *   rodata_a28ee                             @ 0x000a28ee   [INLINED -- G6 literal batch]
 *   rodata_a291d                             @ 0x000a291d
 *   rodata_a294a                             @ 0x000a294a
 *   rodata_a2977                             @ 0x000a2977   [INLINED -- G6 literal batch]
 *   rodata_a29be                             @ 0x000a29be   [INLINED -- G6 literal batch]
 *   rodata_a3311                             @ 0x000a3311
 *   rodata_a39d6                             @ 0x000a39d6   [INLINED -- G6 literal batch]
 *   g_log_level                              @ 0x2000230c
 *   g_log_use_alt_sink                       @ 0x20007554
 */
/* Reconstructed FUN_0002c714 @ 0x2c714  (parity: 300/300 trials, PROVEN) */
typedef unsigned char byte; typedef unsigned char undefined1; typedef uint32_t undefined4; typedef unsigned int uint;
extern int get_device_info(void);
extern unsigned int update_temp_task_status(int, unsigned int, unsigned int);
extern unsigned int get_message_type_param(int, unsigned int);
extern unsigned char message_pool_read_byte_0xd(int);
extern unsigned long get_message_pending_state(void);
extern void set_message_pending_state(int);
extern int is_msg_expiration(void);
extern int sync_to_slave(void*,...);
extern void wait_for_event(unsigned long, unsigned long);

static inline __attribute__((always_inline)) uint32_t load_u32_le(const void *address)
{
  const uint8_t *p = (const uint8_t *)address;
  return (uint32_t)p[0] | ((uint32_t)p[1] << 8) |
         ((uint32_t)p[2] << 16) | ((uint32_t)p[3] << 24);
}

undefined4 process_for_message_show(char *param_1,int param_2,byte *param_3,undefined4 *param_4)
{
  byte bVar1; volatile int *piVar2; undefined1 uVar3; int iVar4=0; char *pcVar5;
  undefined4 uVar6; byte bVar7; short sVar8; uint uVar9; int bVar10;
  int state_raw;
  sVar8 = 1000;
  do {
    iVar4 = get_device_info();
    if (*(char *)(iVar4 + 0xdd) == '\0') break;
    iVar4 = get_device_info();
    iVar4 = message_pool_read_byte_0xd(*(byte *)(iVar4 + 0xdd) - 1);
    if (iVar4 == 4) break;
    sVar8 = sVar8 + -1;
    wait_for_event(0x21,0);
  } while (sVar8 != 0);
  uVar9 = 0;
  *(undefined1 *)(param_2 + 8) = 0;
  set_message_pending_state(4);
  state_raw = get_message_type_param(param_1[0xfea],0xf);
  uVar3 = (undefined1)state_raw;
  piVar2 = (volatile int*)((unsigned long)&g_log_level) /*=0x2000230c*/;
  *(undefined1 *)(param_2 + 7) = uVar3;
  do {
    while( 1 ) {
      if (param_1[0x108f] == '\0') { bVar10 = *param_3 == 1; }
      else { iVar4 = is_msg_expiration(); bVar10 = iVar4 == 2; }
      if (((bVar10) || (*(char *)(param_2 + 7) == '\0')) && (param_1[0xfea] == '\n')) break;
      if (((param_1[1] == '\x01') || (iVar4 = get_device_info(), *(char *)(iVar4 + 1) == '\b')) ||
         (iVar4 = get_device_info(), *(char *)(iVar4 + 0xfea) == '\f')) {
        if (2 < *(volatile int *)((unsigned long)&g_log_level) /*=0x2000230c*/) {
          G1_LOG_ROUTE(*(volatile int *)((unsigned long)&g_log_use_alt_sink) /*=0x20007554*/ == 0, ((unsigned long)&rodata_a294a) /*=0xa294a*/,((unsigned long)"process_for_message_show") /*=0xa39d6*/,(uint)*(byte *)(param_2 + 1));
        }
        update_persist_task_status_to_idle(param_1);
        *param_4 = ((unsigned long)&rodata_a3311) /*=0xa3311*/;
        set_message_pending_state(5);
        return 10;
      }
      if (*(char *)(param_2 + 1) != '\x04') {
        if (2 < *(volatile int *)((unsigned long)&g_log_level) /*=0x2000230c*/) {
          G1_LOG_ROUTE(*(volatile int *)((unsigned long)&g_log_use_alt_sink) /*=0x20007554*/ == 0, ((unsigned long)"%s(): #3 %d: screen_id is changed, I will go to next screen, goodbye!\n") /*=0xa2977*/,((unsigned long)"process_for_message_show") /*=0xa39d6*/,(uint)*(byte *)(param_2 + 1));
        }
        if (*(char *)(param_2 + 1) != '\0') { return 0xb; }
        goto LAB_0002c884;
      }
      uVar9 = uVar9 + 1;
      if (((uVar9 & 0xf) == 0) && (2 < *piVar2)) {
        G1_LOG_ROUTE(*(volatile int *)((unsigned long)&g_log_use_alt_sink) /*=0x20007554*/ == 0, ((unsigned long)"%s(): [message]\347\255\211\345\276\205\351\200\200\345\207\272:%d, expect_ts: %d, imu:%d, unread_msg_num:%d, persist_task:%d/%d - %d\n") /*=0xa29be*/,((unsigned long)"process_for_message_show") /*=0xa39d6*/,uVar9,
                      load_u32_le((const void *)(uintptr_t)load_u32_le(param_1 + 0xff0)),
                      (uint)*param_3,(uint)*(byte *)(param_2 + 9),(uint)*(byte *)(param_2 + 0xf),
                      load_u32_le((const void *)(uintptr_t)(param_2 + 0xb)),
                      (uint)*(byte *)(param_2 + 8));
      }
      if (((param_1[0x108f] != '\0') && (*param_1 == '\x01')) &&
         (((uVar9 * 0xcccccccdU >> 2 | uVar9 * 0x40000000) ) <= 0x0ccccccc)) {
        bVar1 = *(byte *)(param_2 + 7);
        bVar7 = bVar1;
        if (bVar1 < 0x14) { bVar7 = bVar1 - 1; }
        if (bVar1 < 0x14) { *(byte *)(param_2 + 7) = bVar7; }
      }
LAB_0002c894:
      wait_for_event(0x667,0);
    }
    if ((*(char *)(param_2 + 1) == '\x06') ||
       ((*(char *)(param_2 + 1) != '\x06' && (*param_3 == 2)))) {
      iVar4 = get_device_info();
      if ((*(char *)(iVar4 + 0x108f) != '\0') &&
         (pcVar5 = (char *)get_device_info(), *pcVar5 == '\x01')) {
        iVar4 = get_device_info();
        uVar9 = *(uint *)(iVar4 + 0x1060);
        *(uint *)(iVar4 + 0x1060) = uVar9 - 1000;
        *(uint *)(iVar4 + 0x1064) = *(int *)(iVar4 + 0x1064) + -1 + (uint)(999 < uVar9);
      }
      sync_to_slave(param_1,0xc,0,0);
      uVar6 = get_device_info();
      update_temp_task_status(uVar6,6,2);
      if (2 < *(volatile int *)((unsigned long)&g_log_level) /*=0x2000230c*/) {
        G1_LOG_ROUTE(*(volatile int *)((unsigned long)&g_log_use_alt_sink) /*=0x20007554*/ == 0, ((unsigned long)"%s(): #0 %d: I will go to dashboard, goodbye!\n") /*=0xa28ee*/,((unsigned long)"process_for_message_show") /*=0xa39d6*/,(uint)*(byte *)(param_2 + 1));
      }
      return 0xb;
    }
    sync_to_slave(param_1,8,0,0);
    if (*param_1 == '\x01') { update_persist_task_status_to_idle(param_1); }
    else if (*(char *)(param_2 + 1) == '\x04') goto LAB_0002c894;
    set_message_pending_state(5);
    if (*param_1 == '\x01') { wait_for_event(0x4000,0); }
    iVar4 = get_message_pending_state();
  } while (iVar4 == 4);
  if (2 < *(volatile int *)((unsigned long)&g_log_level) /*=0x2000230c*/) {
    G1_LOG_ROUTE(*(volatile int *)((unsigned long)&g_log_use_alt_sink) /*=0x20007554*/ == 0, ((unsigned long)&rodata_a291d) /*=0xa291d*/,((unsigned long)"process_for_message_show") /*=0xa39d6*/,(uint)*(byte *)(param_2 + 1));
  }
LAB_0002c884:
  *param_4 = ((unsigned long)&rodata_a3311) /*=0xa3311*/;
  return 10;
}

/* ---- device_reg3_init_config.c ---- */
/* readable reconstruction; identity: FUN_0002ea78 @ 0x0002ea78
 * public-name: device_reg3_init_config
 * durable-map: recon/catalogs/function_names_app.json
 * callees (readable <= raw @ address):
 *   device_reg3_init_config                  <= FUN_0002ea78 @ 0x0002ea78
 *   dev_write_reg3                           <= FUN_00083dc8 @ 0x00083dc8
 * address symbols (name @ address):
 *   rodata_a3e1a                             @ 0x000a3e1a   [INLINED -- G6 literal batch]
 */
/* Reconstructed FUN_0002ea78 @ 0x2ea78  (parity: 300/300 trials, PROVEN) */

extern int dev_write_reg3(unsigned int a0, unsigned int a1, unsigned int a2, unsigned int a3);

unsigned int device_reg3_init_config(void)
{
  int iVar1;
  unsigned int uVar2;
  unsigned int base = *(volatile unsigned int *)((unsigned long)&rodata_87ce0 + 4) /*=0x87ce0*/;
  iVar1 = dev_write_reg3(*(volatile unsigned int *)(base + 0x1c), 3, 0xc, 8);
  if (iVar1 < 0) {
    log_message(((unsigned long)"Could not change termination voltage to 4.2V\n") /*=0xa3e1a*/);
    uVar2 = 0xffffffff;
  } else {
    uVar2 = 0;
  }
  return uVar2;
}

/* ---- dev_read_status_bit_reg34.c ---- */
/* readable reconstruction; identity: FUN_0002ead8 @ 0x0002ead8
 * public-name: dev_read_status_bit_reg34
 * durable-map: recon/catalogs/function_names_app.json
 * callees (readable <= raw @ address):
 *   dev_read_status_bit_reg34                <= FUN_0002ead8 @ 0x0002ead8
 *   dev_ctrl_read1                           <= FUN_00083dba @ 0x00083dba
 * address symbols (name @ address):
 *   rodata_a3e62                             @ 0x000a3e62   [INLINED -- G6 literal batch]
 */
/* Reconstructed FUN_0002ead8 @ 0x2ead8  (parity: 300/300 trials, PROVEN) */

extern int dev_ctrl_read1(int,int,int,void*,int);

unsigned int dev_read_status_bit_reg34(int param_1, unsigned int param_2)
{
    unsigned char byte7 = 0;
    int base = *(volatile int *)((unsigned long)&rodata_87ce0 + 4) /*=0x87ce0*/;
    int arg0 = *(volatile int *)(base + 0x1c);
    int iVar1 = dev_ctrl_read1(arg0, 3, 0x34, &byte7, param_1);
    unsigned int uVar2;
    if (iVar1 < 0) {
        log_message(((unsigned long)"Could not get charger status\n") /*=0xa3e62*/);
        uVar2 = 0xffffffff;
    } else {
        unsigned int combined = (byte7 >> 3) | (byte7 >> 2);
        if (combined & 1) {
            uVar2 = 0;
        } else {
            uVar2 = (~(unsigned int)(byte7 >> 4)) & 1;
        }
    }
    return uVar2;
}

/* ---- set_pending_state_flag.c ---- */
/* readable reconstruction; identity: FUN_0002eb28 @ 0x0002eb28
 * public-name: set_pending_state_flag
 * durable-map: recon/catalogs/function_names_app.json
 * callees (readable <= raw @ address):
 *   set_pending_state_flag                   <= FUN_0002eb28 @ 0x0002eb28
 * address symbols (name @ address):
 *   g_ancs_inbox_flag_current                @ 0x20018da6
 */
/* Reconstructed FUN_0002eb28 @ 0x2eb28  (parity: 300/300 trials, PROVEN) */

void set_pending_state_flag(unsigned long param_1, unsigned long param_2) {
  if (param_1 < 3) {
    if (param_2 != 0) {
      *(volatile unsigned char *)(((unsigned long)&g_ancs_inbox_flag_current) /*=0x20018da6*/ + param_1) = 1;
      return;
    }
    *(volatile unsigned char *)(((unsigned long)&g_ancs_inbox_flag_current) /*=0x20018da6*/ + param_1) = 0;
  }
}

/* ---- debounce_read_pending_flag_1.c ---- */
/* readable reconstruction; identity: FUN_0002eb78 @ 0x0002eb78
 * public-name: debounce_read_pending_flag_1
 * durable-map: recon/catalogs/function_names_app.json
 * callees (readable <= raw @ address):
 *   debounce_read_pending_flag_1             <= FUN_0002eb78 @ 0x0002eb78
 * address symbols (name @ address):
 *   rodata_a3e9f                             @ 0x000a3e9f   [INLINED -- G6 literal batch]
 *   g_confirmed_state_flag_1                 @ 0x20018da4
 *   g_ancs_inbox_flag_current                @ 0x20018da6
 */
/* Reconstructed FUN_0002eb78 @ 0x2eb78  (parity: 300/300 trials, PROVEN) */

unsigned int debounce_read_pending_flag_1(unsigned int param_1,unsigned int param_2,unsigned int param_3,unsigned int param_4)
{
  unsigned char bVar1 = *(volatile unsigned char *)(((unsigned long)&g_ancs_inbox_flag_current) /*=0x20018da6*/ + 1);
  unsigned int uVar3 = bVar1;
  if (*(volatile unsigned char *)((unsigned long)&g_confirmed_state_flag_1) /*=0x20018da4*/ != uVar3) {
    log_message(((unsigned long)"[csh_debug_box]isLidCLose is %d \n") /*=0xa3e9f*/, uVar3, param_3, (unsigned int)(*(volatile unsigned char *)((unsigned long)&g_confirmed_state_flag_1) /*=0x20018da4*/), param_4);
  }
  *(volatile unsigned char *)((unsigned long)&g_confirmed_state_flag_1) /*=0x20018da4*/ = bVar1;
  return uVar3;
}

/* ---- debounce_read_pending_flag_2.c ---- */
/* readable reconstruction; identity: FUN_0002eba0 @ 0x0002eba0
 * public-name: debounce_read_pending_flag_2
 * durable-map: recon/catalogs/function_names_app.json
 * callees (readable <= raw @ address):
 *   debounce_read_pending_flag_2             <= FUN_0002eba0 @ 0x0002eba0
 * address symbols (name @ address):
 *   rodata_a3ec1                             @ 0x000a3ec1   [INLINED -- G6 literal batch]
 *   g_confirmed_state_flag_2                 @ 0x20018da3
 *   g_ancs_inbox_flag_current                @ 0x20018da6
 */
/* Reconstructed FUN_0002eba0 @ 0x2eba0  (parity: 300/300 trials, PROVEN) */

unsigned int debounce_read_pending_flag_2(unsigned int param_1,unsigned int param_2,unsigned int param_3,unsigned int param_4)
{
  unsigned char bVar1 = *(volatile unsigned char *)(((unsigned long)&g_ancs_inbox_flag_current) /*=0x20018da6*/ + 2);
  unsigned int uVar3 = bVar1;
  if (*(volatile unsigned char *)((unsigned long)&g_confirmed_state_flag_2) /*=0x20018da3*/ != uVar3) {
    log_message(((unsigned long)"[csh_debug_box] isInCharge is %d \n") /*=0xa3ec1*/, uVar3, param_3, (unsigned int)(*(volatile unsigned char *)((unsigned long)&g_confirmed_state_flag_2) /*=0x20018da3*/), param_4);
  }
  *(volatile unsigned char *)((unsigned long)&g_confirmed_state_flag_2) /*=0x20018da3*/ = bVar1;
  return uVar3;
}

/* ---- clear_pending_state_flags.c ---- */
/* readable reconstruction; identity: FUN_0002ebc8 @ 0x0002ebc8
 * public-name: clear_pending_state_flags
 * durable-map: recon/catalogs/function_names_app.json
 * callees (readable <= raw @ address):
 *   clear_pending_state_flags                <= FUN_0002ebc8 @ 0x0002ebc8
 * address symbols (name @ address):
 *   g_ancs_inbox_flag_current                @ 0x20018da6
 *   g_lid_closed_flag                        @ 0x20018da7
 *   g_charging_flag                          @ 0x20018da8
 */
/* Reconstructed FUN_0002ebc8 @ 0x2ebc8  (parity: 300/300 trials, PROVEN) */

void clear_pending_state_flags(void)
{
  *(volatile unsigned char *)((unsigned long)&g_ancs_inbox_flag_current) /*=0x20018da6*/ = 0;
  *(volatile unsigned char *)((unsigned long)&g_lid_closed_flag) /*=0x20018da7*/ = 0;
  *(volatile unsigned char *)((unsigned long)&g_charging_flag) /*=0x20018da8*/ = 0;
}

/* ---- attr_store_init_sequence.c ---- */
/* readable reconstruction; identity: FUN_00030288 @ 0x00030288
 * public-name: attr_store_init_sequence
 * durable-map: recon/catalogs/function_names_app.json
 * callees (readable <= raw @ address):
 *   attr_store_set                           <= FUN_00030178 @ 0x00030178
 *   attr_store_init_sequence                 <= FUN_00030288 @ 0x00030288
 * address symbols (name @ address):
 *   rodata_ff20                              @ 0x0000ff20
 */
/* Reconstructed FUN_00030288 @ 0x30288  (parity: 300/300 trials, PROVEN) */

extern int attr_store_set(int a, int b);
int attr_store_init_sequence(int param_1)
{
  int iVar1;
  iVar1 = attr_store_set(((unsigned long)&rodata_ff20) /*=0xff20*/, 0x3c00f091);
  if (iVar1 == 0 && (iVar1 = attr_store_set(0x4820, 6), iVar1 == 0)) {
    iVar1 = 0;
    if (param_1 == 0) {
      iVar1 = attr_store_set(0x4794, 0x5a637955);
      if (iVar1 != 0) {
        iVar1 = 1;
      }
      iVar1 = -iVar1;
    }
  } else {
    iVar1 = -1;
  }
  return iVar1;
}

/* ---- pt_nfc_eeprom_link_init.c ---- */
/* readable reconstruction; identity: FUN_00030b3c @ 0x00030b3c
 * public-name: pt_nfc_eeprom_link_init
 * durable-map: recon/catalogs/function_names_app.json
 * callees (readable <= raw @ address):
 *   attr_store_set                           <= FUN_00030178 @ 0x00030178
 *   flash_driver_reset_sequence              <= FUN_000301bc @ 0x000301bc
 *   flash_apply_config_table                 <= FUN_00030224 @ 0x00030224
 *   attr_store_get                           <= FUN_000302f8 @ 0x000302f8
 *   flash_get_ready_status_bit               <= FUN_000304f0 @ 0x000304f0
 *   commit_default_config_record             <= FUN_00030710 @ 0x00030710
 *   flash_firmware_update_transfer           <= FUN_00030754 @ 0x00030754
 *   pt_nfc_eeprom_link_init                  <= FUN_00030b3c @ 0x00030b3c
 *   wait_for_attr_0x4410_set                 <= FUN_0007cf70 @ 0x0007cf70
 * address symbols (name @ address):
 *   rodata_ff20                              @ 0x0000ff20
 *   g_pt_nfc_link_init_active                @ 0x20003030
 *   g_pt_nfc_link_cfg                        @ 0x20007bc0
 *   g_pt_nfc_link_attr_0x4414_cache          @ 0x20007bc4
 *   g_pt_nfc_link_ready_flag                 @ 0x20007bc8
 *   g_pt_nfc_link_busy                       @ 0x20019dad
 */
/* Reconstructed FUN_00030b3c @ 0x30b3c  (parity: 300/300 trials, PROVEN) */

extern int flash_driver_reset_sequence(void);
extern int flash_apply_config_table(void);
extern int attr_store_get(int,void*);
extern int flash_get_ready_status_bit(void);
extern int commit_default_config_record(void);
extern int flash_firmware_update_transfer(int);
extern int wait_for_attr_0x4410_set(void);

static int pt_nfc_eeprom_link_init(int *param_1){
    uint8_t auStack_1c[4], auStack_18[4], auStack_14[8];
    int iVar1;
    if (param_1 && *param_1 && param_1[1] && param_1[2] && param_1[3]){
        *(volatile int *)((unsigned long)&g_pt_nfc_link_cfg) /*=0x20007bc0*/ = (int)param_1;
        *(volatile int *)((unsigned long)&g_pt_nfc_link_ready_flag) /*=0x20007bc8*/ = 0;
        *(volatile int *)((unsigned long)&g_pt_nfc_link_attr_0x4414_cache) /*=0x20007bc4*/ = 0;
        *(volatile uint8_t *)((unsigned long)&g_pt_nfc_link_busy) /*=0x20019dad*/ = 0;
        *(volatile uint8_t *)((unsigned long)&g_pt_nfc_link_init_active) /*=0x20003030*/ = 1;
        iVar1 = flash_get_ready_status_bit();
        if (iVar1 != -1 && (iVar1=flash_driver_reset_sequence())==0 && (iVar1=wait_for_attr_0x4410_set())!=-1){
            if (iVar1 == -2){
                attr_store_set(((unsigned long)&rodata_ff20) /*=0xff20*/, 0x3c00f091);
                attr_store_get(0x1c00, auStack_1c);
                attr_store_get(0x4744, auStack_14);
                attr_store_get(0x4444, auStack_18);
                attr_store_set(((unsigned long)&rodata_ff20) /*=0xff20*/, 0x3c00f011);
            }
            iVar1 = flash_firmware_update_transfer(iVar1 == -2);
            if (iVar1==0 || ((iVar1=commit_default_config_record())==0 && (iVar1=flash_driver_reset_sequence())==0 && (iVar1=flash_get_ready_status_bit())==0 && (iVar1=wait_for_attr_0x4410_set())==0)){
                iVar1 = flash_apply_config_table();
                if (iVar1 != 0) iVar1 = 1;
                return -iVar1;
            }
        }
    }
    return -1;
}

/* ---- pt_nfc_eeprom_link_start.c ---- */
/* readable reconstruction; identity: FUN_00030c90 @ 0x00030c90
 * public-name: pt_nfc_eeprom_link_start
 * durable-map: recon/catalogs/function_names_app.json
 * callees (readable <= raw @ address):
 *   pt_nfc_eeprom_link_init                  <= FUN_00030b3c @ 0x00030b3c
 *   pt_nfc_eeprom_link_start                 <= FUN_00030c90 @ 0x00030c90
 * address symbols (name @ address):
 *   g_pt_nfc_link_cfg_static                 @ 0x20002408
 *   g_pt_nfc_link_ready                      @ 0x20007bcc
 */
/* Reconstructed FUN_00030c90 @ 0x30c90  (parity: 300/300 trials, PROVEN) */

static int pt_nfc_eeprom_link_init(int *);

void pt_nfc_eeprom_link_start(void)
{
    int iVar1 = pt_nfc_eeprom_link_init(((unsigned long)&g_pt_nfc_link_cfg_static) /*=0x20002408*/);
    if (iVar1 >= 0) {
        *(volatile unsigned int *)((unsigned long)&g_pt_nfc_link_ready) /*=0x20007bcc*/ = 1;
    }
}

/* ---- nfc_eeprom_comm_lock.c ---- */
/* readable reconstruction; identity: FUN_00030cb8 @ 0x00030cb8
 * public-name: nfc_eeprom_comm_lock
 * durable-map: recon/catalogs/function_names_app.json
 * callees (readable <= raw @ address):
 *   nfc_eeprom_comm_lock                     <= FUN_00030cb8 @ 0x00030cb8
 * address symbols (name @ address):
 *   g_fuel_gauge_poll_stop_flag              @ 0x20019dae
 */
/* Reconstructed FUN_00030cb8 @ 0x30cb8  (parity: 300/300 trials, PROVEN) */

void nfc_eeprom_comm_lock(void)
{
    *(volatile unsigned char *)((unsigned long)&g_fuel_gauge_poll_stop_flag) /*=0x20019dae*/ = 1;
}

/* ---- nfc_eeprom_comm_unlock.c ---- */
/* readable reconstruction; identity: FUN_00030cc4 @ 0x00030cc4
 * public-name: nfc_eeprom_comm_unlock
 * durable-map: recon/catalogs/function_names_app.json
 * callees (readable <= raw @ address):
 *   nfc_eeprom_comm_unlock                   <= FUN_00030cc4 @ 0x00030cc4
 * address symbols (name @ address):
 *   g_fuel_gauge_poll_stop_flag              @ 0x20019dae
 */
/* Reconstructed FUN_00030cc4 @ 0x30cc4  (parity: 300/300 trials, PROVEN) */

void nfc_eeprom_comm_unlock(void)
{
    *(volatile unsigned char *)((unsigned long)&g_fuel_gauge_poll_stop_flag) /*=0x20019dae*/ = 0;
}

/* ---- build_device_info_response.c ---- */
/* readable reconstruction; identity: FUN_00031bd8 @ 0x00031bd8
 * public-name: build_device_info_response
 * durable-map: recon/catalogs/function_names_app.json
 * callees (readable <= raw @ address):
 *   get_device_info                          <= FUN_000167a8 @ 0x000167a8
 *   build_device_info_response               <= FUN_00031bd8 @ 0x00031bd8
 * address symbols (name @ address):
 *   rodata_a6603                             @ 0x000a6603   [INLINED -- G6 literal batch]
 *   rodata_a704b                             @ 0x000a704b   [INLINED -- G6 literal batch]
 */
/* Reconstructed FUN_00031bd8 @ 0x31bd8  (parity: 300/300 trials, PROVEN) */

static unsigned build_device_info_response(int param_1, unsigned param_2, uint32_t *param_3, uint8_t *param_4){
  int iVar1; uint16_t uVar2; uint8_t *puVar3;
  log_message(((unsigned long)"join in get_mac_info\n") /*=0xa704b*/);
  if(param_3==0 || param_4==0){ log_message(((unsigned long)"get_mac_info para is NULL\n") /*=0xa6603*/); return 0xffffffff; }
  puVar3=(uint8_t*)*param_3;
  *puVar3=5; puVar3[1]=1; puVar3[2]=3; puVar3[3]=6;
  if(*(char*)(param_1+2)==1){ iVar1=get_device_info(); *(uint32_t*)(puVar3+4)=*(uint32_t*)(iVar1+0xfda); uVar2=*(uint16_t*)(iVar1+0xfde); }
  else { if(*(char*)(param_1+2)!=0) goto LAB; iVar1=get_device_info(); *(uint32_t*)(puVar3+4)=*(uint32_t*)(iVar1+0xfe0); uVar2=*(uint16_t*)(iVar1+0xfe4); }
  *(uint16_t*)(puVar3+8)=uVar2;
  LAB: *param_4=10; return 0;
}

/* ---- test_mode_apply_base_status_cmd.c ---- */
/* readable reconstruction; identity: FUN_00031dd8 @ 0x00031dd8
 * public-name: test_mode_apply_base_status_cmd
 * durable-map: recon/catalogs/function_names_app.json
 * callees (readable <= raw @ address):
 *   get_device_info                          <= FUN_000167a8 @ 0x000167a8
 *   build_and_send_device_status_report      <= FUN_00022b00 @ 0x00022b00
 *   read_sys_settting_from_flash             <= FUN_000232f8 @ 0x000232f8
 *   test_mode_apply_base_status_cmd          <= FUN_00031dd8 @ 0x00031dd8
 *   k_msleep_ticks32768_b                    <= FUN_0007d14a @ 0x0007d14a
 *   memset_bytes                             <= FUN_00086c78 @ 0x00086c78
 *   vdprintf_to_fd                           <= FUN_00086f00 @ 0x00086f00
 * address symbols (name @ address):
 *   rodata_9ddbf                             @ 0x0009ddbf
 *   rodata_a672f                             @ 0x000a672f   [INLINED -- G6 literal batch]
 *   rodata_a715d                             @ 0x000a715d   [INLINED -- G6 literal batch]
 *   rodata_a7173                             @ 0x000a7173   [INLINED -- G6 literal batch]
 *   g_dashboard_lock_pending_flag            @ 0x20007aa4
 *   g_app_switch_pending_flag                @ 0x20007aa8
 *   g_ble_switch_status_reason               @ 0x20007aac
 *   g_test_mode_flag                         @ 0x20019ef3
 */
/* Reconstructed FUN_00031dd8 @ 0x31dd8  (parity: 300/300 trials, PROVEN) */
extern void build_and_send_device_status_report(unsigned,int);
extern void memset_bytes(void*,int,int);
extern void vdprintf_to_fd(void*,int,int,unsigned,int);
unsigned test_mode_apply_base_status_cmd(unsigned param_1, unsigned param_2, unsigned **param_3, unsigned char *param_4)
{
  int *piVar1; int iVar2, iVar4; unsigned uVar3; unsigned char *puVar5; unsigned char uVar6; char cVar7;
  unsigned local_b0; unsigned char auStack_ac[16]; unsigned char auStack_9c[12]; int local_90;
  /* G7-B2 defect fix.  All three of these formats are argument-free --
   *   0xa715d = "join in set_imu_base\n"
   *   0xa7173 = "set_imu_base para is NULL\n"
   *   0xa672f = "warning: not test mode,disable setting\n"
   * -- and the shipped image loads ONLY r0 at 0x31dde, 0x31dea and 0x31e00
   * before each `bl 0x7dda4`.  The extra arguments, and the `uint64_t
   * debug_result` that was assigned from the first call and then fed back as
   * argument 2 of the other two, were decompiler artefacts of r1..r3 being
   * live scratch across a `void` variadic callee (recon/headers/g1_log.h). */
  log_message(((unsigned long)"join in set_imu_base\n") /*=0xa715d*/);
  if ((param_3 == 0) || (param_4 == 0)) {
    log_message(((unsigned long)"set_imu_base para is NULL\n") /*=0xa7173*/);
    return 0xffffffff;
  }
  if (*(char*)((unsigned long)&g_test_mode_flag) /*=0x20019ef3*/ != 1) {
    log_message(((unsigned long)"warning: not test mode,disable setting\n") /*=0xa672f*/);
    return 0xfffffffe;
  }
  puVar5 = (unsigned char*)*param_3;
  *(volatile unsigned char *)(puVar5) = 0x2d;
  *(volatile unsigned char *)(puVar5+2) = 3;
  *(volatile unsigned char *)(puVar5+3) = 5;
  *(volatile unsigned char *)(puVar5+1) = 1;
  piVar1 = (int*)((unsigned long)&g_ble_switch_status_reason) /*=0x20007aac*/;
  local_b0 = 0;
  memset_bytes(auStack_ac, 0, 0x10);
  if ((((*(int*)((unsigned long)&g_app_switch_pending_flag) /*=0x20007aa8*/ == 0 && *piVar1 == 0) && *(int*)((unsigned long)&g_dashboard_lock_pending_flag) /*=0x20007aa4*/ == 0) &&
       (iVar2 = get_device_info(), *(int*)(iVar2+0x107c) == 0)) &&
      (iVar2 = get_device_info(), *(int*)(iVar2+0x1080) == 0)) {
    iVar2 = get_device_info();
    uVar6 = 1;
    if (*(int*)(iVar2+0x1084) == 0) goto LAB_6e;
  }
  iVar2 = get_device_info();
  uVar6 = 0;
  *(volatile int *)(iVar2+0xf64) = *piVar1;
LAB_6e:
  iVar2 = *piVar1;
  *(volatile unsigned char *)(puVar5+4) = uVar6;
  vdprintf_to_fd(&local_b0, 0, 0x14, ((unsigned long)&rodata_9ddbf) /*=0x9ddbf*/, iVar2);
  iVar2 = get_device_info();
  cVar7 = 0;
  *(volatile unsigned int *)(puVar5+5) = *(unsigned*)(iVar2+0xf64);
  uVar3 = get_device_info();
  build_and_send_device_status_report(uVar3, 0);
  iVar2 = get_device_info();
  iVar2 = *(int*)(iVar2+0xf64);
  do {
    iVar4 = read_sys_settting_from_flash(auStack_9c);
    if ((iVar4 == 0) && (local_90 == iVar2)) goto LAB_c0;
    cVar7 = cVar7 + 1;
    k_msleep_ticks32768_b(100);
  } while (cVar7 != 5);
  *(volatile unsigned char *)(puVar5+4) = 2;
LAB_c0:
  *(volatile unsigned char *)param_4 = 9;
  return 0;
}

