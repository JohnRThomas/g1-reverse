/*
 * Call-cohesive translation unit for the `core' module.
 *
 * GENERATED by recon/refactor/transforms/t09_call_cohesion.py.  Do
 * not edit: a stage tree is regenerated, never hand-patched
 * (recon/refactor/README.md C4).
 *
 * The 2 translation units below were grouped because they CALL ONE
 * ANOTHER, not because they were adjacent in the generated source
 * list.  Each member's text is reproduced VERBATIM.  Every member was
 * checked pairwise against every other member already in this unit by
 * stage 04's seven refusal rules, unchanged: no symbol is declared
 * here with two types, no identifier has internal linkage in one
 * member and is named by another, and no local typedef, macro, struct
 * tag or enum constant of one member is visible to a member that
 * names it.
 *
 * members, in generated-source-list order:
 *   g1_core_01.c
 *   g1_core_22.c
 *
 * call edges inside this unit (caller -> callee): 1
 *   g1_core_01.c -> g1_core_22.c
 */

/* File-scope forward declarations for every struct/union tag this
 * unit names.  Without them a tag whose only appearance in a member
 * is inside a parameter list has PARAMETER-LIST scope, so two
 * textually IDENTICAL declarations in two members declare two
 * different incomplete types and the second is a conflicting
 * redeclaration (C11 6.2.1p7).  Incomplete-type forward
 * declarations emit no code. */
struct k_sem;
/* ================================================================ */
/* member unit: g1_core_01.c */
/* ================================================================ */
/*
 * Cohesive translation unit for the `core' module.
 *
 * GENERATED by recon/refactor/transforms/t04_cohesive_tu.py.  Do not
 * edit: a stage tree is regenerated, never hand-patched
 * (recon/refactor/README.md C4).
 *
 * The 3 functions below were 3 separate translation units until this
 * stage.  Each one's text is reproduced VERBATIM and in the order the
 * generated source list gave it, and they were CONSECUTIVE in that list.
 * They were proven able to share a translation unit: no symbol is
 * declared here with two types, no identifier has internal linkage in one
 * member and is named by another, and no local typedef, macro, struct tag
 * or enum constant of one member is visible to a member that names it.
 *
 * members, in link order:
 *   switch_to_dfu_mode.c
 *   power_for_imu_and_mic.c
 *   power_down_imu_and_mic.c
 */
/* ---- switch_to_dfu_mode.c ---- */
#include "g1_app_symbols.h"
#include "../../../headers/g1_log.h"
#include "g1_core.h"
#include "../../../headers/g1_dedupe.h"
/* readable reconstruction; identity: FUN_000158bc @ 0x000158bc
 * public-name: switch_to_dfu_mode
 * durable-map: recon/catalogs/function_names_app.json
 * callees (readable <= raw @ address):
 *   debug_print                              <= FUN_00019c70 @ 0x00019c70
 *   sys_reboot                               <= FUN_0004c0a8 @ 0x0004c0a8
 *   app_msleep_thunk_a                       <= FUN_0007c038 @ 0x0007c038
 *   k_is_in_isr                              <= FUN_00086406 @ 0x00086406
 * address symbols (name @ address):
 *   rodata_990cf                             @ 0x000990cf
 *   rodata_990dc                             @ 0x000990dc   [INLINED -- G6 literal batch]
 *   rodata_99105                             @ 0x00099105   [INLINED -- G6 literal batch]
 *   rodata_99b2a                             @ 0x00099b2a   [INLINED -- G6 literal batch]
 *   g_log_level                              @ 0x2000230c
 *   device_info                              @ 0x200069fc
 *   g_log_use_alt_sink                       @ 0x20007554
 *   g_runtime_mode_flag                      @ 0x2000ff6e
 */
/* Reconstructed switch_to_dfu_mode @ 0x158bc  (parity: 300/300 trials, PROVEN) */

typedef unsigned char u8;
typedef unsigned int u32;
extern _Bool k_is_in_isr(void);
extern void app_msleep_thunk_a(int);

void switch_to_dfu_mode(unsigned int param_1)
{
    volatile u8 *puVar1 = (volatile u8*)((unsigned long)&g_runtime_mode_flag) /*=0x2000ff6e*/;
    int iVar2;
    unsigned int r2val;
    typedef int (*fnptr)(unsigned int, void*, int);

    *puVar1 = 1;
    iVar2 = k_is_in_isr();
    if (iVar2 != 0) {
        process_sync_buffer(param_1);
        return;
    }
    {
        fnptr f = *(fnptr*)((*(volatile u32 *)((unsigned long)&device_info) /*=0x200069fc*/) + 0x1040);
        iVar2 = f(((unsigned long)&rodata_990cf) /*=0x990cf*/, (void*)puVar1, 1);
    }
    if (iVar2 == 0) {
        if (*(volatile int *)((unsigned long)&g_log_level) /*=0x2000230c*/ > 0) {
            if (*(volatile u32 *)((unsigned long)&g_log_use_alt_sink) /*=0x20007554*/ != 0) {
                debug_print(((unsigned long)"%s(): sys reboot because system reset %d, %d\n") /*=0x99105*/, ((unsigned long)"switch_to_dfu_mode") /*=0x99b2a*/, 0, *puVar1);
                goto loop_start;
            } else {
                r2val = 0;
                goto print_lab;
            }
        }
        goto loop_start;
    } else {
        if (*(volatile int *)((unsigned long)&g_log_level) /*=0x2000230c*/ < 1) return;
        if (*(volatile u32 *)((unsigned long)&g_log_use_alt_sink) /*=0x20007554*/ != 0) {
            debug_print(((unsigned long)"%s(): failed to switch to ble mode [%d]\n") /*=0x990dc*/, ((unsigned long)"switch_to_dfu_mode") /*=0x99b2a*/, (unsigned int)iVar2, 0);
            return;
        }
        log_message(((unsigned long)"%s(): failed to switch to ble mode [%d]\n") /*=0x990dc*/, ((unsigned long)"switch_to_dfu_mode") /*=0x99b2a*/, (unsigned int)iVar2, 0);
        return;
    }
loop_start:
    for (;;) {
        app_msleep_thunk_a(500);
        r2val = (unsigned int)sys_reboot(1);
print_lab:
        log_message(((unsigned long)"%s(): sys reboot because system reset %d, %d\n") /*=0x99105*/, ((unsigned long)"switch_to_dfu_mode") /*=0x99b2a*/, r2val);
    }
}

/* ---- power_for_imu_and_mic.c ---- */
/* readable reconstruction; identity: FUN_00015f80 @ 0x00015f80
 * public-name: power_for_imu_and_mic
 * durable-map: recon/catalogs/function_names_app.json
 * callees (readable <= raw @ address):
 *   debug_print                              <= FUN_00019c70 @ 0x00019c70
 *   dev_write_reg3                           <= FUN_00083dc8 @ 0x00083dc8
 * address symbols (name @ address):
 *   rodata_9945a                             @ 0x0009945a   [INLINED -- G6 literal batch]
 *   rodata_99c28                             @ 0x00099c28   [INLINED -- G6 literal batch]
 *   g_log_level                              @ 0x2000230c
 *   g_log_use_alt_sink                       @ 0x20007554
 */
/* Reconstructed power_for_imu_and_mic @ 0x15f80  (parity: 300/300 trials, PROVEN) */

extern int dev_write_reg3(unsigned int,unsigned int,unsigned int,unsigned int);

unsigned int power_for_imu_and_mic(void)
{
    int iVar1 = dev_write_reg3(
        *(volatile unsigned int *)(*(volatile unsigned int *)((unsigned long)&rodata_87ce0 + 4) /*=0x87ce0*/ + 0x1c),
        8, 2, 1);
    if (*(volatile int *)((unsigned long)&g_log_level) /*=0x2000230c*/ < 1) {
        return 0;
    }
    int flag = *(volatile int *)((unsigned long)&g_log_use_alt_sink) /*=0x20007554*/;
    G1_LOG_ROUTE(flag == 0, iVar1 < 0 ? ((unsigned long)"%s(): Could not set ldsw2.\n") /*=0x9945a*/ : ((unsigned long)"%s(): enable ldsw2 for imu and mic\n") /*=0x99476*/, ((unsigned long)"power_for_imu_and_mic") /*=0x99c28*/);
    return 0;
}

/* ---- power_down_imu_and_mic.c ---- */
/* readable reconstruction; identity: FUN_000160b4 @ 0x000160b4
 * public-name: power_down_imu_and_mic
 * durable-map: recon/catalogs/function_names_app.json
 * callees (readable <= raw @ address):
 *   debug_print                              <= FUN_00019c70 @ 0x00019c70
 *   dev_write_reg3                           <= FUN_00083dc8 @ 0x00083dc8
 * address symbols (name @ address):
 *   rodata_9945a                             @ 0x0009945a   [INLINED -- G6 literal batch]
 *   rodata_99c00                             @ 0x00099c00   [INLINED -- G6 literal batch]
 *   g_log_level                              @ 0x2000230c
 *   g_log_use_alt_sink                       @ 0x20007554
 */
/* Reconstructed power_down_imu_and_mic @ 0x160b4  (parity: 300/300 trials, PROVEN) */


unsigned int power_down_imu_and_mic(void)
{
    int iVar1 = dev_write_reg3(
        *(volatile unsigned int *)(*(volatile unsigned int *)((unsigned long)&rodata_87ce0 + 4) /*=0x87ce0*/ + 0x1c),
        8, 3, 1);
    if (*(volatile int *)((unsigned long)&g_log_level) /*=0x2000230c*/ < 1) {
        return 0;
    }
    int flag = *(volatile int *)((unsigned long)&g_log_use_alt_sink) /*=0x20007554*/;
    G1_LOG_ROUTE(flag == 0, iVar1 < 0 ? ((unsigned long)"%s(): Could not set ldsw2.\n") /*=0x9945a*/ : 0x000994f7, ((unsigned long)"power_down_imu_and_mic") /*=0x99c00*/);
    return 0;
}

/* ================================================================ */
/* member unit: g1_core_22.c */
/* ================================================================ */
/*
 * Cohesive translation unit for the `core' module.
 *
 * GENERATED by recon/refactor/transforms/t04_cohesive_tu.py.  Do not
 * edit: a stage tree is regenerated, never hand-patched
 * (recon/refactor/README.md C4).
 *
 * The 11 functions below were 11 separate translation units until this
 * stage.  Each one's text is reproduced VERBATIM and in the order the
 * generated source list gave it, and they were CONSECUTIVE in that list.
 * They were proven able to share a translation unit: no symbol is
 * declared here with two types, no identifier has internal linkage in one
 * member and is named by another, and no local typedef, macro, struct tag
 * or enum constant of one member is visible to a member that names it.
 *
 * members, in link order:
 *   power_manager_system_off.c
 *   boot_write_image_trailer_magic.c
 *   flag32_channel_alloc_wrapper.c
 *   sem_init_zero.c
 *   app_msleep_thunk_a.c
 *   device_info_set_bytes_cc_ce.c
 *   device_info_store_chunk.c
 *   store_device_info_bytes_cd_cf.c
 *   app_msleep_thunk_b.c
 *   rproc_virtio_negotiate_features.c
 *   init_config_fields_default9.c
 */

/* File-scope forward declarations for every struct/union tag this
 * unit names.  Without them a tag whose only appearance in a member
 * is inside a parameter list has PARAMETER-LIST scope, so two
 * textually IDENTICAL declarations in two members declare two
 * different incomplete types and the second is a conflicting
 * redeclaration (C11 6.2.1p7).  Incomplete-type forward
 * declarations emit no code. */
struct k_sem;
/* ---- power_manager_system_off.c ---- */
#include "g1_app_symbols.h"
#include "../../../headers/g1_log.h"
#include "../../../headers/g1_dedupe.h"
#include "g1_core.h"
/* readable reconstruction; identity: FUN_00063c3c @ 0x00063c3c
 * public-name: power_manager_system_off
 * durable-map: recon/catalogs/function_names_app.json
 * callees (readable <= raw @ address):
 *   z_log_msg_runtime_create                 <= FUN_0004d944 @ 0x0004d944
 *   app_event_manager_submit                 <= FUN_0004f770 @ 0x0004f770
 *   ancs_notify_table_is_idle                <= FUN_00063ba8 @ 0x00063ba8
 *   app_event_submit_power                   <= FUN_00063bcc @ 0x00063bcc
 *   power_manager_set_system_off_flag        <= FUN_00063c14 @ 0x00063c14
 *   power_manager_system_off                 <= FUN_00063c3c @ 0x00063c3c
 *   assert_post_action                       <= FUN_0007e2ec @ 0x0007e2ec
 *   printk                                   <= FUN_0007e2fa @ 0x0007e2fa
 * address symbols (name @ address):
 *   rodata_88268                             @ 0x00088268
 *   rodata_99cbd                             @ 0x00099cbd   [INLINED -- G6 literal batch]
 *   rodata_f6716                             @ 0x000f6716
 *   rodata_f6749                             @ 0x000f6749   [INLINED -- G6 literal batch]
 *   rodata_f6769                             @ 0x000f6769   [INLINED -- G6 literal batch]
 *   rodata_f67a5                             @ 0x000f67a5
 *   g_caf_power_manager_system_off_flag      @ 0x2001d563
 */
/* Reconstructed FUN_00063c3c @ 0x63c3c  (parity: 300/300 trials, PROVEN) */

extern void z_log_msg_runtime_create(unsigned int, unsigned int, unsigned int, unsigned int);
extern void app_event_manager_submit(unsigned long*);
extern int ancs_notify_table_is_idle(int);
extern int app_event_submit_power(void);
extern void assert_post_action(const char *, unsigned int);
static void power_manager_system_off(void){
  int iVar1; unsigned local_18, local_14;
  unsigned char r5 = *(volatile unsigned char *)((unsigned long)&g_caf_power_manager_system_off_flag) /*=0x2001d563*/;
  if(r5 != 0){
    G1_ASSERT_FAIL((((unsigned long)"ASSERTION FAIL [%s] @ %s:%d\n") /*=0x99cbd*/,((unsigned long)"power_state == POWER_STATE_IDLE") /*=0xf6749*/,((unsigned long)&rodata_f6716) /*=0xf6716*/,0xab), (((unsigned long)&rodata_f6716) /*=0xf6716*/,0xab));
  }
  L:
  iVar1 = ancs_notify_table_is_idle(r5);
  if(iVar1==0){
    G1_ASSERT_FAIL((((unsigned long)"ASSERTION FAIL [%s] @ %s:%d\n") /*=0x99cbd*/,((unsigned long)"check_if_power_state_allowed(POWER_MANAGER_LEVEL_SUSPENDED)") /*=0xf6769*/,((unsigned long)&rodata_f6716) /*=0xf6716*/,0xac), (((unsigned long)&rodata_f6716) /*=0xf6716*/,0xac));
    goto L;
  }
  local_14=((unsigned long)&rodata_f67a5) /*=0xf67a5*/; local_18=2;
  z_log_msg_runtime_create(((unsigned long)&rodata_88268) /*=0x88268*/,0x10c0,&local_18,0);
  iVar1=app_event_submit_power();
  *(unsigned char*)(iVar1+8)=r5;
  power_manager_set_system_off_flag(1);
  app_event_manager_submit(iVar1);
  return;
}

/* ---- boot_write_image_trailer_magic.c ---- */
/* readable reconstruction; identity: FUN_00063ff8 @ 0x00063ff8
 * public-name: boot_write_image_trailer_magic
 * durable-map: recon/catalogs/function_names_app.json
 * callees (readable <= raw @ address):
 *   boot_write_image_trailer_magic           <= FUN_00063ff8 @ 0x00063ff8
 *   flash_area_write                         <= FUN_0007efaa @ 0x0007efaa
 *   flash_area_erased_val                    <= FUN_0007f012 @ 0x0007f012
 * address symbols (name @ address):
 *   rodata_9907c                             @ 0x0009907c
 */
/* Reconstructed FUN_00063ff8 @ 0x63ff8  (parity: 300/300 trials, PROVEN) */

extern unsigned int flash_area_erased_val(unsigned int);
extern int flash_area_write(int a, unsigned int b, void *c, int d);

static int boot_write_image_trailer_magic(int param_1)
{
  unsigned int local_28[5];
  unsigned int iVar2 = *(volatile unsigned int *)(param_1+8);
  unsigned int i;
  volatile unsigned int *src = (volatile unsigned int*)((unsigned long)&rodata_9907c) /*=0x9907c*/;
  int r;
  flash_area_erased_val(param_1);
  for (i = 0; i < 4; i++) {
    local_28[i] = src[i];
  }
  r = flash_area_write(param_1, (iVar2 - 0x10) & 0xfffffff8, local_28, 0x10);
  if (r != 0) r = 1;
  return r;
}

/* ---- flag32_channel_alloc_wrapper.c ---- */
/* readable reconstruction; identity: FUN_0006540c @ 0x0006540c
 * public-name: flag32_channel_alloc_wrapper
 * durable-map: recon/catalogs/function_names_app.json
 * callees (readable <= raw @ address):
 *   nrfx_flag32_alloc                        <= FUN_00064eb8 @ 0x00064eb8
 *   flag32_channel_alloc_wrapper             <= FUN_0006540c @ 0x0006540c
 * address symbols (name @ address):
 *   g_flag32_channel_alloc_mask              @ 0x20002bbc
 */
/* Reconstructed FUN_0006540c @ 0x6540c  (parity: 300/300 trials, PROVEN) */

extern void nrfx_flag32_alloc(unsigned int, unsigned int);
void flag32_channel_alloc_wrapper(unsigned int param_1)
{
    nrfx_flag32_alloc(((unsigned long)&g_flag32_channel_alloc_mask) /*=0x20002bbc*/, param_1);
}

/* ---- sem_init_zero.c ---- */
/* readable reconstruction; identity: FUN_0007c030 @ 0x0007c030
 * public-name: sem_init_zero
 * durable-map: recon/catalogs/function_names_app.json
 * callees (readable <= raw @ address):
 *   sem_init_zero                            <= FUN_0007c030 @ 0x0007c030
 *   z_impl_k_sem_init                        <= FUN_00086534 @ 0x00086534
 */
/* Reconstructed FUN_0007c030 @ 0x7c030  (parity: 300/300 trials, PROVEN) */

extern int z_impl_k_sem_init(struct k_sem *, unsigned int,  unsigned int);
unsigned int sem_init_zero(void*param_1, unsigned int param_2) {
    z_impl_k_sem_init(param_1, 0, param_2);
}

/* ---- app_msleep_thunk_a.c ---- */
#include <stdint.h>
/* readable reconstruction; identity: FUN_0007c038 @ 0x0007c038
 * public-name: app_msleep_thunk_a
 * durable-map: recon/catalogs/function_names_app.json
 * callees (readable <= raw @ address):
 *   __aeabi_uldivmod                         <= FUN_0000e244 @ 0x0000e244
 *   k_sleep                                  <= FUN_00074844 @ 0x00074844
 *   app_msleep_thunk_a                       <= FUN_0007c038 @ 0x0007c038
 */
/* Reconstructed FUN_0007c038 @ 0x7c038  (parity: 300/300 trials, PROVEN) */

extern int32_t k_sleep(k_timeout_t);
void app_msleep_thunk_a(int param_1)
{
  __aeabi_uldivmod(param_1 * 0x8000 + 999, param_1 >> 0x11, 1000, 0);
  k_sleep();
  return;
}

/* ---- device_info_set_bytes_cc_ce.c ---- */
/* readable reconstruction; identity: FUN_0007c176 @ 0x0007c176
 * public-name: device_info_set_bytes_cc_ce
 * durable-map: recon/catalogs/function_names_app.json
 * callees (readable <= raw @ address):
 *   get_device_info                          <= FUN_000167a8 @ 0x000167a8
 *   device_info_set_bytes_cc_ce              <= FUN_0007c176 @ 0x0007c176
 */
/* Reconstructed FUN_0007c176 @ 0x7c176  (parity: 300/300 trials, PROVEN) */

extern int get_device_info(void);
void device_info_set_bytes_cc_ce(unsigned char param_1, unsigned char param_2) {
    char *p1 = get_device_info();
    *(volatile unsigned char *)(p1 + 0xce) = param_2;
    char *p2 = get_device_info();
    *(volatile unsigned char *)(p2 + 0xcc) = param_1;
}

/* ---- device_info_store_chunk.c ---- */
/* readable reconstruction; identity: FUN_0007c1aa @ 0x0007c1aa
 * public-name: device_info_store_chunk
 * durable-map: recon/catalogs/function_names_app.json
 * callees (readable <= raw @ address):
 *   get_device_info                          <= FUN_000167a8 @ 0x000167a8
 *   device_info_store_chunk                  <= FUN_0007c1aa @ 0x0007c1aa
 *   memcpy                                   <= FUN_00086c04 @ 0x00086c04
 */
/* Reconstructed FUN_0007c1aa @ 0x7c1aa  (parity: 300/300 trials, PROVEN) */

extern unsigned int memcpy(unsigned int, unsigned int, unsigned int);

unsigned int device_info_store_chunk(unsigned int param_1, unsigned int param_2, unsigned char param_3, int param_4)
{
    unsigned int base;
    unsigned int uVar2;
    if (param_4 == 0) {
        base = get_device_info();
        uVar2 = *(volatile unsigned int *)(base + 0x1028UL);
    } else {
        base = get_device_info();
        uVar2 = *(volatile unsigned int *)(base + 0x1024UL);
    }
    unsigned int r0 = memcpy(uVar2, param_1, param_2);
    *(volatile unsigned char *)(r0 + 0x200UL) = param_3;
    return 0;
}

/* ---- store_device_info_bytes_cd_cf.c ---- */
/* readable reconstruction; identity: FUN_0007c1dc @ 0x0007c1dc
 * public-name: store_device_info_bytes_cd_cf
 * durable-map: recon/catalogs/function_names_app.json
 * callees (readable <= raw @ address):
 *   get_device_info                          <= FUN_000167a8 @ 0x000167a8
 *   device_info_set_bytes_cc_ce              <= FUN_0007c176 @ 0x0007c176
 *   store_device_info_bytes_cd_cf            <= FUN_0007c1dc @ 0x0007c1dc
 */
/* Reconstructed FUN_0007c1dc @ 0x7c1dc  (parity: 300/300 trials, PROVEN) */

extern void device_info_set_bytes_cc_ce(unsigned char, unsigned char);
unsigned int store_device_info_bytes_cd_cf(unsigned char param_1, unsigned char param_2, int param_3)
{
  int iVar1;
  if (param_3 == 0) {
    iVar1 = get_device_info();
    *(volatile unsigned char *)(iVar1 + 0xcf) = param_2;
    iVar1 = get_device_info();
    *(volatile unsigned char *)(iVar1 + 0xcd) = param_1;
  } else {
    device_info_set_bytes_cc_ce(param_1, param_2);
  }
  return 0;
}

/* ---- app_msleep_thunk_b.c ---- */
/* readable reconstruction; identity: FUN_0007c26e @ 0x0007c26e
 * public-name: app_msleep_thunk_b
 * durable-map: recon/catalogs/function_names_app.json
 * callees (readable <= raw @ address):
 *   __aeabi_uldivmod                         <= FUN_0000e244 @ 0x0000e244
 *   k_sleep                                  <= FUN_00074844 @ 0x00074844
 *   app_msleep_thunk_b                       <= FUN_0007c26e @ 0x0007c26e
 */
/* Reconstructed FUN_0007c26e @ 0x7c26e  (parity: 300/300 trials, PROVEN) */

void app_msleep_thunk_b(int param_1)
{
  __aeabi_uldivmod(param_1 * 0x8000 + 999, param_1 >> 0x11, 1000, 0);
  k_sleep();
  return;
}

/* ---- rproc_virtio_negotiate_features.c ---- */
/* readable reconstruction; identity: FUN_0007c34a @ 0x0007c34a
 * public-name: rproc_virtio_negotiate_features
 * durable-map: recon/catalogs/function_names_app.json
 * callees (readable <= raw @ address):
 *   build_and_send_device_status_report      <= FUN_00022b00 @ 0x00022b00
 *   save_usr_setting                         <= FUN_0007c28e @ 0x0007c28e
 *   rproc_virtio_negotiate_features          <= FUN_0007c34a @ 0x0007c34a
 */
/* Reconstructed FUN_0007c34a @ 0x7c34a  (parity: 300/300 trials, PROVEN) */

extern int build_and_send_device_status_report(const unsigned char*);
extern void save_usr_setting(unsigned int, unsigned int);

unsigned int rproc_virtio_negotiate_features(void*param_1, unsigned int param_2) {
    build_and_send_device_status_report(param_1);
    save_usr_setting(param_1, param_2);
    return 0;
}

/* ---- init_config_fields_default9.c ---- */
/* readable reconstruction; identity: FUN_0007c3c2 @ 0x0007c3c2
 * public-name: init_config_fields_default9
 * durable-map: recon/catalogs/function_names_app.json
 * callees (readable <= raw @ address):
 *   init_config_fields_default9              <= FUN_0007c3c2 @ 0x0007c3c2
 */
/* Reconstructed FUN_0007c3c2 @ 0x7c3c2  (parity: 300/300 trials, PROVEN) */

void init_config_fields_default9(void *param_1)
{
  *(volatile uint8_t *)((char*)param_1 + 0xb) = 9;
  *(volatile uint8_t *)((char*)param_1 + 0xc) = 9;
  *(volatile uint16_t *)((char*)param_1 + 0x30) = 0x909;
  return;
}

