/*
 * Cohesive translation unit for the `core' module.
 *
 * GENERATED by recon/refactor/transforms/t04_cohesive_tu.py.  Do not
 * edit: a stage tree is regenerated, never hand-patched
 * (recon/refactor/README.md C4).
 *
 * The 5 functions below were 5 separate translation units until this
 * stage.  Each one's text is reproduced VERBATIM and in the order the
 * generated source list gave it, and they were CONSECUTIVE in that list.
 * They were proven able to share a translation unit: no symbol is
 * declared here with two types, no identifier has internal linkage in one
 * member and is named by another, and no local typedef, macro, struct tag
 * or enum constant of one member is visible to a member that names it.
 *
 * members, in link order:
 *   dev_update_bits5.c
 *   dev_write_config_word.c
 *   dev_ctrl_write1.c
 *   dev_ctrl_write2.c
 *   dev_ctrl_read1.c
 */

/* File-scope forward declarations for every struct/union tag this
 * unit names.  Without them a tag whose only appearance in a member
 * is inside a parameter list has PARAMETER-LIST scope, so two
 * textually IDENTICAL declarations in two members declare two
 * different incomplete types and the second is a conflicting
 * redeclaration (C11 6.2.1p7).  Incomplete-type forward
 * declarations emit no code. */
struct g1_i2c_msg;
/* ---- dev_update_bits5.c ---- */
#include "g1_app_symbols.h"
/* readable reconstruction; identity: FUN_00083bca @ 0x00083bca
 * public-name: dev_update_bits5
 * durable-map: recon/catalogs/function_names_app.json
 * callees (readable <= raw @ address):
 *   dev_write_bits5_diff                     <= FUN_00083b62 @ 0x00083b62
 *   dev_read_bits5                           <= FUN_00083ba6 @ 0x00083ba6
 *   dev_update_bits5                         <= FUN_00083bca @ 0x00083bca
 */
/* Reconstructed FUN_00083bca @ 0x83bca  (parity: 300/300 trials, PROVEN) */

extern int dev_read_bits5(unsigned int a, unsigned int *b, unsigned int c, unsigned int d, unsigned int e);
extern void dev_write_bits5_diff(unsigned int a, unsigned int b, unsigned int c);

void dev_update_bits5(unsigned int param_1, unsigned int param_2, unsigned int param_3, unsigned int param_4)
{
  unsigned int local_14 = param_2;
  int iVar1 = dev_read_bits5(param_1, &local_14, param_3, param_4, param_1);
  if (iVar1 >= 0) {
    dev_write_bits5_diff(param_1, param_2, ~local_14);
  }
}

/* ---- dev_write_config_word.c ---- */
/* readable reconstruction; identity: FUN_00083bf0 @ 0x00083bf0
 * public-name: dev_write_config_word
 * durable-map: recon/catalogs/function_names_app.json
 * callees (readable <= raw @ address):
 *   dev_write_config_word                    <= FUN_00083bf0 @ 0x00083bf0
 *   dev_write_reg3                           <= FUN_00083dc8 @ 0x00083dc8
 *   k_is_in_isr                              <= FUN_00086406 @ 0x00086406
 * address symbols (name @ address):
 *   rodata_10000                             @ 0x00010000
 */
/* Reconstructed FUN_00083bf0 @ 0x83bf0  (parity: 300/300 trials, PROVEN) */
extern int dev_write_reg3(unsigned int, unsigned int, unsigned int, unsigned int);
extern _Bool k_is_in_isr(void);
int dev_write_config_word(int param_1, unsigned param_2, int param_3){
  int iVar3 = *(int*)(param_1 + 4);
  unsigned uVar2;
  int iVar1;
  if (k_is_in_isr() != 0) return -0xb;
  if (param_2 > 4) return -0x16;
  uVar2 = 0;
  if ((param_3 & ((unsigned long)&rodata_10000) /*=0x10000*/) == 0){
    if (param_3 & 0x400) uVar2 = 6;
    else if (param_3 & 0x800) uVar2 = 7;
    else if (param_3 & 0x80000) uVar2 = 8;
    else { if ((param_3 & 0x20000) == 0) goto L_c36; uVar2 = 9; }
  }
  iVar1 = dev_write_reg3(*(int*)(iVar3+4), 6, param_2, uVar2);
  if (iVar1 < 0) return iVar1;
 L_c36:
  iVar1 = dev_write_reg3(*(int*)(iVar3+4), 6, (param_2+0x14)&0xff, (unsigned)(param_3>>1)&1);
  if (iVar1 < 0) return iVar1;
  iVar1 = dev_write_reg3(*(int*)(iVar3+4), 6, (param_2+0xa)&0xff, (unsigned)(param_3>>4)&1);
  if (iVar1 < 0) return iVar1;
  iVar1 = dev_write_reg3(*(int*)(iVar3+4), 6, (param_2+0xf)&0xff, (unsigned)(param_3>>5)&1);
  if (iVar1 < 0) return iVar1;
  iVar1 = dev_write_reg3(*(int*)(iVar3+4), 6, (param_2+5)&0xff, (unsigned)(param_3>>8)&1);
  if (iVar1 < 0) return iVar1;
  return dev_write_reg3(*(int*)(iVar3+4), 6, (param_2+0x19)&0xff, (unsigned)(param_3>>9)&1);
}

/* ---- dev_ctrl_write1.c ---- */
/* readable reconstruction; identity: FUN_00083d60 @ 0x00083d60
 * public-name: dev_ctrl_write1
 * durable-map: recon/catalogs/function_names_app.json
 * callees (readable <= raw @ address):
 *   dev_ctrl_write1                          <= FUN_00083d60 @ 0x00083d60
 */
/* Reconstructed FUN_00083d60 @ 0x83d60  (parity: 300/300 trials, PROVEN) */

typedef void (*fnptr)(int, void*, int, short, void*);
void dev_ctrl_write1(int *param_1,unsigned int param_2,unsigned int param_3,unsigned int param_4)
{
  /* struct i2c_msg { uint8_t *buf; uint32_t len; uint8_t flags; }
   * ITERATION-10 DEFECT FIX: the original stores flags = 2
   * (I2C_MSG_WRITE | I2C_MSG_STOP) into the message; the earlier
   * reconstruction dropped that store, because the parity harness compares
   * only NON-STACK writes and this message is a stack object.  Original
   * disassembly (FUN_00083d60 @ 0x83d60, 32 B):
   *     83d62  mov    r3, r0
   *     83d64  strd   r1, r2, [sp, #4]      ; msg.buf, msg.len
   *     83d68  movs   r2, #2
   *     83d6e  strb.w r2, [sp, #0xc]        ; msg.flags = 2   <-- was missing
   *     83d74  add    r1, sp, #4            ; &msg
   *     83d78  movs   r2, #1                ; num_msgs
   *     83d7a  blx    r4                    ; api->transfer
   */
  struct { unsigned int buf; unsigned int len; unsigned char flags; } msg;
  int base;
  int vt;
  fnptr f;
  unsigned short h;
  msg.buf = param_2;
  msg.len = param_3;
  msg.flags = 2;
  base = *param_1;
  vt = *(volatile int *)(base + 8);
  f = (fnptr)(*(volatile int *)(vt + 8));
  h = *(volatile unsigned short *)((char*)param_1 + 4);
  f(base, &msg, 1, (short)h, param_1);
  return;
}

/* ---- dev_ctrl_write2.c ---- */
/* readable reconstruction; identity: FUN_00083d80 @ 0x00083d80
 * public-name: dev_ctrl_write2
 * durable-map: recon/catalogs/function_names_app.json
 * callees (readable <= raw @ address):
 *   dev_ctrl_write2                          <= FUN_00083d80 @ 0x00083d80
 */
/* Reconstructed dev_ctrl_write2 @ 0x83d80  (CFG-directed candidate) */
/* Reconstructed dev_ctrl_write2 @ 0x83d80  (dev_ctrl_write2)
 *
 * ITERATION-13 DEFECT FIX, same class as iteration 10's fix to
 * dev_ctrl_write1 (0x83d60): the message array is a STACK object, and the
 * parity harness compares only NON-stack writes, so a body that never
 * materialises it still reported "300/300 PROVEN".  The previous
 * reconstruction declared six unrelated locals and passed `&local_28`,
 * relying on GCC laying them out contiguously.  GCC instead dropped every
 * store except the one whose address escapes, and the linked code was
 *     push {r0,r1,r4,lr} ; add r2,sp,#3 ; str r2,[sp,#4] ; strb r1,[sp,#3]
 *     add r1,sp,#4 ; movs r2,#2 ; blx r4
 * i.e. a two-element i2c_msg array of which only msgs[0].buf was written.
 * nrfx_twim then asserted on an uninitialised 16-bit-overflowing length
 * (nrfx_twim.c:593) and the boot reset at 0.0466 s.
 *
 * Original (58 B):
 *     83d84  strb.w r1,[sp,#4]        ; data[0]
 *     83d98  strb.w r2,[sp,#5]        ; data[1]
 *     83d9c  add    r2,sp,#4
 *     83d9e  str    r2,[sp,#8]        ; msgs[0].buf  = data
 *     83da6  str    r2,[sp,#12]       ; msgs[0].len  = 2
 *     83d92  strb.w r1,[sp,#16]       ; msgs[0].flags= 0
 *     83da8  str    r5,[sp,#20]       ; msgs[1].buf  = param_4
 *     83da0  str    r1,[sp,#24]       ; msgs[1].len  = param_5 (stack arg)
 *     83daa  strb.w r1,[sp,#28]       ; msgs[1].flags= 7
 *     83db2  add    r1,sp,#8          ; msgs
 *     83da2  movs   r2,#2             ; num_msgs
 *     83db4  blx    r4                ; api->transfer(bus, msgs, 2, addr)
 * The result of the transfer is returned (the original does not touch r0
 * between `blx` and `pop`), which dev_reg_modify_bits relies on.
 */

typedef int (*g1_i2c_transfer_fn)(int bus, void *msgs, int num_msgs,
                                  unsigned short addr);

struct g1_i2c_msg {
    unsigned int buf;
    unsigned int len;
    unsigned char flags;
};

static int dev_ctrl_write2(int param_1, unsigned char param_2, unsigned char param_3,
                 unsigned int param_4, unsigned int param_5)
{
    struct g1_i2c_msg msgs[2];
    unsigned char data[2];
    int *spec;
    int base;
    g1_i2c_transfer_fn f;

    spec = *(int **)(param_1 + 4);
    base = *spec;
    data[0] = param_2;
    data[1] = param_3;
    msgs[0].buf = (unsigned int)(unsigned long)&data[0];
    msgs[0].len = 2;
    msgs[0].flags = 0;
    msgs[1].buf = param_4;
    msgs[1].len = param_5;
    msgs[1].flags = 7;
    f = (g1_i2c_transfer_fn)(*(volatile int *)(*(volatile int *)(base + 8) + 8));
    return f(base, msgs, 2, *(volatile unsigned short *)((char *)spec + 4));
}

/* ---- dev_ctrl_read1.c ---- */
/* readable reconstruction; identity: FUN_00083dba @ 0x00083dba
 * public-name: dev_ctrl_read1
 * durable-map: recon/catalogs/function_names_app.json
 * callees (readable <= raw @ address):
 *   dev_ctrl_write2                          <= FUN_00083d80 @ 0x00083d80
 *   dev_ctrl_read1                           <= FUN_00083dba @ 0x00083dba
 */
/* Reconstructed dev_ctrl_read1 @ 0x83dba  (CFG-directed candidate) */
/* Reconstructed dev_ctrl_read1 @ 0x83dba  (dev_ctrl_read1)
 *
 * ITERATION-13 DEFECT FIX, same class as iteration 12's k_thread_create
 * veneer (0x7cb66): the previous reconstruction declared both this function
 * and its callee as taking NO arguments and simply calling through, which GCC
 * compiled to a bare `b.w` tail branch.  That forwarded the caller's register
 * arguments by accident and left the fifth (stack) argument -- the message
 * length -- as whatever the caller happened to have below its own frame.
 *
 * Original (14 B):
 *     83dba  push {r0,r1,r4,lr}
 *     83dbc  movs r4,#1
 *     83dbe  str  r4,[sp,#0]      ; 5th argument = 1
 *     83dc0  bl   0x83d80         ; dev_ctrl_write2(dev,b1,b2,buf,1)
 *     83dc4  add  sp,#8
 *     83dc6  pop  {r4,pc}         ; returns dev_ctrl_write2's result
 */

extern int dev_ctrl_write2(int param_1, unsigned char param_2,
                        unsigned char param_3, unsigned int param_4,
                        unsigned int param_5);

int dev_ctrl_read1(int param_1, unsigned char param_2, unsigned char param_3,
                 unsigned int param_4)
{
    return dev_ctrl_write2(param_1, param_2, param_3, param_4, 1);
}

