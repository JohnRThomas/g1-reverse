/*
 * Call-cohesive translation unit for the `core' module.
 *
 * GENERATED by recon/refactor/transforms/t09_call_cohesion.py.  Do
 * not edit: a stage tree is regenerated, never hand-patched
 * (recon/refactor/README.md C4).
 *
 * The 2 translation units below were grouped because they CALL ONE
 * ANOTHER, not because they were adjacent in the generated source
 * list.  Each member's text is reproduced VERBATIM.  Every member was
 * checked pairwise against every other member already in this unit by
 * stage 04's seven refusal rules, unchanged: no symbol is declared
 * here with two types, no identifier has internal linkage in one
 * member and is named by another, and no local typedef, macro, struct
 * tag or enum constant of one member is visible to a member that
 * names it.
 *
 * members, in generated-source-list order:
 *   g1_core_07.c
 *   g1_core_09.c
 *
 * call edges inside this unit (caller -> callee): 1
 *   g1_core_09.c -> g1_core_07.c
 */

/* File-scope forward declarations for every struct/union tag this
 * unit names.  Without them a tag whose only appearance in a member
 * is inside a parameter list has PARAMETER-LIST scope, so two
 * textually IDENTICAL declarations in two members declare two
 * different incomplete types and the second is a conflicting
 * redeclaration (C11 6.2.1p7).  Incomplete-type forward
 * declarations emit no code. */
struct device;
struct watchdog_timeout_cfg;
struct watchdog_window;
/* ================================================================ */
/* member unit: g1_core_07.c */
/* ================================================================ */
/*
 * Cohesive translation unit for the `core' module.
 *
 * GENERATED by recon/refactor/transforms/t04_cohesive_tu.py.  Do not
 * edit: a stage tree is regenerated, never hand-patched
 * (recon/refactor/README.md C4).
 *
 * The 2 functions below were 2 separate translation units until this
 * stage.  Each one's text is reproduced VERBATIM and in the order the
 * generated source list gave it, and they were CONSECUTIVE in that list.
 * They were proven able to share a translation unit: no symbol is
 * declared here with two types, no identifier has internal linkage in one
 * member and is named by another, and no local typedef, macro, struct tag
 * or enum constant of one member is visible to a member that names it.
 *
 * members, in link order:
 *   low_speed_peripheral_dispatch_thread_for_test.c
 *   check_bind_status.c
 */
/* ---- low_speed_peripheral_dispatch_thread_for_test.c ---- */
#include "g1_app_symbols.h"
/* readable reconstruction; identity: FUN_0002685c @ 0x0002685c
 * public-name: low_speed_peripheral_dispatch_thread_for_test
 * durable-map: recon/catalogs/function_names_app.json
 * callees (readable <= raw @ address):
 *   debug_print                              <= FUN_00019c70 @ 0x00019c70
 *   handle_box_placement_event               <= FUN_00025528 @ 0x00025528
 *   low_speed_peripheral_dispatch_thread_for_test <= FUN_0002685c @ 0x0002685c
 *   watchdog_feed_retry                      <= FUN_0002ae84 @ 0x0002ae84
 *   disable_watchdog                         <= FUN_0002aeb4 @ 0x0002aeb4
 *   mark_master_or_low_battery_flag          <= FUN_0002efc0 @ 0x0002efc0
 *   set_click_dispatch_flag                  <= FUN_00032fd0 @ 0x00032fd0
 *   sys_reboot                               <= FUN_0004c0a8 @ 0x0004c0a8
 *   k_msleep                                 <= FUN_0007cb8e @ 0x0007cb8e
 * address symbols (name @ address):
 *   rodata_28000                             @ 0x00028000
 *   rodata_87d70                             @ 0x00087d70
 *   rodata_9fc8b                             @ 0x0009fc8b   [INLINED -- G6 literal batch]
 *   rodata_9fc99                             @ 0x0009fc99   [INLINED -- G6 literal batch]
 *   rodata_a19e5                             @ 0x000a19e5   [INLINED -- G6 literal batch]
 *   g_log_level                              @ 0x2000230c
 *   g_flash_crc_active_flag                  @ 0x2000302c
 *   g_log_use_alt_sink                       @ 0x20007554
 *   g_flash_crc_skip_watchdog_flag           @ 0x20018d90
 */
/* Full reconstruction FUN_0002685c @ 0x2685c, exact extent 176 bytes.
 * CFG_VERIFY_PREFIX_FIRST CFG_VERIFY_PREFIX_K=150 */
#include <stdint.h>
#include "../../../headers/g1_log.h"
#include "g1_core.h"
#include "../../../headers/g1_dedupe.h"
extern void handle_box_placement_event(void);
extern void watchdog_feed_retry(void);
extern int disable_watchdog(void);
extern unsigned int mark_master_or_low_battery_flag(void);
extern void set_click_dispatch_flag(long);
extern int32_t k_msleep(int32_t);
extern void wait_for_event(uint32_t, uint32_t);

void low_speed_peripheral_dispatch_thread_for_test(uintptr_t context)
{
    volatile int *const log_level = (volatile int *)((unsigned long)&g_log_level) /*=0x2000230c*/;
    if (*log_level > 1) {
        if (*(volatile int *)((unsigned long)&g_log_use_alt_sink) /*=0x20007554*/)
            debug_print(((unsigned long)"%s(): #enter\n") /*=0x9fc8b*/, ((unsigned long)"low_speed_peripheral_dispatch_thread_for_test") /*=0xa19e5*/);
        else
            log_message(((unsigned long)"%s(): #enter\n") /*=0x9fc8b*/, ((unsigned long)"low_speed_peripheral_dispatch_thread_for_test") /*=0xa19e5*/);
    }

    *(volatile uint16_t *)(context + 0xfc0) = 0;
    *(volatile uint16_t *)(context + 0xfc4) = 0x8000;
    uint32_t count = 0;
    for (;;) {
        if (*(volatile uint8_t *)(context + 1) == 1) {
            disable_watchdog();
            set_click_dispatch_flag(0);
            mark_master_or_low_battery_flag();
            if (count > 0x22) {
                if (*log_level > 0) {
                    if (*(volatile int *)((unsigned long)&g_log_use_alt_sink) /*=0x20007554*/)
                        debug_print(((unsigned long)"%s(): reboot because dfu exceed time\r\n\n") /*=0x9fc99*/, ((unsigned long)"low_speed_peripheral_dispatch_thread_for_test") /*=0xa19e5*/);
                    else
                        log_message(((unsigned long)"%s(): reboot because dfu exceed time\r\n\n") /*=0x9fc99*/, ((unsigned long)"low_speed_peripheral_dispatch_thread_for_test") /*=0xa19e5*/);
                }
                for (;;) {
                    k_msleep(500);
                    uintptr_t result = sys_reboot(1);
                    log_message(result);
                }
            }
            ++count;
            wait_for_event(((unsigned long)&rodata_28000) /*=0x28000*/, 0);
        } else {
            handle_box_placement_event();
            if (*(volatile uint8_t *)((unsigned long)&g_flash_crc_active_flag) /*=0x2000302c*/ == 0)
                disable_watchdog();
            else if (*(volatile uint8_t *)((unsigned long)&g_flash_crc_skip_watchdog_flag) /*=0x20018d90*/ == 0)
                watchdog_feed_retry();
            fuel_gauge_update(((unsigned long)&rodata_87d70) /*=0x87d70*/, 0);
            wait_for_event(0x8000, 0);
        }
    }
}

/* ---- check_bind_status.c ---- */
/* readable reconstruction; identity: FUN_00026b88 @ 0x00026b88
 * public-name: check_bind_status
 * durable-map: recon/catalogs/function_names_app.json
 * callees (readable <= raw @ address):
 *   debug_print                              <= FUN_00019c70 @ 0x00019c70
 * address symbols (name @ address):
 *   rodata_9fce4                             @ 0x0009fce4   [INLINED -- G6 literal batch]
 *   rodata_9fd02                             @ 0x0009fd02   [INLINED -- G6 literal batch]
 *   rodata_a1ad8                             @ 0x000a1ad8   [INLINED -- G6 literal batch]
 *   g_log_level                              @ 0x2000230c
 *   g_log_use_alt_sink                       @ 0x20007554
 *   g_bind_status_log_debounce_cnt           @ 0x20018d83
 */
/* Reconstructed check_bind_status @ 0x26b88  (parity: 300/300 trials, PROVEN) */

typedef unsigned char u8;
typedef unsigned int u32;

void check_bind_status(int param_1, int param_2, int param_3)
{
    volatile char *pcVar2 = (volatile char*)((unsigned long)&g_bind_status_log_debounce_cnt) /*=0x20018d83*/;
    char cVar1;
    char *base;

    if (param_2 == 0) {
        cVar1 = *pcVar2;
        if (cVar1 != 0) {
            char nv = (char)(cVar1 - 1);
            *pcVar2 = nv;
            if (nv != 0) return;
        }
        base = (char*)(param_1 + 0x1000);
        if (base[0x71] != 1) return;
        base[0x71] = 0;
        if (*(volatile int *)((unsigned long)&g_log_level) /*=0x2000230c*/ <= 0) return;
        G1_LOG_ROUTE(*(volatile u32 *)((unsigned long)&g_log_use_alt_sink) /*=0x20007554*/ == 0, ((unsigned long)"%s(): disable allow bind mode\n") /*=0x9fd02*/, ((unsigned long)"check_bind_status") /*=0xa1ad8*/);
        return;
    } else {
        base = (char*)(param_1 + 0x1000);
        if (param_3 == 0) {
            if (base[0x71] == 0) {
                base[0x71] = 1;
                if (*(volatile int *)((unsigned long)&g_log_level) /*=0x2000230c*/ > 0) {
                    G1_LOG_ROUTE(*(volatile u32 *)((unsigned long)&g_log_use_alt_sink) /*=0x20007554*/ == 0, ((unsigned long)"%s(): enable allow bind mode\n") /*=0x9fce4*/, ((unsigned long)"check_bind_status") /*=0xa1ad8*/);
                }
            }
        } else {
            base[0x71] = 0;
        }
        *pcVar2 = 3;
    }
}

/* ================================================================ */
/* member unit: g1_core_09.c */
/* ================================================================ */
/*
 * Cohesive translation unit for the `core' module.
 *
 * GENERATED by recon/refactor/transforms/t04_cohesive_tu.py.  Do not
 * edit: a stage tree is regenerated, never hand-patched
 * (recon/refactor/README.md C4).
 *
 * The 2 functions below were 2 separate translation units until this
 * stage.  Each one's text is reproduced VERBATIM and in the order the
 * generated source list gave it, and they were CONSECUTIVE in that list.
 * They were proven able to share a translation unit: no symbol is
 * declared here with two types, no identifier has internal linkage in one
 * member and is named by another, and no local typedef, macro, struct tag
 * or enum constant of one member is visible to a member that names it.
 *
 * members, in link order:
 *   low_speed_peripheral_dispatch_thread.c
 *   init_watchdog.c
 */

/* File-scope forward declarations for every struct/union tag this
 * unit names.  Without them a tag whose only appearance in a member
 * is inside a parameter list has PARAMETER-LIST scope, so two
 * textually IDENTICAL declarations in two members declare two
 * different incomplete types and the second is a conflicting
 * redeclaration (C11 6.2.1p7).  Incomplete-type forward
 * declarations emit no code. */
struct device;
struct watchdog_timeout_cfg;
struct watchdog_window;
/* ---- low_speed_peripheral_dispatch_thread.c ---- */
#include "g1_app_symbols.h"
/* readable reconstruction; identity: FUN_0002a8d8 @ 0x0002a8d8
 * public-name: low_speed_peripheral_dispatch_thread
 * durable-map: recon/catalogs/function_names_app.json
 * callees (readable <= raw @ address):
 *   runtime_info_sync                        <= FUN_00016268 @ 0x00016268
 *   get_dashboard_startup_mode_field63       <= FUN_00016580 @ 0x00016580
 *   set_dashboard_startup_mode_field63       <= FUN_0001658c @ 0x0001658c
 *   get_device_info                          <= FUN_000167a8 @ 0x000167a8
 *   check_device_readiness                   <= FUN_000167b4 @ 0x000167b4
 *   get_ancs_conn_handle                     <= FUN_00019b2c @ 0x00019b2c
 *   debug_print                              <= FUN_00019c70 @ 0x00019c70
 *   reset_all_usr_data                       <= FUN_0002316c @ 0x0002316c
 *   handle_box_placement_event               <= FUN_00025528 @ 0x00025528
 *   check_disp_onboarding                    <= FUN_00026a08 @ 0x00026a08
 *   check_bind_status                        <= FUN_00026b88 @ 0x00026b88
 *   check_charging_and_touch_flags           <= FUN_00026c28 @ 0x00026c28
 *   try_enter_low_power_mode                 <= FUN_00026c8c @ 0x00026c8c
 *   esb_send_command_and_wait_ack            <= FUN_00027448 @ 0x00027448
 *   check_sw0_status                         <= FUN_0002a868 @ 0x0002a868
 *   watchdog_feed_retry                      <= FUN_0002ae84 @ 0x0002ae84
 *   disable_watchdog                         <= FUN_0002aeb4 @ 0x0002aeb4
 *   update_persist_task_status_to_idle       <= FUN_0002c0e8 @ 0x0002c0e8
 *   check_ancs_inbox_flag_change             <= FUN_0002eb40 @ 0x0002eb40
 *   debounce_read_pending_flag_1             <= FUN_0002eb78 @ 0x0002eb78
 *   msg_queue_init                           <= FUN_00033c5c @ 0x00033c5c
 *   sys_reboot                               <= FUN_0004c0a8 @ 0x0004c0a8
 *   bt_conn_disconnect_by_state              <= FUN_00056a68 @ 0x00056a68
 *   k_uptime_get_1                           <= FUN_0007cb2c @ 0x0007cb2c
 *   k_msleep                                 <= FUN_0007cb8e @ 0x0007cb8e
 *   resolve_not_disturb_context              <= FUN_0007cbae @ 0x0007cbae
 *   set_shutdown_flag                        <= FUN_0007cbfe @ 0x0007cbfe
 *   errno_wrapped_tick_call                  <= FUN_0007d1d6 @ 0x0007d1d6
 *   g1_recon_bt_conn_set_security            <= FUN_0008149a @ 0x0008149a
 * address symbols (name @ address):
 *   rodata_28000                             @ 0x00028000
 *   rodata_87d70                             @ 0x00087d70
 *   rodata_9fc8b                             @ 0x0009fc8b   [INLINED -- G6 literal batch]
 *   rodata_a1914                             @ 0x000a1914   [INLINED -- G6 literal batch]
 *   rodata_a193c                             @ 0x000a193c   [INLINED -- G6 literal batch]
 *   rodata_a1962                             @ 0x000a1962   [INLINED -- G6 literal batch]
 *   rodata_a19c0                             @ 0x000a19c0   [INLINED -- G6 literal batch]
 *   g_log_level                              @ 0x2000230c
 *   g_flash_crc_active_flag                  @ 0x2000302c
 *   g_log_use_alt_sink                       @ 0x20007554
 *   g_flash_crc_skip_watchdog_flag           @ 0x20018d90
 *   g_box_lid_or_charge_state                @ 0x20018d91
 */
/* Full reconstruction low_speed_peripheral_dispatch_thread @ 0x2a8d8,
 * CFG-reviewed extent 1012 bytes (live tail through 0x2acca).
 * CFG_VERIFY_PREFIX_FIRST CFG_VERIFY_PREFIX_K=240
 */
#include <stdint.h>
#include "../../../headers/g1_log.h"
#include "g1_core.h"

extern unsigned int change_work_mode_to(unsigned int);
extern int sync_to_slave(uint8_t *, uint32_t, uint32_t);
extern unsigned int get_ancs_conn_handle(void);
extern int g1_recon_bt_conn_set_security(int, uint32_t);
extern uint32_t check_ancs_inbox_flag_change(void);
extern uint32_t debounce_read_pending_flag_1(void);
extern void check_bind_status(int, int, int);
extern void runtime_info_sync(uint8_t *);
extern uint32_t esb_send_command_and_wait_ack(uint8_t *, uint32_t, uint32_t);
extern void msg_queue_init(void);
extern void handle_box_placement_event(void);
extern int disable_watchdog(void);
extern void watchdog_feed_retry(void);
extern void errno_wrapped_tick_call(uint8_t *, uint32_t);
extern int32_t k_msleep(int32_t);
extern void wait_for_event(uint32_t, uint32_t);
extern int get_dashboard_startup_mode_field63(void);
extern unsigned int check_device_readiness(void);
extern void set_dashboard_startup_mode_field63(uint32_t);
extern uint32_t check_charging_and_touch_flags(void);
extern void try_enter_low_power_mode(void);
extern void check_work_mode(uint32_t, uint32_t, uint32_t);
extern void check_disp_onboarding(uint32_t);
extern void bt_conn_disconnect_by_state(unsigned int, int);
extern int get_device_info(void);
extern void set_shutdown_flag(uintptr_t, uint32_t);
extern void reset_all_usr_data(unsigned char *, int);
extern void resolve_not_disturb_context(void);

static inline uint8_t rd8(uint8_t *p, unsigned o) { return *(volatile uint8_t *)(p + o); }
static inline void wr8(uint8_t *p, unsigned o, uint8_t v) { *(volatile uint8_t *)(p + o) = v; }
static inline uint32_t rd32(uint8_t *p, unsigned o) { return *(volatile uint32_t *)(p + o); }
static inline void wr32(uint8_t *p, unsigned o, uint32_t v) { *(volatile uint32_t *)(p + o) = v; }

void low_speed_peripheral_dispatch_thread(uint8_t *ctx)
{
    volatile int *const log_level = (volatile int *)((unsigned long)&g_log_level) /*=0x2000230c*/;
    volatile uint8_t *const phase_hold = (volatile uint8_t *)((unsigned long)&g_box_lid_or_charge_state) /*=0x20018d91*/;
    uint8_t tick = 0;
    int8_t connected_runs = 0;

    change_work_mode_to(3);
    update_persist_task_status_to_idle(ctx);
    if (*log_level > 1) {
        if (*(volatile int *)((unsigned long)&g_log_use_alt_sink) /*=0x20007554*/ == 0)
            log_message(((unsigned long)"%s(): #enter\n") /*=0x9fc8b*/, ((unsigned long)"low_speed_peripheral_dispatch_thread") /*=0xa19c0*/);
        else
            debug_print(((unsigned long)"%s(): #enter\n") /*=0x9fc8b*/, ((unsigned long)"low_speed_peripheral_dispatch_thread") /*=0xa19c0*/);
    }
    *(volatile uint16_t *)(ctx + 0xfc4) = 0x8000;
    *(volatile uint16_t *)(ctx + 0xfc0) = 0;
    if (rd8(ctx, 0) == 1)
        sync_to_slave(ctx, rd8(ctx, 0xfea) == 12 ? 4 : 5, 0);

    for (;;) {
        tick = (uint8_t)(tick + 1);
        if (tick % 5 == 0) {
            int connection = get_ancs_conn_handle();
            if (connection == 0 || rd8(ctx, 0xae2) == 0 ||
                rd8(ctx, 0xae3) == 0 || rd32(ctx, 0x9b4) == 0) {
                connected_runs = 0;
            } else if (++connected_runs > 4) {
                int error = g1_recon_bt_conn_set_security(connection, 2);
                if (error != 0 && *log_level > 2) {
                    if (*(volatile int *)((unsigned long)&g_log_use_alt_sink) /*=0x20007554*/ == 0)
                        log_message(((unsigned long)"%s(): Failed to set security (err %d)\n\n") /*=0xa1914*/, ((unsigned long)"low_speed_peripheral_dispatch_thread") /*=0xa19c0*/, error);
                    else
                        debug_print(((unsigned long)"%s(): Failed to set security (err %d)\n\n") /*=0xa1914*/, ((unsigned long)"low_speed_peripheral_dispatch_thread") /*=0xa19c0*/, error);
                }
                connected_runs = -5;
            }

            uint8_t a = rd8(ctx, 0xfc0), b = rd8(ctx, 0xfc1);
            wr8(ctx, 0xde, a <= b ? a : b);
            fuel_gauge_update(((unsigned long)&rodata_87d70) /*=0x87d70*/, 0);
            uint32_t power = check_ancs_inbox_flag_change();
            uint32_t thermal = debounce_read_pending_flag_1();
            uint32_t side = 0;

            check_bind_status(ctx, power, thermal);
            if (rd8(ctx, 0) == 1) {
                runtime_info_sync(ctx);
                if (connection != 0 && rd8(ctx, 0xae3) == 0 && rd32(ctx, 0x9b4) != 0 &&
                    (rd8(ctx, 0x6de) & 1)) {
                    wr8(ctx, 0xe4, rd8(ctx, 0xe4) | 3);
                    *phase_hold = 3;
                    side = 1;
                } else if (*phase_hold != 0) {
                    --*phase_hold;
                } else {
                    wr8(ctx, 0xe4, rd8(ctx, 0xe4) & 0xfcu);
                }
                int elapsed = sync_to_slave(ctx, 12, 0);
                if (elapsed < 500 && (rd8(ctx, 0xe4) & 4)) {
                    msg_queue_init();
                    wr8(ctx, 0xe4, rd8(ctx, 0xe4) & 0xfbu);
                }
            } else {
                if (connection != 0 && rd8(ctx, 0xae3) == 0 && rd32(ctx, 0x9b4) != 0) {
                    *phase_hold = 3;
                    wr8(ctx, 0x6de, rd8(ctx, 0x6de) | 1);
                    side = 1;
                } else if (*phase_hold != 0) {
                    --*phase_hold;
                } else {
                    wr8(ctx, 0x6de, rd8(ctx, 0x6de) & 0xfeu);
                }
                if ((rd8(ctx, 0xe4) ^ rd8(ctx, 0x6de)) & 1)
                    wr8(ctx, 0x6df, (uint8_t)(rd8(ctx, 0x6df) + 1));
                uint32_t elapsed = esb_send_command_and_wait_ack(ctx, 1, 0);
                if (elapsed < 500 && (rd8(ctx, 0x6de) & 4)) {
                    msg_queue_init();
                    wr8(ctx, 0x6de, rd8(ctx, 0x6de) & 0xfbu);
                    wr8(ctx, 0xe4, rd8(ctx, 0xe4) & 0xfbu);
                }
            }

            handle_box_placement_event();
            while (rd8(ctx, 1) == 1) {
                disable_watchdog();
                if (rd8(ctx, 0) == 1)
                    errno_wrapped_tick_call(ctx, rd32(ctx, 0xfec));
                if ((int64_t)(k_uptime_get_1() -
                              *(volatile uint64_t *)(ctx + 0x1060)) > 0x927bf) {
                    if (*log_level > 0) {
                        if (*(volatile int *)((unsigned long)&g_log_use_alt_sink) /*=0x20007554*/)
                            debug_print(((unsigned long)"%s(): reboot because dfu exceed time\n") /*=0xa193c*/, ((unsigned long)"low_speed_peripheral_dispatch_thread") /*=0xa19c0*/);
                        else
                            log_message(((unsigned long)"%s(): reboot because dfu exceed time\n") /*=0xa193c*/, ((unsigned long)"low_speed_peripheral_dispatch_thread") /*=0xa19c0*/);
                    }
                    for (;;) {
                        k_msleep(500);
                        uint32_t printed = sys_reboot(1);
                        log_message(printed);
                    }
                }
                wait_for_event(((unsigned long)&rodata_28000) /*=0x28000*/, 0);
            }
            if (*(volatile uint8_t *)((unsigned long)&g_flash_crc_active_flag) /*=0x2000302c*/ == 0)
                disable_watchdog();
            else if (*(volatile uint8_t *)((unsigned long)&g_flash_crc_skip_watchdog_flag) /*=0x20018d90*/ == 0)
                watchdog_feed_retry();
            if (rd8(ctx, 0) == 1)
                errno_wrapped_tick_call(ctx, rd32(ctx, 0xfec));
            if (get_dashboard_startup_mode_field63() != 0 && (int64_t)k_uptime_get_1() >= 60000) {
                check_device_readiness();
                set_dashboard_startup_mode_field63(0);
            }
            if (*log_level > 1) {
                uint32_t mode = rd8(ctx, 0xfea);
                uint32_t value = check_charging_and_touch_flags();
                if (*(volatile int *)((unsigned long)&g_log_use_alt_sink) /*=0x20007554*/ == 0)
                    log_message(((unsigned long)"%s(): Global Working Mode: %d get_glasses_ble_status %d ble_is_connected %d\n") /*=0xa1962*/, ((unsigned long)"low_speed_peripheral_dispatch_thread") /*=0xa19c0*/, mode, value, side);
                else
                    debug_print(((unsigned long)"%s(): Global Working Mode: %d get_glasses_ble_status %d ble_is_connected %d\n") /*=0xa1962*/, ((unsigned long)"low_speed_peripheral_dispatch_thread") /*=0xa19c0*/, mode, value, side);
            }
            try_enter_low_power_mode();
            check_work_mode(power, thermal, side);
            check_disp_onboarding(power);
            if (connection != 0 && rd8(ctx, 0x1068) == 0 &&
                (uint32_t)k_uptime_get_1() - rd32(ctx, 0xae4) > 30000 && rd8(ctx, 1) != 1) {
                wr32(ctx, 0xae4, (uint32_t)k_uptime_get_1());
                bt_conn_disconnect_by_state(connection, 0x13);
            }
            if (rd8(ctx, 0x108e) != 0) {
                wr8(ctx, 0x108e, 0);
                set_shutdown_flag(get_device_info(), 0);
                reset_all_usr_data(ctx, 1);
            }
            check_sw0_status();
            tick = 0;
        }
        resolve_not_disturb_context();
        if (*(volatile uint8_t *)((unsigned long)&g_flash_crc_skip_watchdog_flag) /*=0x20018d90*/ == 0)
            watchdog_feed_retry();
        wait_for_event(0x199a, 0);
    }
}

/* ---- init_watchdog.c ---- */
/* readable reconstruction; identity: FUN_0002ace0 @ 0x0002ace0
 * public-name: init_watchdog
 * durable-map: recon/catalogs/function_names_app.json
 * callees (readable <= raw @ address):
 *   debug_print                              <= FUN_00019c70 @ 0x00019c70
 *   init_watchdog                            <= FUN_0002ace0 @ 0x0002ace0
 *   k_sleep                                  <= FUN_00074844 @ 0x00074844
 *   z_device_is_ready                        <= FUN_0008638c @ 0x0008638c
 *   memset_bytes                             <= FUN_00086c78 @ 0x00086c78
 * address symbols (name @ address):
 *   g_watchdog_device                        @ 0x00087cc8
 *   rodata_a1b10                             @ 0x000a1b10   [INLINED -- G6 literal batch]
 *   rodata_a1b33                             @ 0x000a1b33   [INLINED -- G6 literal batch]
 *   rodata_a1b50                             @ 0x000a1b50   [INLINED -- G6 literal batch]
 *   rodata_a1b88                             @ 0x000a1b88   [INLINED -- G6 literal batch]
 *   rodata_a1bbc                             @ 0x000a1bbc
 *   rodata_a1bf6                             @ 0x000a1bf6   [INLINED -- G6 literal batch]
 *   rodata_a1c17                             @ 0x000a1c17
 *   rodata_a1c96                             @ 0x000a1c96   [INLINED -- G6 literal batch]
 *   g_log_level                              @ 0x2000230c
 *   g_log_use_alt_sink                       @ 0x20007554
 *   g_wdt_channel_id                         @ 0x20007b50
 */
/* Reconstructed FUN_0002ace0 @ 0x2ace0  (parity: 300/300 trials, PROVEN) */
extern int32_t k_sleep(k_timeout_t);
extern _Bool z_device_is_ready(const struct device *);
extern void memset_bytes(void*,int,int);
struct watchdog_window {
  uint32_t min;
  uint32_t max;
};

struct watchdog_timeout_cfg {
  struct watchdog_window window;
  void *callback;
  uint8_t flags;
  uint8_t reserved[3];
};

typedef int (*install_timeout_fn)(void *device,
                                  const struct watchdog_timeout_cfg *config);
typedef int (*setup_watchdog_fn)(void *device, uint8_t options);
typedef int (*feed_watchdog_fn)(void *device, int channel_id);

int init_watchdog(int param_1,int param_2,int param_3,int param_4){
  volatile int *piVar1 = (volatile int*)((unsigned long)&g_log_level) /*=0x2000230c*/;
  volatile int *g50   = (volatile int*)((unsigned long)&g_log_use_alt_sink) /*=0x20007554*/;
  volatile int *puVar3= (volatile int*)((unsigned long)&g_watchdog_device) /*=0x87cc8*/;
  volatile int *piVar4= (volatile int*)((unsigned long)&g_wdt_channel_id) /*=0x20007b50*/;
  int iVar5, uVar6, fmt, iVar7;
  struct watchdog_timeout_cfg timeout;
  (void)param_1;(void)param_2;(void)param_3;(void)param_4;

  if (3 < *piVar1) { if (*g50==0) log_message(((unsigned long)"%s(): Watchdog sample application\n") /*=0xa1b10*/,((unsigned long)"init_watchdog") /*=0xa1c96*/); else debug_print(((unsigned long)"%s(): Watchdog sample application\n") /*=0xa1b10*/,((unsigned long)"init_watchdog") /*=0xa1c96*/); }
  iVar5 = z_device_is_ready(((unsigned long)&g_watchdog_device) /*=0x87cc8*/);
  if (iVar5 == 0) {
    if (0 < *piVar1) { if (*g50==0) log_message(((unsigned long)"%s(): %s: device not ready.\n") /*=0xa1b33*/,((unsigned long)"init_watchdog") /*=0xa1c96*/,*puVar3); else debug_print(((unsigned long)"%s(): %s: device not ready.\n") /*=0xa1b33*/,((unsigned long)"init_watchdog") /*=0xa1c96*/,*puVar3); }
    return 0;
  }
  memset_bytes(&timeout,0,sizeof(timeout));
  timeout.window.max = 30000;
  timeout.flags = 2;
  if (3 < *piVar1) { if (*g50==0) log_message(((unsigned long)"%s(): Callback in RESET_SOC disabled for this platform\n") /*=0xa1b50*/,((unsigned long)"init_watchdog") /*=0xa1c96*/); else debug_print(((unsigned long)"%s(): Callback in RESET_SOC disabled for this platform\n") /*=0xa1b50*/,((unsigned long)"init_watchdog") /*=0xa1c96*/); }
  iVar7 = puVar3[2];
  iVar5 = ((install_timeout_fn)(*(volatile int *)(iVar7+8)))(
      (void *)((unsigned long)&g_watchdog_device) /*=0x87cc8*/, &timeout);
  *piVar4 = iVar5;
  if (iVar5 == -0x86) {
    if (0 < *piVar1) { if (*g50==0) log_message(((unsigned long)"%s(): Callback support rejected, continuing anyway\n") /*=0xa1b88*/,((unsigned long)"init_watchdog") /*=0xa1c96*/); else debug_print(((unsigned long)"%s(): Callback support rejected, continuing anyway\n") /*=0xa1b88*/,((unsigned long)"init_watchdog") /*=0xa1c96*/); }
    timeout.callback = 0;
    iVar7 = puVar3[2];
    iVar5 = ((install_timeout_fn)(*(volatile int *)(iVar7+8)))(
        (void *)((unsigned long)&g_watchdog_device) /*=0x87cc8*/, &timeout);
    *piVar4 = iVar5;
  }
  if (*piVar4 < 0) {
    if (*piVar1 < 1) return 0;
    iVar5 = *g50; uVar6 = ((unsigned long)&rodata_a1bbc) /*=0xa1bbc*/;
  } else {
    iVar7 = puVar3[2];
    iVar5 = ((setup_watchdog_fn)(*(volatile int *)iVar7))(
        (void *)((unsigned long)&g_watchdog_device) /*=0x87cc8*/, 2);
    if (iVar5 < 0) {
      if (*piVar1 < 1) return 0;
      iVar5 = *g50; uVar6 = 0x000a1bda;
    } else {
      if (3 < *piVar1) { if (*g50==0) log_message(((unsigned long)"%s(): Feeding watchdog %d times\n") /*=0xa1bf6*/,((unsigned long)"init_watchdog") /*=0xa1c96*/,5); else debug_print(((unsigned long)"%s(): Feeding watchdog %d times\n") /*=0xa1bf6*/,((unsigned long)"init_watchdog") /*=0xa1c96*/,5); }
      fmt = ((unsigned long)&rodata_a1c17) /*=0xa1c17*/;
      iVar5 = 5;
      do {
        if (3 < *piVar1) { if (*g50==0) log_message(fmt,((unsigned long)"init_watchdog") /*=0xa1c96*/); else debug_print(fmt,((unsigned long)"init_watchdog") /*=0xa1c96*/); }
        iVar7 = puVar3[2];
        if (((feed_watchdog_fn)(*(volatile int *)(iVar7+0xc)))(
                (void *)((unsigned long)&g_watchdog_device) /*=0x87cc8*/, *piVar4) == 0) break;
        k_sleep(0x667,0);
        iVar5 = iVar5 - 1;
      } while (iVar5 != 0);
      if (*piVar1 < 4) return 0;
      iVar5 = *g50; uVar6 = 0x000a1c32;
    }
  }
  if (iVar5 == 0) log_message(uVar6,((unsigned long)"init_watchdog") /*=0xa1c96*/); else debug_print(uVar6,((unsigned long)"init_watchdog") /*=0xa1c96*/);
  return 0;
}

