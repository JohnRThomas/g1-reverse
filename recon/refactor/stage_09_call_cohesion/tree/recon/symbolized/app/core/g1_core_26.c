/*
 * Cohesive translation unit for the `core' module.
 *
 * GENERATED by recon/refactor/transforms/t04_cohesive_tu.py.  Do not
 * edit: a stage tree is regenerated, never hand-patched
 * (recon/refactor/README.md C4).
 *
 * The 5 functions below were 5 separate translation units until this
 * stage.  Each one's text is reproduced VERBATIM and in the order the
 * generated source list gave it, and they were CONSECUTIVE in that list.
 * They were proven able to share a translation unit: no symbol is
 * declared here with two types, no identifier has internal linkage in one
 * member and is named by another, and no local typedef, macro, struct tag
 * or enum constant of one member is visible to a member that names it.
 *
 * members, in link order:
 *   wdt_feed.c
 *   watchdog_disable_write_work.c
 *   reset_state_and_stop_timer.c
 *   buffer_pool_freelist_init.c
 *   kmutex_dlist_init.c
 */

/* File-scope forward declarations for every struct/union tag this
 * unit names.  Without them a tag whose only appearance in a member
 * is inside a parameter list has PARAMETER-LIST scope, so two
 * textually IDENTICAL declarations in two members declare two
 * different incomplete types and the second is a conflicting
 * redeclaration (C11 6.2.1p7).  Incomplete-type forward
 * declarations emit no code. */
struct request;
/* ---- wdt_feed.c ---- */
#include "g1_app_symbols.h"
/* readable reconstruction; identity: FUN_00084c7e @ 0x00084c7e
 * public-name: wdt_feed
 * durable-map: recon/catalogs/function_names_app.json
 * callees (readable <= raw @ address):
 *   dev_write_reg3                           <= FUN_00083dc8 @ 0x00083dc8
 *   wdt_feed                                 <= FUN_00084c7e @ 0x00084c7e
 */
/* Reconstructed FUN_00084c7e @ 0x84c7e  (parity: 300/300 trials, PROVEN) */

extern int dev_write_reg3(unsigned int, unsigned int, unsigned int, unsigned int);

static unsigned int wdt_feed(void *param_1, int param_2)
{
    unsigned int *p = *(volatile unsigned int**)((char*)param_1 + 4);
    if (param_2 == 0) {
        return dev_write_reg3(*(volatile unsigned int *)p, 7, 4, 1);
    }
    return 0xffffffea;
}

/* ---- watchdog_disable_write_work.c ---- */
/* readable reconstruction; identity: FUN_00084c94 @ 0x00084c94
 * public-name: watchdog_disable_write_work
 * durable-map: recon/catalogs/function_names_app.json
 * callees (readable <= raw @ address):
 *   dev_write_reg3                           <= FUN_00083dc8 @ 0x00083dc8
 *   watchdog_disable_write_work              <= FUN_00084c94 @ 0x00084c94
 */
/* Reconstructed FUN_00084c94 @ 0x84c94  (parity: 300/300 trials, PROVEN) */

extern int dev_write_reg3(unsigned int, unsigned int,
                        unsigned int, unsigned int);

struct request {
  unsigned int reserved_00;
  unsigned int *value;
  unsigned int reserved_08;
  unsigned int reserved_0c;
  unsigned char *completion;
};

static void watchdog_disable_write_work(struct request *request)
{
  int status = dev_write_reg3(*request->value, 7, 1, 1);
  if (status >= 0) {
    *request->completion = 0;
  }
}

/* ---- reset_state_and_stop_timer.c ---- */
#include "g1_core.h"
/* readable reconstruction; identity: FUN_00084d36 @ 0x00084d36
 * public-name: reset_state_and_stop_timer
 * durable-map: recon/catalogs/function_names_app.json
 * callees (readable <= raw @ address):
 *   app_event_manager_submit                 <= FUN_0004f770 @ 0x0004f770
 *   app_event_submit_power                   <= FUN_00063bcc @ 0x00063bcc
 *   power_manager_set_system_off_flag        <= FUN_00063c14 @ 0x00063c14
 *   reset_state_and_stop_timer               <= FUN_00084d36 @ 0x00084d36
 */
/* Reconstructed FUN_00084d36 @ 0x84d36  (parity: 300/300 trials, PROVEN) */

extern char *app_event_submit_power(void);
extern void app_event_manager_submit(void);
void reset_state_and_stop_timer(void) {
    char *p = app_event_submit_power();
    *(volatile unsigned char *)(p + 8) = 0;
    app_event_manager_submit();
    power_manager_set_system_off_flag(5);
}

/* ---- buffer_pool_freelist_init.c ---- */
/* readable reconstruction; identity: FUN_00085cf2 @ 0x00085cf2
 * public-name: buffer_pool_freelist_init
 * durable-map: recon/catalogs/function_names_app.json
 * callees (readable <= raw @ address):
 *   buffer_pool_freelist_init                <= FUN_00085cf2 @ 0x00085cf2
 */
/* Reconstructed FUN_00085cf2 @ 0x85cf2  (parity: 300/300 trials, PROVEN) */

void buffer_pool_freelist_init(unsigned int param_1, unsigned int param_2, int param_3, int param_4, int param_5)
{
    *(volatile int *)(param_1+0) = param_3;
    *(volatile int *)(param_1+8) = param_5;
    *(volatile int *)(param_1+0xc) = param_3 + param_4;
    *(volatile unsigned short *)(param_1+0x10) = 0;
    if (param_2 < 2) {
        *(volatile int *)(param_1+0x14) = 0;
    } else {
        unsigned int off = param_2*24 - 24;
        unsigned int p5 = param_1 + off;
        *(volatile unsigned int *)(param_1+0x14) = p5;
        *(volatile int *)p5 = 0;
        *(volatile unsigned int *)(p5+8) = param_2 - 2;
        *(volatile int *)(p5+4) = 0;
        *(volatile int *)(p5+0xc) = 0;
        *(volatile unsigned char *)(p5+0x10) = 0;
        if (param_2 != 2) {
            *(volatile unsigned int *)p5 = param_1 + 0x18;
        }
    }
}

/* ---- kmutex_dlist_init.c ---- */
/* readable reconstruction; identity: FUN_000864c2 @ 0x000864c2
 * public-name: kmutex_dlist_init
 * durable-map: recon/catalogs/function_names_app.json
 * callees (readable <= raw @ address):
 *   kmutex_dlist_init                        <= FUN_000864c2 @ 0x000864c2
 */
/* Reconstructed FUN_000864c2 @ 0x864c2  (parity: 300/300 trials, PROVEN) */

void kmutex_dlist_init(unsigned int *param_1) {
  param_1[0] = (unsigned int)param_1;
  param_1[1] = (unsigned int)param_1;
  param_1[2] = 0;
  param_1[3] = 0;
}

