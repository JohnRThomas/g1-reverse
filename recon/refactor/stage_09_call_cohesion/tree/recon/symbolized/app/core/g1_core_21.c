/*
 * Cohesive translation unit for the `core' module.
 *
 * GENERATED by recon/refactor/transforms/t04_cohesive_tu.py.  Do not
 * edit: a stage tree is regenerated, never hand-patched
 * (recon/refactor/README.md C4).
 *
 * The 4 functions below were 4 separate translation units until this
 * stage.  Each one's text is reproduced VERBATIM and in the order the
 * generated source list gave it, and they were CONSECUTIVE in that list.
 * They were proven able to share a translation unit: no symbol is
 * declared here with two types, no identifier has internal linkage in one
 * member and is named by another, and no local typedef, macro, struct tag
 * or enum constant of one member is visible to a member that names it.
 *
 * members, in link order:
 *   fatal_log_and_reset.c
 *   app_event_submit_power.c
 *   caf_power_manager_restart_timer.c
 *   power_manager_set_system_off_flag.c
 */

/* File-scope forward declarations for every struct/union tag this
 * unit names.  Without them a tag whose only appearance in a member
 * is inside a parameter list has PARAMETER-LIST scope, so two
 * textually IDENTICAL declarations in two members declare two
 * different incomplete types and the second is a conflicting
 * redeclaration (C11 6.2.1p7).  Incomplete-type forward
 * declarations emit no code. */
struct k_work_delayable;
struct log_record2;
/* ---- fatal_log_and_reset.c ---- */
#include "g1_app_symbols.h"
/* readable reconstruction; identity: FUN_00063b7c @ 0x00063b7c
 * public-name: fatal_log_and_reset
 * durable-map: recon/catalogs/function_names_app.json
 * callees (readable <= raw @ address):
 *   z_log_msg_runtime_create                 <= FUN_0004d944 @ 0x0004d944
 *   nrf_cc3xx_platform_abort                 <= FUN_00050af8 @ 0x00050af8
 *   fatal_log_and_reset                      <= FUN_00063b7c @ 0x00063b7c
 * address symbols (name @ address):
 *   rodata_881a8                             @ 0x000881a8
 *   rodata_f66f9                             @ 0x000f66f9   [INLINED -- G6 literal batch]
 */
/* Full reconstruction FUN_00063b7c @ 0x00063b7c (44-byte exact extent). */
#include <stdint.h>

extern void g1_recon_z_impl_log_panic(void);
extern void z_log_msg_runtime_create(uintptr_t, uint32_t, const void *, uint32_t, ...);
extern void nrf_cc3xx_platform_abort(uint32_t) __attribute__((noreturn));

struct log_record2 { uint32_t count, format; };

static void fatal_log_and_reset(uint32_t a, uint32_t b, uint32_t c, uint32_t d)
{
    struct log_record2 record = { 2, ((unsigned long)"Resetting system") /*=0xf66f9*/ };
    g1_recon_z_impl_log_panic();
    z_log_msg_runtime_create(((unsigned long)&rodata_881a8) /*=0x881a8*/, 0x1040u, &record, 0, a, b, c, d);
    nrf_cc3xx_platform_abort(0);
}

/* ---- app_event_submit_power.c ---- */
/* readable reconstruction; identity: FUN_00063bcc @ 0x00063bcc
 * public-name: app_event_submit_power
 * durable-map: recon/catalogs/function_names_app.json
 * callees (readable <= raw @ address):
 *   app_event_alloc                          <= FUN_0004f564 @ 0x0004f564
 *   app_event_submit_power                   <= FUN_00063bcc @ 0x00063bcc
 * address symbols (name @ address):
 *   rodata_fa9cc                             @ 0x000fa9cc
 */
/* Reconstructed FUN_00063bcc @ 0x63bcc  (parity: 300/300 trials, PROVEN) */

extern unsigned int app_event_alloc(unsigned int a);
void app_event_submit_power(void) {
  unsigned int r = app_event_alloc(0xc);
  if (r != 0) {
    *(unsigned int*)(r + 4) = ((unsigned long)&rodata_fa9cc) /*=0xfa9cc*/;
  }
}

/* ---- caf_power_manager_restart_timer.c ---- */
/* readable reconstruction; identity: FUN_00063be0 @ 0x00063be0
 * public-name: caf_power_manager_restart_timer
 * durable-map: recon/catalogs/function_names_app.json
 * callees (readable <= raw @ address):
 *   ancs_notify_table_is_idle                <= FUN_00063ba8 @ 0x00063ba8
 *   caf_power_manager_restart_timer          <= FUN_00063be0 @ 0x00063be0
 *   k_work_reschedule                        <= FUN_0007350c @ 0x0007350c
 * address symbols (name @ address):
 *   g_caf_power_manager_timer                @ 0x200066f0
 *   g_caf_power_manager_wake_evt_cnt         @ 0x2000b310
 *   g_caf_power_manager_system_off_flag      @ 0x2001d563
 */
/* Reconstructed FUN_00063be0 @ 0x63be0  (parity: 300/300 trials, PROVEN) */

extern long long ancs_notify_table_is_idle(int a0);
extern void k_work_reschedule(unsigned int, unsigned int, unsigned int, unsigned int);

static void caf_power_manager_restart_timer(void)
{
  if (*(volatile unsigned char *)((unsigned long)&g_caf_power_manager_system_off_flag) /*=0x2001d563*/ == 0) {
    long long uVar1 = ancs_notify_table_is_idle(0);
    if ((int)uVar1 != 0) {
      *(volatile unsigned int *)((unsigned long)&g_caf_power_manager_wake_evt_cnt) /*=0x2000b310*/ = 0;
      k_work_reschedule(((unsigned long)&g_caf_power_manager_timer) /*=0x200066f0*/, (int)((unsigned long long)uVar1 >> 0x20), 0x8000, 0);
    }
  }
}

/* ---- power_manager_set_system_off_flag.c ---- */
/* readable reconstruction; identity: FUN_00063c14 @ 0x00063c14
 * public-name: power_manager_set_system_off_flag
 * durable-map: recon/catalogs/function_names_app.json
 * callees (readable <= raw @ address):
 *   caf_power_manager_restart_timer          <= FUN_00063be0 @ 0x00063be0
 *   power_manager_set_system_off_flag        <= FUN_00063c14 @ 0x00063c14
 *   k_work_cancel_delayable                  <= FUN_00073518 @ 0x00073518
 * address symbols (name @ address):
 *   g_caf_power_manager_timer                @ 0x200066f0
 *   g_caf_power_manager_system_off_flag      @ 0x2001d563
 */
/* Reconstructed FUN_00063c14 @ 0x63c14  (parity: 300/300 trials, PROVEN) */

static void caf_power_manager_restart_timer(void);
extern int k_work_cancel_delayable(struct k_work_delayable *);
void power_manager_set_system_off_flag(int param_1)
{
  unsigned char b;
  b = *(volatile unsigned char *)((unsigned long)&g_caf_power_manager_system_off_flag) /*=0x2001d563*/;
  if (b == 0) {
    if (param_1 != 0) {
      k_work_cancel_delayable(((unsigned long)&g_caf_power_manager_timer) /*=0x200066f0*/);
    }
  } else if (param_1 == 0) {
    caf_power_manager_restart_timer();
  }
  *(volatile unsigned char *)((unsigned long)&g_caf_power_manager_system_off_flag) /*=0x2001d563*/ = (unsigned char)param_1;
  return;
}

