/*
 * Call-cohesive translation unit for the `core' module.
 *
 * GENERATED by recon/refactor/transforms/t09_call_cohesion.py.  Do
 * not edit: a stage tree is regenerated, never hand-patched
 * (recon/refactor/README.md C4).
 *
 * The 2 translation units below were grouped because they CALL ONE
 * ANOTHER, not because they were adjacent in the generated source
 * list.  Each member's text is reproduced VERBATIM.  Every member was
 * checked pairwise against every other member already in this unit by
 * stage 04's seven refusal rules, unchanged: no symbol is declared
 * here with two types, no identifier has internal linkage in one
 * member and is named by another, and no local typedef, macro, struct
 * tag or enum constant of one member is visible to a member that
 * names it.
 *
 * members, in generated-source-list order:
 *   transport_dispatch_thread.c
 *   g1_core_15.c
 *
 * call edges inside this unit (caller -> callee): 1
 *   transport_dispatch_thread.c -> g1_core_15.c
 */
/* ================================================================ */
/* member unit: transport_dispatch_thread.c */
/* ================================================================ */
#include "g1_app_symbols.h"
/* readable reconstruction; identity: FUN_0002a4f4 @ 0x0002a4f4
 * public-name: transport_dispatch_thread
 * durable-map: recon/catalogs/function_names_app.json
 * callees (readable <= raw @ address):
 *   get_device_info                          <= FUN_000167a8 @ 0x000167a8
 *   init_nfc_comm                            <= FUN_0002560c @ 0x0002560c
 *   ipc_service_send_with_retry              <= FUN_0002563c @ 0x0002563c
 *   set_delay_deadline                       <= FUN_0002a4d8 @ 0x0002a4d8
 *   transport_dispatch_thread                <= FUN_0002a4f4 @ 0x0002a4f4
 *   set_pending_state_flag                   <= FUN_0002eb28 @ 0x0002eb28
 *   periodic_check_run                       <= FUN_0003271c @ 0x0003271c
 *   arm_timeout_10s                          <= FUN_00032c0c @ 0x00032c0c
 *   is_battery_critical                      <= FUN_00032ee4 @ 0x00032ee4
 *   init_serial_comm                         <= FUN_00033340 @ 0x00033340
 *   k_uptime_get_1                           <= FUN_0007cb2c @ 0x0007cb2c
 *   z_impl_k_sem_init                        <= FUN_00086534 @ 0x00086534
 * address symbols (name @ address):
 *   rodata_28000                             @ 0x00028000
 *   rodata_a1895                             @ 0x000a1895   [INLINED -- G6 literal batch]
 *   g_delay_deadline_ticks                   @ 0x200040c8
 *   g_misc_dispatch_ctx                      @ 0x20007b00
 *   g_misc_dispatch_pending_flag             @ 0x20018d88
 *   g_low_power_mode_enabled                 @ 0x20018d94
 */
/* Full reconstruction FUN_0002a4f4 @ 0x2a4f4, exact extent 320 bytes.
 * CFG_VERIFY_PREFIX_FIRST */
#include <stdint.h>
#include "../../../headers/g1_log.h"
#include "g1_core.h"

extern int z_impl_k_sem_init(uintptr_t object, uint32_t flags, uint32_t count);
extern uintptr_t get_device_info(void);
extern void set_delay_deadline(uint32_t delay);
extern void arm_timeout_10s(void);
extern void wait_for_event(uint32_t ticks, uint32_t flags);
extern uint64_t is_battery_critical(void);
extern int k_sem_take(uintptr_t object, uint32_t high,
                             uint32_t timeout, uint32_t flags);
extern void ipc_service_send_with_retry(uint8_t *status);
extern int init_nfc_comm(void);
extern void set_pending_state_flag(uint32_t channel, uint32_t enabled);
extern int init_serial_comm(void);

void transport_dispatch_thread(uint32_t inherited_stack, uint32_t packed_status,
                  uint32_t inherited_r2, uint32_t inherited_r3)
{
    volatile uint8_t *const initialized = (volatile uint8_t *)((unsigned long)&g_misc_dispatch_pending_flag) /*=0x20018d88*/;
    volatile uint64_t *const deadline = (volatile uint64_t *)((unsigned long)&g_delay_deadline_ticks) /*=0x200040c8*/;
    volatile uint8_t *const channels_stopped = (volatile uint8_t *)((unsigned long)&g_low_power_mode_enabled) /*=0x20018d94*/;
    unsigned attempts = 0;

    (void)inherited_stack;
    (void)inherited_r2;
    (void)inherited_r3;
    int init_result = z_impl_k_sem_init(((unsigned long)&g_misc_dispatch_ctx) /*=0x20007b00*/, 0, 10);
    uint32_t stale_r2 = 10;
    if (init_result == 0) {
        *initialized = 1;
        stale_r2 = 1;
    }
    log_message(((unsigned long)"[csh_debug_nfc] g_nfcMsgSemInitOk is %d \n") /*=0xa1895*/, (uint32_t)*initialized, stale_r2, ((unsigned long)&g_misc_dispatch_pending_flag) /*=0x20018d88*/);

    for (;;) {
        if (*(volatile uint8_t *)(get_device_info() + 1) == 8) {
            set_delay_deadline(10000);
            arm_timeout_10s();
            wait_for_event(0x667, 0);
            continue;
        }
        if (*(volatile uint8_t *)(get_device_info() + 1) == 1) {
            wait_for_event(((unsigned long)&rodata_28000) /*=0x28000*/, 0);
            continue;
        }

        uint64_t state = is_battery_critical();
        if ((uint32_t)state == 1) {
            int active = init_nfc_comm();
            if (*(volatile uint8_t *)(get_device_info() + 0x1088) == 1)
                active = init_serial_comm();
            wait_for_event(0x1334, 0);
            if (active == 0)
                periodic_check_run();
            wait_for_event(0x1334, 0);
            continue;
        }

        int wait_result = k_sem_take(((unsigned long)&g_misc_dispatch_ctx) /*=0x20007b00*/,
                                             (uint32_t)(state >> 32),
                                             0x18000, 0);
        if (wait_result != 0) {
            if (*channels_stopped == 0 &&
                *(volatile uint8_t *)(get_device_info() + 1) != 8) {
                uint64_t then = *deadline;
                uint64_t first_now = k_uptime_get_1();
                uint64_t second_now = k_uptime_get_1();
                if (then < second_now && first_now - then >= 3001) {
                    set_pending_state_flag(0, 0);
                    set_pending_state_flag(1, 0);
                    *channels_stopped = 0;
                }
            }
            continue;
        }

        uint8_t status = (uint8_t)(packed_status >> 24);
        uint64_t now = k_uptime_get_1();
        if (*deadline < now)
            set_delay_deadline(0);
        ipc_service_send_with_retry(&status);
        if (status & 0x20) {
            init_nfc_comm();
            set_pending_state_flag(0, 1);
            attempts = 0;
        } else if (++attempts >= 10) {
            set_pending_state_flag(0, 1);
            attempts = 0;
        }
    }
}

/* ================================================================ */
/* member unit: g1_core_15.c */
/* ================================================================ */
/*
 * Cohesive translation unit for the `core' module.
 *
 * GENERATED by recon/refactor/transforms/t04_cohesive_tu.py.  Do not
 * edit: a stage tree is regenerated, never hand-patched
 * (recon/refactor/README.md C4).
 *
 * The 5 functions below were 5 separate translation units until this
 * stage.  Each one's text is reproduced VERBATIM and in the order the
 * generated source list gave it, and they were CONSECUTIVE in that list.
 * They were proven able to share a translation unit: no symbol is
 * declared here with two types, no identifier has internal linkage in one
 * member and is named by another, and no local typedef, macro, struct tag
 * or enum constant of one member is visible to a member that names it.
 *
 * members, in link order:
 *   init_serial_comm.c
 *   uart_read_start.c
 *   msg_queue_debug_dump.c
 *   debug_dump_message_slots_10_19.c
 *   message_pool_read_byte_0xd.c
 */
/* ---- init_serial_comm.c ---- */
#include "g1_app_symbols.h"
#include "../../../headers/g1_log.h"
#include <stdint.h>
#include "../../../headers/g1_dedupe.h"
/* readable reconstruction; identity: FUN_00033340 @ 0x00033340
 * public-name: init_serial_comm
 * durable-map: recon/catalogs/function_names_app.json
 * callees (readable <= raw @ address):
 *   fuel_gauge_dev_register                  <= FUN_00033088 @ 0x00033088
 *   process_pt_data                          <= FUN_000330ec @ 0x000330ec
 *   init_serial_port                         <= FUN_000332dc @ 0x000332dc
 *   init_serial_comm                         <= FUN_00033340 @ 0x00033340
 *   k_sleep                                  <= FUN_00074844 @ 0x00074844
 * address symbols (name @ address):
 *   rodata_87bc0                             @ 0x00087bc0
 *   rodata_a7907                             @ 0x000a7907   [INLINED -- G6 literal batch]
 */
/* Reconstructed FUN_00033340 @ 0x33340  (parity: 300/300 trials, PROVEN) */

extern int fuel_gauge_dev_register(unsigned int a);
extern int process_pt_data(void);
extern unsigned int init_serial_port(void);
extern void k_sleep(unsigned int a, unsigned int b);

int init_serial_comm(void)
{
    int iVar1;

    iVar1 = init_serial_port();
    if (iVar1 == 0) {
        iVar1 = fuel_gauge_dev_register(((unsigned long)&rodata_87bc0) /*=0x87bc0*/);
        if (iVar1 == 0) {
            iVar1 = process_pt_data();
            if (iVar1 != 0) {
                iVar1 = -3;
            }
        } else {
            log_message(((unsigned long)"init_serial_comm is failed\n") /*=0xa7907*/);
            k_sleep(0x4000, 0);
            iVar1 = -2;
        }
    } else {
        iVar1 = -1;
    }
    return iVar1;
}

/* ---- uart_read_start.c ---- */
/* readable reconstruction; identity: FUN_000336a0 @ 0x000336a0
 * public-name: uart_read_start
 * durable-map: recon/catalogs/function_names_app.json
 * callees (readable <= raw @ address):
 *   uart_read_start                          <= FUN_000336a0 @ 0x000336a0
 *   k_mem_slab_alloc                         <= FUN_00071c20 @ 0x00071c20
 * address symbols (name @ address):
 *   ADDR_uart_callback_THUMB                 @ 0x00033385
 *   rodata_a7b13                             @ 0x000a7b13   [INLINED -- G6 literal batch]
 *   rodata_a7b29                             @ 0x000a7b29   [INLINED -- G6 literal batch]
 *   rodata_a7b41                             @ 0x000a7b41   [INLINED -- G6 literal batch]
 *   g_uart_rx_mem_slab                       @ 0x200037b8
 */
/* Reconstructed FUN_000336a0 @ 0x336a0  (parity: 300/300 trials, PROVEN) */

extern int k_mem_slab_alloc(unsigned,void*,int,int,int);
typedef int (*fp1)(int,unsigned,int);
typedef int (*fp2)(int,unsigned,int,int);
unsigned uart_read_start(int param_1, unsigned param_2, unsigned param_3){
  int iVar1; unsigned local_14, uStack_10;
  if(param_1!=0){
    local_14=param_2; uStack_10=param_3;
    iVar1=k_mem_slab_alloc(((unsigned long)&g_uart_rx_mem_slab) /*=0x200037b8*/,&local_14,0,0,param_1);
    if(iVar1==0){
      void **p = *(void***)(param_1+8);
      if((fp1)p[0]!=0 && (iVar1=((fp1)p[0])(param_1,ADDR_uart_callback_THUMB /*=0x33385*/,param_1))==0){
        void **p2 = *(void***)(param_1+8);
        iVar1=((fp2)p2[3])(param_1,local_14,0x100,10000);
        if(iVar1==0) return 0;
        log_message(((unsigned long)"Failed to enable RX\n") /*=0xa7b41*/); return 0xfffffffd;
      }
      log_message(((unsigned long)"Failed to set callback\n") /*=0xa7b29*/); return 0xfffffffe;
    }
    log_message(((unsigned long)"Failed to alloc slab\n") /*=0xa7b13*/);
  }
  return 0xffffffff;
}

/* ---- msg_queue_debug_dump.c ---- */
/* readable reconstruction; identity: FUN_00033b0c @ 0x00033b0c
 * public-name: msg_queue_debug_dump
 * durable-map: recon/catalogs/function_names_app.json
 * callees (readable <= raw @ address):
 *   debug_print                              <= FUN_00019c70 @ 0x00019c70
 *   msg_queue_debug_dump                     <= FUN_00033b0c @ 0x00033b0c
 * address symbols (name @ address):
 *   rodata_a7d1c                             @ 0x000a7d1c   [INLINED -- G6 literal batch]
 *   g_log_use_alt_sink                       @ 0x20007554
 *   g_message_pool                           @ 0x20007dac
 */
/* Reconstructed FUN_00033b0c @ 0x33b0c  (parity: 300/300 trials, PROVEN) */


void msg_queue_debug_dump(unsigned int param_1, unsigned int param_2, unsigned int param_3)
{
    unsigned int format_string = ((unsigned long)"normal g_arrMsgContent[%d].uidTail is %d %d recvTime %d\n") /*=0xa7d1c*/;
    volatile int *piVar1 = (volatile int*)((unsigned long)&g_log_use_alt_sink) /*=0x20007554*/;
    volatile unsigned int *puVar3 = (volatile unsigned int*)((unsigned long)g_message_pool) /*=0x20007dac*/;
    int iVar2 = 0;
    do {
        unsigned int value0 = puVar3[0];
        unsigned int buffered = *piVar1;
        unsigned int value1 = puVar3[1];
        unsigned int value2 = puVar3[2];
        G1_LOG_ROUTE(buffered == 0, format_string, iVar2, value2, value1, value0, param_2, param_3);
        iVar2 = iVar2 + 1;
        puVar3 = puVar3 + 0x6d;
    } while (iVar2 != 10);
}

/* ---- debug_dump_message_slots_10_19.c ---- */
/* readable reconstruction; identity: FUN_00033b4c @ 0x00033b4c
 * public-name: debug_dump_message_slots_10_19
 * durable-map: recon/catalogs/function_names_app.json
 * callees (readable <= raw @ address):
 *   debug_print                              <= FUN_00019c70 @ 0x00019c70
 *   debug_dump_message_slots_10_19           <= FUN_00033b4c @ 0x00033b4c
 * address symbols (name @ address):
 *   rodata_a7d55                             @ 0x000a7d55   [INLINED -- G6 literal batch]
 *   g_log_use_alt_sink                       @ 0x20007554
 *   g_message_table_mirror                   @ 0x20008eb4
 */
/* Reconstructed FUN_00033b4c @ 0x33b4c  (parity: 300/300 trials, PROVEN) */


void debug_dump_message_slots_10_19(void)
{
  uint32_t format_string = ((unsigned long)"PUSH: g_arrMsgContent[%d].uidTail is %d push %d \n") /*=0xa7d55*/;
  volatile int32_t *piVar1 = (volatile int32_t*)((unsigned long)&g_log_use_alt_sink) /*=0x20007554*/;
  int32_t iVar2 = 10;
  volatile uint32_t *puVar3 = (volatile uint32_t*)((unsigned long)g_message_table_mirror) /*=0x20008eb4*/;
  do {
    G1_LOG_ROUTE(*piVar1 == 0, format_string, (uint32_t)iVar2, puVar3[2], puVar3[0]);
    iVar2 = iVar2 + 1;
    puVar3 = puVar3 + 0x6d;
  } while (iVar2 != 0x14);
}

/* ---- message_pool_read_byte_0xd.c ---- */
/* readable reconstruction; identity: FUN_00033c04 @ 0x00033c04
 * public-name: message_pool_read_byte_0xd
 * durable-map: recon/catalogs/function_names_app.json
 * callees (readable <= raw @ address):
 *   message_pool_read_byte_0xd               <= FUN_00033c04 @ 0x00033c04
 * address symbols (name @ address):
 *   g_message_pool                           @ 0x20007dac
 */
/* Reconstructed FUN_00033c04 @ 0x33c04  (parity: 300/300 trials, PROVEN) */

uint8_t message_pool_read_byte_0xd(int param_1)
{
  return *(volatile uint8_t *)(param_1 * 0x1b4 + ((unsigned long)g_message_pool) /*=0x20007dac*/ + 0xd);
}

