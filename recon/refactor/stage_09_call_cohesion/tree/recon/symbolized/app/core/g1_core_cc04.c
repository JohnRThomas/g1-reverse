/*
 * Call-cohesive translation unit for the `core' module.
 *
 * GENERATED by recon/refactor/transforms/t09_call_cohesion.py.  Do
 * not edit: a stage tree is regenerated, never hand-patched
 * (recon/refactor/README.md C4).
 *
 * The 3 translation units below were grouped because they CALL ONE
 * ANOTHER, not because they were adjacent in the generated source
 * list.  Each member's text is reproduced VERBATIM.  Every member was
 * checked pairwise against every other member already in this unit by
 * stage 04's seven refusal rules, unchanged: no symbol is declared
 * here with two types, no identifier has internal linkage in one
 * member and is named by another, and no local typedef, macro, struct
 * tag or enum constant of one member is visible to a member that
 * names it.
 *
 * members, in generated-source-list order:
 *   g1_core_08.c
 *   g1_core_14.c
 *   g1_core_17.c
 *
 * call edges inside this unit (caller -> callee): 2
 *   g1_core_08.c -> g1_core_17.c
 *   g1_core_14.c -> g1_core_08.c
 */

/* File-scope forward declarations for every struct/union tag this
 * unit names.  Without them a tag whose only appearance in a member
 * is inside a parameter list has PARAMETER-LIST scope, so two
 * textually IDENTICAL declarations in two members declare two
 * different incomplete types and the second is a conflicting
 * redeclaration (C11 6.2.1p7).  Incomplete-type forward
 * declarations emit no code. */
struct device;
/* ================================================================ */
/* member unit: g1_core_08.c */
/* ================================================================ */
/*
 * Cohesive translation unit for the `core' module.
 *
 * GENERATED by recon/refactor/transforms/t04_cohesive_tu.py.  Do not
 * edit: a stage tree is regenerated, never hand-patched
 * (recon/refactor/README.md C4).
 *
 * The 3 functions below were 3 separate translation units until this
 * stage.  Each one's text is reproduced VERBATIM and in the order the
 * generated source list gave it, and they were CONSECUTIVE in that list.
 * They were proven able to share a translation unit: no symbol is
 * declared here with two types, no identifier has internal linkage in one
 * member and is named by another, and no local typedef, macro, struct tag
 * or enum constant of one member is visible to a member that names it.
 *
 * members, in link order:
 *   prepare_system_suspend_state.c
 *   some_module_sem_init.c
 *   set_delay_deadline.c
 */
/* ---- prepare_system_suspend_state.c ---- */
#include "g1_app_symbols.h"
#include <stdint.h>
#include "g1_core.h"
/* readable reconstruction; identity: FUN_000289b0 @ 0x000289b0
 * public-name: prepare_system_suspend_state
 * durable-map: recon/catalogs/function_names_app.json
 * callees (readable <= raw @ address):
 *   get_device_info                          <= FUN_000167a8 @ 0x000167a8
 *   prepare_system_suspend_state             <= FUN_000289b0 @ 0x000289b0
 *   global_system_suspend                    <= FUN_0002bd7c @ 0x0002bd7c
 *   free_pixel4bit_row_buf                   <= FUN_00047ab8 @ 0x00047ab8
 *   display_close_screen                     <= FUN_00049858 @ 0x00049858
 * address symbols (name @ address):
 *   g_suspend_pending_flag                   @ 0x20018d8b
 */
/* Reconstructed FUN_000289b0 @ 0x289b0  (parity: 300/300 trials, PROVEN) */

extern int get_device_info(void);
extern void global_system_suspend(int context);
extern void free_pixel4bit_row_buf(void);
extern void display_close_screen(int);

void prepare_system_suspend_state(void)
{
    int iVar2;
    free_pixel4bit_row_buf();
    /* iteration 14: the original forwards get_device_info()'s return (r0, the
     * device context) straight into global_system_suspend -- 0x289b6 bl
     * 0x167a8 ; 0x289ba bl 0x2bd7c.  Dropping it handed the callee a NULL
     * context, and its `ldr r3,[r4,#0xb70] ; blx r3` then faulted. */
    iVar2 = get_device_info();
    global_system_suspend(iVar2);
    iVar2 = get_device_info();
    *(unsigned char*)(iVar2 + 0xee4) = 1;
    display_close_screen(3);
    iVar2 = get_device_info();
    *(unsigned char*)(iVar2 + 0xd5) = 0;
    *(volatile unsigned char *)((unsigned long)&g_suspend_pending_flag) /*=0x20018d8b*/ = 0;
    return;
}

/* ---- some_module_sem_init.c ---- */
/* readable reconstruction; identity: FUN_0002953c @ 0x0002953c
 * public-name: some_module_sem_init
 * durable-map: recon/catalogs/function_names_app.json
 * callees (readable <= raw @ address):
 *   some_module_sem_init                     <= FUN_0002953c @ 0x0002953c
 *   z_impl_k_sem_init                        <= FUN_00086534 @ 0x00086534
 * address symbols (name @ address):
 *   g_some_module_sem                        @ 0x20007b1c
 *   g_some_module_init_done_flag             @ 0x20018d8a
 */
/* Reconstructed FUN_0002953c @ 0x2953c  (parity: 300/300 trials, PROVEN) */

extern int z_impl_k_sem_init(unsigned int a, unsigned int b, unsigned int c, unsigned int d, unsigned int e);

void some_module_sem_init(void)
{
    int iVar1 = z_impl_k_sem_init(((unsigned long)&g_some_module_sem) /*=0x20007b1c*/, 0, 5, 0, 0);
    if (iVar1 == 0) {
        *(volatile uint8_t *)((unsigned long)&g_some_module_init_done_flag) /*=0x20018d8a*/ = 1;
    }
}

/* ---- set_delay_deadline.c ---- */
/* readable reconstruction; identity: FUN_0002a4d8 @ 0x0002a4d8
 * public-name: set_delay_deadline
 * durable-map: recon/catalogs/function_names_app.json
 * callees (readable <= raw @ address):
 *   set_delay_deadline                       <= FUN_0002a4d8 @ 0x0002a4d8
 *   k_uptime_get_1                           <= FUN_0007cb2c @ 0x0007cb2c
 * address symbols (name @ address):
 *   g_delay_deadline_ticks                   @ 0x200040c8
 */
/* Reconstructed FUN_0002a4d8 @ 0x2a4d8  (parity: 300/300 trials, PROVEN) */


void set_delay_deadline(unsigned long param_1) {
    uint64_t lVar1 = k_uptime_get_1();
    *(volatile uint64_t *)((unsigned long)&g_delay_deadline_ticks) /*=0x200040c8*/ = lVar1 + (uint64_t)param_1;
}

/* ================================================================ */
/* member unit: g1_core_14.c */
/* ================================================================ */
/*
 * Cohesive translation unit for the `core' module.
 *
 * GENERATED by recon/refactor/transforms/t04_cohesive_tu.py.  Do not
 * edit: a stage tree is regenerated, never hand-patched
 * (recon/refactor/README.md C4).
 *
 * The 3 functions below were 3 separate translation units until this
 * stage.  Each one's text is reproduced VERBATIM and in the order the
 * generated source list gave it, and they were CONSECUTIVE in that list.
 * They were proven able to share a translation unit: no symbol is
 * declared here with two types, no identifier has internal linkage in one
 * member and is named by another, and no local typedef, macro, struct tag
 * or enum constant of one member is visible to a member that names it.
 *
 * members, in link order:
 *   pt_comm_bind_device.c
 *   process_pt_data.c
 *   init_serial_port.c
 */

/* File-scope forward declarations for every struct/union tag this
 * unit names.  Without them a tag whose only appearance in a member
 * is inside a parameter list has PARAMETER-LIST scope, so two
 * textually IDENTICAL declarations in two members declare two
 * different incomplete types and the second is a conflicting
 * redeclaration (C11 6.2.1p7).  Incomplete-type forward
 * declarations emit no code. */
struct device;
/* ---- pt_comm_bind_device.c ---- */
#include "g1_app_symbols.h"
/* readable reconstruction; identity: FUN_000330a8 @ 0x000330a8
 * public-name: pt_comm_bind_device
 * durable-map: recon/catalogs/function_names_app.json
 * callees (readable <= raw @ address):
 *   pt_comm_bind_device                      <= FUN_000330a8 @ 0x000330a8
 * address symbols (name @ address):
 *   g_fuel_gauge_dev                         @ 0x20002424
 *   g_pt_comm_state                          @ 0x2000242c
 */
/* Reconstructed FUN_000330a8 @ 0x330a8  (parity: 300/300 trials, PROVEN) */

unsigned int pt_comm_bind_device(unsigned int param_1)
{
    if (param_1 == 0) {
        return 0xffffffff;
    }
    if (*(volatile unsigned int *)((unsigned long)&g_fuel_gauge_dev) /*=0x20002424*/ != param_1) {
        *(volatile unsigned int *)((unsigned long)&g_fuel_gauge_dev) /*=0x20002424*/ = param_1;
    }
    *(volatile unsigned char *)((unsigned long)&g_pt_comm_state) /*=0x2000242c*/ = 0;
    return 0;
}

/* ---- process_pt_data.c ---- */
#include "../../../headers/g1_log.h"
#include "g1_core.h"
/* readable reconstruction; identity: FUN_000330ec @ 0x000330ec
 * public-name: process_pt_data
 * durable-map: recon/catalogs/function_names_app.json
 * callees (readable <= raw @ address):
 *   debug_print                              <= FUN_00019c70 @ 0x00019c70
 *   set_delay_deadline                       <= FUN_0002a4d8 @ 0x0002a4d8
 *   display_dev_reg_config                   <= FUN_0002eaa8 @ 0x0002eaa8
 *   set_pending_state_flag                   <= FUN_0002eb28 @ 0x0002eb28
 *   erase_audio_buffer                       <= FUN_0002f008 @ 0x0002f008
 *   nfc_eeprom_comm_lock                     <= FUN_00030cb8 @ 0x00030cb8
 *   nfc_eeprom_comm_unlock                   <= FUN_00030cc4 @ 0x00030cc4
 *   pt_comm_transport_write                  <= FUN_00030cd0 @ 0x00030cd0
 *   pt_cmd_dispatch_and_encode_response      <= FUN_00032b24 @ 0x00032b24
 *   process_pt_data                          <= FUN_000330ec @ 0x000330ec
 *   sys_reboot                               <= FUN_0004c0a8 @ 0x0004c0a8
 *   serial_data_read_dispatch                <= FUN_0007d0e8 @ 0x0007d0e8
 *   k_msleep_ticks32768_c                    <= FUN_0007d194 @ 0x0007d194
 *   log_message                              <= FUN_0007dda4 @ 0x0007dda4
 * address symbols (name @ address):
 *   rodata_a776c                             @ 0x000a776c   [INLINED -- refactor stage 01]
 *   rodata_a7780                             @ 0x000a7780   [INLINED -- refactor stage 01]
 *   rodata_a779f                             @ 0x000a779f   [INLINED -- refactor stage 01]
 *   rodata_a77b5                             @ 0x000a77b5   [INLINED -- refactor stage 01]
 *   rodata_a77cc                             @ 0x000a77cc   [INLINED -- refactor stage 01]
 *   rodata_a780d                             @ 0x000a780d   [INLINED -- refactor stage 01]
 *   rodata_a7882                             @ 0x000a7882   [INLINED -- refactor stage 01]
 *   g_log_level                              @ 0x2000230c
 *   g_fuel_gauge_dev                         @ 0x20002424
 *   g_pt_comm_dev                            @ 0x20002428
 *   g_pt_comm_state                          @ 0x2000242c
 *   g_log_use_alt_sink                       @ 0x20007554
 *   g_low_power_mode_enabled                 @ 0x20018d94
 *   g_system_19ff5                           @ 0x20019ff5
 *   g_pt_status_msg_buf                      @ 0x2001a0f5
 */
/* Reconstructed FUN_000330ec @ 0x330ec  (parity: 300/300 trials, PROVEN) */
extern void set_delay_deadline(unsigned long);
extern int display_dev_reg_config(void);
extern int set_pending_state_flag(int,...);
extern int erase_audio_buffer(void);
extern void nfc_eeprom_comm_lock(void);
extern void nfc_eeprom_comm_unlock(void);
extern int pt_comm_transport_write(int,...);
extern int pt_cmd_dispatch_and_encode_response(int,...);
extern int serial_data_read_dispatch(int,...);
extern int k_msleep_ticks32768_c(int,...);
extern unsigned int change_work_mode_to(unsigned int);

unsigned process_pt_data(unsigned param_1)
{
    unsigned uVar6 = ((unsigned long)&g_system_19ff5) /*=0x20019ff5*/;
    unsigned uVar4;
    int iVar3;
    unsigned char *pbVar5;
    unsigned char *L = (unsigned char *)((unsigned long)&g_pt_status_msg_buf) /*=0x2001a0f5*/;
    unsigned local_28 = 0;
    unsigned local_24 = 0;
    unsigned local_20 = ((unsigned long)&g_system_19ff5) /*=0x20019ff5*/;
    unsigned char *local_1c = L;
    unsigned int mode;
    int channel;

    if ((*(volatile int *)((unsigned long)&g_fuel_gauge_dev) /*=0x20002424*/ == 0) || (*(volatile int *)((unsigned long)&g_pt_comm_dev) /*=0x20002428*/ == 0) ||
        ((char)*(volatile unsigned char *)((unsigned long)&g_pt_comm_state) /*=0x2000242c*/ == 2)) {
        log_message(((unsigned long)"comm para is error\n") /*=0xa776c*/);
        return 0xffffffff;
    }

    nfc_eeprom_comm_lock();
    mode = *(volatile unsigned char *)((unsigned long)&g_pt_comm_state) /*=0x2000242c*/;
    channel = *(volatile int *)((unsigned long)&g_fuel_gauge_dev) /*=0x20002424*/;
    if (mode != 0)
        channel = *(volatile int *)((unsigned long)&g_pt_comm_dev) /*=0x20002428*/;
    iVar3 = serial_data_read_dispatch(mode, channel, &local_20, &local_24);
    if (iVar3 != 0) { nfc_eeprom_comm_unlock(); return 0xfffffffe; }

    iVar3 = pt_cmd_dispatch_and_encode_response(mode, uVar6, local_24 & 0xff,
                         &local_1c, &local_28, param_1);
    if (iVar3 != 0) { log_message(((unsigned long)"process_pt_protocol is failed\n") /*=0xa7780*/); nfc_eeprom_comm_unlock(); return 0xfffffffd; }

    channel = *(volatile int *)((unsigned long)&g_fuel_gauge_dev) /*=0x20002424*/;
    if (mode != 0)
        channel = *(volatile int *)((unsigned long)&g_pt_comm_dev) /*=0x20002428*/;
    iVar3 = pt_comm_transport_write(mode, channel, local_1c, local_28 & 0xff);
    if (iVar3 != 0) { log_message(((unsigned long)"comm_write is failed\n") /*=0xa779f*/); nfc_eeprom_comm_unlock(); return 0xfffffffc; }

    nfc_eeprom_comm_unlock();
    if (local_1c[9] == 0x80) {
        k_msleep_ticks32768_c(1000);
        local_1c[9] = 0;
        nfc_eeprom_comm_lock();
        pt_comm_transport_write(mode, *(volatile int *)((unsigned long)&g_fuel_gauge_dev) /*=0x20002424*/,
                     local_1c, local_28 & 0xff);
        nfc_eeprom_comm_unlock();
    }

    pbVar5 = local_1c;
    if (mode != 0) pbVar5 = local_1c + 4;
    uVar4 = (unsigned)*pbVar5;
    uVar6 = 0;
    if (uVar4 == 0x1b) {
        if (pbVar5[8] != 0) erase_audio_buffer();
    } else if (uVar4 == 0x13) {
        if (((pbVar5[4] & 0xfb) == 0) && (iVar3 = display_dev_reg_config(), iVar3 != 0)) uVar6 = 0xfffffffb;
    } else {
        if (uVar4 != 6) {
            if (uVar4 != 0xb) goto LAB_0003325a;
            pbVar5 = (unsigned char *)*(volatile int *)((unsigned long)&g_log_level) /*=0x2000230c*/;
            if ((int)pbVar5 < 1) goto LAB_0003324c;
            pbVar5 = (unsigned char *)*(volatile int *)((unsigned long)&g_log_use_alt_sink) /*=0x20007554*/;
            do {
                if (pbVar5 == 0) log_message(((unsigned long)"%s(): sys reboot because process_pt_data cmd PTP_DEVICE_RESTART\n") /*=0xa77cc*/, ((unsigned long)"process_pt_data") /*=0xa7882*/);
                else debug_print(((unsigned long)"%s(): sys reboot because process_pt_data cmd PTP_DEVICE_RESTART\n") /*=0xa77cc*/, ((unsigned long)"process_pt_data") /*=0xa7882*/);
LAB_0003324c:
                do {
                    while (1) {
                        k_msleep_ticks32768_c(300);
                        sys_reboot(1);
LAB_0003325a:
                        if (uVar4 != 0x3c) break;
                        if (pbVar5[4] != 0) return 0;
                        pbVar5 = (unsigned char *)*(volatile int *)((unsigned long)&g_log_level) /*=0x2000230c*/;
                        if (0 < (int)pbVar5) {
                            pbVar5 = (unsigned char *)*(volatile int *)((unsigned long)&g_log_use_alt_sink) /*=0x20007554*/;
                            if (pbVar5 == 0) log_message(((unsigned long)"%s(): sys reboot because process_pt_data cmd %d and ACK_SUCC\n") /*=0xa780d*/, ((unsigned long)"process_pt_data") /*=0xa7882*/);
                            else debug_print(((unsigned long)"%s(): sys reboot because process_pt_data cmd %d and ACK_SUCC\n") /*=0xa780d*/, ((unsigned long)"process_pt_data") /*=0xa7882*/);
                        }
                    }
                    if (uVar4 != 1) return 0;
                    if (pbVar5[4] != 0) return 0;
                    pbVar5 = (unsigned char *)*(volatile int *)((unsigned long)&g_log_level) /*=0x2000230c*/;
                } while ((int)pbVar5 < 1);
                pbVar5 = (unsigned char *)*(volatile int *)((unsigned long)&g_log_use_alt_sink) /*=0x20007554*/;
            } while (1);
        }
        if (pbVar5[2] == 2) {
            *(volatile unsigned char *)((unsigned long)&g_low_power_mode_enabled) /*=0x20018d94*/ = 1;
            set_pending_state_flag(1, 1);
            set_delay_deadline(10000);
        } else {
            log_message(((unsigned long)"enter into long trip \n") /*=0xa77b5*/);
            k_msleep_ticks32768_c(10000);
            change_work_mode_to(7);
        }
    }
    return uVar6;
}

/* ---- init_serial_port.c ---- */
#include "../../../headers/g1_dedupe.h"
/* readable reconstruction; identity: FUN_000332dc @ 0x000332dc
 * public-name: init_serial_port
 * durable-map: recon/catalogs/function_names_app.json
 * callees (readable <= raw @ address):
 *   init_serial_port                         <= FUN_000332dc @ 0x000332dc
 *   uart_read_start                          <= FUN_000336a0 @ 0x000336a0
 *   assert_post_action                       <= FUN_0007e2ec @ 0x0007e2ec
 *   printk                                   <= FUN_0007e2fa @ 0x0007e2fa
 *   z_device_is_ready                        <= FUN_0008638c @ 0x0008638c
 * address symbols (name @ address):
 *   rodata_87bc0                             @ 0x00087bc0
 *   rodata_99cbd                             @ 0x00099cbd   [INLINED -- G6 literal batch]
 *   rodata_a7892                             @ 0x000a7892   [INLINED -- G6 literal batch]
 *   rodata_a78b9                             @ 0x000a78b9   [INLINED -- G6 literal batch]
 *   rodata_a78d1                             @ 0x000a78d1   [INLINED -- G6 literal batch]
 *   rodata_a78eb                             @ 0x000a78eb   [INLINED -- G6 literal batch]
 *   g_serial_port_ready                      @ 0x2001a127
 */
/* Reconstructed FUN_000332dc @ 0x332dc  (parity: 300/300 trials, PROVEN) */

extern _Bool z_device_is_ready(const struct device *);
extern int uart_read_start(void*);
extern void assert_post_action(const char *, unsigned int);

unsigned int init_serial_port(void)
{
  volatile unsigned char *pcVar1 = (volatile unsigned char*)((unsigned long)&g_serial_port_ready) /*=0x2001a127*/;
  int iVar2;

  if (*pcVar1 == 0) {
    iVar2 = z_device_is_ready((void*)((unsigned long)&rodata_87bc0) /*=0x87bc0*/);
    if (iVar2 == 0) {
      printk((unsigned long)((unsigned long)"ASSERTION FAIL [%s] @ %s:%d\n") /*=0x99cbd*/, (void*)((unsigned long)"device_is_ready(lpuart)") /*=0xa78b9*/, (void*)((unsigned long)"../src/production_test/serial_thread.c") /*=0xa7892*/, 0x2e, 0);
      G1_ASSERT_FAIL(((unsigned long)((unsigned long)"\tLPUART device not ready\n") /*=0xa78d1*/, 0, 0, 0, 0), ((void*)((unsigned long)"../src/production_test/serial_thread.c") /*=0xa7892*/, 0x2e));
    }
    iVar2 = uart_read_start((void*)((unsigned long)&rodata_87bc0) /*=0x87bc0*/);
    if (iVar2 != 0) {
      *pcVar1 = 0;
      log_message((unsigned long)((unsigned long)"init_serial_port is failed\n") /*=0xa78eb*/);
      return 0xffffffff;
    }
    *pcVar1 = 1;
  }
  return 0;
}

/* ================================================================ */
/* member unit: g1_core_17.c */
/* ================================================================ */
/*
 * Cohesive translation unit for the `core' module.
 *
 * GENERATED by recon/refactor/transforms/t04_cohesive_tu.py.  Do not
 * edit: a stage tree is regenerated, never hand-patched
 * (recon/refactor/README.md C4).
 *
 * The 2 functions below were 2 separate translation units until this
 * stage.  Each one's text is reproduced VERBATIM and in the order the
 * generated source list gave it, and they were CONSECUTIVE in that list.
 * They were proven able to share a translation unit: no symbol is
 * declared here with two types, no identifier has internal linkage in one
 * member and is named by another, and no local typedef, macro, struct tag
 * or enum constant of one member is visible to a member that names it.
 *
 * members, in link order:
 *   reset_ipc_evt_ctx.c
 *   free_pixel4bit_row_buf.c
 */
/* ---- reset_ipc_evt_ctx.c ---- */
#include "g1_app_symbols.h"
/* readable reconstruction; identity: FUN_0003dfe4 @ 0x0003dfe4
 * public-name: reset_ipc_evt_ctx
 * durable-map: recon/catalogs/function_names_app.json
 * callees (readable <= raw @ address):
 *   reset_ipc_evt_ctx                        <= FUN_0003dfe4 @ 0x0003dfe4
 *   memset_bytes                             <= FUN_00086c78 @ 0x00086c78
 * address symbols (name @ address):
 *   g_ipc_or_evt_ctx                         @ 0x20004bb8
 */
/* Reconstructed FUN_0003dfe4 @ 0x3dfe4  (parity: 300/300 trials, PROVEN) */

extern void memset_bytes(void*, int, int);
unsigned int reset_ipc_evt_ctx(void) {
  memset_bytes(((unsigned long)g_ipc_or_evt_ctx) /*=0x20004bb8*/, 0, 0x38);
  return 0;
}

/* ---- free_pixel4bit_row_buf.c ---- */
/* readable reconstruction; identity: FUN_00047ab8 @ 0x00047ab8
 * public-name: free_pixel4bit_row_buf
 * durable-map: recon/catalogs/function_names_app.json
 * callees (readable <= raw @ address):
 *   free_pixel4bit_row_buf                   <= FUN_00047ab8 @ 0x00047ab8
 *   free                                     <= FUN_00076d7c @ 0x00076d7c
 * address symbols (name @ address):
 *   g_pixel4bit_row_buf                      @ 0x20009fcc
 */
/* Reconstructed FUN_00047ab8 @ 0x47ab8  (parity: 300/300 trials, PROVEN) */

extern void free(void *);

void free_pixel4bit_row_buf(void)
{
  volatile int *piVar1 = (volatile int *)((unsigned long)&g_pixel4bit_row_buf) /*=0x20009fcc*/;
  int value = *piVar1;
  if (value != 0) {
    free((unsigned int)value);
    *piVar1 = 0;
  }
}

