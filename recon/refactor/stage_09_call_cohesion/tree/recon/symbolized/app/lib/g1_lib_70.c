/*
 * Cohesive translation unit for the `lib' module.
 *
 * GENERATED by recon/refactor/transforms/t04_cohesive_tu.py.  Do not
 * edit: a stage tree is regenerated, never hand-patched
 * (recon/refactor/README.md C4).
 *
 * The 19 functions below were 19 separate translation units until this
 * stage.  Each one's text is reproduced VERBATIM and in the order the
 * generated source list gave it, and they were CONSECUTIVE in that list.
 * They were proven able to share a translation unit: no symbol is
 * declared here with two types, no identifier has internal linkage in one
 * member and is named by another, and no local typedef, macro, struct tag
 * or enum constant of one member is visible to a member that names it.
 *
 * members, in link order:
 *   qspi_rdsr.c
 *   is_regular_addr_valid.c
 *   nvs_timer_arm_and_mark_dirty.c
 *   nvs_ate_id_matches.c
 *   nvs_flush_close_ate.c
 *   cjson_skip_whitespace.c
 *   alloc_zeroed_node.c
 *   cbor_decode_start_default.c
 *   cjson_print_pretty.c
 *   cjson_print_unformatted.c
 *   cjson_add_item_to_object_thunk.c
 *   cjson_add_bool_to_object.c
 *   cjson_object_add_number.c
 *   cjson_add_string_to_object.c
 *   cjson_is_array.c
 *   gpio_pin_check_output_available.c
 *   nrf_gpio_cfg_sense_set.c
 *   nrf_gpio_pin_outset.c
 *   nrf_gpio_pin_set.c
 */

/* File-scope forward declarations for every struct/union tag this
 * unit names.  Without them a tag whose only appearance in a member
 * is inside a parameter list has PARAMETER-LIST scope, so two
 * textually IDENTICAL declarations in two members declare two
 * different incomplete types and the second is a conflicting
 * redeclaration (C11 6.2.1p7).  Incomplete-type forward
 * declarations emit no code. */
struct qspi_buf;
struct qspi_cmd;
struct text_cursor;
/* ---- qspi_rdsr.c ---- */
#include "g1_app_symbols.h"
/* readable reconstruction; identity: FUN_000839a6 @ 0x000839a6
 * public-name: qspi_rdsr
 * durable-map: recon/catalogs/function_names_app.json
 */
/* Config-specialized NCS qspi_rdsr @ 0x000839a6 (FUN_000839a6). */
#include <stddef.h>
#include <stdint.h>
#include "g1_lib.h"

struct qspi_buf {
    uint8_t *buf;
    size_t len;
};
struct qspi_cmd {
    uint8_t opcode;
    uint8_t reserved[3];
    const struct qspi_buf *tx;
    struct qspi_buf *rx;
};


int qspi_rdsr(const void *device)
{
    uint8_t status = 0xffu;
    struct qspi_buf receive = { &status, 1u };
    struct qspi_cmd command = { 5u, {0u, 0u, 0u}, 0, &receive };
    int result = qspi_nor_send_cinstr(device, &command, 0u);
    return result >= 0 ? (int)status : result;
}

/* ---- is_regular_addr_valid.c ---- */
/* readable reconstruction; identity: FUN_000839dc @ 0x000839dc
 * public-name: is_regular_addr_valid
 * durable-map: recon/catalogs/function_names_app.json
 */
/* is_regular_addr_valid @ 0x000839dc; raw FUN_000839dc.
 * NCS 2.5.1 zephyr/drivers/flash/soc_flash_nrf.c. */

extern uint32_t nrfx_nvmc_flash_size_get(void); /*=0x000851e8*/
int is_regular_addr_valid(int32_t address, uint32_t length)
{
    uint32_t flash_size = nrfx_nvmc_flash_size_get();
    return address >= 0 && (uint32_t)address < flash_size &&
           length <= flash_size - (uint32_t)address;
}

/* ---- nvs_timer_arm_and_mark_dirty.c ---- */
/* readable reconstruction; identity: FUN_000849da @ 0x000849da
 * public-name: nvs_timer_arm_and_mark_dirty
 * durable-map: recon/catalogs/function_names_app.json
 * callees (readable <= raw @ address):
 *   nvs_timer_arm_and_mark_dirty             <= FUN_000849da @ 0x000849da
 *   z_impl_k_timer_stop                      <= FUN_0008673e @ 0x0008673e
 */
/* Reconstructed FUN_000849da @ 0x849da  (parity: 300/300 trials, PROVEN) */

extern void z_impl_k_timer_stop(int a, unsigned int b, int c, int d, unsigned int e);
unsigned int nvs_timer_arm_and_mark_dirty(int param_1,unsigned int param_2,unsigned int param_3,unsigned int param_4)
{
  unsigned int uVar1;
  int iVar2;
  int iVar3;
  int iVar4;
  int iVar5;

  iVar5 = *(int *)(param_1 + 0x10);
  iVar4 = **(int **)(param_1 + 4);
  iVar2 = *(int *)(*(int *)(iVar5 + 0xc) + 0x58);
  if (iVar2 == 0) {
    uVar1 = 0xfffffff2;
  } else {
    iVar3 = *(int *)(*(int *)(iVar5 + 0xc) + 100);
    if (iVar3 != 0) {
      *(unsigned int *)(iVar4 + 0x200) = *(unsigned int *)(iVar4 + 0x200) & 0xffffffdf;
      *(unsigned int *)(iVar4 + 0x14c) = 0;
      iVar3 = *(int *)(iVar4 + 0x14c);
    }
    z_impl_k_timer_stop(*(int *)(iVar5 + 0xc) + 0x80,param_2,iVar2,iVar3,param_4);
    uVar1 = 0;
    *(unsigned char *)(*(int *)(iVar5 + 0xc) + 0xca) = 0;
    *(unsigned char *)(*(int *)(iVar5 + 0xc) + 0xcb) = 1;
    *(unsigned int *)(iVar4 + 4) = 1;
  }
  return uVar1;
}

/* ---- nvs_ate_id_matches.c ---- */
/* readable reconstruction; identity: FUN_00084d70 @ 0x00084d70
 * public-name: nvs_ate_id_matches
 * durable-map: recon/catalogs/function_names_app.json
 * callees (readable <= raw @ address):
 *   nvs_ate_id_matches                       <= FUN_00084d70 @ 0x00084d70
 */
/* Reconstructed FUN_00084d70 @ 0x84d70  (parity: 300/300 trials, PROVEN) */

unsigned int nvs_ate_id_matches(int param_1,int param_2)
{
  unsigned int uVar1;
  if (param_1 == 4) { return 1; }
  if (param_1 == 5) {
    uVar1 = (unsigned int)(param_2 - 1);
    if (uVar1 != 0) { uVar1 = 1; }
    return uVar1;
  }
  return (unsigned int)(param_1 == param_2);
}

/* ---- nvs_flush_close_ate.c ---- */
/* readable reconstruction; identity: FUN_00084e58 @ 0x00084e58
 * public-name: nvs_flush_close_ate
 * durable-map: recon/catalogs/function_names_app.json
 * callees (readable <= raw @ address):
 *   flash_write_close_ate_marker             <= FUN_00084e44 @ 0x00084e44
 *   nvs_flush_close_ate                      <= FUN_00084e58 @ 0x00084e58
 */
/* Reconstructed FUN_00084e58 @ 0x84e58 */

extern void flash_write_close_ate_marker(uintptr_t, uint32_t, uint32_t);

static void nvs_flush_close_ate(uintptr_t peripheral)
{
  uint32_t buffer =
      (*(volatile uint32_t *)(peripheral + 8) - 0x18u) & ~7u;
  flash_write_close_ate_marker(peripheral, buffer, 1);
}

/* ---- cjson_skip_whitespace.c ---- */
/* readable reconstruction; identity: FUN_00084ed8 @ 0x00084ed8
 * public-name: cjson_skip_whitespace
 * durable-map: recon/catalogs/function_names_app.json
 * callees (readable <= raw @ address):
 *   cjson_skip_whitespace                    <= FUN_00084ed8 @ 0x00084ed8
 */
/* Full reconstruction FUN_00084ed8 @ 0x84ed8 (46-byte extent). */

struct text_cursor {
    uint8_t *data;
    uint32_t length;
    uint32_t position;
};

struct text_cursor *cjson_skip_whitespace(struct text_cursor *cursor)
{
    if (cursor == 0 || cursor->data == 0)
        return cursor == 0 ? 0 : (struct text_cursor *)0;

    if (cursor->position < cursor->length) {
        while (cursor->position < cursor->length) {
            if (cursor->data[cursor->position] > 0x20)
                return cursor;
            cursor->position++;
        }
        if (cursor->position == cursor->length)
            cursor->position--;
    }
    return cursor;
}

/* ---- alloc_zeroed_node.c ---- */
/* readable reconstruction; identity: FUN_00084fd4 @ 0x00084fd4
 * public-name: alloc_zeroed_node
 * durable-map: recon/catalogs/function_names_app.json
 * callees (readable <= raw @ address):
 *   alloc_zeroed_node                        <= FUN_00084fd4 @ 0x00084fd4
 *   memset_bytes                             <= FUN_00086c78 @ 0x00086c78
 */
/* Reconstructed FUN_00084fd4 @ 0x84fd4  (parity: 300/300 trials, PROVEN) */

extern void memset_bytes(int a, int b, int c);
typedef int (*fnptr)(int);
int alloc_zeroed_node(fnptr param_1) {
    int iVar1 = param_1(0x28);
    if (iVar1 != 0) {
        memset_bytes(iVar1, 0, 0x28);
    }
    return iVar1;
}

/* ---- cbor_decode_start_default.c ---- */
/* readable reconstruction; identity: FUN_0008500c @ 0x0008500c
 * public-name: cbor_decode_start_default
 * durable-map: recon/catalogs/function_names_app.json
 * callees (readable <= raw @ address):
 *   enqueue_string_with_len                  <= FUN_00084fec @ 0x00084fec
 *   cbor_decode_start_default                <= FUN_0008500c @ 0x0008500c
 */
/* Reconstructed FUN_0008500c @ 0x8500c. */
/* Tail wrapper: clear the callee's second and third ABI arguments. */
extern void enqueue_string_with_len(unsigned int, unsigned int, unsigned int);

void cbor_decode_start_default(unsigned int param_1)
{
    enqueue_string_with_len(param_1, 0, 0);
}

/* ---- cjson_print_pretty.c ---- */
/* readable reconstruction; identity: FUN_00085014 @ 0x00085014
 * public-name: cjson_print_pretty
 * durable-map: recon/catalogs/function_names_app.json
 * callees (readable <= raw @ address):
 *   cjson_print                              <= FUN_00064a88 @ 0x00064a88
 *   cjson_print_pretty                       <= FUN_00085014 @ 0x00085014
 */
/* Reconstructed FUN_00085014 @ 0x85014  (parity: 300/300 trials, PROVEN) */

extern int cjson_print(unsigned long, unsigned long);
void cjson_print_pretty(unsigned int param_1)
{
    cjson_print(param_1, 1);
}

/* ---- cjson_print_unformatted.c ---- */
/* readable reconstruction; identity: FUN_0008501a @ 0x0008501a
 * public-name: cjson_print_unformatted
 * durable-map: recon/catalogs/function_names_app.json
 * callees (readable <= raw @ address):
 *   cjson_print                              <= FUN_00064a88 @ 0x00064a88
 *   cjson_print_unformatted                  <= FUN_0008501a @ 0x0008501a
 */
/* Reconstructed FUN_0008501a @ 0x8501a  (parity: 300/300 trials, PROVEN) */

void cjson_print_unformatted(unsigned int param_1)
{
    cjson_print(param_1, 0);
}

/* ---- cjson_add_item_to_object_thunk.c ---- */
/* readable reconstruction; identity: FUN_00085046 @ 0x00085046
 * public-name: cjson_add_item_to_object_thunk
 * durable-map: recon/catalogs/function_names_app.json
 * callees (readable <= raw @ address):
 *   cjson_add_item_to_object                 <= FUN_0006466c @ 0x0006466c
 *   cjson_add_item_to_object_thunk           <= FUN_00085046 @ 0x00085046
 */
/* Reconstructed FUN_00085046 @ 0x85046  (parity: 300/300 trials, PROVEN) */

void cjson_add_item_to_object_thunk(unsigned int a, unsigned int b, unsigned int c, unsigned int unused)
{
    (void)unused;
    cjson_add_item_to_object(a, b, c, 0);
}

/* ---- cjson_add_bool_to_object.c ---- */
/* readable reconstruction; identity: FUN_0008504c @ 0x0008504c
 * public-name: cjson_add_bool_to_object
 * durable-map: recon/catalogs/function_names_app.json
 * callees (readable <= raw @ address):
 *   cjson_add_item_to_object                 <= FUN_0006466c @ 0x0006466c
 *   cjson_delete                             <= FUN_00064b1c @ 0x00064b1c
 *   cjson_create_bool                        <= FUN_00064c3c @ 0x00064c3c
 *   cjson_add_bool_to_object                 <= FUN_0008504c @ 0x0008504c
 */
/* Reconstructed FUN_0008504c @ 0x8504c  (parity: 300/300 trials, PROVEN) */

extern int cjson_create_bool(int);
int cjson_add_bool_to_object(int param_1,int param_2,int param_3)
{
    int uVar1 = cjson_create_bool(param_3);
    int iVar2 = cjson_add_item_to_object(param_1,param_2,uVar1,0);
    if (iVar2 == 0) {
        cjson_delete(uVar1);
        uVar1 = 0;
    }
    return uVar1;
}

/* ---- cjson_object_add_number.c ---- */
/* readable reconstruction; identity: FUN_00085076 @ 0x00085076
 * public-name: cjson_object_add_number
 * durable-map: recon/catalogs/function_names_app.json
 * callees (readable <= raw @ address):
 *   cjson_create_number                      <= FUN_00012c18 @ 0x00012c18
 *   cjson_add_item_to_object                 <= FUN_0006466c @ 0x0006466c
 *   cjson_delete                             <= FUN_00064b1c @ 0x00064b1c
 *   cjson_object_add_number                  <= FUN_00085076 @ 0x00085076
 */
/* Reconstructed FUN_00085076 @ 0x85076  (parity: 300/300 trials, PROVEN) */

extern unsigned int cjson_create_number(void);

unsigned int cjson_object_add_number(unsigned int param_1, unsigned int param_2)
{
    unsigned int uVar1;
    int iVar2;
    uVar1 = cjson_create_number();
    iVar2 = cjson_add_item_to_object(param_1, param_2, uVar1, 0);
    if (iVar2 == 0) {
        cjson_delete(uVar1);
        uVar1 = 0;
    }
    return uVar1;
}

/* ---- cjson_add_string_to_object.c ---- */
/* readable reconstruction; identity: FUN_0008509e @ 0x0008509e
 * public-name: cjson_add_string_to_object
 * durable-map: recon/catalogs/function_names_app.json
 * callees (readable <= raw @ address):
 *   cjson_add_item_to_object                 <= FUN_0006466c @ 0x0006466c
 *   cjson_delete                             <= FUN_00064b1c @ 0x00064b1c
 *   cjson_create_string                      <= FUN_00064c5c @ 0x00064c5c
 *   cjson_add_string_to_object               <= FUN_0008509e @ 0x0008509e
 */
/* Reconstructed FUN_0008509e @ 0x8509e  (parity: 300/300 trials, PROVEN) */

extern int cjson_create_string(unsigned int);
int cjson_add_string_to_object(int param_1,int param_2,int param_3)
{
    int uVar1 = cjson_create_string(param_3);
    int iVar2 = cjson_add_item_to_object(param_1,param_2,uVar1,0);
    if (iVar2 == 0) {
        cjson_delete(uVar1);
        uVar1 = 0;
    }
    return uVar1;
}

/* ---- cjson_is_array.c ---- */
/* readable reconstruction; identity: FUN_000850c8 @ 0x000850c8
 * public-name: cjson_is_array
 * durable-map: recon/catalogs/function_names_app.json
 * callees (readable <= raw @ address):
 *   cjson_is_array                           <= FUN_000850c8 @ 0x000850c8
 */
/* Reconstructed FUN_000850c8 @ 0x850c8  (parity: 300/300 trials, PROVEN) */

unsigned int cjson_is_array(unsigned char *param_1) {
  unsigned int result = (unsigned int)(uintptr_t)param_1;
  if (param_1 != 0) {
    result = (unsigned int)(param_1[0xc] == 0x20);
  }
  return result;
}

/* ---- gpio_pin_check_output_available.c ---- */
/* readable reconstruction; identity: FUN_0008511a @ 0x0008511a
 * public-name: gpio_pin_check_output_available
 * durable-map: recon/catalogs/function_names_app.json
 * callees (readable <= raw @ address):
 *   pin_in_use_by_te                         <= FUN_00065460 @ 0x00065460
 *   pin_is_output                            <= FUN_00065494 @ 0x00065494
 *   gpio_pin_check_output_available          <= FUN_0008511a @ 0x0008511a
 */
/* Reconstructed FUN_0008511a @ 0x8511a  (parity: 300/300 trials, PROVEN) */

extern unsigned long long pin_is_output(unsigned int, unsigned int, unsigned int, unsigned int, unsigned int);
extern unsigned int pin_in_use_by_te(unsigned int);

unsigned int gpio_pin_check_output_available(unsigned int param_1, unsigned int param_2, unsigned int param_3, unsigned int param_4)
{
    unsigned int uVar1;
    unsigned long long uVar2;
    uVar2 = pin_is_output(param_1, param_1, param_3, param_4, param_4);
    uVar1 = (unsigned int)uVar2;
    if (uVar1 != 0) {
        uVar1 = pin_in_use_by_te((unsigned int)(uVar2 >> 32));
    }
    return uVar1 & 1;
}

/* ---- nrf_gpio_cfg_sense_set.c ---- */
/* readable reconstruction; identity: FUN_000851ca @ 0x000851ca
 * public-name: nrf_gpio_cfg_sense_set
 * durable-map: recon/catalogs/function_names_app.json
 */
/* Reconstructed nrf_gpio_cfg_sense_set @ 0x000851ca from configured NCS 2.5.1 nrf_gpio.h.
 * Identity/backmap: FUN_000851ca.
 */

extern void gpio_pin_cnf_build_fields(uint32_t pin,
                                      const uint8_t *direction,
                                      const uint8_t *input,
                                      const uint8_t *pull,
                                      const uint8_t *drive,
                                      const uint8_t *sense);
/* gpio_pin_cnf_build_fields <= FUN_00085130 @ 0x00085130 */

void nrf_gpio_cfg_sense_set(uint32_t pin, uint8_t sense)
{
    gpio_pin_cnf_build_fields(pin, 0, 0, 0, 0, &sense);
}

/* ---- nrf_gpio_pin_outset.c ---- */
/* readable reconstruction; identity: FUN_000852e6 @ 0x000852e6
 * public-name: nrf_gpio_pin_outset
 * durable-map: recon/catalogs/function_names_app.json
 * callees (readable <= raw @ address):
 *   nrf_gpio_pin_port_base_get               <= FUN_00066d1c @ 0x00066d1c
 *   nrf_gpio_pin_outset                      <= FUN_000852e6 @ 0x000852e6
 */
/* Reconstructed FUN_000852e6 @ 0x852e6  (parity: 300/300 trials, PROVEN) */

extern int nrf_gpio_pin_port_base_get(unsigned int *p);
static void nrf_gpio_pin_outset(unsigned int param_1, int param_2, int param_3) {
    unsigned int local_c = param_1;
    int iVar1 = nrf_gpio_pin_port_base_get(&local_c);
    *(int*)(iVar1 + 8) = (int)(1u << (local_c & 0xff));
}

/* ---- nrf_gpio_pin_set.c ---- */
/* readable reconstruction; identity: FUN_000852fe @ 0x000852fe
 * public-name: nrf_gpio_pin_set
 * durable-map: recon/catalogs/function_names_app.json
 * callees (readable <= raw @ address):
 *   nrf_gpio_pin_port_base_get               <= FUN_00066d1c @ 0x00066d1c
 *   nrf_gpio_pin_set                         <= FUN_000852fe @ 0x000852fe
 */
/* Reconstructed FUN_000852fe @ 0x852fe  (parity: 300/300 trials, PROVEN) */

static void nrf_gpio_pin_set(unsigned int param_1, int param_2, int param_3) {
    unsigned int local_c = param_1;
    int iVar1 = nrf_gpio_pin_port_base_get(&local_c);
    *(int*)(iVar1 + 0xc) = (int)(1u << (local_c & 0xff));
}

