/*
 * Call-cohesive translation unit for the `lib' module.
 *
 * GENERATED by recon/refactor/transforms/t09_call_cohesion.py.  Do
 * not edit: a stage tree is regenerated, never hand-patched
 * (recon/refactor/README.md C4).
 *
 * The 7 translation units below were grouped because they CALL ONE
 * ANOTHER, not because they were adjacent in the generated source
 * list.  Each member's text is reproduced VERBATIM.  Every member was
 * checked pairwise against every other member already in this unit by
 * stage 04's seven refusal rules, unchanged: no symbol is declared
 * here with two types, no identifier has internal linkage in one
 * member and is named by another, and no local typedef, macro, struct
 * tag or enum constant of one member is visible to a member that
 * names it.
 *
 * members, in generated-source-list order:
 *   g1_lib_07.c
 *   g1_lib_09.c
 *   g1_lib_20.c
 *   g1_lib_53.c
 *   g1_lib_56.c
 *   g1_lib_62.c
 *   g1_lib_67.c
 *
 * call edges inside this unit (caller -> callee): 6
 *   g1_lib_09.c -> g1_lib_07.c
 *   g1_lib_20.c -> g1_lib_09.c
 *   g1_lib_53.c -> g1_lib_07.c
 *   g1_lib_56.c -> g1_lib_07.c
 *   g1_lib_62.c -> g1_lib_07.c
 *   g1_lib_67.c -> g1_lib_07.c
 */

/* File-scope forward declarations for every struct/union tag this
 * unit names.  Without them a tag whose only appearance in a member
 * is inside a parameter list has PARAMETER-LIST scope, so two
 * textually IDENTICAL declarations in two members declare two
 * different incomplete types and the second is a conflicting
 * redeclaration (C11 6.2.1p7).  Incomplete-type forward
 * declarations emit no code. */
struct device;
struct format_state;
struct k_work;
struct k_work_q;
struct log_record3;
struct log_record4;
struct net_buf_view;
struct overflow_log;
struct slist;
struct slist_node;
struct unaligned_u32;
/* ================================================================ */
/* member unit: g1_lib_07.c */
/* ================================================================ */
/*
 * Cohesive translation unit for the `lib' module.
 *
 * GENERATED by recon/refactor/transforms/t04_cohesive_tu.py.  Do not
 * edit: a stage tree is regenerated, never hand-patched
 * (recon/refactor/README.md C4).
 *
 * The 7 functions below were 7 separate translation units until this
 * stage.  Each one's text is reproduced VERBATIM and in the order the
 * generated source list gave it, and they were CONSECUTIVE in that list.
 * They were proven able to share a translation unit: no symbol is
 * declared here with two types, no identifier has internal linkage in one
 * member and is named by another, and no local typedef, macro, struct tag
 * or enum constant of one member is visible to a member that names it.
 *
 * members, in link order:
 *   z_log_msg_runtime_create.c
 *   g1_recon_log_backend_uart_panic.c
 *   settings_nvs_load.c
 *   settings_nvs_backend_mount.c
 *   settings_invalid_index_log.c
 *   gatt_dm_attr_alloc.c
 *   gatt_dm_notify_discovery_complete.c
 */

/* File-scope forward declarations for every struct/union tag this
 * unit names.  Without them a tag whose only appearance in a member
 * is inside a parameter list has PARAMETER-LIST scope, so two
 * textually IDENTICAL declarations in two members declare two
 * different incomplete types and the second is a conflicting
 * redeclaration (C11 6.2.1p7).  Incomplete-type forward
 * declarations emit no code. */
struct format_state;
struct overflow_log;
/* ---- z_log_msg_runtime_create.c ---- */
#include "g1_app_symbols.h"
/* readable reconstruction; identity: FUN_0004d944 @ 0x0004d944
 * public-name: z_log_msg_runtime_create
 * durable-map: recon/catalogs/function_names_app.json
 * callees (readable <= raw @ address):
 *   cbprintf_package_convert                 <= FUN_0004abc0 @ 0x0004abc0
 *   g1_recon_z_log_msg_alloc                 <= FUN_0004d55c @ 0x0004d55c
 *   z_log_msg_runtime_create                 <= FUN_0004d944 @ 0x0004d944
 *   assert_post_action                       <= FUN_0007e2ec @ 0x0007e2ec
 *   printk                                   <= FUN_0007e2fa @ 0x0007e2fa
 *   log_msg_finalize_commit                  <= FUN_0007ee74 @ 0x0007ee74
 * address symbols (name @ address):
 *   ADDR_z_cbprintf_cpy_THUMB                @ 0x0007ee49
 *   rodata_881e0                             @ 0x000881e0
 *   rodata_99cbd                             @ 0x00099cbd   [INLINED -- G6 literal batch]
 *   rodata_f0dff                             @ 0x000f0dff   [INLINED -- G6 literal batch]
 *   rodata_f0e3e                             @ 0x000f0e3e   [INLINED -- G6 literal batch]
 *   rodata_f0e6a                             @ 0x000f0e6a   [INLINED -- G6 literal batch]
 */
/* Full reconstruction of FUN_0004d944 @ 0x4d944 (268 bytes). */
#include <stdint.h>
#include "../../../headers/g1_log.h"
#include "../../../headers/g1_dedupe.h"

extern uintptr_t g1_recon_z_log_msg_alloc(uint32_t words);
extern int32_t cbprintf_package_convert(uintptr_t source, uint32_t count, uintptr_t callback,
                           void *state, uint32_t type, void *buffer, uint32_t width);
extern void log_msg_finalize_commit(uintptr_t, uintptr_t, uint32_t, uintptr_t);
extern void assert_post_action(const char *, unsigned int);

struct format_state {
    uintptr_t destination;
    uint32_t used;
    uint32_t zero;
};

void z_log_msg_runtime_create(unsigned int owner, unsigned int descriptor, unsigned int source, unsigned int arg4) {
    uint32_t encoded = (descriptor >> 9) & 0x7ffu;
    uint32_t requested = encoded;
    uint32_t upper = descriptor >> 20;
    uintptr_t allocation;

    if (!encoded) {
        allocation = g1_recon_z_log_msg_alloc(((upper + 0x17u) & ~7u) >> 2);
    } else {
        struct format_state state = {0, 0, 0};
        uint8_t scratch[8];
        int32_t length = cbprintf_package_convert(source, encoded, 0, &state, 10, scratch, 4);
        if ((uint32_t)length >= 0x800u) {
            struct overflow_log {
                uint32_t type;
                uint32_t string;
                uint32_t value;
                uint32_t limit;
                uint16_t code;
            };
            struct overflow_log *log = __builtin_alloca(sizeof(*log));
            log->type = 0x01000004u;
            log->string = ((unsigned long)"Message (\"%s\") dropped because it exceeds size limitation (%u)") /*=0xf0dff*/;
            log->value = *(volatile uint32_t *)(source + 4);
            log->limit = 0x7ffu;
            log->code = 0x200u;
            z_log_msg_runtime_create(((unsigned long)&rodata_881e0) /*=0x881e0*/, 0x2480u, (uintptr_t)log, 0);
            return;
        }
        encoded = (uint32_t)length & 0x7ffu;
        allocation = g1_recon_z_log_msg_alloc(((upper + 0x17u + (uint32_t)length) & ~7u) >> 2);
        descriptor &= 0xfff001ffu;
        if (allocation) {
            state.destination = allocation + 0x10u;
            state.used = (uint32_t)length;
            state.zero = 0;
            int32_t rc = cbprintf_package_convert(source, requested, ADDR_z_cbprintf_cpy_THUMB /*=0x7ee49*/, &state,
                                      10, scratch, 4);
            if (rc < 0) {
                G1_ASSERT_FAIL((((unsigned long)"ASSERTION FAIL [%s] @ %s:%d\n") /*=0x99cbd*/, ((unsigned long)"len >= 0") /*=0xf0e6a*/, ((unsigned long)"WEST_TOPDIR/zephyr/subsys/logging/log_msg.c") /*=0xf0e3e*/, 0x59u), (((unsigned long)"WEST_TOPDIR/zephyr/subsys/logging/log_msg.c") /*=0xf0e3e*/, 0x59u));
            }
        }
    }
    descriptor = (descriptor & 0xfff001ffu) | (encoded << 9);
    log_msg_finalize_commit(allocation, owner, descriptor, arg4);
}

/* ---- g1_recon_log_backend_uart_panic.c ---- */
/* readable reconstruction; identity: FUN_0004def8 @ 0x0004def8
 * public-name: g1_recon_log_backend_uart_panic
 * durable-map: recon/catalogs/function_names_app.json
 * callees (readable <= raw @ address):
 *   onoff_transition_invoke                  <= FUN_0004dfb8 @ 0x0004dfb8
 *   log_output_flush                         <= FUN_0007eece @ 0x0007eece
 *   audio_hw_lock_get_status_byte            <= FUN_0007ef1c @ 0x0007ef1c
 * address symbols (name @ address):
 *   rodata_87bc0                             @ 0x00087bc0
 *   rodata_8ad08                             @ 0x0008ad08
 *   log_output_flush_done                    @ 0x2001d44e
 */
/* Reconstructed g1_recon_log_backend_uart_panic @ 0x4def8.
 * Raw/address back-map: g1_recon_log_backend_uart_panic <= FUN_0004def8 @ 0x0004def8.
 */

extern int audio_hw_lock_get_status_byte(unsigned int, void*, unsigned int, unsigned int, unsigned int);
extern void onoff_transition_invoke(unsigned int);
extern void log_output_flush(unsigned int);

static void g1_recon_log_backend_uart_panic(unsigned int param_1, unsigned int param_2,
                                     unsigned int param_3, unsigned int param_4)
{
    int iVar2;
    unsigned int uStack_c = param_2;
    unsigned int uStack_8 = param_3;
    iVar2 = audio_hw_lock_get_status_byte(((unsigned long)&rodata_87bc0) /*=0x87bc0*/, (char*)&uStack_c + 3, param_3, param_4, param_1);
    if (iVar2 == 0 && *((unsigned char*)&uStack_c + 3) == 1) {
        onoff_transition_invoke(((unsigned long)&rodata_87bc0) /*=0x87bc0*/);
    }
    unsigned int uVar1 = ((unsigned long)&rodata_8ad08) /*=0x8ad08*/;
    *(volatile unsigned char *)((unsigned long)&log_output_flush_done) /*=0x2001d44e*/ = 1;
    log_output_flush(uVar1);
    return;
}

/* ---- settings_nvs_load.c ---- */
/* readable reconstruction; identity: FUN_0004e780 @ 0x0004e780
 * public-name: settings_nvs_load
 * durable-map: recon/catalogs/function_names_app.json
 * callees (readable <= raw @ address):
 *   nvs_write                                <= FUN_0004c8f8 @ 0x0004c8f8
 *   settings_call_set_handler                <= FUN_0004e604 @ 0x0004e604
 *   settings_nvs_load                        <= FUN_0004e780 @ 0x0004e780
 *   settings_nvs_delete_id                   <= FUN_0007e9d4 @ 0x0007e9d4
 *   settings_nvs_read_latest                 <= FUN_0007e9dc @ 0x0007e9dc
 * address symbols (name @ address):
 *   ADDR_settings_nvs_read_fn_THUMB          @ 0x0007f211
 */
/* Reconstructed FUN_0004e780 @ 0x4e780  (parity: 100/100 trials, PROVEN) */
extern int settings_nvs_read_latest(int,int,void*,int);
extern void settings_nvs_delete_id(unsigned int, unsigned int);
extern void nvs_write(int,int,void*,int);
extern int settings_call_set_handler(void*,int,unsigned,void*,unsigned);

int settings_nvs_load(int param_1, unsigned param_2){
    int iVar7 = param_1 + 8;
    struct {
        unsigned char reserved[11];
        unsigned char marker;
        int owner;
        short key;
        unsigned char alignment[2];
        unsigned char data[76];
    } frame;
    unsigned short r4v = (unsigned short)(*(unsigned short*)(param_1+0x38) + 1);
    int iVar2, iVar3;
    unsigned short sVar4, sVar6, sVar5;
  LOOP:
    sVar4 = r4v;
    sVar6 = (unsigned short)(sVar4 - 1);
    if (sVar6 == 0x8000) return 0;
    iVar2 = settings_nvs_read_latest(iVar7, sVar6, frame.data, 0x4a);
    sVar5 = (unsigned short)(sVar4 + 0x3fff);
    iVar3 = settings_nvs_read_latest(iVar7, sVar5, &frame.marker, 1);
    if (iVar2 > 0){
        if (iVar3 > 0) goto L806;
        goto L7d8;
    }
    if (iVar3 > 0) goto L7d8;
    r4v = sVar6;
    goto LOOP;
  L7d8:
    if (*(unsigned short*)(param_1+0x38) == sVar6){
        *(unsigned short*)(param_1+0x38) = (unsigned short)(sVar4 - 2);
        nvs_write(iVar7, 0x8000, (void*)(param_1+0x38), 2);
    }
    settings_nvs_delete_id(iVar7, sVar6);
    settings_nvs_delete_id(iVar7, sVar5);
    r4v = sVar6;
    goto LOOP;
  L806:
    frame.data[iVar2] = 0;
    frame.owner = iVar7;
    frame.key = (short)sVar5;
    iVar2 = settings_call_set_handler(frame.data, iVar3, ADDR_settings_nvs_read_fn_THUMB /*=0x7f211*/,
                         &frame.owner, param_2);
    if (iVar2 != 0) return iVar2;
    r4v = sVar6;
    goto LOOP;
}

/* ---- settings_nvs_backend_mount.c ---- */
/* readable reconstruction; identity: FUN_0004e83c @ 0x0004e83c
 * public-name: settings_nvs_backend_mount
 * durable-map: recon/catalogs/function_names_app.json
 * callees (readable <= raw @ address):
 *   flash_area_open                          <= FUN_0004e048 @ 0x0004e048
 *   flash_area_get_sectors                   <= FUN_0004e098 @ 0x0004e098
 *   settings_src_register                    <= FUN_0004e3c0 @ 0x0004e3c0
 *   settings_dst_register                    <= FUN_0004e3dc @ 0x0004e3dc
 *   settings_nvs_backend_mount               <= FUN_0004e83c @ 0x0004e83c
 *   settings_nvs_backend_init                <= FUN_0007f344 @ 0x0007f344
 * address symbols (name @ address):
 *   rodata_10000                             @ 0x00010000
 *   g_settings_nvs_backend_list_next         @ 0x200027fc
 *   g_settings_nvs_default_backend           @ 0x2000a114
 */
/* Reconstructed FUN_0004e83c @ 0x4e83c  (parity: 300/300 trials, PROVEN) */

extern int flash_area_open(unsigned int, void*);
extern int flash_area_get_sectors(int,void*,void*);
extern int settings_src_register(void*);
extern int settings_dst_register(void*);
extern int settings_nvs_backend_init(void*);
static int settings_nvs_backend_mount(int param_1,int param_2,int param_3,unsigned int param_4){
  unsigned int args[4];
  int iVar1, iVar3; unsigned int uVar4,uVar5; unsigned int uVar2;
  args[0]=(unsigned int)param_1; args[1]=1; args[2]=(unsigned int)param_3; args[3]=param_4;
  iVar3=flash_area_open(9,args);
  if(iVar3==0){
    iVar3=flash_area_get_sectors(9,args+1,args+2);
    iVar1=((unsigned long)&g_settings_nvs_default_backend) /*=0x2000a114*/;
    if(iVar3==0 || iVar3==-0xc){
      if(args[3]<((unsigned long)&rodata_10000) /*=0x10000*/){
        uVar5=0; uVar4=0;
        do{
          uVar4=uVar4+args[3];
          if(*(unsigned int*)(args[0]+8)<uVar4){ uVar5=uVar5&0xffff; break; }
          uVar5=uVar5+1;
        }while(uVar5!=8);
        *(volatile short *)(((unsigned long)&g_settings_nvs_default_backend) /*=0x2000a114*/+0x14)=(short)args[3];
        *(volatile short *)(iVar1+0x16)=(short)uVar5;
        *(int*)(iVar1+8)=*(int*)(args[0]+4);
        *(int*)(iVar1+0x3c)=*(int*)(args[0]+0xc);
        iVar3=settings_nvs_backend_init((void*)iVar1);
        uVar2=((unsigned long)&g_settings_nvs_backend_list_next) /*=0x200027fc*/;
        if(iVar3==0){
          *(int*)(iVar1+4)=((unsigned long)&g_settings_nvs_backend_list_next) /*=0x200027fc*/;
          settings_src_register((void*)iVar1);
          *(int*)(iVar1+4)=uVar2;
          settings_dst_register((void*)iVar1);
        }
      } else { iVar3=-0x21; }
    }
  }
  return iVar3;
}

/* ---- settings_invalid_index_log.c ---- */
/* readable reconstruction; identity: FUN_0004e8c0 @ 0x0004e8c0
 * public-name: settings_invalid_index_log
 * durable-map: recon/catalogs/function_names_app.json
 * callees (readable <= raw @ address):
 *   settings_invalid_index_log               <= FUN_0004e8c0 @ 0x0004e8c0
 *   gatt_dm_log_helper                       <= FUN_0007f406 @ 0x0007f406
 * address symbols (name @ address):
 *   rodata_88130                             @ 0x00088130
 *   rodata_f11a5                             @ 0x000f11a5   [INLINED -- G6 literal batch]
 */
/* Reconstructed FUN_0004e8c0 @ 0x4e8c0
 * CFG_VERIFY_CALL_ARITIES=3
 * Readable identity: settings_invalid_index_log.
 * Raw/address backmap: FUN_0004e8c0 @ 0x0004e8c0.
 */
#include "g1_lib.h"
int settings_invalid_index_log(void)
{
    const uint32_t package[2] = { 2U, ((unsigned long)"Unsupported UUID type.") /*=0xf11a5*/ };
    gatt_dm_log_helper(((unsigned long)&rodata_88130) /*=0x88130*/, 0x1040U, package);
    return 0;
}

/* ---- gatt_dm_attr_alloc.c ---- */
/* readable reconstruction; identity: FUN_0004e8e8 @ 0x0004e8e8
 * public-name: gatt_dm_attr_alloc
 * durable-map: recon/catalogs/function_names_app.json
 * callees (readable <= raw @ address):
 *   gatt_dm_attr_alloc                       <= FUN_0004e8e8 @ 0x0004e8e8
 *   assert_post_action                       <= FUN_0007e2ec @ 0x0007e2ec
 *   printk                                   <= FUN_0007e2fa @ 0x0007e2fa
 *   k_calloc                                 <= FUN_000868ca @ 0x000868ca
 * address symbols (name @ address):
 *   rodata_99cbd                             @ 0x00099cbd   [INLINED -- G6 literal batch]
 *   rodata_f11bc                             @ 0x000f11bc
 *   rodata_f11e7                             @ 0x000f11e7   [INLINED -- G6 literal batch]
 *   cur_service_val                          @ 0x2000a154
 */
/* Reconstructed FUN_0004e8e8 @ 0x4e8e8  (parity: 300/300 trials, PROVEN) */
typedef unsigned int uint;
extern int k_calloc(int,int);
int gatt_dm_attr_alloc(int param_1,uint32_t param_2,uint32_t param_3,uint32_t param_4){
  int iVar1=((unsigned long)&cur_service_val) /*=0x2000a154*/;
  uint uVar5=((uint)param_1+3)&0xfffffffcu;
  if(uVar5>0x74){ G1_ASSERT_FAIL((((unsigned long)"ASSERTION FAIL [%s] @ %s:%d\n") /*=0x99cbd*/,((unsigned long)"len <= (128 - sizeof(struct k_mem_block_id) - sizeof(struct data_chunk_item *))") /*=0xf11e7*/,((unsigned long)&rodata_f11bc) /*=0xf11bc*/,0x5b), (((unsigned long)&rodata_f11bc) /*=0xf11bc*/,0x5b)); }
  uint uVar3=*(volatile uint *)(((unsigned long)&cur_service_val) /*=0x2000a154*/+0x150);
  uint32_t* puVar2;
  if(uVar3==0 || (uVar3=*(volatile uint *)(((unsigned long)&cur_service_val) /*=0x2000a154*/+0x158)+uVar5, uVar3>0x74)){
    puVar2=(uint32_t*)(uintptr_t)k_calloc(1,0x78);
    if(puVar2==0) return 0;
    *(volatile uint32_t *)puVar2=0;
    if(*(volatile uint32_t *)(iVar1+0x154)==0){
      *(volatile uint32_t *)(iVar1+0x150)=(uint32_t)(uintptr_t)puVar2;
      *(volatile uint32_t *)(iVar1+0x154)=(uint32_t)(uintptr_t)puVar2;
    } else {
      *(volatile uint32_t *)(uintptr_t)(*(volatile uint32_t *)(iVar1+0x154))=(uint32_t)(uintptr_t)puVar2;
      *(volatile uint32_t *)(iVar1+0x154)=(uint32_t)(uintptr_t)puVar2;
    }
    *(volatile uint32_t *)(iVar1+0x158)=0;
  } else {
    puVar2=(uint32_t*)(uintptr_t)*(volatile uint32_t *)(iVar1+0x154);
  }
  int iVar4=*(volatile int *)(iVar1+0x158);
  *(volatile uint32_t *)(iVar1+0x158)=uVar5+iVar4;
  return (int)(uintptr_t)puVar2+iVar4+4;
}

/* ---- gatt_dm_notify_discovery_complete.c ---- */
/* readable reconstruction; identity: FUN_0004e964 @ 0x0004e964
 * public-name: gatt_dm_notify_discovery_complete
 * durable-map: recon/catalogs/function_names_app.json
 * callees (readable <= raw @ address):
 *   gatt_dm_notify_discovery_complete        <= FUN_0004e964 @ 0x0004e964
 * address symbols (name @ address):
 *   cur_service_val                          @ 0x2000a154
 *   g_gatt_dm_context                        @ 0x2000a158
 *   g_gatt_dm_in_progress_flag               @ 0x2000a28c
 *   g_gatt_dm_svc_range_end                  @ 0x2000a2b0
 */
/* Reconstructed FUN_0004e964 @ 0x4e964, exact extent 34 bytes.
 * CFG_VERIFY_CALL_ARITIES=2 */

typedef void (*notify_fn_t)(uintptr_t object, uint32_t value);

void gatt_dm_notify_discovery_complete(void)
{
    volatile uint32_t *state = (volatile uint32_t *)((unsigned long)&g_gatt_dm_in_progress_flag) /*=0x2000a28c*/;
    __atomic_fetch_or(state, 2u, __ATOMIC_RELAXED);

    uintptr_t slot = *(volatile uintptr_t *)((unsigned long)&g_gatt_dm_svc_range_end) /*=0x2000a2b0*/;
    notify_fn_t notify = slot != 0 ? *(notify_fn_t volatile *)slot : 0;
    if (notify != 0)
        notify(((unsigned long)&cur_service_val) /*=0x2000a154*/, *(volatile uint32_t *)((unsigned long)&g_gatt_dm_context) /*=0x2000a158*/);
}

/* ================================================================ */
/* member unit: g1_lib_09.c */
/* ================================================================ */
/*
 * Cohesive translation unit for the `lib' module.
 *
 * GENERATED by recon/refactor/transforms/t04_cohesive_tu.py.  Do not
 * edit: a stage tree is regenerated, never hand-patched
 * (recon/refactor/README.md C4).
 *
 * The 13 functions below were 13 separate translation units until this
 * stage.  Each one's text is reproduced VERBATIM and in the order the
 * generated source list gave it, and they were CONSECUTIVE in that list.
 * They were proven able to share a translation unit: no symbol is
 * declared here with two types, no identifier has internal linkage in one
 * member and is named by another, and no local typedef, macro, struct tag
 * or enum constant of one member is visible to a member that names it.
 *
 * members, in link order:
 *   sys_rand32_get.c
 *   bt_settings_set_name_identity.c
 *   bt_settings_subsys_init_check.c
 *   gatt_sc_settings_delete.c
 *   gatt_ccc_bt_settings_store.c
 *   gatt_settings_delete_key.c
 *   bt_keys_settings_store.c
 *   bt_settings_save_or_delete_key.c
 *   k_work_schedule_at_ticks.c
 *   ver_str.c
 *   bt_hci_rx_work_submit.c
 *   bt_hci_core_recv_event.c
 *   bt_security_err_lookup.c
 */

/* File-scope forward declarations for every struct/union tag this
 * unit names.  Without them a tag whose only appearance in a member
 * is inside a parameter list has PARAMETER-LIST scope, so two
 * textually IDENTICAL declarations in two members declare two
 * different incomplete types and the second is a conflicting
 * redeclaration (C11 6.2.1p7).  Incomplete-type forward
 * declarations emit no code. */
struct device;
struct k_work;
struct k_work_q;
struct log_record3;
struct log_record4;
struct unaligned_u32;
/* ---- sys_rand32_get.c ---- */
#include "g1_app_symbols.h"
#include "../../../headers/g1_log.h"
#include "../../../headers/g1_dedupe.h"
/* readable reconstruction; identity: FUN_00052c40 @ 0x00052c40
 * public-name: sys_rand32_get
 * durable-map: recon/catalogs/function_names_app.json
 * callees (readable <= raw @ address):
 *   entropy_get_entropy_isr_call             <= FUN_00052bf8 @ 0x00052bf8
 *   sys_rand32_get                           <= FUN_00052c40 @ 0x00052c40
 *   assert_post_action                       <= FUN_0007e2ec @ 0x0007e2ec
 *   printk                                   <= FUN_0007e2fa @ 0x0007e2fa
 *   sys_clock_cycle_get_32                   <= FUN_00084c76 @ 0x00084c76
 *   z_device_is_ready                        <= FUN_0008638c @ 0x0008638c
 * address symbols (name @ address):
 *   entropy_dev                              @ 0x00087b90
 *   rodata_99cbd                             @ 0x00099cbd   [INLINED -- G6 literal batch]
 *   rodata_f2abf                             @ 0x000f2abf
 *   rodata_f2af8                             @ 0x000f2af8   [INLINED -- G6 literal batch]
 *   rodata_f2b15                             @ 0x000f2b15   [INLINED -- G6 literal batch]
 */
/* Reconstructed FUN_00052c40 @ 0x52c40  (parity: 300/300 trials, PROVEN) */

extern int entropy_get_entropy_isr_call(int*, int);
extern void assert_post_action(const char *, unsigned int);
extern uint32_t sys_clock_cycle_get_32(void);
extern _Bool z_device_is_ready(const struct device *);

int sys_rand32_get(int param_1, int param_2)
{
    int local_c = param_2;
    int iVar2;
    iVar2 = z_device_is_ready(((unsigned long)&entropy_dev) /*=0x87b90*/);
    if (iVar2 == 0) {
        printk(((unsigned long)"ASSERTION FAIL [%s] @ %s:%d\n") /*=0x99cbd*/, ((unsigned long)"device_is_ready(entropy_dev)") /*=0xf2af8*/, ((unsigned long)&rodata_f2abf) /*=0xf2abf*/, 0x15, param_1);
        G1_ASSERT_FAIL((((unsigned long)"\tEntropy device %s not ready\n") /*=0xf2b15*/, *(volatile int *)((unsigned long)&entropy_dev) /*=0x87b90*/), (((unsigned long)&rodata_f2abf) /*=0xf2abf*/, 0x15));
    }
    iVar2 = entropy_get_entropy_isr_call(&local_c, 4);
    if (iVar2 < 0) {
        local_c = sys_clock_cycle_get_32();
    }
    return local_c;
}

/* ---- bt_settings_set_name_identity.c ---- */
/* readable reconstruction; identity: FUN_00052d58 @ 0x00052d58
 * public-name: bt_settings_set_name_identity
 * durable-map: recon/catalogs/function_names_app.json
 * callees (readable <= raw @ address):
 *   z_log_msg_runtime_create                 <= FUN_0004d944 @ 0x0004d944
 *   bt_settings_set_name_identity            <= FUN_00052d58 @ 0x00052d58
 *   settings_name_next                       <= FUN_0007f1e8 @ 0x0007f1e8
 *   strncmp                                  <= FUN_00087036 @ 0x00087036
 * address symbols (name @ address):
 *   rodata_88178                             @ 0x00088178
 *   rodata_9a1dd                             @ 0x0009a1dd
 *   rodata_f2b65                             @ 0x000f2b65
 *   rodata_f2b86                             @ 0x000f2b86
 *   rodata_f2baa                             @ 0x000f2baa
 *   rodata_f2bcf                             @ 0x000f2bcf
 *   rodata_f33e4                             @ 0x000f33e4
 *   g_ble_dev_ncmd_sem                       @ 0x200020d4
 */
/* Reconstructed FUN_00052d58 @ 0x52d58  (parity: 300/300 trials, PROVEN) */
#include <stdint.h>
#include "g1_lib.h"
extern unsigned int bt_settings_delete(unsigned int a0, unsigned char *a1, int a2);
extern int settings_name_next(int, int);
extern int strncmp(int,...);
typedef int (*codeptr)(int, uintptr_t, unsigned int);
struct unaligned_u32 { unsigned int value; } __attribute__((packed));
_Static_assert(sizeof(struct unaligned_u32) == 4, "packed word layout");
static unsigned int bt_settings_set_name_identity(int param_1, int param_2, codeptr param_3, int param_4)
{
  const uintptr_t g_addr = UINT32_C(0x200020d4);
  volatile int *const g = (volatile int *)g_addr;
  int iVar3, uVar2; unsigned int uVar4;
  unsigned char scratch[20];
  if ((int)((unsigned)*g << 0x1f) < 0) {
    if (param_1 == 0) {
      struct { unsigned kind, descriptor; } short_log = {2, ((unsigned long)&rodata_f2b65) /*=0xf2b65*/};
      z_log_msg_runtime_create(((unsigned long)&rodata_88178) /*=0x88178*/,0x1040,&short_log,0);
      return 0xfffffffe;
    }
    uVar2 = settings_name_next(param_1, scratch);
    iVar3 = strncmp(param_1, ((unsigned long)&rodata_9a1dd) /*=0x9a1dd*/, uVar2);
    if (iVar3 == 0) {
      int t = *g;
      unsigned uVar5 = (unsigned)t << 0x1c;
      unsigned uVar6 = uVar5 >> 0x1f;
      if ((int)uVar5 < 0) {
        struct { unsigned kind, descriptor; } short_log = {2, ((unsigned long)&rodata_f2b86) /*=0xf2b86*/};
        z_log_msg_runtime_create(((unsigned long)&rodata_88178) /*=0x88178*/,0x1080,&short_log,0);
      } else {
        uVar4 = param_3(param_4, g_addr - UINT32_C(0xd4), 7);
        if (uVar4 < 7) {
          struct { unsigned kind, descriptor; } short_log = {2, ((unsigned long)&rodata_f2baa) /*=0xf2baa*/};
          z_log_msg_runtime_create(((unsigned long)&rodata_88178) /*=0x88178*/,0x1040,&short_log,uVar6);
          *(volatile int *)(g_addr - UINT32_C(0xd4)) = (int)uVar6;
          *(volatile unsigned char *)(g_addr - UINT32_C(0xcd)) =
              (unsigned char)(uVar5 >> 0x1f);
          ((volatile struct unaligned_u32 *)(g_addr - UINT32_C(0xd1)))->value = uVar6;
        } else {
          *(volatile unsigned char *)(g_addr - UINT32_C(0xcd)) =
              (unsigned char)(uVar4 / 7);
        }
      }
    } else {
      iVar3 = strncmp(param_1, ((unsigned long)&rodata_f33e4) /*=0xf33e4*/, uVar2, iVar3);
      if (iVar3 != 0) return 0xfffffffe;
      int iStack_48 = param_3(param_4, g_addr + UINT32_C(0x98), 0x1c);
      if (iStack_48 < 0) {
        struct { unsigned kind, descriptor, value; } full_log = {
          3, ((unsigned long)&rodata_f2bcf) /*=0xf2bcf*/, (unsigned)iStack_48
        };
        z_log_msg_runtime_create(((unsigned long)&rodata_88178) /*=0x88178*/,0x1840,&full_log,0);
      } else {
        *(volatile unsigned char *)(g_addr + UINT32_C(0x98) +
                                    (uintptr_t)iStack_48) = 0;
      }
    }
  }
  return 0;
}

/* ---- bt_settings_subsys_init_check.c ---- */
/* readable reconstruction; identity: FUN_00052edc @ 0x00052edc
 * public-name: bt_settings_subsys_init_check
 * durable-map: recon/catalogs/function_names_app.json
 * callees (readable <= raw @ address):
 *   z_log_msg_runtime_create                 <= FUN_0004d944 @ 0x0004d944
 *   settings_subsys_init                     <= FUN_0004e744 @ 0x0004e744
 *   bt_settings_subsys_init_check            <= FUN_00052edc @ 0x00052edc
 * address symbols (name @ address):
 *   rodata_88178                             @ 0x00088178
 *   rodata_f2c46                             @ 0x000f2c46   [INLINED -- G6 literal batch]
 */
/* Reconstructed FUN_00052edc @ 0x52edc  (parity: 300/300 trials, PROVEN) */

extern int settings_subsys_init(void);

static int bt_settings_subsys_init_check(void)
{
    int iVar1 = settings_subsys_init();
    if (iVar1 != 0) {
        struct { unsigned int f0; unsigned int f1; unsigned int f2; } s;
        s.f0 = 3;
        s.f1 = ((unsigned long)"settings_subsys_init failed (err %d)") /*=0xf2c46*/;
        s.f2 = iVar1;
        z_log_msg_runtime_create(((unsigned long)&rodata_88178) /*=0x88178*/, 0x1840, &s, 0);
    }
    return iVar1;
}

/* ---- gatt_sc_settings_delete.c ---- */
/* readable reconstruction; identity: FUN_00053024 @ 0x00053024
 * public-name: gatt_sc_settings_delete
 * durable-map: recon/catalogs/function_names_app.json
 * callees (readable <= raw @ address):
 *   bt_settings_delete                       <= FUN_00052fbc @ 0x00052fbc
 *   gatt_sc_settings_delete                  <= FUN_00053024 @ 0x00053024
 * address symbols (name @ address):
 *   rodata_f4de3                             @ 0x000f4de3
 */
/* Reconstructed FUN_00053024 @ 0x53024  (parity: 300/300 trials, PROVEN) */

unsigned int gatt_sc_settings_delete(unsigned char *param_1, int param_2)
{
  return bt_settings_delete(((unsigned long)&rodata_f4de3) /*=0xf4de3*/, param_1, param_2);
}

/* ---- gatt_ccc_bt_settings_store.c ---- */
/* readable reconstruction; identity: FUN_00053050 @ 0x00053050
 * public-name: gatt_ccc_bt_settings_store
 * durable-map: recon/catalogs/function_names_app.json
 * callees (readable <= raw @ address):
 *   bt_settings_store                        <= FUN_00052f18 @ 0x00052f18
 *   gatt_ccc_bt_settings_store               <= FUN_00053050 @ 0x00053050
 * address symbols (name @ address):
 *   rodata_f4aa1                             @ 0x000f4aa1
 */
/* Reconstructed FUN_00053050 @ 0x53050  (parity: 300/300 trials, PROVEN) */


static void gatt_ccc_bt_settings_store(unsigned int param_1, unsigned int param_2, unsigned int param_3, unsigned int param_4)
{
    bt_settings_store(((unsigned long)&rodata_f4aa1) /*=0xf4aa1*/, param_1, param_2, param_3, param_4, param_2, param_3);
}

/* ---- gatt_settings_delete_key.c ---- */
/* readable reconstruction; identity: FUN_0005306c @ 0x0005306c
 * public-name: gatt_settings_delete_key
 * durable-map: recon/catalogs/function_names_app.json
 * callees (readable <= raw @ address):
 *   bt_settings_delete                       <= FUN_00052fbc @ 0x00052fbc
 *   gatt_settings_delete_key                 <= FUN_0005306c @ 0x0005306c
 * address symbols (name @ address):
 *   rodata_f4aa1                             @ 0x000f4aa1
 */
/* Reconstructed FUN_0005306c @ 0x5306c  (parity: 300/300 trials, PROVEN) */

unsigned int gatt_settings_delete_key(unsigned char *param_1, int param_2)
{
  return bt_settings_delete(((unsigned long)&rodata_f4aa1) /*=0xf4aa1*/, param_1, param_2);
}

/* ---- bt_keys_settings_store.c ---- */
/* readable reconstruction; identity: FUN_00053168 @ 0x00053168
 * public-name: bt_keys_settings_store
 * durable-map: recon/catalogs/function_names_app.json
 * callees (readable <= raw @ address):
 *   bt_settings_store                        <= FUN_00052f18 @ 0x00052f18
 *   bt_keys_settings_store                   <= FUN_00053168 @ 0x00053168
 * address symbols (name @ address):
 *   rodata_f5373                             @ 0x000f5373
 */
/* Reconstructed FUN_00053168 @ 0x53168  (parity: 300/300 trials, PROVEN) */


static void bt_keys_settings_store(unsigned int param_1, unsigned int param_2, unsigned int param_3, unsigned int param_4)
{
    bt_settings_store(((unsigned long)&rodata_f5373) /*=0xf5373*/, param_1, param_2, param_3, param_4, param_2, param_3);
}

/* ---- bt_settings_save_or_delete_key.c ---- */
/* readable reconstruction; identity: FUN_00053184 @ 0x00053184
 * public-name: bt_settings_save_or_delete_key
 * durable-map: recon/catalogs/function_names_app.json
 * callees (readable <= raw @ address):
 *   bt_settings_delete                       <= FUN_00052fbc @ 0x00052fbc
 *   bt_settings_save_or_delete_key           <= FUN_00053184 @ 0x00053184
 * address symbols (name @ address):
 *   rodata_f5373                             @ 0x000f5373
 */
/* Reconstructed FUN_00053184 @ 0x53184  (parity: 300/300 trials, PROVEN) */


static int bt_settings_save_or_delete_key(unsigned char *param_1, int param_2)
{
    return bt_settings_delete(((unsigned long)&rodata_f5373) /*=0xf5373*/, param_1, param_2);
}

/* ---- k_work_schedule_at_ticks.c ---- */
/* readable reconstruction; identity: FUN_000531cc @ 0x000531cc
 * public-name: k_work_schedule_at_ticks
 * durable-map: recon/catalogs/function_names_app.json
 * callees (readable <= raw @ address):
 *   k_work_schedule_at_ticks                 <= FUN_000531cc @ 0x000531cc
 *   k_work_schedule_for_queue                <= FUN_0007332c @ 0x0007332c
 * address symbols (name @ address):
 *   g_sys_work_q                             @ 0x20005d38
 */
/* Reconstructed FUN_000531cc @ 0x531cc  owned extent: 0x8 bytes */

extern int k_work_schedule_for_queue(uint32_t, int);
static int k_work_schedule_at_ticks(int param_1){
    return k_work_schedule_for_queue(((unsigned long)&g_sys_work_q) /*=0x20005d38*/, param_1);
}

/* ---- ver_str.c ---- */
/* readable reconstruction; identity: FUN_00053344 @ 0x00053344
 * public-name: ver_str
 * durable-map: recon/catalogs/function_names_app.json
 * address symbols (name @ address):
 *   rodata_88480                             @ 0x00088480
 *   rodata_ef596                             @ 0x000ef596
 */
/* Reconstructed ver_str @ 0x53344  (CFG-directed candidate) */
/* Owner: NCS 2.5.1 Bluetooth host hci_core.c; raw backmap FUN_00053344@0x00053344. */
const char *ver_str(uint32_t version)
{
    const uint32_t *version_strings = (const uint32_t *)((unsigned long)&rodata_88480) /*=0x88480*/;
    if (version < 14u) {
        return (const char *)(uintptr_t)version_strings[version];
    }
    return (const char *)((unsigned long)&rodata_ef596) /*=0xef596*/;
}

/* ---- bt_hci_rx_work_submit.c ---- */
/* readable reconstruction; identity: FUN_00053530 @ 0x00053530
 * public-name: bt_hci_rx_work_submit
 * durable-map: recon/catalogs/function_names_app.json
 * callees (readable <= raw @ address):
 *   bt_hci_rx_work_submit                    <= FUN_00053530 @ 0x00053530
 *   net_buf_slist_put                        <= FUN_0005f074 @ 0x0005f074
 *   bt_log_forward_3arg                      <= FUN_00080ea2 @ 0x00080ea2
 *   k_work_submit_to_queue                   <= FUN_000865fc @ 0x000865fc
 * address symbols (name @ address):
 *   rodata_88138                             @ 0x00088138
 *   rodata_f2ddb                             @ 0x000f2ddb   [INLINED -- G6 literal batch]
 *   g_bt_hci_recv_fifo                       @ 0x20002144
 *   g_bt_hci_rx_work                         @ 0x20002980
 *   bt_workqueue                             @ 0x20005f08
 */
/* Reconstructed FUN_00053530 @ 0x53530  (parity: 300/300 trials, PROVEN) */

extern void net_buf_slist_put(unsigned int a, unsigned int b);
extern void bt_log_forward_3arg(unsigned int a, unsigned int b, void *c);
extern int k_work_submit_to_queue(struct k_work_q *, struct k_work *);

void bt_hci_rx_work_submit(unsigned int param_1, unsigned int param_2, unsigned int param_3, unsigned int param_4)
{
    unsigned int local_20;
    unsigned int local_1c;
    int iStack_18;

    net_buf_slist_put(((unsigned long)&g_bt_hci_recv_fifo) /*=0x20002144*/, param_1);
    iStack_18 = k_work_submit_to_queue(((unsigned long)&bt_workqueue) /*=0x20005f08*/, ((unsigned long)&g_bt_hci_rx_work) /*=0x20002980*/);
    if (iStack_18 < 0) {
        local_1c = ((unsigned long)"Could not submit rx_work: %d") /*=0xf2ddb*/;
        local_20 = 3;
        bt_log_forward_3arg(((unsigned long)&rodata_88138) /*=0x88138*/, 0x1840, &local_20);
    }
}

/* ---- bt_hci_core_recv_event.c ---- */
/* readable reconstruction; identity: FUN_000536b8 @ 0x000536b8
 * public-name: bt_hci_core_recv_event
 * durable-map: recon/catalogs/function_names_app.json
 * callees (readable <= raw @ address):
 *   bt_hci_core_recv_event                   <= FUN_000536b8 @ 0x000536b8
 * address symbols (name @ address):
 *   rodata_88138                             @ 0x00088138
 *   rodata_8b190                             @ 0x0008b190
 *   rodata_99cbd                             @ 0x00099cbd   [INLINED -- G6 literal batch]
 *   rodata_f2ddb                             @ 0x000f2ddb   [INLINED -- G6 literal batch]
 *   rodata_f2e84                             @ 0x000f2e84   [INLINED -- refactor stage 01]
 *   rodata_f2eb8                             @ 0x000f2eb8   [INLINED -- G6 literal batch]
 *   rodata_f2ed1                             @ 0x000f2ed1   [INLINED -- G6 literal batch]
 *   rodata_f2ef5                             @ 0x000f2ef5   [INLINED -- G6 literal batch]
 *   rodata_f2f17                             @ 0x000f2f17   [INLINED -- G6 literal batch]
 *   rodata_f2f45                             @ 0x000f2f45   [INLINED -- G6 literal batch]
 *   g_bt_hci_recv_fifo                       @ 0x20002144
 *   g_bt_hci_rx_work                         @ 0x20002980
 *   bt_workqueue                             @ 0x20005f08
 *   g_bt_hci_acl_frag_conn_handle            @ 0x2000ff08
 */
/* Reconstructed bt_hci_core_recv_event @ 0x000536b8. */

extern void dispatch_hci_event(uint32_t event, void *buffer, uint32_t table, uint32_t count); /* FUN_00053658 */
extern void process_number_completed_packets(void *connection, void *buffer, uint32_t count); /* FUN_00056394 */
extern void ble_conn_unref(int); /* FUN_000566a4 */
extern void *ble_conn_lookup_masked(uint32_t handle, uint32_t mask); /* FUN_00056908 */
extern uint32_t net_buf_id(void *buffer); /* FUN_0005ee18 */
extern void net_buf_unref(int); /* FUN_0005f24c */
extern void *net_buf_simple_pull(void *buffer, uint32_t length); /* FUN_0005f594 */
/* FUN_0007e2fa */
/* FUN_00080ea2 */

struct log_record3 {
    uint32_t argument_count;
    uint32_t format;
    uint32_t argument0;
};

struct log_record4 {
    uint32_t argument_count;
    uint32_t format;
    uint32_t argument0;
    uint32_t argument1;
};

__attribute__((noreturn, always_inline)) static inline void fatal_packet_length(uint32_t line)
{
    printk(((unsigned long)"ASSERTION FAIL [%s] @ %s:%d\n") /*=0x99cbd*/, ((unsigned long)"buf->len >= sizeof(*hdr)") /*=0xf2eb8*/, ((unsigned long)"WEST_TOPDIR/zephyr/subsys/bluetooth/host/hci_core.c") /*=0xf2e84*/, line);
    __asm__ volatile("movs r0, #0\n\tmsr basepri, r0\n\tmovs r0, #3\n\tsvc #2" ::: "r0", "memory");
    __builtin_unreachable();
}

void bt_hci_core_recv_event(void)
{
    void *buffer = net_buf_slist_get((void *)((unsigned long)&g_bt_hci_recv_fifo) /*=0x20002144*/);
    if (buffer == 0) {
        return;
    }

    uint8_t type = *(uint8_t *)((uint8_t *)buffer + 0x18);
    if (type == 1) {
        if (*(uint16_t *)((uint8_t *)buffer + 0x10) < 2) {
            fatal_packet_length(0x0a5du);
        }
        uint8_t *event = net_buf_simple_pull((uint8_t *)buffer + 0x0c, 2);
        if ((bt_hci_evt_get_flags(*event) & 2) == 0) {
            printk(((unsigned long)"ASSERTION FAIL [%s] @ %s:%d\n") /*=0x99cbd*/, ((unsigned long)"bt_hci_evt_get_flags(hdr->evt) & (1UL << (1))") /*=0xf2f17*/, ((unsigned long)"WEST_TOPDIR/zephyr/subsys/bluetooth/host/hci_core.c") /*=0xf2e84*/, 0x0a61u);
            __asm__ volatile("movs r0, #0\n\tmsr basepri, r0\n\tmovs r0, #3\n\tsvc #2" ::: "r0", "memory");
            __builtin_unreachable();
        }
        dispatch_hci_event(*event, buffer, ((unsigned long)&rodata_8b190) /*=0x8b190*/, 6);
        net_buf_unref(buffer);
    } else if (type == 3) {
        if (*(uint16_t *)((uint8_t *)buffer + 0x10) < 4) {
            fatal_packet_length(0x0200u);
        }
        const uint16_t *completed = net_buf_simple_pull((uint8_t *)buffer + 0x0c, 4);
        uint16_t advertised_length = completed[1];
        uint16_t handle_and_count = completed[0];
        uint32_t id = net_buf_id(buffer);
        volatile uint16_t *handles = (volatile uint16_t *)((unsigned long)&g_bt_hci_acl_frag_conn_handle) /*=0x2000ff08*/;
        handles[id] = handle_and_count & 0x0fffu;

        uint16_t actual_length = *(uint16_t *)((uint8_t *)buffer + 0x10);
        if (advertised_length != actual_length) {
            struct log_record4 mismatch = {
                4, ((unsigned long)"ACL data length mismatch (%u != %u)") /*=0xf2ed1*/, actual_length, advertised_length,
            };
            log_message(((unsigned long)&rodata_88138) /*=0x88138*/, 0x2040u, &mismatch);
            net_buf_unref(buffer);
        } else {
            void *connection = ble_conn_lookup_masked(handles[net_buf_id(buffer)], 0x0fu);
            if (connection != 0) {
                process_number_completed_packets(connection, buffer, handle_and_count >> 12);
                ble_conn_unref(connection);
            } else {
                struct log_record3 missing = {
                    3, ((unsigned long)"Unable to find conn for handle %u") /*=0xf2ef5*/, handles[net_buf_id(buffer)],
                };
                log_message(((unsigned long)&rodata_88138) /*=0x88138*/, 0x1840u, &missing);
                net_buf_unref(buffer);
            }
        }
    } else {
        struct log_record3 unexpected = {3, ((unsigned long)"Unknown buf type %u") /*=0xf2f45*/, type};
        log_message(((unsigned long)&rodata_88138) /*=0x88138*/, 0x1840u, &unexpected);
        net_buf_unref(buffer);
    }

    if (*(volatile uint32_t *)((unsigned long)&g_bt_hci_recv_fifo) /*=0x20002144*/ != 0) {
        int status = k_work_submit_to_queue((void *)((unsigned long)&bt_workqueue) /*=0x20005f08*/,
                                            (void *)((unsigned long)&g_bt_hci_rx_work) /*=0x20002980*/);
        if (status < 0) {
            struct log_record3 failed = {3, ((unsigned long)"Could not submit rx_work: %d") /*=0xf2ddb*/, (uint32_t)status};
            log_message(((unsigned long)&rodata_88138) /*=0x88138*/, 0x1840u, &failed);
        }
    }
}

/* ---- bt_security_err_lookup.c ---- */
/* readable reconstruction; identity: FUN_00054250 @ 0x00054250
 * public-name: bt_security_err_lookup
 * durable-map: recon/catalogs/function_names_app.json
 * callees (readable <= raw @ address):
 *   bt_security_err_lookup                   <= FUN_00054250 @ 0x00054250
 */
/* Reconstructed FUN_00054250 @ 0x54250  (parity: 300/300 trials, PROVEN) */

uint8_t bt_security_err_lookup(unsigned int param_1)
{
  uint8_t uVar1;
  if (param_1 < 0x2a) {
    uVar1 = *(volatile uint8_t *)(0x000f33e9UL + param_1);
  } else {
    uVar1 = 9;
  }
  return uVar1;
}

/* ================================================================ */
/* member unit: g1_lib_20.c */
/* ================================================================ */
/*
 * Cohesive translation unit for the `lib' module.
 *
 * GENERATED by recon/refactor/transforms/t04_cohesive_tu.py.  Do not
 * edit: a stage tree is regenerated, never hand-patched
 * (recon/refactor/README.md C4).
 *
 * The 2 functions below were 2 separate translation units until this
 * stage.  Each one's text is reproduced VERBATIM and in the order the
 * generated source list gave it, and they were CONSECUTIVE in that list.
 * They were proven able to share a translation unit: no symbol is
 * declared here with two types, no identifier has internal linkage in one
 * member and is named by another, and no local typedef, macro, struct tag
 * or enum constant of one member is visible to a member that names it.
 *
 * members, in link order:
 *   gatt_sub_free.c
 *   bt_gatt_clear_sc.c
 */
/* ---- gatt_sub_free.c ---- */
#include "g1_app_symbols.h"
#include "../../../headers/g1_log.h"
#include "../../../headers/g1_dedupe.h"
/* readable reconstruction; identity: FUN_00059e78 @ 0x00059e78
 * public-name: gatt_sub_free
 * durable-map: recon/catalogs/function_names_app.json
 * callees (readable <= raw @ address):
 *   gatt_sub_free                            <= FUN_00059e78 @ 0x00059e78
 *   assert_post_action                       <= FUN_0007e2ec @ 0x0007e2ec
 *   printk                                   <= FUN_0007e2fa @ 0x0007e2fa
 *   bt_addr_le_copy_828da                    <= FUN_000828da @ 0x000828da
 * address symbols (name @ address):
 *   rodata_99cbd                             @ 0x00099cbd   [INLINED -- G6 literal batch]
 *   rodata_f2b3a                             @ 0x000f2b3a
 *   rodata_f46b8                             @ 0x000f46b8
 *   rodata_f4707                             @ 0x000f4707   [INLINED -- G6 literal batch]
 */
/* Reconstructed FUN_00059e78 @ 0x59e78  (parity: 300/300 trials, PROVEN) */

extern void assert_post_action(const char *, unsigned int);
extern void bt_addr_le_copy_828da(void *a, unsigned int b, unsigned int c, unsigned int d);

void gatt_sub_free(char *param_1, unsigned int param_2, unsigned int param_3, unsigned int param_4)
{
    if (*(volatile int *)(param_1 + 8) != 0) {
        G1_ASSERT_FAIL((((unsigned long)"ASSERTION FAIL [%s] @ %s:%d\n") /*=0x99cbd*/, ((unsigned long)"gatt_sub_is_empty(sub)") /*=0xf4707*/, ((unsigned long)&rodata_f46b8) /*=0xf46b8*/, 0xd5c), (((unsigned long)&rodata_f46b8) /*=0xf46b8*/, 0xd5c));
    }
    bt_addr_le_copy_828da(param_1 + 1, ((unsigned long)&rodata_f2b3a) /*=0xf2b3a*/, param_3, param_4);
}

/* ---- bt_gatt_clear_sc.c ---- */
/* readable reconstruction; identity: FUN_0005a044 @ 0x0005a044
 * public-name: bt_gatt_clear_sc
 * durable-map: recon/catalogs/function_names_app.json
 * callees (readable <= raw @ address):
 *   gatt_sc_settings_delete                  <= FUN_00053024 @ 0x00053024
 *   find_sc_cfg_59bcc                        <= FUN_00059bcc @ 0x00059bcc
 *   bt_gatt_clear_sc                         <= FUN_0005a044 @ 0x0005a044
 *   gatt_sc_ctx_clear                        <= FUN_00082928 @ 0x00082928
 *   log_msg_create_3arg                      <= FUN_00082a42 @ 0x00082a42
 * address symbols (name @ address):
 *   rodata_88128                             @ 0x00088128
 *   rodata_f47a4                             @ 0x000f47a4
 */
/* Reconstructed FUN_0005a044 @ 0x5a044  (parity: 300/300 trials, PROVEN) */

extern void* find_sc_cfg_59bcc(void);
extern unsigned int gatt_sc_settings_delete(unsigned char*, int);
extern void log_msg_create_3arg(unsigned int, unsigned int, void*);
extern void gatt_sc_ctx_clear(unsigned int*);

unsigned int bt_gatt_clear_sc(void){
  unsigned char *puVar1 = (unsigned char*)find_sc_cfg_59bcc();
  if (puVar1 != (unsigned char*)0) {
    int iVar2 = gatt_sc_settings_delete(*puVar1, puVar1+1);
    if (iVar2 != 0) {
      struct { unsigned int a; unsigned int b; int c; } local;
      local.a = 3;
      local.b = ((unsigned long)&rodata_f47a4) /*=0xf47a4*/;
      local.c = iVar2;
      log_msg_create_3arg(((unsigned long)&rodata_88128) /*=0x88128*/, 0x1840, &local);
    }
    gatt_sc_ctx_clear(puVar1);
  }
  return 0;
}

/* ================================================================ */
/* member unit: g1_lib_53.c */
/* ================================================================ */
/*
 * Cohesive translation unit for the `lib' module.
 *
 * GENERATED by recon/refactor/transforms/t04_cohesive_tu.py.  Do not
 * edit: a stage tree is regenerated, never hand-patched
 * (recon/refactor/README.md C4).
 *
 * The 5 functions below were 5 separate translation units until this
 * stage.  Each one's text is reproduced VERBATIM and in the order the
 * generated source list gave it, and they were CONSECUTIVE in that list.
 * They were proven able to share a translation unit: no symbol is
 * declared here with two types, no identifier has internal linkage in one
 * member and is named by another, and no local typedef, macro, struct tag
 * or enum constant of one member is visible to a member that names it.
 *
 * members, in link order:
 *   gatt_service_changed_c_discovery_completed.c
 *   arm_fault_forward_handler.c
 *   att_get_max_payload_len.c
 *   z_impl_net_if_ipv6_addr_rm_by_index.c
 *   bt_smp_ah.c
 */
/* ---- gatt_service_changed_c_discovery_completed.c ---- */
#include "g1_app_symbols.h"
#include "g1_lib.h"
#include <stdint.h>
#include <stddef.h>
/* readable reconstruction; identity: FUN_0007f8dc @ 0x0007f8dc
 * public-name: gatt_service_changed_c_discovery_completed
 * durable-map: recon/catalogs/function_names_app.json
 * callees (readable <= raw @ address):
 *   gatt_dm_char_by_uuid                     <= FUN_0004ed3c @ 0x0004ed3c
 *   bt_gatt_dm_attr_service_val              <= FUN_0007f460 @ 0x0007f460
 *   bt_gatt_dm_conn_get                      <= FUN_0007f4c8 @ 0x0007f4c8
 *   bt_gatt_dm_service_get                   <= FUN_0007f4d2 @ 0x0007f4d2
 *   bt_gatt_dm_desc_by_uuid                  <= FUN_0007f570 @ 0x0007f570
 *   gatt_service_changed_c_discovery_completed <= FUN_0007f8dc @ 0x0007f8dc
 *   bt_uuid_cmp                              <= FUN_00080d3e @ 0x00080d3e
 */
/* Reconstructed FUN_0007f8dc @ 0x7f8dc  (parity: 300/300 trials, PROVEN) */

extern unsigned int gatt_dm_char_by_uuid(unsigned int, const void *);
extern unsigned bt_gatt_dm_attr_service_val(void);
extern unsigned bt_gatt_dm_conn_get(unsigned a);
extern void bt_gatt_dm_service_get(void);
extern int bt_gatt_dm_desc_by_uuid(unsigned a, int b, void*c);
extern int bt_uuid_cmp(int, int);
unsigned gatt_service_changed_c_discovery_completed(unsigned param_1, unsigned *param_2, unsigned param_3, unsigned param_4){
    unsigned char local_24[4], local_20[4], local_1c[4];
    volatile unsigned *p2 = (volatile unsigned*)param_2;
    bt_gatt_dm_service_get();
    unsigned *puVar2 = (unsigned*)bt_gatt_dm_attr_service_val();
    unsigned pv = *(volatile unsigned int *)puVar2;
    local_1c[0] = 0;
    *(volatile unsigned short *)(local_1c + 2) = 0x1801;
    int iVar3 = bt_uuid_cmp(pv, local_1c);
    if (iVar3 != 0) return 0xffffff7au;
    p2[0] = 0; p2[1] = 0; p2[10] = 0;
    local_24[0] = 0;
    *(volatile unsigned short *)(local_24 + 2) = 0x2a05;
    int h = gatt_dm_char_by_uuid(param_1, local_24);
    if (h == 0) return 0xffffffeau;
    local_20[0] = 0;
    *(volatile unsigned short *)(local_20 + 2) = 0x2a05;
    int iVar4 = bt_gatt_dm_desc_by_uuid(param_1, h, local_20);
    if (iVar4 == 0) return 0xffffffeau;
    *(volatile unsigned short *)((char*)param_2 + 4) = *(volatile unsigned short *)(iVar4 + 4);
    local_1c[0] = 0;
    *(volatile unsigned short *)(local_1c + 2) = 0x2902;
    int iVar3b = bt_gatt_dm_desc_by_uuid(param_1, h, local_1c);
    if (iVar3b == 0) return 0xffffffeau;
    *(volatile unsigned short *)((char*)param_2 + 6) = *(volatile unsigned short *)(iVar3b + 4);
    unsigned uVar5 = bt_gatt_dm_conn_get(param_1);
    p2[0] = uVar5;
    return 0;
}

/* ---- arm_fault_forward_handler.c ---- */
/* readable reconstruction; identity: FUN_00080780 @ 0x00080780
 * public-name: arm_fault_forward_handler
 * durable-map: recon/catalogs/function_names_app.json
 * callees (readable <= raw @ address):
 *   z_log_msg_runtime_create                 <= FUN_0004d944 @ 0x0004d944
 *   arm_fault_forward_handler                <= FUN_00080780 @ 0x00080780
 */
/* Reconstructed FUN_00080780 @ 0x80780  (parity: 300/300 trials, PROVEN) */

static void arm_fault_forward_handler(unsigned r0, unsigned r1, unsigned r2)
{
    z_log_msg_runtime_create(r0, r1, r2, 0);
}

/* ---- att_get_max_payload_len.c ---- */
/* readable reconstruction; identity: FUN_00080c7c @ 0x00080c7c
 * public-name: att_get_max_payload_len
 * durable-map: recon/catalogs/function_names_app.json
 * callees (readable <= raw @ address):
 *   att_get_max_payload_len                  <= FUN_00080c7c @ 0x00080c7c
 */
/* Reconstructed FUN_00080c7c @ 0x80c7c  (parity: 300/300 trials, PROVEN) */

extern unsigned int thunk_FUN_000823fa(void);
unsigned int att_get_max_payload_len(unsigned char *param_1) {
  unsigned int v = *(unsigned int*)(param_1 + 0x18);
  if (v != 0) {
    unsigned int r = thunk_FUN_000823fa();
    v = (r - 3) & 0xffff;
  }
  return v;
}

/* ---- z_impl_net_if_ipv6_addr_rm_by_index.c ---- */
/* readable reconstruction; identity: FUN_00080c8c @ 0x00080c8c
 * public-name: z_impl_net_if_ipv6_addr_rm_by_index
 * durable-map: recon/catalogs/function_names_app.json
 * callees (readable <= raw @ address):
 *   active_transfer_conn_match               <= FUN_000527dc @ 0x000527dc
 *   k_sem_give                               <= FUN_00072880 @ 0x00072880
 *   z_impl_net_if_ipv6_addr_rm_by_index      <= FUN_00080c8c @ 0x00080c8c
 */
/* Reconstructed FUN_00080c8c @ 0x80c8c  (parity: 300/300 trials, PROVEN) */

extern uint64_t active_transfer_conn_match(unsigned long);
extern void k_sem_give(unsigned int a, unsigned int b, unsigned int c, unsigned int d);

void z_impl_net_if_ipv6_addr_rm_by_index(unsigned int param_1, unsigned int param_2, unsigned int param_3, unsigned int param_4)
{
    uint64_t uVar1 = active_transfer_conn_match(param_1);
    unsigned int lo = (unsigned int)uVar1;
    unsigned int hi = (unsigned int)(uVar1 >> 32);
    if ((int)lo != 0) {
        k_sem_give(lo + 0x6c, hi, param_3, param_4);
    }
}

/* ---- bt_smp_ah.c ---- */
/* readable reconstruction; identity: FUN_00080ca0 @ 0x00080ca0
 * public-name: bt_smp_ah
 * durable-map: recon/catalogs/function_names_app.json
 * callees (readable <= raw @ address):
 *   bt_smp_ah                                <= FUN_00080ca0 @ 0x00080ca0
 *   bt_encrypt_le                            <= FUN_00081326 @ 0x00081326
 *   memcmp                                   <= FUN_00086be4 @ 0x00086be4
 *   memset_bytes                             <= FUN_00086c78 @ 0x00086c78
 */
/* Reconstructed FUN_00080ca0 @ 0x80ca0  (parity: 300/300 trials, PROVEN) */

extern void memset_bytes(void *a, int b, int c);
extern int bt_encrypt_le(int a, void *b);
extern int memcmp(const void *, const void *, size_t);

static int bt_smp_ah(int param_1, int param_2)
{
    unsigned char decoded[16];
    unsigned char key[3];
    int iVar2;

    decoded[0] = *(volatile unsigned char *)(param_2 + 3);
    decoded[1] = *(volatile unsigned char *)(param_2 + 4);
    decoded[2] = *(volatile unsigned char *)(param_2 + 5);
    memset_bytes(decoded + 3, 0, 13);
    iVar2 = bt_encrypt_le(param_1, decoded);
    if (iVar2 == 0) {
        key[0] = decoded[0];
        key[1] = decoded[1];
        key[2] = decoded[2];
        iVar2 = memcmp(param_2, key, 3);
        return iVar2 == 0;
    }
    return 0;
}

/* ================================================================ */
/* member unit: g1_lib_56.c */
/* ================================================================ */
/*
 * Cohesive translation unit for the `lib' module.
 *
 * GENERATED by recon/refactor/transforms/t04_cohesive_tu.py.  Do not
 * edit: a stage tree is regenerated, never hand-patched
 * (recon/refactor/README.md C4).
 *
 * The 3 functions below were 3 separate translation units until this
 * stage.  Each one's text is reproduced VERBATIM and in the order the
 * generated source list gave it, and they were CONSECUTIVE in that list.
 * They were proven able to share a translation unit: no symbol is
 * declared here with two types, no identifier has internal linkage in one
 * member and is named by another, and no local typedef, macro, struct tag
 * or enum constant of one member is visible to a member that names it.
 *
 * members, in link order:
 *   bt_le_adv_set_enable_legacy_veneer.c
 *   atomic_and_2.c
 *   bt_conn_call_4arg_zero.c
 */
/* ---- bt_le_adv_set_enable_legacy_veneer.c ---- */
#include "g1_app_symbols.h"
/* readable reconstruction; identity: FUN_0008131c @ 0x0008131c
 * public-name: bt_le_adv_set_enable_legacy_veneer
 * durable-map: recon/catalogs/function_names_app.json
 * callees (readable <= raw @ address):
 *   bt_le_adv_set_enable_legacy_veneer       <= FUN_0008131c @ 0x0008131c
 */
/* Reconstructed FUN_0008131c @ 0x0008131c.
 * Exact branch veneer to bt_le_adv_set_enable_legacy @ 0x000812d2.
 */
#include <stdint.h>
#include "g1_lib.h"
extern int bt_le_adv_set_enable_legacy(void *, unsigned int);
int bt_le_adv_set_enable_legacy_veneer(void *advertising_set, uint32_t enable)
{
    return bt_le_adv_set_enable_legacy(advertising_set, enable);
}

/* ---- atomic_and_2.c ---- */
/* readable reconstruction; identity: FUN_000813b4 @ 0x000813b4
 * public-name: atomic_and_2
 * durable-map: recon/catalogs/function_names_app.json
 */
/* Reconstructed atomic_and_2 @ 0x813b4  (CFG-directed candidate) */

/* Pinned Zephyr 3.4.99 atomic_builtin.h semantics. */
int atomic_and_2(volatile int32_t *target, int32_t value)
{
    return __atomic_fetch_and(target, value, __ATOMIC_SEQ_CST);
}

/* ---- bt_conn_call_4arg_zero.c ---- */
/* readable reconstruction; identity: FUN_000813ca @ 0x000813ca
 * public-name: bt_conn_call_4arg_zero
 * durable-map: recon/catalogs/function_names_app.json
 * callees (readable <= raw @ address):
 *   z_log_msg_runtime_create                 <= FUN_0004d944 @ 0x0004d944
 *   bt_conn_call_4arg_zero                   <= FUN_000813ca @ 0x000813ca
 */
/* Reconstructed FUN_000813ca @ 0x813ca  (parity: 300/300 trials, PROVEN) */

void bt_conn_call_4arg_zero(unsigned r0, unsigned r1, unsigned r2)
{
    z_log_msg_runtime_create(r0, r1, r2, 0);
}

/* ================================================================ */
/* member unit: g1_lib_62.c */
/* ================================================================ */
/*
 * Cohesive translation unit for the `lib' module.
 *
 * GENERATED by recon/refactor/transforms/t04_cohesive_tu.py.  Do not
 * edit: a stage tree is regenerated, never hand-patched
 * (recon/refactor/README.md C4).
 *
 * The 6 functions below were 6 separate translation units until this
 * stage.  Each one's text is reproduced VERBATIM and in the order the
 * generated source list gave it, and they were CONSECUTIVE in that list.
 * They were proven able to share a translation unit: no symbol is
 * declared here with two types, no identifier has internal linkage in one
 * member and is named by another, and no local typedef, macro, struct tag
 * or enum constant of one member is visible to a member that names it.
 *
 * members, in link order:
 *   gatt_send_service_changed_ind.c
 *   sys_slist_get.c
 *   net_buf_frags_len_0.c
 *   gatt_recompute_max_mtu.c
 *   bt_gatt_foreach_attr.c
 *   att_log_emit_3arg.c
 */

/* File-scope forward declarations for every struct/union tag this
 * unit names.  Without them a tag whose only appearance in a member
 * is inside a parameter list has PARAMETER-LIST scope, so two
 * textually IDENTICAL declarations in two members declare two
 * different incomplete types and the second is a conflicting
 * redeclaration (C11 6.2.1p7).  Incomplete-type forward
 * declarations emit no code. */
struct net_buf_view;
struct slist;
struct slist_node;
/* ---- gatt_send_service_changed_ind.c ---- */
#include "g1_app_symbols.h"
/* readable reconstruction; identity: FUN_00081b30 @ 0x00081b30
 * public-name: gatt_send_service_changed_ind
 * durable-map: recon/catalogs/function_names_app.json
 * callees (readable <= raw @ address):
 *   smp_pairing_event_cnt_inc                <= FUN_00057394 @ 0x00057394
 *   att_alloc_pdu_with_hdr                   <= FUN_000573f4 @ 0x000573f4
 *   net_buf_simple_add                       <= FUN_0005f5d0 @ 0x0005f5d0
 *   att_send_and_schedule_tx                 <= FUN_00081962 @ 0x00081962
 *   gatt_send_service_changed_ind            <= FUN_00081b30 @ 0x00081b30
 * address symbols (name @ address):
 *   rodata_10000                             @ 0x00010000
 */
/* Reconstructed FUN_00081b30 @ 0x81b30  (parity: 300/300 trials, PROVEN) */

extern int smp_pairing_event_cnt_inc(void);
extern int att_alloc_pdu_with_hdr(int a, int b, int c);
extern short *net_buf_simple_add(int a, int b);
extern void att_send_and_schedule_tx(int a, int b, int c, int d, int e);

unsigned int gatt_send_service_changed_ind(int *param_1, int param_2, int param_3, int param_4)
{
    unsigned int uVar1;
    int iVar2;

    if (*param_1 == 0) {
        uVar1 = 0xffffff80;
    } else {
        uVar1 = smp_pairing_event_cnt_inc();
        *(volatile char *)((char *)param_1 + 0xb8) = (char)uVar1;
        iVar2 = att_alloc_pdu_with_hdr(6, uVar1, 4);
        if (iVar2 == 0) {
            uVar1 = 0xfffffff4;
        } else {
            short *puVar3 = net_buf_simple_add(iVar2 + 0xc, 4);
            *(volatile short *)puVar3 = *(volatile short *)((char *)param_1 + 0x24);
            *(volatile short *)(puVar3 + 1) = *(volatile short *)((char *)param_1 + 0x14);
            att_send_and_schedule_tx((int)param_1, iVar2, ((unsigned long)&rodata_10000) /*=0x10000*/, 0, param_4);
            uVar1 = 0;
            *(volatile char *)((char *)param_1 + 0xb4) = 4;
        }
    }
    return uVar1;
}

/* ---- sys_slist_get.c ---- */
/* readable reconstruction; identity: FUN_00081bac @ 0x00081bac
 * public-name: sys_slist_get
 * durable-map: recon/catalogs/function_names_app.json
 */
/* sys_slist_get @ 0x00081bac; raw FUN_00081bac */

struct slist_node {
    struct slist_node *next;
};

struct slist {
    struct slist_node *head;
    struct slist_node *tail;
};

struct slist_node *sys_slist_get(struct slist *list)
{
    struct slist_node *node = list->head;

    if (node) {
        list->head = node->next;
        if (node == list->tail) {
            list->tail = node->next;
        }
    }
    return node;
}

/* ---- net_buf_frags_len_0.c ---- */
/* readable reconstruction; identity: FUN_00081bc0 @ 0x00081bc0
 * public-name: net_buf_frags_len_0
 * durable-map: recon/catalogs/function_names_app.json
 */
/* Reconstructed net_buf_frags_len_0 @ 0x00081bc0 from Zephyr net/buf.h.
 * Raw backmap: FUN_00081bc0@0x00081bc0. */

#include <stddef.h>
#include <stdint.h>
struct net_buf_view {
    void *node_next;
    struct net_buf_view *frags;
    uint8_t ref;
    uint8_t flags;
    uint8_t pool_id;
    uint8_t user_data_size;
    uint8_t *data;
    uint16_t len;
};

size_t net_buf_frags_len_0(struct net_buf_view *buf)
{
    size_t bytes = 0;
    while (buf != 0) {
        bytes += buf->len;
        buf = buf->frags;
    }
    return bytes;
}

/* ---- gatt_recompute_max_mtu.c ---- */
/* readable reconstruction; identity: FUN_00081c22 @ 0x00081c22
 * public-name: gatt_recompute_max_mtu
 * durable-map: recon/catalogs/function_names_app.json
 * callees (readable <= raw @ address):
 *   bt_gatt_att_max_mtu_changed              <= FUN_0005c76c @ 0x0005c76c
 *   gatt_recompute_max_mtu                   <= FUN_00081c22 @ 0x00081c22
 */
/* Reconstructed FUN_00081c22 @ 0x81c22  (parity: 300/300 trials, PROVEN) */

extern void bt_gatt_att_max_mtu_changed(uint32_t,uint32_t,uint32_t,uint32_t);
typedef uint32_t u32; typedef uint16_t u16;
#define H(p,off) (*(u16*)((char*)(p)+(off)))
void gatt_recompute_max_mtu(u32* param_1){
    u32 *puVar5, *puVar7, *puVar8;
    u32 uVar3, uVar9; u16 uVar4, uVar1;
    puVar5 = (u32*)((u32*)*param_1)[0xc];
    if(puVar5 != 0){
        puVar7 = (u32*)*puVar5;
        if(puVar7 != 0) puVar7 = puVar7 - 100;
        uVar4 = 0; uVar3 = 0;
        puVar5 = puVar5 - 100;
        do {
            puVar8 = puVar7;
            if(puVar5 == param_1) goto L54;
            while(1){
                if(uVar3 < H(puVar5,0x2e)) uVar3 = H(puVar5,0x2e);
                puVar8 = puVar7;
                if(uVar4 < H(puVar5,0x1e)) uVar4 = H(puVar5,0x1e);
            L54:
                if(puVar8 == 0) goto L64;
                puVar5 = puVar8;
                if(puVar8[100] != 0) break;
                puVar7 = 0;
                if(puVar8 == param_1) goto L64;
            }
            puVar7 = (u32*)(puVar8[100] - 400);
        } while(1);
    }
    uVar3 = 0; uVar4 = 0;
L64:
    uVar9 = H(param_1,0x2e);
    uVar1 = H(param_1,0x1e);
    if((uVar9 <= uVar3) && (uVar1 <= uVar4)) return;
    if(uVar4 < uVar1) uVar4 = uVar1;
    u32 uVar2 = *(u32*)*param_1;
    if(uVar3 < uVar9) uVar3 = uVar9;
    bt_gatt_att_max_mtu_changed(uVar2, uVar3, uVar4, uVar9);
}

/* ---- bt_gatt_foreach_attr.c ---- */
/* readable reconstruction; identity: FUN_00081cee @ 0x00081cee
 * public-name: bt_gatt_foreach_attr
 * durable-map: recon/catalogs/function_names_app.json
 */
/* Reconstructed bt_gatt_foreach_attr @ 0x00081cee from NCS 2.5.1 gatt.h.
 * Raw backmap: FUN_00081cee@0x00081cee. */

typedef uint8_t (*bt_gatt_attr_func_t)(const void*,void*);
extern void bt_gatt_foreach_attr_type(uint16_t,uint16_t,const void*,const void*,uint16_t,bt_gatt_attr_func_t,void*);
void bt_gatt_foreach_attr(uint16_t start,uint16_t end,bt_gatt_attr_func_t callback,void *user_data){bt_gatt_foreach_attr_type(start,end,0,0,0,callback,user_data);}

/* ---- att_log_emit_3arg.c ---- */
#include "g1_lib.h"
/* readable reconstruction; identity: FUN_00081ddc @ 0x00081ddc
 * public-name: att_log_emit_3arg
 * durable-map: recon/catalogs/function_names_app.json
 * callees (readable <= raw @ address):
 *   z_log_msg_runtime_create                 <= FUN_0004d944 @ 0x0004d944
 *   att_log_emit_3arg                        <= FUN_00081ddc @ 0x00081ddc
 */
/* Reconstructed FUN_00081ddc @ 0x81ddc  (parity: 300/300 trials, PROVEN) */

void att_log_emit_3arg(unsigned int a, unsigned int b, unsigned int c, unsigned int unused)
{
    (void)unused;
    z_log_msg_runtime_create(a, b, c, 0);
}

/* ================================================================ */
/* member unit: g1_lib_67.c */
/* ================================================================ */
/*
 * Cohesive translation unit for the `lib' module.
 *
 * GENERATED by recon/refactor/transforms/t04_cohesive_tu.py.  Do not
 * edit: a stage tree is regenerated, never hand-patched
 * (recon/refactor/README.md C4).
 *
 * The 3 functions below were 3 separate translation units until this
 * stage.  Each one's text is reproduced VERBATIM and in the order the
 * generated source list gave it, and they were CONSECUTIVE in that list.
 * They were proven able to share a translation unit: no symbol is
 * declared here with two types, no identifier has internal linkage in one
 * member and is named by another, and no local typedef, macro, struct tag
 * or enum constant of one member is visible to a member that names it.
 *
 * members, in link order:
 *   bt_conn_security_sufficient.c
 *   atomic_clear_bit_1.c
 *   smp_log_message.c
 */
/* ---- bt_conn_security_sufficient.c ---- */
#include "g1_app_symbols.h"
#include <stdint.h>
#include "g1_lib.h"
/* readable reconstruction; identity: FUN_00083002 @ 0x00083002
 * public-name: bt_conn_security_sufficient
 * durable-map: recon/catalogs/function_names_app.json
 * callees (readable <= raw @ address):
 *   atomic_test_bit                          <= FUN_00082ff6 @ 0x00082ff6
 *   bt_conn_security_sufficient              <= FUN_00083002 @ 0x00083002
 */
/* Reconstructed FUN_00083002 @ 0x83002  (parity: 300/300 trials, PROVEN) */

extern int atomic_test_bit(int a, int b, int c, int d, unsigned int e);
unsigned char bt_conn_security_sufficient(int param_1,int param_2,unsigned int param_3,unsigned int param_4)
{
  int iVar1;
  unsigned char bVar2;
  if ((param_2 != 0) && ((*(volatile unsigned short *)(param_2 + 0xe) & 0x24) != 0)) {
    bVar2 = *(volatile unsigned char *)(param_1 + 0x14);
    if (*(volatile unsigned char *)(param_1 + 0xd) <= *(volatile unsigned char *)(param_1 + 0x14)) {
      bVar2 = *(volatile unsigned char *)(param_1 + 0xd);
    }
    if ((bVar2 < *(volatile unsigned char *)(param_2 + 0xc)) ||
       (((int)((unsigned int)*(volatile unsigned short *)(param_2 + 0xe) << 0x1a) < 0 &&
        (iVar1 = atomic_test_bit(param_1 + 4,5,param_2,param_1,param_4), iVar1 == 0)))) {
      return 0;
    }
    if ((int)((unsigned int)*(volatile unsigned char *)(param_2 + 0xd) << 0x1f) < 0) {
      if (*(volatile char *)(param_1 + 8) == 0) {
        return 0;
      }
      return 1;
    }
  }
  return 1;
}

/* ---- atomic_clear_bit_1.c ---- */
/* readable reconstruction; identity: FUN_0008304c @ 0x0008304c
 * public-name: atomic_clear_bit_1
 * durable-map: recon/catalogs/function_names_app.json
 */
/* Reconstructed atomic_clear_bit_1 @ 0x0008304c (FUN_0008304c; CFG-verified). */
/* Pinned Zephyr 3.4.99 owner: include/zephyr/sys/atomic.h. */
void atomic_clear_bit_1(volatile int32_t *target, int bit)
{
    (void)__atomic_fetch_and(target, ~((int32_t)1 << bit), __ATOMIC_SEQ_CST);
}

/* ---- smp_log_message.c ---- */
/* readable reconstruction; identity: FUN_00083074 @ 0x00083074
 * public-name: smp_log_message
 * durable-map: recon/catalogs/function_names_app.json
 * callees (readable <= raw @ address):
 *   z_log_msg_runtime_create                 <= FUN_0004d944 @ 0x0004d944
 *   smp_log_message                          <= FUN_00083074 @ 0x00083074
 */
/* Reconstructed FUN_00083074 @ 0x83074  (parity: 300/300 trials, PROVEN) */

void smp_log_message(unsigned int a, unsigned int b, unsigned int c, unsigned int unused)
{
    (void)unused;
    z_log_msg_runtime_create(a, b, c, 0);
}

