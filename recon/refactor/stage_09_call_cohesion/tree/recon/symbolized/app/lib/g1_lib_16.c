/*
 * Cohesive translation unit for the `lib' module.
 *
 * GENERATED by recon/refactor/transforms/t04_cohesive_tu.py.  Do not
 * edit: a stage tree is regenerated, never hand-patched
 * (recon/refactor/README.md C4).
 *
 * The 3 functions below were 3 separate translation units until this
 * stage.  Each one's text is reproduced VERBATIM and in the order the
 * generated source list gave it, and they were CONSECUTIVE in that list.
 * They were proven able to share a translation unit: no symbol is
 * declared here with two types, no identifier has internal linkage in one
 * member and is named by another, and no local typedef, macro, struct tag
 * or enum constant of one member is visible to a member that names it.
 *
 * members, in link order:
 *   att_op_get_type.c
 *   att_chan_req_free.c
 *   att_get.c
 */
/* ---- att_op_get_type.c ---- */
#include "g1_app_symbols.h"
/* readable reconstruction; identity: FUN_000582b8 @ 0x000582b8
 * public-name: att_op_get_type
 * durable-map: recon/catalogs/function_names_app.json
 */
/* Reconstructed att_op_get_type @ 0x000582b8 (FUN_000582b8; CFG-verified). */
/* Pinned Zephyr 3.4.99 owner: subsys/bluetooth/host/att.c. */
#include <stdint.h>
#include "../../../headers/g1_log.h"
#include "../../../headers/g1_dedupe.h"
uint32_t att_op_get_type(uint8_t op)
{
    switch (op) {
    case 0x02: case 0x04: case 0x06: case 0x08:
    case 0x0a: case 0x0c: case 0x0e: case 0x20:
    case 0x10: case 0x12: case 0x16: case 0x18:
        return 1;
    case 0x1e:
        return 4;
    case 0x52: case 0xd2:
        return 0;
    case 0x01: case 0x03: case 0x05: case 0x07:
    case 0x09: case 0x0b: case 0x0d: case 0x0f:
    case 0x21: case 0x11: case 0x13: case 0x17: case 0x19:
        return 2;
    case 0x1b: case 0x23:
        return 3;
    case 0x1d:
        return 5;
    }
    if (op & 0x40) return 0;
    return 6;
}

/* ---- att_chan_req_free.c ---- */
/* readable reconstruction; identity: FUN_0005833c @ 0x0005833c
 * public-name: att_chan_req_free
 * durable-map: recon/catalogs/function_names_app.json
 * callees (readable <= raw @ address):
 *   att_chan_req_free                        <= FUN_0005833c @ 0x0005833c
 *   assert_post_action                       <= FUN_0007e2ec @ 0x0007e2ec
 *   printk                                   <= FUN_0007e2fa @ 0x0007e2fa
 *   net_pkt_skip                             <= FUN_00086502 @ 0x00086502
 *   memset_bytes                             <= FUN_00086c78 @ 0x00086c78
 * address symbols (name @ address):
 *   rodata_99cbd                             @ 0x00099cbd   [INLINED -- G6 literal batch]
 *   rodata_f3b6f                             @ 0x000f3b6f
 *   rodata_f4388                             @ 0x000f4388
 *   rodata_f43b7                             @ 0x000f43b7   [INLINED -- G6 literal batch]
 *   rodata_f43b8                             @ 0x000f43b8
 *   g_bt_att_pool                            @ 0x20003a28
 *   g_bt_gatt_indicate_ctx_pool              @ 0x2000add4
 *   att_handle_rsp_thread                    @ 0x2000ae9c
 */
/* Reconstructed FUN_0005833c @ 0x5833c, exact extent 118 bytes. */

extern void assert_post_action(const char *, unsigned int);
extern void net_pkt_skip(uintptr_t queue, void *item);
extern void memset_bytes(void*, int, int);

void att_chan_req_free(int*item) {
    if (item == 0) {
        G1_ASSERT_FAIL((((unsigned long)"ASSERTION FAIL [%s] @ %s:%d\n") /*=0x99cbd*/, ((unsigned long)&rodata_f3b6f) /*=0xf3b6f*/, ((unsigned long)&rodata_f4388) /*=0xf4388*/, 0xc4u), (((unsigned long)&rodata_f4388) /*=0xf4388*/, 0xc4u));
        return;
    }

    uint32_t *owner_item = (uint32_t *)(uintptr_t)(*item + 0x148u);
    uintptr_t address = (uintptr_t)item;
    if (address < ((unsigned long)&g_bt_gatt_indicate_ctx_pool) /*=0x2000add4*/ || address >= ((unsigned long)&att_handle_rsp_thread) /*=0x2000ae9c*/) {
        if (owner_item == item) {
            memset_bytes(item, 0u, 0x14u);
            return;
        }
        G1_ASSERT_FAIL((((unsigned long)"ASSERTION FAIL [%s] @ %s:%d\n") /*=0x99cbd*/, ((unsigned long)&rodata_f43b8) /*=0xf43b8*/, ((unsigned long)&rodata_f4388) /*=0xf4388*/, 0xcdu), (((unsigned long)&rodata_f4388) /*=0xf4388*/, 0xcdu));
        return;
    }

    if (owner_item == item) {
        G1_ASSERT_FAIL((((unsigned long)"ASSERTION FAIL [%s] @ %s:%d\n") /*=0x99cbd*/, ((unsigned long)"!alloc_from_global") /*=0xf43b7*/, ((unsigned long)&rodata_f4388) /*=0xf4388*/, 0xcbu), (((unsigned long)&rodata_f4388) /*=0xf4388*/, 0xcbu));
        return;
    }

    memset_bytes(item, 0u, 0x14u);
    net_pkt_skip(((unsigned long)&g_bt_att_pool) /*=0x20003a28*/, item);
}

/* ---- att_get.c ---- */
/* readable reconstruction; identity: FUN_0005858c @ 0x0005858c
 * public-name: att_get
 * durable-map: recon/catalogs/function_names_app.json
 * callees (readable <= raw @ address):
 *   att_get                                  <= FUN_0005858c @ 0x0005858c
 *   bt_l2cap_le_lookup_rx_cid                <= FUN_00081aca @ 0x00081aca
 *   att_log_emit_3arg                        <= FUN_00081ddc @ 0x00081ddc
 * address symbols (name @ address):
 *   rodata_88100                             @ 0x00088100
 */
/* Reconstructed FUN_0005858c @ 0x5858c  (parity: 300/300 trials, PROVEN) */

extern int bt_l2cap_le_lookup_rx_cid(int a, int b, int c, int d, int e, int f, int g, int h);
extern void att_log_emit_3arg(int a, int b, void *c);

unsigned int att_get(int param_1, int param_2, int param_3, int param_4)
{
    int iVar1;
    unsigned int uVar2;
    int local[2];

    if (*(char *)(param_1 + 0xd) == 7) {
        iVar1 = bt_l2cap_le_lookup_rx_cid(param_1, 4, param_3, 7, param_1, param_2, param_3, param_4);
        if (iVar1 != 0 && (*(volatile int *)(iVar1 + 0x118) << 0x1d) < 0) {
            return *(unsigned int *)(iVar1 - 8);
        }
        uVar2 = 0x1040;
    } else {
        uVar2 = 0x1080;
    }
    att_log_emit_3arg(((unsigned long)&rodata_88100) /*=0x88100*/, uVar2, local);
    return 0;
}

