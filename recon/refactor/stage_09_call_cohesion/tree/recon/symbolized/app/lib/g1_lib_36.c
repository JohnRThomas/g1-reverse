/*
 * Cohesive translation unit for the `lib' module.
 *
 * GENERATED by recon/refactor/transforms/t04_cohesive_tu.py.  Do not
 * edit: a stage tree is regenerated, never hand-patched
 * (recon/refactor/README.md C4).
 *
 * The 4 functions below were 4 separate translation units until this
 * stage.  Each one's text is reproduced VERBATIM and in the order the
 * generated source list gave it, and they were CONSECUTIVE in that list.
 * They were proven able to share a translation unit: no symbol is
 * declared here with two types, no identifier has internal linkage in one
 * member and is named by another, and no local typedef, macro, struct tag
 * or enum constant of one member is visible to a member that names it.
 *
 * members, in link order:
 *   nrf_gpiote_int_enable.c
 *   nrf_gpiote_int_disable.c
 *   nvmc_readonly_mode_set.c
 *   nvmc_word_write.c
 */
/* ---- nrf_gpiote_int_enable.c ---- */
#include "g1_app_symbols.h"
#include "../../../headers/g1_log.h"
#include <stdint.h>
/* readable reconstruction; identity: FUN_00065e10 @ 0x00065e10
 * public-name: nrf_gpiote_int_enable
 * durable-map: recon/catalogs/function_names_app.json
 * callees (readable <= raw @ address):
 *   nrf_gpiote_int_enable                    <= FUN_00065e10 @ 0x00065e10
 *   assert_post_action                       <= FUN_0007e2ec @ 0x0007e2ec
 *   printk                                   <= FUN_0007e2fa @ 0x0007e2fa
 * address symbols (name @ address):
 *   rodata_99cbd                             @ 0x00099cbd   [INLINED -- G6 literal batch]
 *   rodata_f6bc5                             @ 0x000f6bc5
 *   rodata_f6c09                             @ 0x000f6c09   [INLINED -- G6 literal batch]
 *   g_nrfx_gpiote_init_flag                  @ 0x2000b328
 *   REG_5002a304                             @ 0x5002a304
 */
/* Reconstructed FUN_00065e10 @ 0x65e10  (parity: 300/300 trials, PROVEN) */

extern int assert_post_action(int, int);

static void nrf_gpiote_int_enable(unsigned int param_1, unsigned int param_2, unsigned int param_3, unsigned int param_4)
{
    unsigned int r0 = param_1;
    if (*(volatile unsigned char *)((unsigned long)&g_nrfx_gpiote_init_flag) /*=0x2000b328*/ != 1) {
        printk(((unsigned long)"ASSERTION FAIL [%s] @ %s:%d\n") /*=0x99cbd*/, ((unsigned long)"m_cb.state == NRFX_DRV_STATE_INITIALIZED") /*=0xf6c09*/, ((unsigned long)&rodata_f6bc5) /*=0xf6bc5*/, 0x6c, param_4);
        r0 = assert_post_action(((unsigned long)&rodata_f6bc5) /*=0xf6bc5*/, 0x6c);
    }
    *(volatile int *)REG_5002a304 /*=0x5002a304*/ = 1 << (r0 & 0xff);
}

/* ---- nrf_gpiote_int_disable.c ---- */
/* readable reconstruction; identity: FUN_00065e4c @ 0x00065e4c
 * public-name: nrf_gpiote_int_disable
 * durable-map: recon/catalogs/function_names_app.json
 * callees (readable <= raw @ address):
 *   nrf_gpiote_int_disable                   <= FUN_00065e4c @ 0x00065e4c
 *   assert_post_action                       <= FUN_0007e2ec @ 0x0007e2ec
 *   printk                                   <= FUN_0007e2fa @ 0x0007e2fa
 * address symbols (name @ address):
 *   rodata_99cbd                             @ 0x00099cbd   [INLINED -- G6 literal batch]
 *   rodata_f6bc5                             @ 0x000f6bc5
 *   rodata_f6c09                             @ 0x000f6c09   [INLINED -- G6 literal batch]
 *   g_nrfx_gpiote_init_flag                  @ 0x2000b328
 *   REG_5002a308                             @ 0x5002a308
 */
/* Reconstructed FUN_00065e4c @ 0x65e4c  (parity: 300/300 trials, PROVEN) */


static void nrf_gpiote_int_disable(unsigned int param_1, unsigned int param_2, unsigned int param_3, unsigned int param_4)
{
    unsigned int r0 = param_1;
    if (*(volatile unsigned char *)((unsigned long)&g_nrfx_gpiote_init_flag) /*=0x2000b328*/ != 1) {
        printk(((unsigned long)"ASSERTION FAIL [%s] @ %s:%d\n") /*=0x99cbd*/, ((unsigned long)"m_cb.state == NRFX_DRV_STATE_INITIALIZED") /*=0xf6c09*/, ((unsigned long)&rodata_f6bc5) /*=0xf6bc5*/, 0x72, param_4);
        r0 = assert_post_action(((unsigned long)&rodata_f6bc5) /*=0xf6bc5*/, 0x72);
    }
    *(volatile int *)REG_5002a308 /*=0x5002a308*/ = 1 << (r0 & 0xff);
}

/* ---- nvmc_readonly_mode_set.c ---- */
/* readable reconstruction; identity: FUN_00065ef0 @ 0x00065ef0
 * public-name: nvmc_readonly_mode_set
 * durable-map: recon/catalogs/function_names_app.json
 * address symbols (name @ address):
 *   NRF_NVMC_S                               @ 0x50039000
 */
/* NCS 2.5.1 nvmc_readonly_mode_set @ 0x00065ef0 (FUN_00065ef0). */

static void nvmc_readonly_mode_set(void)
{
    volatile uint32_t *const nvmc = (volatile uint32_t *)NRF_NVMC_S /*=0x50039000*/;
    nvmc[0x584u / 4u] = 0u;
    nvmc[0x504u / 4u] = 0u;
}

/* ---- nvmc_word_write.c ---- */
/* readable reconstruction; identity: FUN_00065f04 @ 0x00065f04
 * public-name: nvmc_word_write
 * durable-map: recon/catalogs/function_names_app.json
 * address symbols (name @ address):
 *   REG_50039400                             @ 0x50039400
 */
/* nvmc_word_write @ 0x00065f04; raw FUN_00065f04.
 * nrfx_nvmc.c private helper for the nRF5340 NVMC write transaction. */
static void nvmc_word_write(uint32_t address, uint32_t value)
{
    volatile uint32_t *const ready =
        (volatile uint32_t *)REG_50039400 /*=0x50039400*/; /* NRF_NVMC->READY */
    while (*ready == 0u) {
    }
    *(volatile uint32_t *)(uintptr_t)address = value;
    __atomic_thread_fence(__ATOMIC_SEQ_CST);
}

