/*
 * Cohesive translation unit for the `lib' module.
 *
 * GENERATED by recon/refactor/transforms/t04_cohesive_tu.py.  Do not
 * edit: a stage tree is regenerated, never hand-patched
 * (recon/refactor/README.md C4).
 *
 * The 6 functions below were 6 separate translation units until this
 * stage.  Each one's text is reproduced VERBATIM and in the order the
 * generated source list gave it, and they were CONSECUTIVE in that list.
 * They were proven able to share a translation unit: no symbol is
 * declared here with two types, no identifier has internal linkage in one
 * member and is named by another, and no local typedef, macro, struct tag
 * or enum constant of one member is visible to a member that names it.
 *
 * members, in link order:
 *   gatt_dm_data_add_attribute.c
 *   gatt_dm_char_by_uuid.c
 *   gatt_dm_start.c
 *   gatt_subscribe_service_changed.c
 *   gatt_notify_config_change.c
 *   nrf_cc3xx_platform_abort.c
 */
/* ---- gatt_dm_data_add_attribute.c ---- */
#include "g1_app_symbols.h"
/* readable reconstruction; identity: FUN_0004e9a0 @ 0x0004e9a0
 * public-name: gatt_dm_data_add_attribute
 * durable-map: recon/catalogs/function_names_app.json
 * callees (readable <= raw @ address):
 *   gatt_dm_attr_alloc                       <= FUN_0004e8e8 @ 0x0004e8e8
 *   uuid_len_from_type                       <= FUN_0004e98c @ 0x0004e98c
 *   gatt_dm_data_add_attribute               <= FUN_0004e9a0 @ 0x0004e9a0
 *   gatt_dm_log_helper                       <= FUN_0007f406 @ 0x0007f406
 *   memcpy                                   <= FUN_00086c04 @ 0x00086c04
 * address symbols (name @ address):
 *   rodata_88130                             @ 0x00088130
 *   rodata_f1237                             @ 0x000f1237
 *   rodata_f1253                             @ 0x000f1253
 *   cur_service_val                          @ 0x2000a154
 */
/* Reconstructed FUN_0004e9a0 @ 0x4e9a0  (parity: 300/300 trials, PROVEN) */
#include <stdint.h>
#include "g1_lib.h"
#include "../../../headers/g1_log.h"
#include "../../../headers/g1_dedupe.h"
extern int gatt_dm_attr_alloc(int);
extern void memcpy(int, int, int);
int gatt_dm_data_add_attribute(unsigned int* param_1,int param_2){
  int iVar2=((unsigned long)&cur_service_val) /*=0x2000a154*/; int iVar3,iVar4,iVar5,iVar6; short uVar1;
  struct{unsigned int a,b;} s;
  s.b=((unsigned long)&rodata_f1237) /*=0xf1237*/;
  if(*(volatile unsigned int *)(iVar2+0x134)<0x23){
    iVar3=uuid_len_from_type(*(unsigned char*)(*param_1));
    iVar4=gatt_dm_attr_alloc(iVar3+param_2);
    s.b=((unsigned long)&rodata_f1253) /*=0xf1253*/;
    if(iVar4!=0){
      iVar5=*(volatile int *)(iVar2+0x134);
      *(volatile int *)(iVar2+0x134)=iVar5+1;
      iVar5=(iVar5+3)*8; iVar6=iVar2+iVar5;
      *(volatile short *)(iVar6+8)=*(short*)((char*)param_1+0x10);
      uVar1=*(short*)((char*)param_1+0x12);
      *(volatile int *)(iVar6+4)=iVar4+param_2;
      *(volatile char *)(iVar6+10)=(char)uVar1;
      memcpy(iVar4+param_2,*param_1,iVar3);
      return iVar5+4+iVar2;
    }
  }
  s.a=2;
  gatt_dm_log_helper(((unsigned long)&rodata_88130) /*=0x88130*/,0x1040,&s);
  return 0;
}

/* ---- gatt_dm_char_by_uuid.c ---- */
/* readable reconstruction; identity: FUN_0004ed3c @ 0x0004ed3c
 * public-name: gatt_dm_char_by_uuid
 * durable-map: recon/catalogs/function_names_app.json
 * callees (readable <= raw @ address):
 *   gatt_dm_char_by_uuid                     <= FUN_0004ed3c @ 0x0004ed3c
 *   assert_post_action                       <= FUN_0007e2ec @ 0x0007e2ec
 *   printk                                   <= FUN_0007e2fa @ 0x0007e2fa
 *   bt_gatt_dm_attr_chrc_val                 <= FUN_0007f4a0 @ 0x0007f4a0
 *   bt_gatt_dm_char_next                     <= FUN_0007f4d6 @ 0x0007f4d6
 *   bt_uuid_cmp                              <= FUN_00080d3e @ 0x00080d3e
 * address symbols (name @ address):
 *   rodata_99cbd                             @ 0x00099cbd   [INLINED -- G6 literal batch]
 *   rodata_f11bc                             @ 0x000f11bc
 *   rodata_f154a                             @ 0x000f154a
 */
/* Full reconstruction of FUN_0004ed3c @ 0x4ed3c (66-byte extent). */

extern uint32_t bt_gatt_dm_char_next(uint32_t collection, uint32_t previous);
extern const uint32_t *bt_gatt_dm_attr_chrc_val(void);
extern int bt_uuid_cmp(int, int);
extern _Noreturn void assert_post_action(uintptr_t file, uint32_t line);

unsigned int gatt_dm_char_by_uuid(unsigned int collection, const void*key) {
    uint32_t current = 0;
    for (;;) {
        current = bt_gatt_dm_char_next(collection, current);
        if (current == 0)
            return 0;

        const uint32_t *candidate = bt_gatt_dm_attr_chrc_val();
        if (candidate == 0) {
            G1_ASSERT_FAIL((((unsigned long)"ASSERTION FAIL [%s] @ %s:%d\n") /*=0x99cbd*/, ((unsigned long)&rodata_f154a) /*=0xf154a*/, ((unsigned long)&rodata_f11bc) /*=0xf11bc*/, 0x21cu), (((unsigned long)&rodata_f11bc) /*=0xf11bc*/, 0x21cu));
        }
        if (bt_uuid_cmp(key, *candidate) == 0)
            return current;
    }
}

/* ---- gatt_dm_start.c ---- */
/* readable reconstruction; identity: FUN_0004ed8c @ 0x0004ed8c
 * public-name: gatt_dm_start
 * durable-map: recon/catalogs/function_names_app.json
 * callees (readable <= raw @ address):
 *   uuid_len_from_type                       <= FUN_0004e98c @ 0x0004e98c
 *   gatt_dm_start                            <= FUN_0004ed8c @ 0x0004ed8c
 *   bt_gatt_discover                         <= FUN_0005b9cc @ 0x0005b9cc
 *   atomic_and_0                             <= FUN_0007f3f0 @ 0x0007f3f0
 *   gatt_dm_log_helper                       <= FUN_0007f406 @ 0x0007f406
 *   safe_memcpy_checked                      <= FUN_00086c1e @ 0x00086c1e
 * address symbols (name @ address):
 *   ADDR_discovery_callback_THUMB            @ 0x0004ea79
 *   rodata_88130                             @ 0x00088130
 *   rodata_f1574                             @ 0x000f1574
 *   cur_service_val                          @ 0x2000a154
 *   g_gatt_dm_context                        @ 0x2000a158
 *   g_gatt_dm_discover_params_uuid           @ 0x2000a15c
 *   g_gatt_dm_discover_params_func           @ 0x2000a160
 *   g_gatt_dm_discover_params_start_handle   @ 0x2000a164
 *   g_gatt_dm_discover_params_end_handle     @ 0x2000a16a
 *   g_gatt_dm_discover_params_type           @ 0x2000a16c
 *   g_gatt_dm_attr_count                     @ 0x2000a288
 *   g_gatt_dm_in_progress_flag               @ 0x2000a28c
 *   g_gatt_dm_svc_uuid_buf                   @ 0x2000a290
 *   g_gatt_dm_chunk_list_head                @ 0x2000a2a4
 *   g_gatt_dm_chunk_list_tail                @ 0x2000a2a8
 *   g_gatt_dm_chunk_used_len                 @ 0x2000a2ac
 *   g_gatt_dm_svc_range_end                  @ 0x2000a2b0
 *   g_gatt_dm_has_uuid_flag                  @ 0x2000a2b4
 */
/* Reconstructed FUN_0004ed8c @ 0x4ed8c  (parity: 300/300 trials, PROVEN) */

extern long atomic_and_0(volatile long*, long);
extern int safe_memcpy_checked(void*,void*,uint32_t,int);

int gatt_dm_start(uint32_t param_1, uint32_t *param_2, uint32_t param_3, uint32_t param_4){
    int iVar3;
    uint32_t *g = (uint32_t*)((unsigned long)&g_gatt_dm_in_progress_flag) /*=0x2000a28c*/;
    if ( (param_2==0 || (( *(uint8_t*)param_2 & 0xfd)==0)) && (param_3!=0) ) {
        uint32_t uVar4 = __atomic_fetch_or(g, 1u, __ATOMIC_SEQ_CST);
        if ((uVar4 & 1) == 0) {
            uint32_t one = uVar4 & 1;
            *(volatile uint32_t *)((unsigned long)&cur_service_val) /*=0x2000a154*/ = param_1;
            *(volatile uint32_t *)((unsigned long)&g_gatt_dm_context) /*=0x2000a158*/ = param_4;
            *(volatile uint32_t *)((unsigned long)&g_gatt_dm_chunk_list_head) /*=0x2000a2a4*/ = one;
            *(volatile uint32_t *)((unsigned long)&g_gatt_dm_chunk_list_tail) /*=0x2000a2a8*/ = one;
            *(volatile uint8_t *)((unsigned long)&g_gatt_dm_has_uuid_flag) /*=0x2000a2b4*/ = (param_2 != 0) ? 1 : 0;
            *(volatile uint32_t *)((unsigned long)&g_gatt_dm_svc_range_end) /*=0x2000a2b0*/ = param_3;
            *(volatile uint32_t *)((unsigned long)&g_gatt_dm_attr_count) /*=0x2000a288*/ = one;
            *(volatile uint32_t *)((unsigned long)&g_gatt_dm_chunk_used_len) /*=0x2000a2ac*/ = one;
            if (param_2 != 0) {
                uint32_t uVar2 = uuid_len_from_type((uint8_t)*param_2);
                safe_memcpy_checked((void*)((unsigned long)&g_gatt_dm_svc_uuid_buf) /*=0x2000a290*/, (void*)param_2, uVar2, 0x28);
                param_2 = (uint32_t*)((unsigned long)&g_gatt_dm_svc_uuid_buf) /*=0x2000a290*/;
            }
            *(volatile uint32_t *)((unsigned long)&g_gatt_dm_discover_params_func) /*=0x2000a160*/ = ADDR_discovery_callback_THUMB /*=0x4ea79*/;
            *(volatile uint16_t *)((unsigned long)&g_gatt_dm_discover_params_start_handle) /*=0x2000a164*/ = 1;
            *(volatile uint16_t *)((unsigned long)&g_gatt_dm_discover_params_end_handle) /*=0x2000a16a*/ = 0xffff;
            *(volatile uint32_t *)((unsigned long)&g_gatt_dm_discover_params_uuid) /*=0x2000a15c*/ = (uint32_t)param_2;
            *(volatile uint8_t *)((unsigned long)&g_gatt_dm_discover_params_type) /*=0x2000a16c*/ = 0;
            iVar3 = bt_gatt_discover(param_1, ((unsigned long)&g_gatt_dm_discover_params_uuid) /*=0x2000a15c*/);
            if (iVar3 != 0) {
                struct { uint32_t level, message; int error; } log = {
                    3, ((unsigned long)&rodata_f1574) /*=0xf1574*/, iVar3
                };
                gatt_dm_log_helper(((unsigned long)&rodata_88130) /*=0x88130*/, 0x1840, &log);
                atomic_and_0(((unsigned long)&g_gatt_dm_in_progress_flag) /*=0x2000a28c*/, 0xfffffffe);
            }
        } else { iVar3 = -0x78; }
    } else { iVar3 = -0x16; }
    return iVar3;
}

/* ---- gatt_subscribe_service_changed.c ---- */
/* readable reconstruction; identity: FUN_0004f418 @ 0x0004f418
 * public-name: gatt_subscribe_service_changed
 * durable-map: recon/catalogs/function_names_app.json
 * callees (readable <= raw @ address):
 *   z_log_msg_runtime_create                 <= FUN_0004d944 @ 0x0004d944
 *   gatt_subscribe_service_changed           <= FUN_0004f418 @ 0x0004f418
 *   gatt_subscribe_add                       <= FUN_0005c3c4 @ 0x0005c3c4
 * address symbols (name @ address):
 *   ADDR_clock_event_notify_u16pair_THUMB    @ 0x0007f895
 *   rodata_881c0                             @ 0x000881c0
 *   rodata_f1625                             @ 0x000f1625
 */
/* Reconstructed FUN_0004f418 @ 0x4f418  (parity: 300/300 trials, PROVEN) */

extern int gatt_subscribe_add(int, int *);

int gatt_subscribe_service_changed(volatile int *param_1, int param_2, uint32_t param_3, uint32_t param_4){
  int iVar1;
  unsigned uVar2;
  volatile unsigned *puVar3;
  struct {
    uint32_t count;
    uint32_t format;
    int error;
  } log_record;
  if (param_1 == 0 || *param_1 == 0 || param_2 == 0){
    iVar1 = -0x16;
  } else {
    puVar3 = (volatile unsigned*)(param_1 + 10);
    uVar2 = __atomic_fetch_or((unsigned *)puVar3, 1u, __ATOMIC_ACQ_REL);
    iVar1 = ADDR_clock_event_notify_u16pair_THUMB /*=0x7f895*/;
    if ((uVar2 & 1) == 0){
      param_1[9] = param_2;
      param_1[2] = iVar1;
      *(volatile int16_t *)(param_1 + 6) = 2;
      param_1[5] = param_1[1];
      (void)__atomic_fetch_or((unsigned *)&param_1[7], 1u, __ATOMIC_ACQ_REL);
      iVar1 = gatt_subscribe_add((uint32_t)*param_1, (void*)(param_1 + 2));
      if (iVar1 != 0){
        (void)__atomic_fetch_and((unsigned *)puVar3, 0xfffffffeu,
                                 __ATOMIC_ACQ_REL);
        log_record.count = 3;
        log_record.format = ((unsigned long)&rodata_f1625) /*=0xf1625*/;
        log_record.error = iVar1;
        z_log_msg_runtime_create(((unsigned long)&rodata_881c0) /*=0x881c0*/, 0x1840, &log_record, 0);
      }
    } else {
      iVar1 = -0x78;
    }
  }
  return iVar1;
}

/* ---- gatt_notify_config_change.c ---- */
/* readable reconstruction; identity: FUN_0004f518 @ 0x0004f518
 * public-name: gatt_notify_config_change
 * durable-map: recon/catalogs/function_names_app.json
 * callees (readable <= raw @ address):
 *   gatt_notify_config_change                <= FUN_0004f518 @ 0x0004f518
 *   gatt_find_ccc_for_conn                   <= FUN_0005b0dc @ 0x0005b0dc
 *   bt_gatt_notify_cb                        <= FUN_0005b754 @ 0x0005b754
 *   memset_bytes                             <= FUN_00086c78 @ 0x00086c78
 * address symbols (name @ address):
 *   rodata_4f4f1                             @ 0x0004f4f1
 *   rodata_8ad40                             @ 0x0008ad40
 */
/* Reconstructed FUN_0004f518 @ 0x4f518  (parity: 300/300 trials, PROVEN) */

extern void memset_bytes(void*,int,int);
extern int gatt_find_ccc_for_conn(int,int,int);

int gatt_notify_config_change(int param_1, int param_2, short param_3)
{
    unsigned char buf[24];
    int iVar2;
    memset_bytes(buf, 0, 0x18);
    *(int*)(buf+4) = ((unsigned long)&rodata_8ad40) /*=0x8ad40*/;
    *(int*)(buf+8) = param_2;
    *(short*)(buf+0xc) = param_3;
    *(int*)(buf+0x10) = ((unsigned long)&rodata_4f4f1) /*=0x4f4f1*/;
    if (param_1 == 0 || ((iVar2 = gatt_find_ccc_for_conn(param_1, ((unsigned long)&rodata_8ad40) /*=0x8ad40*/, 1)), iVar2 != 0)) {
        return bt_gatt_notify_cb(param_1, buf);
    } else {
        return 0xffffffea;
    }
}

/* ---- nrf_cc3xx_platform_abort.c ---- */
/* readable reconstruction; identity: FUN_00050af8 @ 0x00050af8
 * public-name: nrf_cc3xx_platform_abort
 * durable-map: recon/catalogs/function_names_app.json
 */
/* nrf_cc3xx_platform_abort @ 0x00050af8; raw FUN_00050af8 */

void nrf_cc3xx_platform_abort(void)
{
    volatile uint32_t *aircr = (volatile uint32_t *)0xe000ed0cu;

    *aircr = 0x05fa0004u | (*aircr & 0x700u);
    for (;;) {
    }
}

