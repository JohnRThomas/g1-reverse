/*
 * Cohesive translation unit for the `lib' module.
 *
 * GENERATED by recon/refactor/transforms/t04_cohesive_tu.py.  Do not
 * edit: a stage tree is regenerated, never hand-patched
 * (recon/refactor/README.md C4).
 *
 * The 10 functions below were 10 separate translation units until this
 * stage.  Each one's text is reproduced VERBATIM and in the order the
 * generated source list gave it, and they were CONSECUTIVE in that list.
 * They were proven able to share a translation unit: no symbol is
 * declared here with two types, no identifier has internal linkage in one
 * member and is named by another, and no local typedef, macro, struct tag
 * or enum constant of one member is visible to a member that names it.
 *
 * members, in link order:
 *   split_chunks.c
 *   validate_args.c
 *   _ldiv5.c
 *   _get_digit.c
 *   nvs_log_err.c
 *   settings_nvs_delete_id.c
 *   settings_nvs_read_latest.c
 *   atomic_set.c
 *   shm_size.c
 *   atomic_inc.c
 */
/* ---- split_chunks.c ---- */
#include "g1_app_symbols.h"
/* readable reconstruction; identity: FUN_0007df98 @ 0x0007df98
 * public-name: split_chunks
 * durable-map: recon/catalogs/function_names_app.json
 */
/* split_chunks @ 0x0007df98; raw FUN_0007df98 */
#include <stdint.h>
#include "g1_lib.h"

extern unsigned long chunk_size(void*, unsigned long); /* FUN_0007de18 */
extern void set_chunk_size(uint8_t *, uint32_t, uint32_t); /* FUN_0007de54 */

void split_chunks(uint8_t *heap, uint32_t left, uint32_t right)
{
    uint32_t original = chunk_size(heap, left);
    uint32_t left_size = right - left;
    uint32_t right_size = original - left_size;

    set_chunk_size(heap, left, left_size);
    set_chunk_size(heap, right, right_size);
    chunk_set(heap, right, 0, left_size);
    chunk_set(heap, right + chunk_size(heap, right), 0, right_size);
}

/* ---- validate_args.c ---- */
/* readable reconstruction; identity: FUN_0007e1c6 @ 0x0007e1c6
 * public-name: validate_args
 * durable-map: recon/catalogs/function_names_app.json
 */
/* validate_args @ 0x0007e1c6; raw FUN_0007e1c6 */

extern int sys_notify_validate(void *); /* FUN_0007e238 */

static int validate_args(const void *manager, uint8_t *client)
{
    if (!manager || !client) {
        return -22;
    }

    int result = sys_notify_validate(client + 4);
    if (result == 0 && *(uint32_t *)(client + 8) > 3u) {
        return -22;
    }
    return result;
}

/* ---- _ldiv5.c ---- */
/* readable reconstruction; identity: FUN_0007e260 @ 0x0007e260
 * public-name: _ldiv5
 * durable-map: recon/catalogs/function_names_app.json
 * callees (readable <= raw @ address):
 *   _ldiv5                                   <= FUN_0007e260 @ 0x0007e260
 */
/* Reconstructed FUN_0007e260 @ 0x7e260  (parity: 300/300 trials, PROVEN) */

void _ldiv5(unsigned int *param_1)
{
    unsigned long long lVar1 = (unsigned long long)param_1[0] * 0x33333333ULL;
    unsigned long long lVar2 = lVar1 + (unsigned long long)param_1[1] * 0x33333333ULL;
    unsigned int lo1 = (unsigned int)lVar1;
    unsigned int hi1 = (unsigned int)(lVar1 >> 32);
    unsigned int termb = hi1 + (unsigned int)(0xccccccccU < lo1) + 0x33333333U;
    unsigned int lo2 = (unsigned int)lVar2;
    unsigned int hi2 = (unsigned int)(lVar2 >> 32);
    unsigned int carry2 = (unsigned int)((lo2 + termb) < lo2);
    unsigned long long X = (unsigned long long)hi2 + carry2;
    unsigned long long result = (unsigned long long)param_1[1]*0x33333333ULL + X;
    *(volatile unsigned long long *)param_1 = result;
}

/* ---- _get_digit.c ---- */
/* readable reconstruction; identity: FUN_0007e290 @ 0x0007e290
 * public-name: _get_digit
 * durable-map: recon/catalogs/function_names_app.json
 * callees (readable <= raw @ address):
 *   _get_digit                               <= FUN_0007e290 @ 0x0007e290
 */
/* Reconstructed FUN_0007e290 @ 0x7e290  (parity: 300/300 trials, PROVEN) */

int _get_digit(uint32_t *param_1, int32_t *param_2)
{
    int iVar1;
    uint32_t uVar2;
    if (*param_2 < 1) {
        iVar1 = 0x30;
    } else {
        *param_2 = *param_2 - 1;
        uint64_t prod = (uint64_t)(*param_1) * 10;
        uVar2 = param_1[1] * 10 + (uint32_t)(prod >> 32);
        *param_1 = (uint32_t)prod;
        param_1[1] = uVar2 & 0xfffffffU;
        iVar1 = (int)(uVar2 >> 0x1c) + 0x30;
    }
    return iVar1;
}

/* ---- nvs_log_err.c ---- */
/* readable reconstruction; identity: FUN_0007e658 @ 0x0007e658
 * public-name: nvs_log_err
 * durable-map: recon/catalogs/function_names_app.json
 * callees (readable <= raw @ address):
 *   z_log_msg_runtime_create                 <= FUN_0004d944 @ 0x0004d944
 *   nvs_log_err                              <= FUN_0007e658 @ 0x0007e658
 */
/* Reconstructed FUN_0007e658 @ 0x7e658  (parity: 300/300 trials, PROVEN) */

static void nvs_log_err(unsigned r0, unsigned r1, unsigned r2)
{
    z_log_msg_runtime_create(r0, r1, r2, 0);
}

/* ---- settings_nvs_delete_id.c ---- */
/* readable reconstruction; identity: FUN_0007e9d4 @ 0x0007e9d4
 * public-name: settings_nvs_delete_id
 * durable-map: recon/catalogs/function_names_app.json
 * callees (readable <= raw @ address):
 *   nvs_write                                <= FUN_0004c8f8 @ 0x0004c8f8
 *   settings_nvs_delete_id                   <= FUN_0007e9d4 @ 0x0007e9d4
 */
/* Reconstructed FUN_0007e9d4 @ 0x7e9d4. */
/* Tail wrapper: clear the callee's third and fourth ABI arguments. */
extern void nvs_write(unsigned int, unsigned int,
                         unsigned int, unsigned int);

void settings_nvs_delete_id(unsigned int param_1, unsigned int param_2)
{
    nvs_write(param_1, param_2, 0, 0);
}

/* ---- settings_nvs_read_latest.c ---- */
/* readable reconstruction; identity: FUN_0007e9dc @ 0x0007e9dc
 * public-name: settings_nvs_read_latest
 * durable-map: recon/catalogs/function_names_app.json
 * callees (readable <= raw @ address):
 *   nvs_read_hist                            <= FUN_0004cab4 @ 0x0004cab4
 *   settings_nvs_read_latest                 <= FUN_0007e9dc @ 0x0007e9dc
 */
/* Reconstructed FUN_0007e9dc @ 0x7e9dc  (parity: 300/300 trials, PROVEN) */

extern void nvs_read_hist(void);
void settings_nvs_read_latest(void)
{
  nvs_read_hist();
  return;
}

/* ---- atomic_set.c ---- */
/* readable reconstruction; identity: FUN_0007eb4e @ 0x0007eb4e
 * public-name: atomic_set
 * durable-map: recon/catalogs/function_names_app.json
 */
/* Reconstructed atomic_set @ 0x0007eb4e.
 * Raw/address back-map: FUN_0007eb4e / 0x0007eb4e.
 */

int32_t atomic_set(volatile int32_t *target, int32_t value)
{
    return __atomic_exchange_n(target, value, __ATOMIC_SEQ_CST);
}

/* ---- shm_size.c ---- */
/* readable reconstruction; identity: FUN_0007ebee @ 0x0007ebee
 * public-name: shm_size
 * durable-map: recon/catalogs/function_names_app.json
 */
/* Reconstructed shm_size @ 0x7ebee  (CFG-directed candidate) */
/* Owner: Zephyr 3.4.99 ipc_rpmsg_static_vrings.h; raw backmap FUN_0007ebee@0x0007ebee. */
uint32_t shm_size(uint32_t descriptor_count, uint32_t buffer_size)
{
    uint32_t ring_bytes = (descriptor_count * 18u + 9u) & ~3u;
    uint32_t payload_bytes = (descriptor_count * buffer_size + 3u) & ~3u;
    return 2u * (ring_bytes + descriptor_count * 8u + 8u + payload_bytes);
}

/* ---- atomic_inc.c ---- */
/* readable reconstruction; identity: FUN_0007ee2c @ 0x0007ee2c
 * public-name: atomic_inc
 * durable-map: recon/catalogs/function_names_app.json
 */
/* Reconstructed atomic_inc @ 0x0007ee2c.
 * Raw/address back-map: FUN_0007ee2c / 0x0007ee2c.
 */

unsigned long atomic_inc(volatile unsigned long*target) {
    return __atomic_fetch_add(target, 1, __ATOMIC_SEQ_CST);
}

