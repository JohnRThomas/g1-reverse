/*
 * Cohesive translation unit for the `lib' module.
 *
 * GENERATED by recon/refactor/transforms/t04_cohesive_tu.py.  Do not
 * edit: a stage tree is regenerated, never hand-patched
 * (recon/refactor/README.md C4).
 *
 * The 3 functions below were 3 separate translation units until this
 * stage.  Each one's text is reproduced VERBATIM and in the order the
 * generated source list gave it, and they were CONSECUTIVE in that list.
 * They were proven able to share a translation unit: no symbol is
 * declared here with two types, no identifier has internal linkage in one
 * member and is named by another, and no local typedef, macro, struct tag
 * or enum constant of one member is visible to a member that names it.
 *
 * members, in link order:
 *   log_process.c
 *   g1_recon_z_impl_log_panic.c
 *   z_log_msg_post_finalize.c
 */

/* File-scope forward declarations for every struct/union tag this
 * unit names.  Without them a tag whose only appearance in a member
 * is inside a parameter list has PARAMETER-LIST scope, so two
 * textually IDENTICAL declarations in two members declare two
 * different incomplete types and the second is a conflicting
 * redeclaration (C11 6.2.1p7).  Incomplete-type forward
 * declarations emit no code. */
struct k_sem;
struct k_spinlock;
struct k_timer;
struct listener_entry;
/* ---- log_process.c ---- */
#include "g1_app_symbols.h"
/* readable reconstruction; identity: FUN_0004d594 @ 0x0004d594
 * public-name: log_process
 * durable-map: recon/catalogs/function_names_app.json
 * callees (readable <= raw @ address):
 *   log_dropped                              <= FUN_0004d4a8 @ 0x0004d4a8
 *   z_log_msg_local_claim                    <= FUN_0004d56c @ 0x0004d56c
 *   log_process                              <= FUN_0004d594 @ 0x0004d594
 *   assert_post_action                       <= FUN_0007e2ec @ 0x0007e2ec
 *   printk                                   <= FUN_0007e2fa @ 0x0007e2fa
 * address symbols (name @ address):
 *   rodata_882a0                             @ 0x000882a0
 *   __settings_handler_static_list_start     @ 0x000882b0
 *   rodata_99cbd                             @ 0x00099cbd   [INLINED -- G6 literal batch]
 *   rodata_f0cae                             @ 0x000f0cae
 *   rodata_f0cff                             @ 0x000f0cff   [INLINED -- G6 literal batch]
 *   rodata_f0d20                             @ 0x000f0d20   [INLINED -- G6 literal batch]
 *   log_process_timestamp                    @ 0x200056a0
 *   log_backend_count                        @ 0x2000a0d4
 *   log_buffered_cnt                         @ 0x2000a0d8
 *   log_process_active                       @ 0x2001d44b
 */
/* Full ABI-faithful reconstruction of FUN_0004d594 @ 0x4d594 (220 bytes). */
#include <stdint.h>
#include "../../../headers/g1_log.h"
#include "../../../headers/g1_dedupe.h"

extern uint32_t z_log_msg_local_claim(void);
extern void g1_recon_z_log_msg_free(volatile unsigned long*);
extern void assert_post_action(const char *, unsigned int);
extern uint64_t thunk_FUN_00074f68(void);
extern void log_dropped(uint32_t low, uint32_t high);
extern int g1_recon_z_log_msg_pending(void);

struct listener_entry {
    void (**vtable)(struct listener_entry *, uint32_t);
    const uint8_t *state;
    uint32_t reserved[2];
};

int log_process(void)
{
    if (*(volatile uint8_t *)((unsigned long)&log_process_active) /*=0x2001d44b*/ == 0)
        return 0;

    uint32_t item = z_log_msg_local_claim();
    if (item != 0) {
        __atomic_sub_fetch((uint32_t *)((unsigned long)&log_buffered_cnt) /*=0x2000a0d8*/, 1, __ATOMIC_ACQ_REL);

        struct listener_entry *entry = (struct listener_entry *)((unsigned long)&rodata_882a0) /*=0x882a0*/;
        struct listener_entry *end = (struct listener_entry *)((unsigned long)&__settings_handler_static_list_start) /*=0x882b0*/;
        while (entry < end) {
            if (end < entry) {
                printk(((unsigned long)"ASSERTION FAIL [%s] @ %s:%d\n") /*=0x99cbd*/, ((unsigned long)"backend <= _log_backend_list_end") /*=0xf0cff*/,
                             ((unsigned long)&rodata_f0cae) /*=0xf0cae*/, 0x1c5u);
                G1_ASSERT_FAIL((((unsigned long)"\tunexpected list end location\n") /*=0xf0d20*/), (((unsigned long)&rodata_f0cae) /*=0xf0cae*/, 0x1c5u));
            }
            if (entry->state[5] != 0)
                (*entry->vtable)(entry, item);
            ++entry;
        }
        g1_recon_z_log_msg_free(item);
    }

    volatile uint64_t *deadline = (volatile uint64_t *)((unsigned long)&log_process_timestamp) /*=0x200056a0*/;
    if (*(volatile int32_t *)((unsigned long)&log_backend_count) /*=0x2000a0d4*/ > 0) {
        uint64_t now = (thunk_FUN_00074f68() * UINT64_C(1000)) >> 15;
        uint64_t elapsed = now - *deadline;
        if (elapsed >= UINT64_C(1001))
            log_dropped((uint32_t)elapsed, (uint32_t)(elapsed >> 32));
    }
    *deadline += UINT64_C(1000);

    return g1_recon_z_log_msg_pending();
}

/* ---- g1_recon_z_impl_log_panic.c ---- */
/* readable reconstruction; identity: FUN_0004d678 @ 0x0004d678
 * public-name: g1_recon_z_impl_log_panic
 * durable-map: recon/catalogs/function_names_app.json
 * callees (readable <= raw @ address):
 *   log_msg_process                          <= FUN_0004d334 @ 0x0004d334
 *   log_process                              <= FUN_0004d594 @ 0x0004d594
 *   assert_post_action                       <= FUN_0007e2ec @ 0x0007e2ec
 *   printk                                   <= FUN_0007e2fa @ 0x0007e2fa
 * address symbols (name @ address):
 *   rodata_882a0                             @ 0x000882a0
 *   __settings_handler_static_list_start     @ 0x000882b0
 *   rodata_99cbd                             @ 0x00099cbd   [INLINED -- G6 literal batch]
 *   rodata_f0cae                             @ 0x000f0cae
 *   rodata_f0cff                             @ 0x000f0cff   [INLINED -- G6 literal batch]
 *   rodata_f0d20                             @ 0x000f0d20   [INLINED -- G6 literal batch]
 *   g_log_initialized_flag                   @ 0x2001d44c
 */
/* Reconstructed g1_recon_z_impl_log_panic @ 0x4d678.
 * Raw/address back-map: g1_recon_z_impl_log_panic <= FUN_0004d678 @ 0x0004d678.
 * Authoritative CFG verification supersedes the legacy 298/300 fuzz receipt.
 */
#include "g1_lib.h"
extern int log_msg_process(int);
void g1_recon_z_impl_log_panic(void){
  volatile uint8_t *pcVar1 = (volatile uint8_t*)((unsigned long)&g_log_initialized_flag) /*=0x2001d44c*/;
  if(*pcVar1 == 0){
    log_msg_process(1);
    uint32_t piVar4 = ((unsigned long)&rodata_882a0) /*=0x882a0*/;
    uint32_t piVar2 = ((unsigned long)&__settings_handler_static_list_start) /*=0x882b0*/;
    while(1){
      if(piVar4 > piVar2){
        printk(((unsigned long)"ASSERTION FAIL [%s] @ %s:%d\n") /*=0x99cbd*/, ((unsigned long)"backend <= _log_backend_list_end") /*=0xf0cff*/, ((unsigned long)&rodata_f0cae) /*=0xf0cae*/, 0x188);
        G1_ASSERT_FAIL((((unsigned long)"\tunexpected list end location\n") /*=0xf0d20*/), (((unsigned long)&rodata_f0cae) /*=0xf0cae*/, 0x188));
      }
      if(piVar4 == piVar2) break;
      uint32_t e = *(volatile uint32_t *)(piVar4+4);
      if(*(volatile uint8_t *)(e+5) != 0){
        uint32_t f = *(volatile uint32_t *)(*(volatile uint32_t *)piVar4 + 8);
        ((void(*)(uint32_t))(uintptr_t)f)(piVar4);
      }
      piVar4 += 0x10;
    }
    int iVar3;
    do { iVar3 = log_process(); } while(iVar3 != 0);
    *pcVar1 = 1;
  }
}

/* ---- z_log_msg_post_finalize.c ---- */
struct k_spinlock;
struct k_timer;
struct k_sem;
/* readable reconstruction; identity: FUN_0004d7d8 @ 0x0004d7d8
 * public-name: z_log_msg_post_finalize
 * durable-map: recon/catalogs/function_names_app.json
 * callees (readable <= raw @ address):
 *   log_process                              <= FUN_0004d594 @ 0x0004d594
 *   z_log_msg_post_finalize                  <= FUN_0004d7d8 @ 0x0004d7d8
 *   z_spin_lock_valid                        <= FUN_00072040 @ 0x00072040
 *   z_spin_unlock_valid                      <= FUN_0007205c @ 0x0007205c
 *   z_spin_lock_set_owner                    <= FUN_00072078 @ 0x00072078
 *   k_sem_give                               <= FUN_00072880 @ 0x00072880
 *   z_impl_k_timer_start                     <= FUN_00075174 @ 0x00075174
 *   atomic_inc                               <= FUN_0007ee2c @ 0x0007ee2c
 *   z_impl_k_timer_stop                      <= FUN_0008673e @ 0x0008673e
 * address symbols (name @ address):
 *   g_200039f8                               @ 0x200039f8
 *   g_200056a8                               @ 0x200056a8
 *   g_2000a0c8                               @ 0x2000a0c8
 *   g_2000a0d0                               @ 0x2000a0d0
 *   log_buffered_cnt                         @ 0x2000a0d8
 *   g_log_initialized_flag                   @ 0x2001d44c
 */
/* Reconstructed FUN_0004d7d8 @ 0x0004d7d8 (z_log_msg_post_finalize).
 * Exact configured Zephyr log_core.c static owner; extent 0xb0.
 */
extern int atomic_inc(int); /* atomic_inc */
extern _Bool z_spin_lock_valid(struct k_spinlock *);                 /* z_spin_lock_valid */
extern void z_spin_lock_set_owner(struct k_spinlock *);                 /* z_spin_lock_set_owner */
extern _Bool z_spin_unlock_valid(struct k_spinlock *);                 /* z_spin_unlock_valid */
extern void z_impl_k_timer_start(void *, uint32_t, uint32_t, uint32_t); /* k_timer_start */
extern void z_impl_k_timer_stop(struct k_timer *);                 /* k_timer_stop */
extern void k_sem_give(struct k_sem *);                 /* k_sem_give */

void z_log_msg_post_finalize(void)
{
    uint32_t previous = atomic_inc((volatile uint32_t *)((unsigned long)&log_buffered_cnt) /*=0x2000a0d8*/);
    if (*(volatile uint8_t *)((unsigned long)&g_log_initialized_flag) /*=0x2001d44c*/ != 0U) {
        /* The shipped k_spin_lock/unlock expansion surrounds log_process. */
        z_spin_lock_valid((void *)((unsigned long)&g_2000a0c8) /*=0x2000a0c8*/);
        z_spin_lock_set_owner((void *)((unsigned long)&g_2000a0c8) /*=0x2000a0c8*/);
        log_process();
        z_spin_unlock_valid((void *)((unsigned long)&g_2000a0c8) /*=0x2000a0c8*/);
        return;
    }
    if (*(volatile uintptr_t *)((unsigned long)&g_2000a0d0) /*=0x2000a0d0*/ == 0U)
        return;
    if (previous == 0U) {
        z_impl_k_timer_start((void *)((unsigned long)&g_200056a8) /*=0x200056a8*/, 0x8000U, 0U, 0U);
    } else if (previous == 9U) {
        z_impl_k_timer_stop((void *)((unsigned long)&g_200056a8) /*=0x200056a8*/);
        k_sem_give((void *)((unsigned long)&g_200039f8) /*=0x200039f8*/);
    }
}

