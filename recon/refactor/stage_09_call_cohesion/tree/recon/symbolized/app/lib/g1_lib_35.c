/*
 * Cohesive translation unit for the `lib' module.
 *
 * GENERATED by recon/refactor/transforms/t04_cohesive_tu.py.  Do not
 * edit: a stage tree is regenerated, never hand-patched
 * (recon/refactor/README.md C4).
 *
 * The 4 functions below were 4 separate translation units until this
 * stage.  Each one's text is reproduced VERBATIM and in the order the
 * generated source list gave it, and they were CONSECUTIVE in that list.
 * They were proven able to share a translation unit: no symbol is
 * declared here with two types, no identifier has internal linkage in one
 * member and is named by another, and no local typedef, macro, struct tag
 * or enum constant of one member is visible to a member that names it.
 *
 * members, in link order:
 *   gpiote_pin_channel_get.c
 *   g1_recon_nrfx_gpiote_init.c
 *   gpiote_lock_release.c
 *   gpiote_channel_flag_alloc.c
 */
/* ---- gpiote_pin_channel_get.c ---- */
#include "g1_app_symbols.h"
#include "../../../headers/g1_log.h"
#include "../../../headers/g1_dedupe.h"
#include <stdint.h>
#include "../../../headers/g1_nrf_regs.h"
/* readable reconstruction; identity: FUN_000658e8 @ 0x000658e8
 * public-name: gpiote_pin_channel_get
 * durable-map: recon/catalogs/function_names_app.json
 * callees (readable <= raw @ address):
 *   get_pin_idx                              <= FUN_00065434 @ 0x00065434
 *   pin_in_use_by_te                         <= FUN_00065460 @ 0x00065460
 *   gpiote_pin_channel_get                   <= FUN_000658e8 @ 0x000658e8
 *   assert_post_action                       <= FUN_0007e2ec @ 0x0007e2ec
 *   printk                                   <= FUN_0007e2fa @ 0x0007e2fa
 * address symbols (name @ address):
 *   rodata_99cbd                             @ 0x00099cbd   [INLINED -- G6 literal batch]
 *   rodata_f6b00                             @ 0x000f6b00
 *   rodata_f6b7d                             @ 0x000f6b7d   [INLINED -- G6 literal batch]
 *   g_gpiote_cb                              @ 0x20002bc0
 */
/* Reconstructed FUN_000658e8 @ 0x658e8  (parity: 300/300 trials, PROVEN) */

extern unsigned long long get_pin_idx(unsigned int a);
extern int pin_in_use_by_te(void);
extern void assert_post_action(const char *, unsigned int);

unsigned int gpiote_pin_channel_get(unsigned int param_1, int param_2)
{
  int iVar1;
  unsigned int uVar2;
  unsigned long long uVar3;

  if (param_2 == 0) {
    G1_ASSERT_FAIL((((unsigned long)"ASSERTION FAIL [%s] @ %s:%d\n") /*=0x99cbd*/, ((unsigned long)"p_channel") /*=0xf6b7d*/, ((unsigned long)&rodata_f6b00) /*=0xf6b00*/, 0x265), (((unsigned long)&rodata_f6b00) /*=0xf6b00*/, 0x265));
  }
  iVar1 = pin_in_use_by_te();
  uVar2 = 0x0bad0004;
  if (iVar1 != 0) {
    uVar3 = get_pin_idx(param_1);
    uVar2 = 0x0bad0000;
    unsigned int lo = (unsigned int)uVar3;
    unsigned int hi = (unsigned int)(uVar3 >> 32);
    *(volatile unsigned char *)(unsigned long)hi = (unsigned char)((*(volatile unsigned short *)(((unsigned long)g_gpiote_cb) /*=0x20002bc0*/ + (unsigned long)(lo+8)*2)) >> 0xd);
  }
  return uVar2;
}

/* ---- g1_recon_nrfx_gpiote_init.c ---- */
/* readable reconstruction; identity: FUN_00065940 @ 0x00065940
 * public-name: g1_recon_nrfx_gpiote_init
 * durable-map: recon/catalogs/function_names_app.json
 * callees (readable <= raw @ address):
 *   arch_irq_enable                          <= FUN_000500ac @ 0x000500ac
 *   gpiote_in_event_reg_offset               <= FUN_000655ec @ 0x000655ec
 *   g1_recon_nrfx_gpiote_init                <= FUN_00065940 @ 0x00065940
 *   memset_bytes                             <= FUN_00086c78 @ 0x00086c78
 * address symbols (name @ address):
 *   g_gpiote_cb                              @ 0x20002bc0
 */
/* Reconstructed FUN_00065940 @ 0x65940  (parity: 300/300 trials, PROVEN) */
typedef unsigned int uint;
extern void arch_irq_enable(unsigned int);
extern int gpiote_in_event_reg_offset(uint32_t);
extern void memset_bytes(void*, int, int);
static uint32_t g1_recon_nrfx_gpiote_init(void){
  int iVar1=((unsigned long)g_gpiote_cb) /*=0x20002bc0*/;
  uint32_t uVar3=0x0bad0005;
  int iVar2=0;
  if(*(volatile uint8_t *)(((unsigned long)g_gpiote_cb) /*=0x20002bc0*/+0x78)==0){
    memset_bytes(((unsigned long)g_gpiote_cb) /*=0x20002bc0*/+0x10,0,0x60);
    uint uVar4=0;
    do{
      iVar2=gpiote_in_event_reg_offset(uVar4&0xff);
      if((iVar2-0x100U)>>2==0x1f){
        *(volatile uint32_t *)(iVar2+0x5000d000UL)=0;
      }
      iVar2=G1_NRF_GPIOTE0_S_BASE;
      uVar4=uVar4+1;
    }while(uVar4!=8);
    *(volatile uint32_t *)(0x5000d000UL+0x17c)=0;
    arch_irq_enable(0xd);
    *(volatile uint32_t *)(iVar2+0x304)=0x80000000;
    uVar3=0x0bad0000;
    *(volatile uint8_t *)(iVar1+0x78)=1;
    *(volatile uint32_t *)(iVar1+0x74)=1;
  }
  return uVar3;
}

/* ---- gpiote_lock_release.c ---- */
/* readable reconstruction; identity: FUN_000659cc @ 0x000659cc
 * public-name: gpiote_lock_release
 * durable-map: recon/catalogs/function_names_app.json
 * callees (readable <= raw @ address):
 *   nrfx_flag32_free                         <= FUN_00064ef8 @ 0x00064ef8
 *   gpiote_lock_release                      <= FUN_000659cc @ 0x000659cc
 * address symbols (name @ address):
 *   g_gpiote_lock                            @ 0x20002c30
 */
/* Reconstructed FUN_000659cc @ 0x659cc  (parity: 300/300 trials, PROVEN) */

extern void nrfx_flag32_free(unsigned int, unsigned int);
void gpiote_lock_release(unsigned int param_1)
{
    nrfx_flag32_free(((unsigned long)&g_gpiote_lock) /*=0x20002c30*/, param_1);
}

/* ---- gpiote_channel_flag_alloc.c ---- */
/* readable reconstruction; identity: FUN_000659d8 @ 0x000659d8
 * public-name: gpiote_channel_flag_alloc
 * durable-map: recon/catalogs/function_names_app.json
 * callees (readable <= raw @ address):
 *   nrfx_flag32_alloc                        <= FUN_00064eb8 @ 0x00064eb8
 *   gpiote_channel_flag_alloc                <= FUN_000659d8 @ 0x000659d8
 * address symbols (name @ address):
 *   g_gpiote_lock                            @ 0x20002c30
 */
/* Reconstructed FUN_000659d8 @ 0x659d8  (parity: 300/300 trials, PROVEN) */

extern void nrfx_flag32_alloc(unsigned int, unsigned int);
static void gpiote_channel_flag_alloc(unsigned int param_1)
{
    nrfx_flag32_alloc(((unsigned long)&g_gpiote_lock) /*=0x20002c30*/, param_1);
}

