/*
 * Cohesive translation unit for the `lib' module.
 *
 * GENERATED by recon/refactor/transforms/t04_cohesive_tu.py.  Do not
 * edit: a stage tree is regenerated, never hand-patched
 * (recon/refactor/README.md C4).
 *
 * The 4 functions below were 4 separate translation units until this
 * stage.  Each one's text is reproduced VERBATIM and in the order the
 * generated source list gave it, and they were CONSECUTIVE in that list.
 * They were proven able to share a translation unit: no symbol is
 * declared here with two types, no identifier has internal linkage in one
 * member and is named by another, and no local typedef, macro, struct tag
 * or enum constant of one member is visible to a member that names it.
 *
 * members, in link order:
 *   gpio_pin_configure_dt.c
 *   cjson_parse_string.c
 *   cjson_get_object_item.c
 *   cjson_print_string.c
 */

/* File-scope forward declarations for every struct/union tag this
 * unit names.  Without them a tag whose only appearance in a member
 * is inside a parameter list has PARAMETER-LIST scope, so two
 * textually IDENTICAL declarations in two members declare two
 * different incomplete types and the second is a conflicting
 * redeclaration (C11 6.2.1p7).  Incomplete-type forward
 * declarations emit no code. */
struct cjson_item_raw;
struct device;
struct output_buffer;
/* ---- gpio_pin_configure_dt.c ---- */
#include "g1_app_symbols.h"
/* readable reconstruction; identity: FUN_000639d4 @ 0x000639d4
 * public-name: gpio_pin_configure_dt
 * durable-map: recon/catalogs/function_names_app.json
 * callees (readable <= raw @ address):
 *   gpio_pin_configure_dt                    <= FUN_000639d4 @ 0x000639d4
 *   assert_post_action                       <= FUN_0007e2ec @ 0x0007e2ec
 *   printk                                   <= FUN_0007e2fa @ 0x0007e2fa
 *   z_device_is_ready                        <= FUN_0008638c @ 0x0008638c
 * address symbols (name @ address):
 *   rodata_99c53                             @ 0x00099c53
 *   rodata_99c84                             @ 0x00099c84   [INLINED -- G6 literal batch]
 *   rodata_99cbd                             @ 0x00099cbd   [INLINED -- G6 literal batch]
 *   rodata_99cda                             @ 0x00099cda   [INLINED -- G6 literal batch]
 *   rodata_99dad                             @ 0x00099dad   [INLINED -- G6 literal batch]
 *   rodata_99de0                             @ 0x00099de0   [INLINED -- G6 literal batch]
 *   rodata_99e1e                             @ 0x00099e1e   [INLINED -- G6 literal batch]
 */
/* Reconstructed FUN_000639d4 @ 0x639d4  (parity: 300/300 trials, PROVEN) */

#include <stdint.h>
#include "../../../headers/g1_log.h"
typedef unsigned (*codep)(int,unsigned,unsigned);
extern void assert_post_action(const char *, unsigned int);
extern _Bool z_device_is_ready(const struct device *);
static unsigned gpio_pin_configure_dt(int param_1){
  unsigned char bVar1; int iVar2; unsigned uVar3; unsigned uVar4; unsigned *puVar5; unsigned uVar6; unsigned uVar7;
  puVar5 = *(unsigned **)(param_1 + 4);
  iVar2 = z_device_is_ready(*puVar5);
  if (iVar2 != 0) {
    if (puVar5[1] == 0) { return 0; }
    iVar2 = z_device_is_ready(puVar5[1]);
    if (iVar2 != 0) {
      uVar7 = (unsigned)*(unsigned short *)((int)puVar5 + 10);
      iVar2 = puVar5[1];
      bVar1 = *(unsigned char *)(puVar5 + 2);
      puVar5 = *(unsigned **)(iVar2 + 8);
      if ((uVar7 & 0x30) == 0x30) {
        printk(((unsigned long)"ASSERTION FAIL [%s] @ %s:%d\n") /*=0x99cbd*/,((unsigned long)"(flags & ((1 << 4) | (1 << 5))) != ((1 << 4) | (1 << 5))") /*=0x99c84*/,((unsigned long)&rodata_99c53) /*=0x99c53*/,0x3ca);
        printk(((unsigned long)"\tPull Up and Pull Down should not be enabled simultaneously\n") /*=0x99cda*/);
        uVar3 = 0x3ca;
      } else if ((uVar7 & 6) == 4) {
        printk(((unsigned long)"ASSERTION FAIL [%s] @ %s:%d\n") /*=0x99cbd*/,((unsigned long)"(flags & (1 << 1)) != 0 || (flags & (1 << 2)) == 0") /*=0x99dad*/,((unsigned long)&rodata_99c53) /*=0x99c53*/,0x3d1);
        uVar3 = 0x3d1;
      } else {
        uVar6 = 1u << (unsigned)bVar1;
        if ((uVar6 & **(unsigned **)(iVar2 + 4)) != 0) {
          uVar4 = **(unsigned **)(iVar2 + 0x10);
          if ((int)(uVar7 << 0x1f) < 0) { uVar4 = uVar4 | uVar6; }
          else { uVar4 = uVar4 & ~uVar6; }
          **(unsigned **)(iVar2 + 0x10) = uVar4;
          uVar3 = ((codep)*puVar5)(iVar2,(unsigned)bVar1,uVar7 | 0x400);
          return uVar3;
        }
        printk(((unsigned long)"ASSERTION FAIL [%s] @ %s:%d\n") /*=0x99cbd*/,((unsigned long)"(cfg->port_pin_mask & (gpio_port_pins_t)(1UL << (pin))) != 0U") /*=0x99de0*/,((unsigned long)&rodata_99c53) /*=0x99c53*/,0x3e4);
        printk(((unsigned long)"\tUnsupported pin\n") /*=0x99e1e*/);
        uVar3 = 0x3e4;
      }
      assert_post_action(((unsigned long)&rodata_99c53) /*=0x99c53*/,uVar3);
    }
  }
  return 0xffffffed;
}

/* ---- cjson_parse_string.c ---- */
/* readable reconstruction; identity: FUN_00064290 @ 0x00064290
 * public-name: cjson_parse_string
 * durable-map: recon/catalogs/function_names_app.json
 * callees (readable <= raw @ address):
 *   cjson_parse_string                       <= FUN_00064290 @ 0x00064290
 *   hex4_to_uint                             <= FUN_00084e9a @ 0x00084e9a
 * address symbols (name @ address):
 *   rodata_10000                             @ 0x00010000
 */
/* Reconstructed FUN_00064290 @ 0x64290  (parity: 300/300 trials, PROVEN) */
extern unsigned int hex4_to_uint(void *a0);

int cjson_parse_string(int param_1, int *param_2)
{
    int iVar5, iVar8, iVar9;
    unsigned char *pbVar10, *pbVar11, *pbVar12, *pbVar6, *pbVar2;
    unsigned char bVar1, bVar7;
    unsigned int uVar2, uVar3;
    typedef unsigned char* (*fp1_t)(int);
    typedef void (*fp2_t)(unsigned char*);

    iVar5 = param_2[0];
    iVar8 = param_2[2];
    pbVar10 = (unsigned char*)(iVar8 + 1 + iVar5);
    pbVar2 = (unsigned char*)0;
    if (*(char*)(iVar5 + iVar8) == '"') {
        iVar9 = 0;
        for (pbVar11 = pbVar10; (unsigned int)((int)pbVar11 - iVar5) < (unsigned int)param_2[1]; pbVar11 = pbVar11 + 1) {
            if (*pbVar11 == 0x22) {
                fp1_t f4 = (fp1_t)param_2[4];
                pbVar12 = f4((int)(pbVar11 + ((1 - iVar9) - (iVar5 + iVar8))));
                pbVar2 = pbVar12;
                if (pbVar12 != (unsigned char*)0) goto LAB_642d6;
                break;
            }
            if (*pbVar11 == 0x5c) {
                pbVar11 = pbVar11 + 1;
                if ((unsigned int)param_2[1] <= (unsigned int)((int)pbVar11 - iVar5)) break;
                iVar9 = iVar9 + 1;
            }
        }
        goto LAB_end;
LAB_642d6:
        while (1) {
            if (pbVar11 <= pbVar10) {
                *pbVar12 = 0;
                *(volatile int *)(param_1 + 0xc) = 0x10;
                *(volatile unsigned char**)(param_1 + 0x10) = pbVar2;
                param_2[2] = (int)(pbVar11 + (1 - param_2[0]));
                return 1;
            }
            bVar7 = *pbVar10;
            if (bVar7 == 0x5c) {
                bVar7 = pbVar10[1];
                if (bVar7 > 0x75) goto esc_default;
                if (bVar7 < 0x6e) {
                    if (bVar7 == 0x62) { bVar7 = 8; }
                    else if (bVar7 < 99) {
                        if ((bVar7 != 0x2f) && (bVar7 != 0x5c) && (bVar7 != 0x22)) goto esc_default;
                    } else {
                        if (bVar7 != 0x66) goto esc_default;
                        bVar7 = 0xc;
                    }
                    goto esc_common;
                }
                switch (bVar7) {
                case 0x6e: bVar7 = 10; goto esc_common;
                case 0x72: bVar7 = 0xd; goto esc_common;
                case 0x74: bVar7 = 9; goto esc_common;
                case 0x75: {
                    if (((int)pbVar11 - (int)pbVar10 < 6) ||
                        (uVar2 = hex4_to_uint(pbVar10 + 2), (uVar2 - 0xdc00) < 0x400))
                        goto esc_default;
                    if ((uVar2 - 0xd800) < 0x400) {
                        if (((int)pbVar11 - (int)(pbVar10 + 6) < 6) || (pbVar10[6] != 0x5c) ||
                            (pbVar10[7] != 0x75) ||
                            (uVar3 = hex4_to_uint(pbVar10 + 8), (uVar3 - 0xdc00) > 0x3ff))
                            goto esc_default;
                        iVar5 = 0xc;
                        uVar2 = ((0x000ffc00 & (uVar2 << 10)) | (uVar3 & 0x3ff)) + ((unsigned long)&rodata_10000) /*=0x10000*/;
                        bVar1 = 0xf0; iVar8 = 4;
                    } else if (uVar2 < 0x80) {
                        iVar5 = 6; bVar1 = 0; iVar8 = 1;
                    } else if (uVar2 < 0x800) {
                        iVar5 = 6; bVar1 = 0xc0; iVar8 = 2;
                    } else {
                        if (0xffff < uVar2) {
                            if (uVar2 < 0x110000) {
                                iVar5 = 6; bVar1 = 0xf0; iVar8 = 4;
                            } else goto esc_default;
                        } else {
                            iVar5 = 6; bVar1 = 0xe0; iVar8 = 3;
                        }
                    }
                    for (pbVar6 = pbVar12 + ((iVar8 - 1U) & 0xff); bVar7 = (unsigned char)uVar2, pbVar12 != pbVar6; pbVar6 = pbVar6 - 1) {
                        *pbVar6 = (bVar7 & 0x3f) | 0x80;
                        uVar2 = uVar2 >> 6;
                    }
                    if (iVar8 == 1) { bVar7 = bVar7 & 0x7f; }
                    else { bVar7 = bVar7 | bVar1; }
                    pbVar6 = pbVar12 + iVar8;
                    pbVar10 = pbVar10 + iVar5;
                    goto store_common;
                }
                default:
esc_default:
                    {
                        fp2_t f5 = (fp2_t)param_2[5];
                        f5(pbVar2);
                    }
                    goto LAB_end;
                }
esc_common:
                pbVar6 = pbVar12 + 1;
                iVar5 = 2;
                pbVar10 = pbVar10 + iVar5;
store_common:
                *pbVar12 = bVar7;
                pbVar12 = pbVar6;
                continue;
            } else {
                pbVar10 = pbVar10 + 1;
                pbVar6 = pbVar12 + 1;
                *pbVar12 = bVar7;
                pbVar12 = pbVar6;
                continue;
            }
        }
    }
LAB_end:
    /* Raw 0x0006446c is this function's internal failure/cleanup island,
     * not a separately callable owner. All paths reaching LAB_end fail. */
    return 0;
}

/* ---- cjson_get_object_item.c ---- */
/* readable reconstruction; identity: FUN_0006447c @ 0x0006447c
 * public-name: cjson_get_object_item
 * durable-map: recon/catalogs/function_names_app.json
 * callees (readable <= raw @ address):
 *   strcmp                                   <= FUN_0000eefe @ 0x0000eefe
 * address symbols (name @ address):
 *   rodata_f8a6b                             @ 0x000f8a6b
 */
/* Reconstructed cJSON get_object_item @ 0x0006447c.
 * Raw/address back-map: FUN_0006447c / 0x0006447c.
 */

struct cjson_item_raw {
    struct cjson_item_raw *next;
    struct cjson_item_raw *previous;
    struct cjson_item_raw *child;
    int32_t type;
    char *value_string;
    int32_t value_integer;
    double value_double;
    char *name;
};

#define cjson_string_compare strcmp /*=0x0000eefe*/
extern int cjson_string_compare(const char *left, const char *right);

#define CJSON_CTYPE_TABLE \
    ((volatile const uint8_t *)((unsigned long)&rodata_f8a6b) /*=0xf8a6b*/) /*=0x000f8a6b*/

static __attribute__((always_inline)) inline uint8_t
cjson_ascii_tolower(uint8_t character)
{
    return ((CJSON_CTYPE_TABLE[character] & 3u) == 1u)
        ? (uint8_t)(character + 0x20u)
        : character;
}

static int cjson_case_insensitive_compare(const uint8_t *left,
                                          const uint8_t *right)
{
    if (left == 0 || right == 0) {
        return 1;
    }
    if (left == right) {
        return 0;
    }

    while (cjson_ascii_tolower(*left) == cjson_ascii_tolower(*right)) {
        if (*left == 0u) {
            return 0;
        }
        left++;
        right++;
    }

    return (int)cjson_ascii_tolower(*left) -
           (int)cjson_ascii_tolower(*right);
}

struct cjson_item_raw *cjson_get_object_item(
    const struct cjson_item_raw *object, const char *name,
    int32_t case_sensitive)
{
    struct cjson_item_raw *current;

    if (object == 0 || name == 0) {
        return 0;
    }

    current = object->child;
    if (case_sensitive != 0) {
        while (current != 0 && current->name != 0 &&
               cjson_string_compare(name, current->name) != 0) {
            current = current->next;
        }
    } else {
        while (current != 0 &&
               cjson_case_insensitive_compare(
                   (const uint8_t *)name,
                   (const uint8_t *)current->name) != 0) {
            current = current->next;
        }
    }

    if (current == 0 || current->name == 0) {
        return 0;
    }
    return current;
}

/* ---- cjson_print_string.c ---- */
/* readable reconstruction; identity: FUN_000644f8 @ 0x000644f8
 * public-name: cjson_print_string
 * durable-map: recon/catalogs/function_names_app.json
 * callees (readable <= raw @ address):
 *   cjson_print_string                       <= FUN_000644f8 @ 0x000644f8
 *   snprintf                                 <= FUN_00077914 @ 0x00077914
 *   growbuf_ensure_capacity                  <= FUN_00084f58 @ 0x00084f58
 *   memcpy                                   <= FUN_00086c04 @ 0x00086c04
 *   strncpy_zero_pad                         <= FUN_0008705a @ 0x0008705a
 * address symbols (name @ address):
 *   rodata_f696e                             @ 0x000f696e
 */
/* Full reconstruction FUN_000644f8 @ 0x644f8, exact 310-byte extent. */
#include <stddef.h>

struct output_buffer {
    uint8_t *begin;
    uint8_t *end;
    uint8_t *limit;
};

extern uint8_t *growbuf_ensure_capacity(struct output_buffer *, uint32_t);
extern void *memcpy(void *, const void *, size_t);
extern void strncpy_zero_pad(uint8_t *, const void *, size_t);
extern void snprintf(uint8_t *, size_t, uintptr_t);

int cjson_print_string(const uint8_t *text, struct output_buffer *out,
                 uint32_t unused)
{
    const uint8_t descriptor[3] = { 0x74, 0x69, 0x0f };
    (void)unused;

    if (out == NULL)
        return 0;

    if (text == NULL) {
        uint8_t *slot = growbuf_ensure_capacity(out, 3);
        if (slot == NULL)
            return 0;
        strncpy_zero_pad(slot, descriptor, (size_t)(out->end - out->limit));
        return 1;
    }

    size_t length = 0;
    size_t extra = 0;
    for (const uint8_t *p = text; *p != 0; ++p, ++length) {
        uint8_t c = *p;
        if (c < 8)
            extra += 5;
        else if (c <= 34) {
            if (((0x04000037u >> (uint8_t)(c - 8)) & 1u) != 0)
                extra += 1;
            else if (c <= 31)
                extra += 5;
        } else if (c == '\\') {
            extra += 1;
        }
    }

    size_t encoded_length = length + extra;
    uint8_t *slot = growbuf_ensure_capacity(out, encoded_length + 3);
    if (slot == NULL)
        return 0;

    slot[0] = '"';
    uint8_t *dst = slot + 1;
    if (extra == 0) {
        memcpy(dst, text, encoded_length);
        dst += encoded_length;
    } else {
        for (const uint8_t *p = text; *p != 0; ++p) {
            uint8_t c = *p;
            if (c >= 0x20 && c != '"' && c != '\\') {
                *dst++ = c;
                continue;
            }

            *dst++ = '\\';
            switch (c) {
            case '\b': *dst++ = 'b'; break;
            case '\t': *dst++ = 't'; break;
            case '\n': *dst++ = 'n'; break;
            case '\f': *dst++ = 'f'; break;
            case '\r': *dst++ = 'r'; break;
            case '"':
            case '\\': *dst++ = c; break;
            default:
                snprintf(dst, (size_t)(out->end - (dst - out->begin)),
                             ((unsigned long)&rodata_f696e) /*=0xf696e*/);
                dst += 5;
                break;
            }
        }
    }
    *dst++ = '"';
    *dst = 0;
    return 1;
}

