/*
 * Cohesive translation unit for the `lib' module.
 *
 * GENERATED by recon/refactor/transforms/t04_cohesive_tu.py.  Do not
 * edit: a stage tree is regenerated, never hand-patched
 * (recon/refactor/README.md C4).
 *
 * The 2 functions below were 2 separate translation units until this
 * stage.  Each one's text is reproduced VERBATIM and in the order the
 * generated source list gave it, and they were CONSECUTIVE in that list.
 * They were proven able to share a translation unit: no symbol is
 * declared here with two types, no identifier has internal linkage in one
 * member and is named by another, and no local typedef, macro, struct tag
 * or enum constant of one member is visible to a member that names it.
 *
 * members, in link order:
 *   sys_slist_find_and_remove_2.c
 *   atomic_clear_bit_0.c
 */

/* File-scope forward declarations for every struct/union tag this
 * unit names.  Without them a tag whose only appearance in a member
 * is inside a parameter list has PARAMETER-LIST scope, so two
 * textually IDENTICAL declarations in two members declare two
 * different incomplete types and the second is a conflicting
 * redeclaration (C11 6.2.1p7).  Incomplete-type forward
 * declarations emit no code. */
struct slist;
struct slist_node;
/* ---- sys_slist_find_and_remove_2.c ---- */
#include "g1_app_symbols.h"
/* readable reconstruction; identity: FUN_00081de2 @ 0x00081de2
 * public-name: sys_slist_find_and_remove_2
 * durable-map: recon/catalogs/function_names_app.json
 */
/* sys_slist_find_and_remove_2 @ 0x00081de2; raw FUN_00081de2.
 * Zephyr sys_slist_find_and_remove inline instance with discarded result. */
struct slist_node { struct slist_node *next; };
struct slist { struct slist_node *head; struct slist_node *tail; };
void sys_slist_find_and_remove_2(struct slist *list, struct slist_node *node)
{
    struct slist_node *previous = 0;
    struct slist_node *current = list->head;
    while (current != 0) {
        if (current == node) {
            struct slist_node *next = node->next;
            if (previous == 0) {
                list->head = next;
            } else {
                previous->next = next;
            }
            if (list->tail == node) {
                list->tail = previous ? previous : next;
            }
            node->next = 0;
            return;
        }
        previous = current;
        current = current->next;
    }
}

/* ---- atomic_clear_bit_0.c ---- */
/* readable reconstruction; identity: FUN_00081e14 @ 0x00081e14
 * public-name: atomic_clear_bit_0
 * durable-map: recon/catalogs/function_names_app.json
 */
/* Reconstructed atomic_clear_bit_0 @ 0x00081e14 (FUN_00081e14; CFG-verified). */
/* Pinned Zephyr 3.4.99 owner: include/zephyr/sys/atomic.h. */
#include <stdint.h>
void atomic_clear_bit_0(volatile int*target, int bit) { (void)__atomic_fetch_and(target, ~((int32_t)1 << bit), __ATOMIC_SEQ_CST); }

