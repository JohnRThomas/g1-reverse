/*
 * Cohesive translation unit for the `lib' module.
 *
 * GENERATED by recon/refactor/transforms/t04_cohesive_tu.py.  Do not
 * edit: a stage tree is regenerated, never hand-patched
 * (recon/refactor/README.md C4).
 *
 * The 6 functions below were 6 separate translation units until this
 * stage.  Each one's text is reproduced VERBATIM and in the order the
 * generated source list gave it, and they were CONSECUTIVE in that list.
 * They were proven able to share a translation unit: no symbol is
 * declared here with two types, no identifier has internal linkage in one
 * member and is named by another, and no local typedef, macro, struct tag
 * or enum constant of one member is visible to a member that names it.
 *
 * members, in link order:
 *   smp_alloc_pairing_keys.c
 *   smp_update_bond_flag.c
 *   bt_keys_pool_find_or_alloc.c
 *   net_buf_simple_pull_5f558.c
 *   net_buf_simple_pull_5f594.c
 *   qspi_get_zephyr_ret_code.c
 */
/* ---- smp_alloc_pairing_keys.c ---- */
#include "g1_app_symbols.h"
/* readable reconstruction; identity: FUN_0005e47c @ 0x0005e47c
 * public-name: smp_alloc_pairing_keys
 * durable-map: recon/catalogs/function_names_app.json
 * callees (readable <= raw @ address):
 *   bt_addr_le_str                           <= FUN_00052cdc @ 0x00052cdc
 *   smp_error                                <= FUN_0005dc2c @ 0x0005dc2c
 *   smp_alloc_pairing_keys                   <= FUN_0005e47c @ 0x0005e47c
 *   bt_keys_get_addr                         <= FUN_0005e6a8 @ 0x0005e6a8
 *   bt_keys_add_type                         <= FUN_0005e9a0 @ 0x0005e9a0
 *   bt_keys_clear                            <= FUN_0005ea18 @ 0x0005ea18
 *   atomic_test_bit                          <= FUN_00082ff6 @ 0x00082ff6
 *   smp_log_message                          <= FUN_00083074 @ 0x00083074
 *   smp_chan_lookup                          <= FUN_0008307a @ 0x0008307a
 * address symbols (name @ address):
 *   rodata_88180                             @ 0x00088180
 *   rodata_f4e60                             @ 0x000f4e60
 */
/* Reconstructed FUN_0005e47c @ 0x5e47c  (parity: 300/300 trials, PROVEN) */
#include <stdint.h>
#include "g1_lib.h"
#include "../../../headers/g1_log.h"
extern int bt_keys_get_addr(int,int);
extern int bt_keys_add_type(int,int);
extern int atomic_test_bit(int,int);
extern int smp_log_message(int,int,void*);
extern int smp_chan_lookup(void);

void smp_alloc_pairing_keys(int param_1)
{
    int iVar1;
    int iVar2;
    unsigned int uVar3;
    uint32_t *puVar4;
    unsigned char bVar6;
    int iVar7;
    uint32_t *puVar8;
    int iVar9;
    int local_28, local_24, uStack_20;
    short local_1c;
    uint32_t *puVar5;

    iVar1 = smp_chan_lookup();
    if (iVar1 == 0) return;
    iVar9 = iVar1 + 4;
    iVar2 = atomic_test_bit(iVar9, 3);
    if (iVar2 == 0) return;
    if (*(int *)(param_1 + 0xc0) != 0) {
        bt_keys_clear(*(int *)(param_1 + 0xc0));
    }
    iVar2 = bt_keys_get_addr(*(unsigned char *)(param_1 + 8), param_1 + 0x90);
    *(int *)(param_1 + 0xc0) = iVar2;
    if (iVar2 == 0) {
        uStack_20 = bt_addr_le_str(param_1 + 0x90);
        local_24 = ((unsigned long)&rodata_f4e60) /*=0xf4e60*/;
        local_1c = 0x200;
        local_28 = 0x01000003;
        smp_log_message(((unsigned long)&rodata_88180) /*=0x88180*/, 0x1c40, &local_28);
        smp_error(iVar1, 8);
        return;
    }
    iVar2 = atomic_test_bit(iVar9, 0xe);
    if (iVar2 != 0) {
        *(unsigned char *)(*(int *)(param_1 + 0xc0) + 0xd) = *(unsigned char *)(*(int *)(param_1 + 0xc0) + 0xd) | 2;
    }
    uVar3 = (unsigned int)*(unsigned char *)(iVar1 + 8);
    iVar2 = *(int *)(param_1 + 0xc0);
    if (uVar3 < 4) {
        if (uVar3 != 0) {
LAB_0005e512:
            iVar2 = *(int *)(param_1 + 0xc0);
            bVar6 = *(unsigned char *)(iVar2 + 0xd) | 1;
            goto LAB_0005e51c;
        }
    } else if (uVar3 - 5 < 2) {
        *(unsigned char *)(iVar2 + 0xd) = *(unsigned char *)(iVar2 + 0xd) | 0x20;
        goto LAB_0005e512;
    }
    *(unsigned char *)(iVar2 + 0xd) = *(unsigned char *)(iVar2 + 0xd) & 0xdf;
    iVar2 = *(int *)(param_1 + 0xc0);
    bVar6 = *(unsigned char *)(iVar2 + 0xd) & 0xfe;
LAB_0005e51c:
    *(unsigned char *)(iVar2 + 0xd) = bVar6;
    bVar6 = *(unsigned char *)(iVar1 + 0x14);
    if (*(unsigned char *)(iVar1 + 0xd) <= *(unsigned char *)(iVar1 + 0x14)) {
        bVar6 = *(unsigned char *)(iVar1 + 0xd);
    }
    *(unsigned char *)(*(int *)(param_1 + 0xc0) + 0xc) = bVar6;
    iVar2 = atomic_test_bit(iVar9, 5);
    iVar7 = *(int *)(param_1 + 0xc0);
    if (iVar2 == 0) {
        *(unsigned char *)(iVar7 + 0xd) = *(unsigned char *)(iVar7 + 0xd) & 0xef;
    } else {
        *(unsigned char *)(iVar7 + 0xd) = *(unsigned char *)(iVar7 + 0xd) | 0x10;
        iVar2 = atomic_test_bit(iVar9, 0xd);
        if (iVar2 != 0) {
            bt_keys_add_type(*(uint32_t *)(param_1 + 0xc0), 0x20);
            puVar4 = (uint32_t *)(iVar1 + 0x47);
            puVar8 = (uint32_t *)(*(int *)(param_1 + 0xc0) + 0x1a);
            do {
                puVar5 = puVar4 + 1;
                *puVar8 = *puVar4;
                puVar4 = puVar5;
                puVar8 = puVar8 + 1;
            } while (puVar5 != (uint32_t *)(iVar1 + 0x57));
            iVar1 = *(int *)(param_1 + 0xc0);
            *(uint32_t *)(iVar1 + 0x10) = 0;
            *(uint32_t *)(iVar1 + 0x14) = 0;
            *(unsigned short *)(*(int *)(param_1 + 0xc0) + 0x18) = 0;
        }
    }
    return;
}

/* ---- smp_update_bond_flag.c ---- */
/* readable reconstruction; identity: FUN_0005e5b8 @ 0x0005e5b8
 * public-name: smp_update_bond_flag
 * durable-map: recon/catalogs/function_names_app.json
 * callees (readable <= raw @ address):
 *   bt_pub_key_gen                           <= FUN_00055d08 @ 0x00055d08
 *   smp_update_bond_flag                     <= FUN_0005e5b8 @ 0x0005e5b8
 * address symbols (name @ address):
 *   g_ble_dev_state                          @ 0x20002000
 *   g_bt_smp_settings_load_cb                @ 0x20002a50
 *   g_bt_settings_load_done                  @ 0x2001d532
 */
/* Reconstructed FUN_0005e5b8 @ 0x5e5b8  (parity: 300/300 trials, PROVEN) */

extern void bt_pub_key_gen(unsigned int);
static unsigned int smp_update_bond_flag(void)
{
  unsigned int uVar1;
  uVar1 = ((unsigned long)&g_bt_smp_settings_load_cb) /*=0x20002a50*/;
  *(volatile unsigned char *)((unsigned long)&g_bt_settings_load_done) /*=0x2001d532*/ = ((*(volatile unsigned char *)(((unsigned long)&g_ble_dev_state) /*=0x20002000*/ + 0xa2)) & 6) == 6;
  bt_pub_key_gen(uVar1);
  return 0;
}

/* ---- bt_keys_pool_find_or_alloc.c ---- */
/* readable reconstruction; identity: FUN_0005e614 @ 0x0005e614
 * public-name: bt_keys_pool_find_or_alloc
 * durable-map: recon/catalogs/function_names_app.json
 * callees (readable <= raw @ address):
 *   bt_keys_pool_find_or_alloc               <= FUN_0005e614 @ 0x0005e614
 *   memcmp                                   <= FUN_00086be4 @ 0x00086be4
 * address symbols (name @ address):
 *   rodata_f2b3a                             @ 0x000f2b3a
 *   bt_keys_pool                             @ 0x2000af4c
 *   g_bt_keys_pool_entry0_addr               @ 0x2000af4d
 *   g_bt_keys_pool_entry1_addr               @ 0x2000afa9
 */
/* Reconstructed FUN_0005e614 @ 0x5e614  (parity: 300/300 trials, PROVEN) */

extern int memcmp(int,...);
static unsigned char* bt_keys_pool_find_or_alloc(unsigned param_1, unsigned *param_2, unsigned p3, unsigned p4){
  volatile unsigned char *pbVar1=(volatile unsigned char*)((unsigned long)&bt_keys_pool) /*=0x2000af4c*/;
  int iVar2;
  if(*pbVar1==param_1){
    iVar2=memcmp((int)(pbVar1+1),(int)param_2,7,(unsigned)*pbVar1,p4);
    if(iVar2==0) return (unsigned char*)pbVar1;
  }
  iVar2=memcmp(((unsigned long)&g_bt_keys_pool_entry0_addr) /*=0x2000af4d*/,((unsigned long)&rodata_f2b3a) /*=0xf2b3a*/,7);
  unsigned uVar4=(unsigned)pbVar1[0x5c];
  if(iVar2==0){
    if(uVar4==param_1){
      int iVar3=memcmp(((unsigned long)&g_bt_keys_pool_entry1_addr) /*=0x2000afa9*/,(int)param_2,7,uVar4,p4);
      if(iVar3==0) return (unsigned char*)(pbVar1+0x5c);
    }
    iVar2=0;
  } else {
    if(uVar4==param_1){
      iVar2=memcmp(((unsigned long)&g_bt_keys_pool_entry1_addr) /*=0x2000afa9*/,(int)param_2,7,uVar4,p4);
      if(iVar2==0) return (unsigned char*)(pbVar1+0x5c);
    }
    iVar2=memcmp(((unsigned long)&g_bt_keys_pool_entry1_addr) /*=0x2000afa9*/,((unsigned long)&rodata_f2b3a) /*=0xf2b3a*/,7);
    if(iVar2!=0) return (unsigned char*)0;
    iVar2=1;
  }
  iVar2=iVar2*0x5c;
  pbVar1[iVar2]=(unsigned char)param_1;
  *(volatile uint32_t *)(pbVar1+iVar2+1)=*param_2;
  *(volatile uint16_t *)(pbVar1+iVar2+5)=*(uint16_t*)((char*)param_2+4);
  pbVar1[iVar2+7]=*(uint8_t*)((char*)param_2+6);
  return (unsigned char*)(pbVar1+iVar2);
}

/* ---- net_buf_simple_pull_5f558.c ---- */
/* readable reconstruction; identity: FUN_0005f558 @ 0x0005f558
 * public-name: net_buf_simple_pull_5f558
 * durable-map: recon/catalogs/function_names_app.json
 * callees (readable <= raw @ address):
 *   net_buf_simple_pull_5f558                <= FUN_0005f558 @ 0x0005f558
 *   assert_post_action                       <= FUN_0007e2ec @ 0x0007e2ec
 *   printk                                   <= FUN_0007e2fa @ 0x0007e2fa
 * address symbols (name @ address):
 *   rodata_99cbd                             @ 0x00099cbd   [INLINED -- G6 literal batch]
 *   rodata_f543a                             @ 0x000f543a   [INLINED -- G6 literal batch]
 *   rodata_f5474                             @ 0x000f5474   [INLINED -- G6 literal batch]
 */
/* Reconstructed FUN_0005f558 @ 0x5f558  (parity: 300/300 trials, PROVEN) */

extern unsigned long long assert_post_action(unsigned int, unsigned int);

void net_buf_simple_pull_5f558(int *param_1, unsigned int param_2, unsigned int param_3, unsigned int param_4)
{
    unsigned short ushort_val = *(unsigned short*)((char*)param_1 + 4);
    if (ushort_val < param_2) {
        printk(((unsigned long)"ASSERTION FAIL [%s] @ %s:%d\n") /*=0x99cbd*/, ((unsigned long)"buf->len >= len") /*=0xf5474*/, ((unsigned long)"WEST_TOPDIR/zephyr/subsys/net/buf_simple.c") /*=0xf543a*/, 0x18dU, param_4);
        unsigned long long rv = assert_post_action(((unsigned long)"WEST_TOPDIR/zephyr/subsys/net/buf_simple.c") /*=0xf543a*/, 0x18dU);
        unsigned int r0v = (unsigned int)rv;
        unsigned int r1v = (unsigned int)(rv >> 32);
        unsigned int r2v = ((unsigned long)"WEST_TOPDIR/zephyr/subsys/net/buf_simple.c") /*=0xf543a*/ - r1v;
        *(volatile unsigned short *)(r0v + 4) = (unsigned short)r2v;
        unsigned int memv = *(volatile unsigned int *)r0v;
        unsigned int finalv = memv + r1v;
        *(volatile unsigned int *)0x18dUL = finalv;
        return;
    }
    *(unsigned short*)((char*)param_1 + 4) = (unsigned short)(ushort_val - param_2);
    *param_1 = *param_1 + param_2;
    return;
}

/* ---- net_buf_simple_pull_5f594.c ---- */
/* readable reconstruction; identity: FUN_0005f594 @ 0x0005f594
 * public-name: net_buf_simple_pull_5f594
 * durable-map: recon/catalogs/function_names_app.json
 * callees (readable <= raw @ address):
 *   net_buf_simple_pull_5f594                <= FUN_0005f594 @ 0x0005f594
 *   assert_post_action                       <= FUN_0007e2ec @ 0x0007e2ec
 *   printk                                   <= FUN_0007e2fa @ 0x0007e2fa
 * address symbols (name @ address):
 *   rodata_99cbd                             @ 0x00099cbd   [INLINED -- G6 literal batch]
 *   rodata_f543a                             @ 0x000f543a   [INLINED -- G6 literal batch]
 *   rodata_f5474                             @ 0x000f5474   [INLINED -- G6 literal batch]
 */
/* Reconstructed FUN_0005f594 @ 0x5f594  (parity: 300/300 trials, PROVEN) */


void net_buf_simple_pull_5f594(int *param_1, unsigned int param_2, unsigned int param_3, unsigned int param_4)
{
    unsigned short ushort_val = *(unsigned short*)((char*)param_1 + 4);
    unsigned int loaded = *(unsigned int*)param_1;
    if (ushort_val < param_2) {
        printk(((unsigned long)"ASSERTION FAIL [%s] @ %s:%d\n") /*=0x99cbd*/, ((unsigned long)"buf->len >= len") /*=0xf5474*/, ((unsigned long)"WEST_TOPDIR/zephyr/subsys/net/buf_simple.c") /*=0xf543a*/, 0x199U, param_4);
        unsigned long long rv = assert_post_action(((unsigned long)"WEST_TOPDIR/zephyr/subsys/net/buf_simple.c") /*=0xf543a*/, 0x199U);
        unsigned int r0v = (unsigned int)rv;
        unsigned int r1v = (unsigned int)(rv >> 32);
        unsigned int r2v = ((unsigned long)"WEST_TOPDIR/zephyr/subsys/net/buf_simple.c") /*=0xf543a*/ - r1v;
        unsigned int r1final = r1v + r0v;
        *(volatile unsigned short *)0x19dUL = (unsigned short)r2v;
        *(volatile unsigned int *)0x199UL = r1final;
        return;
    }
    *(unsigned short*)((char*)param_1 + 4) = (unsigned short)(ushort_val - param_2);
    *param_1 = param_2 + loaded;
    return;
}

/* ---- qspi_get_zephyr_ret_code.c ---- */
/* readable reconstruction; identity: FUN_00060990 @ 0x00060990
 * public-name: qspi_get_zephyr_ret_code
 * durable-map: recon/catalogs/function_names_app.json
 */
/* Reconstructed qspi_get_zephyr_ret_code @ 0x60990  (CFG-directed candidate) */
int qspi_get_zephyr_ret_code(int result) { static const int16_t zephyr_errors[11] = {0,-16,-16,-16,-22,-140,-16,-16,-16,-16,-22}; uint32_t index=result-0x0bad0000u; return index <= 10u ? zephyr_errors[index] : -16; }

