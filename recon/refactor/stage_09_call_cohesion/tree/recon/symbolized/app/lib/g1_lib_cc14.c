/*
 * Call-cohesive translation unit for the `lib' module.
 *
 * GENERATED by recon/refactor/transforms/t09_call_cohesion.py.  Do
 * not edit: a stage tree is regenerated, never hand-patched
 * (recon/refactor/README.md C4).
 *
 * The 2 translation units below were grouped because they CALL ONE
 * ANOTHER, not because they were adjacent in the generated source
 * list.  Each member's text is reproduced VERBATIM.  Every member was
 * checked pairwise against every other member already in this unit by
 * stage 04's seven refusal rules, unchanged: no symbol is declared
 * here with two types, no identifier has internal linkage in one
 * member and is named by another, and no local typedef, macro, struct
 * tag or enum constant of one member is visible to a member that
 * names it.
 *
 * members, in generated-source-list order:
 *   g1_lib_48.c
 *   stdio_reset_ungetc_buffer.c
 *
 * call edges inside this unit (caller -> callee): 1
 *   g1_lib_48.c -> stdio_reset_ungetc_buffer.c
 */

/* File-scope forward declarations for every struct/union tag this
 * unit names.  Without them a tag whose only appearance in a member
 * is inside a parameter list has PARAMETER-LIST scope, so two
 * textually IDENTICAL declarations in two members declare two
 * different incomplete types and the second is a conflicting
 * redeclaration (C11 6.2.1p7).  Incomplete-type forward
 * declarations emit no code. */
struct gpio_dt_spec_recovered;
struct scan_conversion_state;
/* ================================================================ */
/* member unit: g1_lib_48.c */
/* ================================================================ */
/*
 * Cohesive translation unit for the `lib' module.
 *
 * GENERATED by recon/refactor/transforms/t04_cohesive_tu.py.  Do not
 * edit: a stage tree is regenerated, never hand-patched
 * (recon/refactor/README.md C4).
 *
 * The 12 functions below were 12 separate translation units until this
 * stage.  Each one's text is reproduced VERBATIM and in the order the
 * generated source list gave it, and they were CONSECUTIVE in that list.
 * They were proven able to share a translation unit: no symbol is
 * declared here with two types, no identifier has internal linkage in one
 * member and is named by another, and no local typedef, macro, struct tag
 * or enum constant of one member is visible to a member that names it.
 *
 * members, in link order:
 *   _isatty_r.c
 *   __malloc_lock.c
 *   __malloc_unlock.c
 *   i2b.c
 *   vfprintf_core.c
 *   vfprintf_field_scan_match.c
 *   write_r_capture_errno.c
 *   gpio_pin_set_dt.c
 *   atomic_and.c
 *   k_msleep_ticks32768_d.c
 *   k_uptime_get_32.c
 *   k_uptime_get_1.c
 */

/* File-scope forward declarations for every struct/union tag this
 * unit names.  Without them a tag whose only appearance in a member
 * is inside a parameter list has PARAMETER-LIST scope, so two
 * textually IDENTICAL declarations in two members declare two
 * different incomplete types and the second is a conflicting
 * redeclaration (C11 6.2.1p7).  Incomplete-type forward
 * declarations emit no code. */
struct gpio_dt_spec_recovered;
struct scan_conversion_state;
/* ---- _isatty_r.c ---- */
#include "g1_app_symbols.h"
/* readable reconstruction; identity: FUN_00078570 @ 0x00078570
 * public-name: _isatty_r
 * durable-map: recon/catalogs/function_names_app.json
 * callees (readable <= raw @ address):
 *   _isatty_r                                <= FUN_00078570 @ 0x00078570
 *   _isatty                                  <= FUN_000807de @ 0x000807de
 * address symbols (name @ address):
 *   g_errno                                  @ 0x2000cc24
 */
/* Reconstructed FUN_00078570 @ 0x78570  (parity: 300/300 trials, PROVEN) */

extern int _isatty(unsigned int);
void _isatty_r(int *param_1,unsigned int param_2)
{
  *(volatile int *)((unsigned long)&g_errno) /*=0x2000cc24*/ = 0;
  int iVar2 = _isatty(param_2);
  if (iVar2 == -1) {
    int v = *(volatile int *)((unsigned long)&g_errno) /*=0x2000cc24*/;
    if (v != 0) {
      *(volatile int *)param_1 = v;
    }
  }
}

/* ---- __malloc_lock.c ---- */
/* readable reconstruction; identity: FUN_000785bc @ 0x000785bc
 * public-name: __malloc_lock
 * durable-map: recon/catalogs/function_names_app.json
 * callees (readable <= raw @ address):
 *   g1_recon_retarget_lock_acquire_recursive <= FUN_000510fc @ 0x000510fc
 *   __malloc_lock                            <= FUN_000785bc @ 0x000785bc
 * address symbols (name @ address):
 *   g_malloc_lock                            @ 0x200037f0
 */
/* Reconstructed FUN_000785bc @ 0x785bc  (parity: 300/300 trials, PROVEN) */

#include <stdint.h>
#define g1_recon_retarget_lock_acquire_recursive g1_recon_retarget_lock_acquire_recursive
extern void g1_recon_retarget_lock_acquire_recursive(uint32_t); /* FUN_000510fc@0x000510fc */
void __malloc_lock(void) {
    g1_recon_retarget_lock_acquire_recursive(((unsigned long)&g_malloc_lock) /*=0x200037f0*/);
}

/* ---- __malloc_unlock.c ---- */
/* readable reconstruction; identity: FUN_000785c8 @ 0x000785c8
 * public-name: __malloc_unlock
 * durable-map: recon/catalogs/function_names_app.json
 * callees (readable <= raw @ address):
 *   g1_recon_retarget_lock_release_recursive <= FUN_00051134 @ 0x00051134
 *   __malloc_unlock                          <= FUN_000785c8 @ 0x000785c8
 * address symbols (name @ address):
 *   g_malloc_lock                            @ 0x200037f0
 */
/* Reconstructed FUN_000785c8 @ 0x785c8  (parity: 300/300 trials, PROVEN) */

#define g1_recon_retarget_lock_release_recursive g1_recon_retarget_lock_release_recursive
extern void g1_recon_retarget_lock_release_recursive(unsigned long); /* FUN_00051134@0x00051134 */
void __malloc_unlock(void)
{
    g1_recon_retarget_lock_release_recursive((void*)((unsigned long)&g_malloc_lock) /*=0x200037f0*/);
}

/* ---- i2b.c ---- */
/* readable reconstruction; identity: FUN_000787bc @ 0x000787bc
 * public-name: i2b
 * durable-map: recon/catalogs/function_names_app.json
 * callees (readable <= raw @ address):
 *   __assert_func                            <= FUN_00076a94 @ 0x00076a94
 *   Balloc                                   <= FUN_000785d4 @ 0x000785d4
 *   i2b                                      <= FUN_000787bc @ 0x000787bc
 * address symbols (name @ address):
 *   rodata_f8c42                             @ 0x000f8c42
 *   rodata_f8cd5                             @ 0x000f8cd5
 */
/* Reconstructed FUN_000787bc @ 0x787bc  (parity: 300/300 trials, PROVEN) */

extern int Balloc(int a, int b);
extern int __assert_func(int a, int b, int c, int d);
static void i2b(int param_1, int param_2)
{
  int iVar1;
  iVar1 = Balloc(param_1, 1);
  if (iVar1 == 0) {
    iVar1 = __assert_func(((unsigned long)&rodata_f8cd5) /*=0xf8cd5*/, 0x140, 0, ((unsigned long)&rodata_f8c42) /*=0xf8c42*/);
  }
  *(volatile int *)(iVar1 + 0x14) = param_2;
  *(volatile int *)(iVar1 + 0x10) = 1;
}

/* ---- vfprintf_core.c ---- */
/* readable reconstruction; identity: FUN_00078f88 @ 0x00078f88
 * public-name: vfprintf_core
 * durable-map: recon/catalogs/function_names_app.json
 * callees (readable <= raw @ address):
 *   vfprintf_core                            <= FUN_00078f88 @ 0x00078f88
 *   vfprintf_field_scan_match                <= FUN_00079278 @ 0x00079278
 *   scanf_convert_integer_field              <= FUN_0007932c @ 0x0007932c
 *   mem_find_byte                            <= FUN_00086bc8 @ 0x00086bc8
 *   stdio_reset_ungetc_buffer                <= FUN_00087862 @ 0x00087862
 *   fnmatch_build_class_table                <= FUN_0008789c @ 0x0008789c
 * address symbols (name @ address):
 *   rodata_79274                             @ 0x00079274
 *   rodata_877ed                             @ 0x000877ed
 *   ADDR_stdio_reset_ungetc_buffer_THUMB     @ 0x00087863
 *   rodata_f8a6b                             @ 0x000f8a6b
 *   rodata_f8b71                             @ 0x000f8b71
 */
/* Reconstructed FUN_00078f88 @ 0x78f88  (parity: 300/300 trials, PROVEN) */
typedef unsigned char byte;
typedef unsigned int uint;

static unsigned vfprintf_field_scan_match(int, unsigned *, int *, unsigned **);
extern int scanf_convert_integer_field(int, void*, void*, void*);
extern char* mem_find_byte(char*, unsigned int, int);
extern int stdio_reset_ungetc_buffer(int, unsigned int *);
extern unsigned char* fnmatch_build_class_table(int, unsigned char*);
typedef int (*fnptr)(int, void*);

int vfprintf_core(int param_1, int *param_2, byte *param_3, int *param_4)
{
  int iVar1 = ((unsigned long)&rodata_f8a6b) /*=0xf8a6b*/;
  int iVar2;
  int iVar3;
  uint uVar4, uVar5;
  byte *pbVar6;
  int *local_2a8;
  unsigned char auStack_2a4[256];
  struct scan_conversion_state {
    uint flags;
    int base;
    uint width;
    int assignments;
    int consumed;
    unsigned char *scratch;
    int kind;
  } state;
  int local_28;
  fnptr local_24;

  local_28 = ((unsigned long)&rodata_877ed) /*=0x877ed*/;
  local_24 = (fnptr)ADDR_stdio_reset_ungetc_buffer_THUMB /*=0x87863*/;
  local_2a8 = param_4;
  state.assignments = 0;
  state.consumed = 0;
  state.scratch = auStack_2a4;

LAB_00078fae:
  for (;;) {
    for (;;) {
      iVar2 = ((unsigned long)&rodata_f8b71) /*=0xf8b71*/;
      uVar5 = (uint)*param_3;
      if (uVar5 == 0) return state.assignments;
      pbVar6 = param_3 + 1;
      uVar4 = (*(volatile byte *)(iVar1 + uVar5)) & 8;
      if (uVar4 == 0) break;
      param_3 = pbVar6;
      while (1) {
        if (!(0 < (int)param_2[1] || (iVar2 = local_24(param_1, param_2), iVar2 == 0))) break;
        if (!((int)((uint)(*(volatile byte *)(iVar1 + (uint)*(byte*)*param_2)) << 0x1c) < 0)) break;
        state.consumed = state.consumed + 1;
        *param_2 = *param_2 + 1;
        param_2[1] = param_2[1] - 1;
      }
    }
    if (uVar5 == 0x25) break;
  LAB_00078ff8:
    if (((int)param_2[1] < 1) && (iVar2 = local_24(param_1, param_2), iVar2 != 0))
      goto LAB_00079138;
    if (*(byte*)*param_2 != uVar5) return state.assignments;
    *param_2 = *param_2 + 1;
    param_2[1] = param_2[1] - 1;
    state.consumed = state.consumed + 1;
    param_3 = pbVar6;
  }
  state.flags = uVar4;
  state.width = uVar4;
  if (param_3[1] == 0x2a) {
    state.flags = 0x10;
    pbVar6 = param_3 + 2;
  }
  for (;;) {
    uVar5 = (uint)*pbVar6;
    if (uVar5 - 0x30 > 9) break;
    state.width = (state.width * 10 + uVar5) - 0x30;
    pbVar6 = pbVar6 + 1;
  }
  iVar3 = mem_find_byte(((unsigned long)&rodata_f8b71) /*=0xf8b71*/, uVar5, 3);
  if (iVar3 != 0) {
    state.flags = (1 << ((iVar3 - iVar2) & 0xffU)) | state.flags;
    pbVar6 = pbVar6 + 1;
  }
  param_3 = pbVar6 + 1;
  uVar5 = (uint)*pbVar6;

  if (uVar5 < 0x79) {
    if (0x57 < uVar5) {
      switch (uVar5) {
        case 0x58: case 0x78:
          state.flags |= 0x200; state.base = 0x10;
          goto SET_UO;
        case 0x5b:
          param_3 = (byte*)fnmatch_build_class_table(auStack_2a4, param_3);
          state.flags |= 0x40; state.kind = 1;
          break;
        case 0x63:
          state.flags |= 0x40; state.kind = 0;
          break;
        case 0x64: case 0x75:
          state.base = 10;
        SET_UO:
          if (uVar5 > 0x6e) { state.kind = 4; break; }
          state.kind = 3;
          break;
        case 0x65: case 0x66: case 0x67:
          state.kind = 5;
          break;
        case 0x69:
          state.base = 0;
          state.kind = 3;
          break;
        case 0x6e:
          if (-1 < (int)(state.flags << 0x1b)) {
            if ((state.flags & 1) == 0) {
              *(volatile int *)*local_2a8 = state.consumed;
              local_2a8 = local_2a8 + 1;
            } else {
              *(volatile short *)*local_2a8 = (short)state.consumed;
              local_2a8 = local_2a8 + 1;
            }
          }
          goto LAB_00078fae;
        case 0x6f:
          state.base = 8; state.kind = 4;
          break;
        case 0x70:
          state.flags |= 0x220; state.base = 0x10; state.kind = 4;
          break;
        case 0x73:
          state.kind = 2;
          break;
        default:
          state.kind = 3; state.base = 10;
          break;
      }
    } else {
      pbVar6 = param_3;
      if (uVar5 == 0x25) goto LAB_00078ff8;
      if (uVar5 < 0x26) {
        if (uVar5 != 0) { state.kind = 3; state.base = 10; goto LAB_00079156; }
        goto LAB_00079140;
      }
      if (uVar5 - 0x45 < 3) { state.kind = 5; goto LAB_00079156; }
      state.kind = 3; state.base = 10;
    }
  } else {
    state.kind = 3; state.base = 10;
  }

LAB_00079156:
  if (((int)param_2[1] < 1) && (iVar2 = local_24(param_1, param_2), iVar2 != 0))
    goto LAB_00079138;
  if (-1 < (int)(state.flags << 0x19)) {
    while ((int)((uint)(*(volatile byte *)(iVar1 + (uint)*(byte*)*param_2)) << 0x1c) < 0) {
      state.consumed = state.consumed + 1;
      iVar2 = param_2[1];
      param_2[1] = iVar2 - 1;
      if (iVar2 - 1 < 1) {
        iVar2 = local_24(param_1, param_2);
        if (iVar2 != 0) goto LAB_00079138;
      } else {
        *param_2 = *param_2 + 1;
      }
    }
  }
  if (state.kind < 3) {
    iVar2 = vfprintf_field_scan_match(param_1, &state, param_2, &local_2a8);
  } else if (state.kind < 5) {
    iVar2 = scanf_convert_integer_field(param_1, &state, param_2, &local_2a8);
  } else {
    iVar2 = param_1;
    if (*(volatile unsigned int *)((unsigned long)&rodata_79274) /*=0x79274*/ == 0) goto LAB_00078fae;
  }
  if (iVar2 == 1) return state.assignments;
  if (iVar2 == 2) {
  LAB_00079138:
    if ((state.assignments == 0) || ((int)((uint)*(unsigned short*)(param_2 + 3) << 0x19) < 0)) {
    LAB_00079140:
      state.assignments = -1;
    }
    return state.assignments;
  }
  goto LAB_00078fae;
}

/* ---- vfprintf_field_scan_match.c ---- */
/* readable reconstruction; identity: FUN_00079278 @ 0x00079278
 * public-name: vfprintf_field_scan_match
 * durable-map: recon/catalogs/function_names_app.json
 * callees (readable <= raw @ address):
 *   vfprintf_field_scan_match                <= FUN_00079278 @ 0x00079278
 * address symbols (name @ address):
 *   rodata_f8a6b                             @ 0x000f8a6b
 */
/* Reconstructed FUN_00079278 @ 0x79278  (parity: 200/200 trials, PROVEN) */

typedef int (*codep)(int,int*,unsigned,void*,unsigned**);
static unsigned vfprintf_field_scan_match(int param_1,unsigned *param_2,int *param_3,unsigned **param_4){
  int iVar1; unsigned uVar2; unsigned *puVar3; int iVar4; unsigned char *unaff_r6; unsigned char *puVar5; int iVar6;
  if (param_2[2] == 0) {
    if (param_2[6] == 0) { uVar2 = 1; } else { uVar2 = 0xffffffff; }
    param_2[2] = uVar2;
  }
  iVar1 = ((unsigned long)&rodata_f8a6b) /*=0xf8a6b*/;
  iVar6 = 0;
  if (-1 < (int)(*param_2 << 0x1b)) {
    puVar3 = (unsigned *)*param_4;
    *param_4 = puVar3 + 1;
    unaff_r6 = (unsigned char *)*puVar3;
  }
  do {
    uVar2 = param_2[6];
    if (uVar2 != 0) {
      if (uVar2 == 1) {
        if (*(char *)(param_2[5] + (unsigned)*(unsigned char *)*param_3) == 0) {
          if (iVar6 == 0) { return 1; }
LAB_00079306:
          if (((*param_2 & 0x10) == 0) && (param_2[3] = param_2[3] + 1, param_2[6] != 0)) {
            *unaff_r6 = 0;
          }
          param_2[4] = param_2[4] + iVar6;
          return 0;
        }
      } else if ((uVar2 != 2) || ((int)((unsigned)*(unsigned char *)(iVar1 + (unsigned)*(unsigned char *)*param_3) << 0x1c) < 0)) goto LAB_00079306;
    }
    iVar6 = iVar6 + 1;
    puVar5 = unaff_r6;
    if (-1 < (int)(*param_2 << 0x1b)) {
      puVar5 = unaff_r6 + 1;
      *unaff_r6 = *(unsigned char *)*param_3;
    }
    iVar4 = param_3[1];
    *param_3 = *param_3 + 1;
    uVar2 = param_2[2];
    param_3[1] = iVar4 + -1;
    uVar2 = uVar2 - 1;
    param_2[2] = uVar2;
    unaff_r6 = puVar5;
    if ((uVar2 == 0) ||
       ((iVar4 + -1 < 1 &&
        (iVar4 = ((codep)param_2[0x60])(param_1,param_3,uVar2,(void*)param_2[0x60],param_4),
        iVar4 != 0)))) goto LAB_00079306;
  } while(1);
}

/* ---- write_r_capture_errno.c ---- */
/* readable reconstruction; identity: FUN_00079528 @ 0x00079528
 * public-name: write_r_capture_errno
 * durable-map: recon/catalogs/function_names_app.json
 * callees (readable <= raw @ address):
 *   read                                     <= FUN_0004b088 @ 0x0004b088
 *   write_r_capture_errno                    <= FUN_00079528 @ 0x00079528
 * address symbols (name @ address):
 *   g_errno                                  @ 0x2000cc24
 */
/* Reconstructed FUN_00079528 @ 0x79528  (parity: 300/300 trials, PROVEN) */

extern int read(unsigned int,unsigned int,unsigned int,unsigned int,unsigned int);
static void write_r_capture_errno(int *param_1,unsigned int param_2,unsigned int param_3,unsigned int param_4)
{
  int *piVar1;
  int iVar2;
  piVar1 = (int*)((unsigned long)&g_errno) /*=0x2000cc24*/;
  *(volatile int *)((unsigned long)&g_errno) /*=0x2000cc24*/ = 0;
  iVar2 = read(param_2,param_3,param_4,param_4,param_4);
  if ((iVar2 == -1) && (*(volatile int *)piVar1 != 0)) {
    *param_1 = *(volatile int *)piVar1;
  }
  return;
}

/* ---- gpio_pin_set_dt.c ---- */
/* readable reconstruction; identity: FUN_0007c084 @ 0x0007c084
 * public-name: gpio_pin_set_dt
 * durable-map: recon/catalogs/function_names_app.json
 * callees (readable <= raw @ address):
 *   gpio_pin_set_checked                     <= FUN_00017768 @ 0x00017768
 *   gpio_pin_set_dt                          <= FUN_0007c084 @ 0x0007c084
 */
/* Reconstructed FUN_0007c084 @ 0x7c084 (CFG-directed: 80/80 PASS).
 * Exact out-of-line instance of Zephyr's gpio_pin_set_dt() inline contract.
 */

struct gpio_dt_spec_recovered {
    const void *port;
    uint8_t pin;
};

extern int gpio_pin_set_checked(const void *port, uint32_t pin, int value);

int gpio_pin_set_dt(const struct gpio_dt_spec_recovered *spec, int value)
{
    return gpio_pin_set_checked(spec->port, spec->pin, value);
}

/* ---- atomic_and.c ---- */
/* readable reconstruction; identity: FUN_0007c08e @ 0x0007c08e
 * public-name: atomic_and
 * durable-map: recon/catalogs/function_names_app.json
 */
/* Reconstructed atomic_and @ 0x0007c08e (FUN_0007c08e; CFG-verified). */
/* Pinned Zephyr 3.4.99 owner: include/zephyr/sys/atomic_builtin.h. */
int32_t atomic_and(volatile int32_t *target, int32_t value)
{
    return __atomic_fetch_and(target, value, __ATOMIC_SEQ_CST);
}

/* ---- k_msleep_ticks32768_d.c ---- */
/* readable reconstruction; identity: FUN_0007c0a8 @ 0x0007c0a8
 * public-name: k_msleep_ticks32768_d
 * durable-map: recon/catalogs/function_names_app.json
 * callees (readable <= raw @ address):
 *   __aeabi_uldivmod                         <= FUN_0000e244 @ 0x0000e244
 *   k_msleep_ticks32768_d                    <= FUN_0007c0a8 @ 0x0007c0a8
 */
/* Reconstructed FUN_0007c0a8 @ 0x7c0a8  (parity: 300/300 trials, PROVEN) */

extern void __aeabi_uldivmod(int,int,int,int);
extern void wait_for_event(void);
void k_msleep_ticks32768_d(int param_1)
{
  __aeabi_uldivmod(param_1 * 0x8000 + 999, param_1 >> 0x11, 1000, 0);
  wait_for_event();
  return;
}

/* ---- k_uptime_get_32.c ---- */
/* readable reconstruction; identity: FUN_0007c0c8 @ 0x0007c0c8
 * public-name: k_uptime_get_32
 * durable-map: recon/catalogs/function_names_app.json
 */
/* Reconstructed k_uptime_get_32 @ 0x0007c0c8 from Zephyr kernel.h.
 * Raw backmap: FUN_0007c0c8@0x0007c0c8. */

#include "g1_lib.h"
unsigned int k_uptime_get_32(void) { return (uint32_t)((uptime_ticks_get()*UINT64_C(1000))>>15); }

/* ---- k_uptime_get_1.c ---- */
/* readable reconstruction; identity: FUN_0007cb2c @ 0x0007cb2c
 * public-name: k_uptime_get_1
 * durable-map: recon/catalogs/function_names_app.json
 */
/* Reconstructed k_uptime_get_1 @ 0x7cb2c  (CFG-directed candidate) */
extern uint64_t thunk_FUN_00074f68(void);
uint64_t k_uptime_get_1(void) {
    return (thunk_FUN_00074f68() * UINT64_C(1000)) >> 15;
}

/* ================================================================ */
/* member unit: stdio_reset_ungetc_buffer.c */
/* ================================================================ */
#include "g1_app_symbols.h"
/* readable reconstruction; identity: FUN_00087862 @ 0x00087862
 * public-name: stdio_reset_ungetc_buffer
 * durable-map: recon/catalogs/function_names_app.json
 * callees (readable <= raw @ address):
 *   _free_r                                  <= FUN_00076d8c @ 0x00076d8c
 *   stdio_reset_ungetc_buffer                <= FUN_00087862 @ 0x00087862
 */
/* Reconstructed FUN_00087862 @ 0x87862  (parity: 300/300 trials, PROVEN) */

extern void _free_r(void);
int stdio_reset_ungetc_buffer(int param_1, unsigned int *param_2)
{
  if (param_2[0xd] != 0) {
    if (param_2[0xd] != (unsigned int)(param_2 + 0x11)) {
      _free_r();
    }
    param_2[0xd] = 0;
    param_2[1] = param_2[0x10];
    if (param_2[0x10] != 0) {
      *param_2 = param_2[0xf];
      return 0;
    }
  }
  *param_2 = param_2[4];
  param_2[1] = 0;
  *(unsigned short *)((char*)param_2 + 0xc) |= 0x20;
  return -1;
}

