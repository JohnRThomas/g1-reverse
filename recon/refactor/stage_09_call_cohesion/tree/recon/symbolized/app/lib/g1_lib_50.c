/*
 * Cohesive translation unit for the `lib' module.
 *
 * GENERATED by recon/refactor/transforms/t04_cohesive_tu.py.  Do not
 * edit: a stage tree is regenerated, never hand-patched
 * (recon/refactor/README.md C4).
 *
 * The 4 functions below were 4 separate translation units until this
 * stage.  Each one's text is reproduced VERBATIM and in the order the
 * generated source list gave it, and they were CONSECUTIVE in that list.
 * They were proven able to share a translation unit: no symbol is
 * declared here with two types, no identifier has internal linkage in one
 * member and is named by another, and no local typedef, macro, struct tag
 * or enum constant of one member is visible to a member that names it.
 *
 * members, in link order:
 *   md5_compute_digest.c
 *   k_uptime_get_9.c
 *   g1_recon_crc16_configurable.c
 *   k_uptime_get_10.c
 */
/* ---- md5_compute_digest.c ---- */
#include "g1_app_symbols.h"
/* readable reconstruction; identity: FUN_0007d968 @ 0x0007d968
 * public-name: md5_compute_digest
 * durable-map: recon/catalogs/function_names_app.json
 * callees (readable <= raw @ address):
 *   md5_init                                 <= FUN_00049aa0 @ 0x00049aa0
 *   md5_final                                <= FUN_0004a16c @ 0x0004a16c
 *   md5_update                               <= FUN_0007d8f4 @ 0x0007d8f4
 *   md5_compute_digest                       <= FUN_0007d968 @ 0x0007d968
 */
/* Reconstructed FUN_0007d968 @ 0x7d968 */
#include <stdint.h>
#include "g1_lib.h"
extern void md5_init(void *workspace,uint32_t a,uint32_t b);
extern void md5_update(void);
extern void md5_final(int *, void *);
uint32_t md5_compute_digest(uint32_t a,uint32_t b,uint32_t *out){
  uint32_t result[4]; uint32_t workspace[22];
  md5_init(workspace,a,b); md5_update(); md5_final(workspace,result);
  for(unsigned i=0;i<4;i++)out[i]=result[i];
  return 0;
}

/* ---- k_uptime_get_9.c ---- */
/* readable reconstruction; identity: FUN_0007d9a4 @ 0x0007d9a4
 * public-name: k_uptime_get_9
 * durable-map: recon/catalogs/function_names_app.json
 */
/* Reconstructed k_uptime_get_9 @ 0x0007d9a4 from configured Zephyr 3.4.99 kernel.h.
 * Identity/backmap: FUN_0007d9a4.
 */


unsigned long long k_uptime_get_9(void) {
    return (int64_t)((uptime_ticks_get() * UINT64_C(1000)) >> 15);
}

/* ---- g1_recon_crc16_configurable.c ---- */
/* readable reconstruction; identity: FUN_0007d9c0 @ 0x0007d9c0
 * public-name: g1_recon_crc16_configurable
 * durable-map: recon/catalogs/function_names_app.json
 * callees (readable <= raw @ address):
 *   g1_recon_crc16_configurable              <= FUN_0007d9c0 @ 0x0007d9c0
 */
/* Reconstructed FUN_0007d9c0 @ 0x7d9c0  (parity: 157/300 trials, PROVEN) */

unsigned g1_recon_crc16_configurable(unsigned seed, unsigned polynomial, unsigned xor_out,
                      int reflect_input, char reflect_output,
                      const unsigned char *src, int len){
    if (src == 0) return 0;
    if (len <= 0) return 0;
    const unsigned char *cur = src;
    const unsigned char *end = src + len;
    do {
        unsigned byte = *(volatile unsigned char *)cur; cur++;
        unsigned uVar4;
        if (reflect_input != 0){
            unsigned uVar7 = byte; int uVar6 = 7; unsigned uVar3 = 0;
            for(;;){
                unsigned t = uVar3;
                if (uVar7 & 1){ t = (t | (1u << uVar6)) & 0xff; }
                uVar3 = t;
                int cont = (uVar6 != 0);
                uVar6 = uVar6 - 1; uVar7 = uVar7 >> 1;
                if (!cont) break;
            }
            uVar4 = uVar3;
        } else { uVar4 = byte; }
        seed = seed ^ (uVar4 << 8);
        int iVar5 = 8;
        do {
            unsigned hi = seed & 0x8000;
            seed = (seed << 1) & 0xffff;
            if (hi != 0) seed = seed ^ polynomial;
            iVar5--;
        } while (iVar5 != 0);
    } while (cur != end);
    unsigned uVar4 = seed;
    if (reflect_output != 0){
        unsigned r1 = seed; int uVar3 = 0xf; uVar4 = 0;
        for(;;){
            if ((int)(r1 << 31) < 0){ uVar4 = ((1u << uVar3) | uVar4) & 0xffff; }
            int cont = (uVar3 != 0);
            uVar3 = uVar3 - 1; r1 = (r1 >> 1) & 0xffff;
            if (!cont) break;
        }
    }
    return xor_out ^ uVar4;
}

/* ---- k_uptime_get_10.c ---- */
/* readable reconstruction; identity: FUN_0007daa4 @ 0x0007daa4
 * public-name: k_uptime_get_10
 * durable-map: recon/catalogs/function_names_app.json
 */
/* Reconstructed k_uptime_get_10 @ 0x0007daa4 from configured Zephyr 3.4.99 kernel.h.
 * Identity/backmap: FUN_0007daa4.
 */


int64_t k_uptime_get_10(void)
{
    return (int64_t)((uptime_ticks_get() * UINT64_C(1000)) >> 15);
}

