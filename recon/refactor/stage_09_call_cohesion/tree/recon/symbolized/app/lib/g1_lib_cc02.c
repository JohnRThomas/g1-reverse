/*
 * Call-cohesive translation unit for the `lib' module.
 *
 * GENERATED by recon/refactor/transforms/t09_call_cohesion.py.  Do
 * not edit: a stage tree is regenerated, never hand-patched
 * (recon/refactor/README.md C4).
 *
 * The 2 translation units below were grouped because they CALL ONE
 * ANOTHER, not because they were adjacent in the generated source
 * list.  Each member's text is reproduced VERBATIM.  Every member was
 * checked pairwise against every other member already in this unit by
 * stage 04's seven refusal rules, unchanged: no symbol is declared
 * here with two types, no identifier has internal linkage in one
 * member and is named by another, and no local typedef, macro, struct
 * tag or enum constant of one member is visible to a member that
 * names it.
 *
 * members, in generated-source-list order:
 *   g1_lib_03.c
 *   g1_lib_68.c
 *
 * call edges inside this unit (caller -> callee): 1
 *   g1_lib_68.c -> g1_lib_03.c
 */

/* File-scope forward declarations for every struct/union tag this
 * unit names.  Without them a tag whose only appearance in a member
 * is inside a parameter list has PARAMETER-LIST scope, so two
 * textually IDENTICAL declarations in two members declare two
 * different incomplete types and the second is a conflicting
 * redeclaration (C11 6.2.1p7).  Incomplete-type forward
 * declarations emit no code. */
struct adc_api_raw;
struct device;
struct device_raw;
struct forwarding_packet;
struct k_sem;
struct request_log_record;
struct request_name_record;
/* ================================================================ */
/* member unit: g1_lib_03.c */
/* ================================================================ */
/*
 * Cohesive translation unit for the `lib' module.
 *
 * GENERATED by recon/refactor/transforms/t04_cohesive_tu.py.  Do not
 * edit: a stage tree is regenerated, never hand-patched
 * (recon/refactor/README.md C4).
 *
 * The 10 functions below were 10 separate translation units until this
 * stage.  Each one's text is reproduced VERBATIM and in the order the
 * generated source list gave it, and they were CONSECUTIVE in that list.
 * They were proven able to share a translation unit: no symbol is
 * declared here with two types, no identifier has internal linkage in one
 * member and is named by another, and no local typedef, macro, struct tag
 * or enum constant of one member is visible to a member that names it.
 *
 * members, in link order:
 *   scalbn.c
 *   gpio_pin_set_checked.c
 *   random.c
 *   gatt_discover.c
 *   bt_start.c
 *   flash_settings_read.c
 *   flash_settings_write_and_verify.c
 *   crc32_table_init.c
 *   crc32_update.c
 *   adc_nfc_init.c
 */

/* File-scope forward declarations for every struct/union tag this
 * unit names.  Without them a tag whose only appearance in a member
 * is inside a parameter list has PARAMETER-LIST scope, so two
 * textually IDENTICAL declarations in two members declare two
 * different incomplete types and the second is a conflicting
 * redeclaration (C11 6.2.1p7).  Incomplete-type forward
 * declarations emit no code. */
struct adc_api_raw;
struct device;
struct device_raw;
struct forwarding_packet;
struct k_sem;
struct request_log_record;
struct request_name_record;
/* ---- scalbn.c ---- */
#include "g1_app_symbols.h"
/* readable reconstruction; identity: FUN_00013e60 @ 0x00013e60
 * public-name: scalbn
 * durable-map: recon/catalogs/function_names_app.json
 * callees (readable <= raw @ address):
 *   __aeabi_dadd                             <= FUN_0000d58c @ 0x0000d58c
 *   __muldf3                                 <= FUN_0000d8f8 @ 0x0000d8f8
 *   scalbn                                   <= FUN_00013e60 @ 0x00013e60
 */
/* Reconstructed FUN_00013e60 @ 0x13e60 */
#include <stdint.h>

extern uint64_t __muldf3(uint32_t, uint32_t, uint32_t, uint32_t);
extern uint64_t __aeabi_dadd(uint32_t, uint32_t, uint32_t);

static uint64_t pack_words(uint32_t low, uint32_t high)
{
    return ((uint64_t)high << 32) | low;
}

double scalbn(double value, int scale)
{
    union { double d; uint64_t bits; } number;
    uint32_t low, high, exponent;

    number.d = value;
    low = (uint32_t)number.bits;
    high = (uint32_t)(number.bits >> 32);
    exponent = (high >> 20) & 0x7ff;

    if (exponent == 0) {
        if (((high & 0x7fffffff) | low) == 0)
            return number.d;
        number.bits = __muldf3(low, high, 0, 0x43500000);
        low = (uint32_t)number.bits;
        high = (uint32_t)(number.bits >> 32);
        if (scale < -50000) {
            number.bits = __muldf3(low, high, 0xc2f8f359, 0x01a56e1f);
            return number.d;
        }
        exponent = ((high >> 20) & 0x7ff) - 0x36;
    } else if (exponent == 0x7ff) {
        number.bits = __aeabi_dadd(low, high, low);
        return number.d;
    }

    {
        int adjusted = (int)exponent + scale;
        if (adjusted > 0 && adjusted < 0x7ff) {
            high = (high & 0x800fffff) | ((uint32_t)adjusted << 20);
            number.bits = pack_words(low, high);
            return number.d;
        }
        if (adjusted >= 0x7ff) {
            uint32_t out_high = (int32_t)high < 0 ? 0xfe37e43c : 0x7e37e43c;
            number.bits = __muldf3(0x8800759c, out_high,
                                      0x8800759c, 0x7e37e43c);
            return number.d;
        }
        if (adjusted < -0x35) {
            uint32_t out_high = (int32_t)high < 0 ? 0x81a56e1f : 0x01a56e1f;
            number.bits = __muldf3(0xc2f8f359, out_high,
                                      0xc2f8f359, 0x01a56e1f);
            return number.d;
        }
        high = (high & 0x800fffff) | ((uint32_t)(adjusted + 0x36) << 20);
        number.bits = __muldf3(low, high, 0, 0x3c900000);
        return number.d;
    }
}

/* ---- gpio_pin_set_checked.c ---- */
#include "../../../headers/g1_log.h"
#include "../../../headers/g1_dedupe.h"
/* readable reconstruction; identity: FUN_00017768 @ 0x00017768
 * public-name: gpio_pin_set_checked
 * durable-map: recon/catalogs/function_names_app.json
 * callees (readable <= raw @ address):
 *   gpio_pin_set_checked                     <= FUN_00017768 @ 0x00017768
 *   assert_post_action                       <= FUN_0007e2ec @ 0x0007e2ec
 *   printk                                   <= FUN_0007e2fa @ 0x0007e2fa
 * address symbols (name @ address):
 *   rodata_99c53                             @ 0x00099c53
 *   rodata_99cbd                             @ 0x00099cbd   [INLINED -- G6 literal batch]
 *   rodata_99de0                             @ 0x00099de0   [INLINED -- G6 literal batch]
 *   rodata_99e1e                             @ 0x00099e1e   [INLINED -- G6 literal batch]
 */
/* Reconstructed FUN_00017768 @ 0x17768  (parity: 300/300 trials, PROVEN) */

extern void assert_post_action(const char *, unsigned int);
typedef void (*jfn847)(void);
void gpio_pin_set_checked(int param_1, unsigned int param_2, unsigned int param_3)
{
  unsigned int uVar1;
  jfn847 UNRECOVERED_JUMPTABLE;

  uVar1 = 1u << (param_2 & 0xff);
  if ((uVar1 & **(volatile unsigned int **)(param_1 + 4)) == 0) {
    printk(((unsigned long)"ASSERTION FAIL [%s] @ %s:%d\n") /*=0x99cbd*/, ((unsigned long)"(cfg->port_pin_mask & (gpio_port_pins_t)(1UL << (pin))) != 0U") /*=0x99de0*/, ((unsigned long)&rodata_99c53) /*=0x99c53*/, 0x64f);
    G1_ASSERT_FAIL((((unsigned long)"\tUnsupported pin\n") /*=0x99e1e*/, 0, 0, 0), (((unsigned long)&rodata_99c53) /*=0x99c53*/, 0x64f));
  }
  if ((uVar1 & **(volatile unsigned int **)(param_1 + 0x10)) != 0) {
    param_3 = param_3 ^ 1;
  }
  /* BRING-UP WIRING FIX (P4 iteration 5) — indirect-call ABI.
   * Original bytes at 0x17768 tail-call the port op with r0 = the port device
   * and r1 = BIT(pin) (`lsl.w r1,r3,r1` at 0x1776c, then
   * `ldr r3,[r0,#8]; ldr r3,[r3,#0x10 or 0xc]; pop; bx r3`), i.e. Zephyr's
   * api->port_clear_bits_raw(port, mask) / api->port_set_bits_raw(port, mask).
   * The `(*UNRECOVERED_JUMPTABLE)()` no-argument form only worked because the
   * ORIGINAL codegen happened to leave r0/r1 correct; our codegen leaves r1 =
   * the raw pin number, so the wrong pins were driven.  Arguments are now
   * explicit.  Build/wiring TU only; recon/app/src left untouched. */
  if (param_3 == 0) {
    UNRECOVERED_JUMPTABLE = *(jfn847 *)(*(int *)(param_1 + 8) + 0x10);
  } else {
    UNRECOVERED_JUMPTABLE = *(jfn847 *)(*(int *)(param_1 + 8) + 0xc);
  }
  ((void (*)(int, unsigned int))UNRECOVERED_JUMPTABLE)(param_1, uVar1);
}

/* ---- random.c ---- */
struct k_sem;
#include <stddef.h>
/* readable reconstruction; identity: FUN_00017f70 @ 0x00017f70
 * public-name: random
 * durable-map: recon/catalogs/function_names_app.json
 * callees (readable <= raw @ address):
 *   get_device_info                          <= FUN_000167a8 @ 0x000167a8
 *   enqueue_bt_data                          <= FUN_00017eec @ 0x00017eec
 *   random                                   <= FUN_00017f70 @ 0x00017f70
 *   debug_print                              <= FUN_00019c70 @ 0x00019c70
 *   k_sem_give                               <= FUN_00072880 @ 0x00072880
 *   set_shutdown_flag                        <= FUN_0007cbfe @ 0x0007cbfe
 *   snprintk                                 <= FUN_0007ddbe @ 0x0007ddbe
 *   bt_conn_get_field_0x90                   <= FUN_00081526 @ 0x00081526
 *   memcpy                                   <= FUN_00086c04 @ 0x00086c04
 *   memset_bytes                             <= FUN_00086c78 @ 0x00086c78
 *   strcpy                                   <= FUN_00086fee @ 0x00086fee
 * address symbols (name @ address):
 *   rodata_9a1c8                             @ 0x0009a1c8
 *   rodata_9a1cf                             @ 0x0009a1cf
 *   rodata_9a1d6                             @ 0x0009a1d6
 *   rodata_9a1e0                             @ 0x0009a1e0
 *   rodata_9a1ea                             @ 0x0009a1ea   [INLINED -- refactor stage 01]
 *   rodata_9a20d                             @ 0x0009a20d   [INLINED -- G6 literal batch]
 *   rodata_9a275                             @ 0x0009a275   [INLINED -- G6 literal batch]
 *   rodata_9a295                             @ 0x0009a295   [INLINED -- G6 literal batch]
 *   rodata_9a2b1                             @ 0x0009a2b1   [INLINED -- G6 literal batch]
 *   rodata_9a2bf                             @ 0x0009a2bf   [INLINED -- G6 literal batch]
 *   rodata_f5071                             @ 0x000f5071
 *   g_log_level                              @ 0x2000230c
 *   g_ble_conn_ctx_ptr                       @ 0x20006a30
 *   g_log_use_alt_sink                       @ 0x20007554
 */
/* Reconstructed FUN_00017f70 @ 0x17f70  (parity: 300/300 trials, PROVEN) */
#include "g1_lib.h"
typedef unsigned int uint;
typedef unsigned char undefined1;
typedef unsigned undefined4;
extern void enqueue_bt_data(void *a, uint b);
extern void k_sem_give(struct k_sem *);
extern void set_shutdown_flag(unsigned a, int b);
extern int snprintk(char *, size_t,  const char *, ...);
extern void FUN_00081526_dummy(void);
extern void memcpy(int, int, int);
extern void memset_bytes(void *a, int b, int c);
extern void strcpy(void *a, unsigned b);
extern long long thunk_FUN_00074f68(void);

struct request_name_record {
    unsigned word;
    unsigned char tail[16];
};

struct request_log_record {
    unsigned header;
    unsigned char text[26];
};

struct forwarding_packet {
    unsigned char length;
    unsigned char payload[256];
};

void random(unsigned param_1, unsigned char *param_2, uint param_3)
{
    volatile int *piVar1;
    volatile int *piVar2;
    unsigned char *puVar3;
    unsigned uVar4;
    uint uVar5, uVar6, uVar7, uVar8, uVar9;
    int iVar10, iVar12;
    long long lVar13;
    struct request_name_record request_name;
    struct request_log_record log_record;
    struct forwarding_packet forwarding;
    volatile int *dbg = (volatile int *)((unsigned long)&g_log_use_alt_sink) /*=0x20007554*/;
    unsigned *puVar11;

    log_record.header = 0;
    memset_bytes(log_record.text, 0, sizeof(log_record.text));
    memset_bytes(&forwarding, 0, sizeof(forwarding));
    puVar3 = bt_conn_get_field_0x90(param_1);
    switch (*puVar3) {
    case 0: uVar4 = ((unsigned long)&rodata_9a1c8) /*=0x9a1c8*/; break;
    case 1: uVar4 = ((unsigned long)&rodata_9a1cf) /*=0x9a1cf*/; break;
    case 2: uVar4 = ((unsigned long)&rodata_9a1d6) /*=0x9a1d6*/; break;
    case 3: uVar4 = ((unsigned long)&rodata_9a1e0) /*=0x9a1e0*/; break;
    default:
        snprintk(&request_name, 10, ((unsigned long)&rodata_f5071) /*=0xf5071*/);
        goto LAB_00017fb6;
    }
    strcpy(&request_name, uVar4);
LAB_00017fb6:
    piVar2 = (volatile int *)((unsigned long)&g_log_level) /*=0x2000230c*/;
    piVar1 = (volatile int *)((unsigned long)&g_ble_conn_ctx_ptr) /*=0x20006a30*/;
    uVar5 = (uint)(unsigned char)puVar3[1];
    uVar6 = (uint)(unsigned char)puVar3[2];
    uVar7 = (uint)(unsigned char)puVar3[3];
    uVar8 = (uint)(unsigned char)puVar3[4];
    uVar9 = (uint)(unsigned char)puVar3[5];
    puVar11 = &request_name.word;
    snprintk(&log_record, 0x1e, ((unsigned long)"%02X:%02X:%02X:%02X:%02X:%02X (%s)") /*=0x9a1ea*/, puVar3[6], uVar9, uVar8, uVar7, uVar6, uVar5, &request_name);
    if (0 < *piVar2) {
        uVar9 = (uint)*param_2;
        uVar8 = (uint)param_2[1];
        uVar7 = (uint)param_2[2];
        uVar6 = (uint)param_2[3];
        uVar5 = (uint)param_2[4];
        puVar11 = (unsigned *)(uint)param_2[5];
        G1_LOG_ROUTE(*dbg == 0, ((unsigned long)"%s(): **Received data from: %s, len=%d,cmd 0x%x 0x%x 0x%x 0x%x 0x%x 0x%x,receiver_thd_is_running is %d\n") /*=0x9a20d*/, ((unsigned long)"bt_receive_cb") /*=0x9a2bf*/, &log_record, param_3, uVar9, uVar8, uVar7, uVar6, uVar5, puVar11,
                        (uint)*(unsigned char *)(*piVar1 + 0x248));
    }
    iVar12 = *piVar1;
    lVar13 = thunk_FUN_00074f68();
    iVar10 = *piVar1;
    *(volatile uint *)(iVar12 + 0x368) =
        (uint)(lVar13 * 1000) >> 0xf | (int)((unsigned long long)(lVar13 * 1000) >> 0x20) * 0x20000;
    if ((*(volatile char *)(iVar10 + 0x248) == '\0') && (*(volatile int *)(iVar10 + 0x220) == 0)) {
        iVar10 = *piVar1;
        if (param_3 < 0x15) {
            memcpy(*(void **)(iVar10 + 0x254), param_2, param_3);
            memset_bytes((void *)(*(int *)(iVar10 + 0x254) + param_3), 0, 0x14 - param_3);
            *(volatile unsigned int *)(iVar10 + 0x358) = 0;
            *(volatile uint *)(iVar10 + 0x360) = param_3;
        } else {
            if (0x100 < param_3) {
                if (*dbg == 0) {
                    uVar4 = 0x6a;
                    goto LAB_000180e2;
                }
                uVar4 = 0x6a;
                goto LAB_000180d4;
            }
            memcpy((void *)(iVar10 + 600), param_2, param_3);
            *(volatile uint *)(iVar10 + 0x358) = param_3;
        }
        *(volatile unsigned int *)(iVar10 + 0x35c) = 1;
        k_sem_give(iVar10 + 0x218);
    } else {
        request_name.word = 0;
        memset_bytes(request_name.tail, 0, sizeof(request_name.tail));
        if (*param_2 == 0x18) {
            uVar4 = get_device_info();
            set_shutdown_flag(uVar4, 0);
            ((unsigned char *)&request_name)[1] = 0xc9;
            (*(void (**)(void *, int))(*piVar1 + 0xc))(&request_name, sizeof(request_name));
            return;
        }
        if (param_3 < 0x101) {
            forwarding.length = (undefined1)param_3;
            memset_bytes(forwarding.payload, 0, sizeof(forwarding.payload));
            memcpy(forwarding.payload, param_2, param_3);
            enqueue_bt_data(forwarding.payload, param_3 & 0xff);
            if (*piVar2 < 1) return;
            if (*dbg != 0) {
                debug_print(((unsigned long)"%s(): enqueue because busy\n") /*=0x9a295*/, ((unsigned long)"bt_receive_cb") /*=0x9a2bf*/);
                return;
            }
            log_message(((unsigned long)"%s(): enqueue because busy\n") /*=0x9a295*/, ((unsigned long)"bt_receive_cb") /*=0x9a2bf*/);
            return;
        }
        if (*dbg == 0) {
            uVar4 = 0x59;
LAB_000180e2:
            log_message(((unsigned long)"[%s-%d]len is %d, too large ! \n") /*=0x9a275*/, ((unsigned long)"bt_receive_cb") /*=0x9a2b1*/, uVar4, param_3, uVar9, uVar8, uVar7, uVar6, uVar5, puVar11);
            return;
        }
        uVar4 = 0x59;
LAB_000180d4:
        debug_print(((unsigned long)"[%s-%d]len is %d, too large ! \n") /*=0x9a275*/, ((unsigned long)"bt_receive_cb") /*=0x9a2b1*/, uVar4, param_3);
    }
    return;
}

/* ---- gatt_discover.c ---- */
/* readable reconstruction; identity: FUN_000187e8 @ 0x000187e8
 * public-name: gatt_discover
 * durable-map: recon/catalogs/function_names_app.json
 * callees (readable <= raw @ address):
 *   get_device_info                          <= FUN_000167a8 @ 0x000167a8
 *   gatt_discover                            <= FUN_000187e8 @ 0x000187e8
 *   is_battery_critical                      <= FUN_00032ee4 @ 0x00032ee4
 *   gatt_dm_start                            <= FUN_0004ed8c @ 0x0004ed8c
 *   atomic_and                               <= FUN_0007c08e @ 0x0007c08e
 * address symbols (name @ address):
 *   rodata_88388                             @ 0x00088388
 *   rodata_88a0c                             @ 0x00088a0c
 *   rodata_9a65b                             @ 0x0009a65b   [INLINED -- G6 literal batch]
 *   g_gatt_discovery_flags                   @ 0x20006ab4
 *   g_ancs_client                            @ 0x20006ae8
 */
/* Reconstructed FUN_000187e8 @ 0x187e8  (parity: 300/300 trials, PROVEN) */
typedef uint32_t u32; typedef uint8_t u8;
extern long atomic_and(volatile long*, long);
extern int gatt_dm_start(unsigned long, unsigned long*, unsigned long, unsigned long);
void gatt_discover(unsigned int param_1, unsigned int param_2) {
    volatile u32* puVar1 = (volatile u32*)((unsigned long)&g_gatt_discovery_flags) /*=0x20006ab4*/;
    char* pcVar2 = (char*)(uintptr_t)get_device_info();
    if(*pcVar2 == 2){
        int iVar3 = is_battery_critical();
        if(iVar3 != 1){
            u32 uVar7 = *puVar1;
            *puVar1 = uVar7 | 1;
            if((uVar7 & 1) == 0){
                u32 v = *puVar1;
                int go_tail = 0;
                if((int)(v << 0x1e) < 0){
                    go_tail = 1;
                } else if(param_2 != 0){
                    iVar3 = atomic_and(((unsigned long)&g_gatt_discovery_flags) /*=0x20006ab4*/, 0xfffffffb);
                    if((int)(iVar3 << 0x1d) >= 0) go_tail = 1;
                }
                if(go_tail){
                    atomic_and(((unsigned long)&g_gatt_discovery_flags) /*=0x20006ab4*/, 0xfffffffe);
                    return;
                }
                u32 local_2c[5];
                u32* src = (u32*)((unsigned long)&rodata_88388) /*=0x88388*/;
                for(int i=0;i<4;i++) local_2c[i] = src[i];
                *(u8*)&local_2c[4] = *(u8*)(src+4);
                iVar3 = gatt_dm_start(param_1, local_2c, ((unsigned long)&rodata_88a0c) /*=0x88a0c*/, ((unsigned long)&g_ancs_client) /*=0x20006ae8*/);
                if(iVar3 != 0){
                    log_message(((unsigned long)"Failed to start discovery for ANCS (err %d)\n") /*=0x9a65b*/, iVar3);
                    atomic_and(((unsigned long)&g_gatt_discovery_flags) /*=0x20006ab4*/, 0xfffffffe);
                }
            }
        }
    }
}

/* ---- bt_start.c ---- */
/* readable reconstruction; identity: FUN_00019308 @ 0x00019308
 * public-name: bt_start
 * durable-map: recon/catalogs/function_names_app.json
 * callees (readable <= raw @ address):
 *   strlen                                   <= FUN_0000ef12 @ 0x0000ef12
 *   get_device_type                          <= FUN_00016568 @ 0x00016568
 *   get_device_info                          <= FUN_000167a8 @ 0x000167a8
 *   debug_print                              <= FUN_00019c70 @ 0x00019c70
 *   get_device_serial_buf                    <= FUN_000232b0 @ 0x000232b0
 *   is_battery_critical                      <= FUN_00032ee4 @ 0x00032ee4
 *   bt_set_name_internal                     <= FUN_00054c74 @ 0x00054c74
 *   bt_le_adv_start                          <= FUN_00055998 @ 0x00055998
 *   k_msleep_ticks32768_d                    <= FUN_0007c0a8 @ 0x0007c0a8
 *   log_message                              <= FUN_0007dda4 @ 0x0007dda4
 *   uptime_ticks_get                         <= FUN_00086698 @ 0x00086698
 *   vdprintf_to_fd                           <= FUN_00086f00 @ 0x00086f00
 *   __strcpy_chk                             <= FUN_00086ffe @ 0x00086ffe
 * address symbols (name @ address):
 *   rodata_8839c                             @ 0x0008839c
 *   rodata_9ac4c                             @ 0x0009ac4c   [INLINED -- G6 literal batch]
 *   rodata_9ac60                             @ 0x0009ac60   [INLINED -- G6 literal batch]
 *   rodata_9ac7c                             @ 0x0009ac7c
 *   rodata_9ac84                             @ 0x0009ac84   [INLINED -- G6 literal batch]
 *   rodata_9ac9d                             @ 0x0009ac9d   [INLINED -- G6 literal batch]
 *   rodata_9acb2                             @ 0x0009acb2   [INLINED -- G6 literal batch]
 *   rodata_9acc4                             @ 0x0009acc4   [INLINED -- G6 literal batch]
 *   rodata_9ace0                             @ 0x0009ace0   [INLINED -- G6 literal batch]
 *   rodata_9acf9                             @ 0x0009acf9   [INLINED -- G6 literal batch]
 *   rodata_9ad0e                             @ 0x0009ad0e   [INLINED -- G6 literal batch]
 *   rodata_9ad20                             @ 0x0009ad20   [INLINED -- G6 literal batch]
 *   rodata_9ad4b                             @ 0x0009ad4b   [INLINED -- G6 literal batch]
 *   rodata_9b13f                             @ 0x0009b13f   [INLINED -- G6 literal batch]
 *   g_log_level                              @ 0x2000230c
 *   g_20002350                               @ 0x20002350
 *   g_20002358                               @ 0x20002358
 *   g_log_use_alt_sink                       @ 0x20007554
 *   g_2000ff72                               @ 0x2000ff72
 *   g_2000ff73                               @ 0x2000ff73
 *   g_2000ff87                               @ 0x2000ff87
 */
/* Reconstructed bt_start @ 0x00019308 (FUN_00019308; CFG-verified). */
/* Firmware application Bluetooth-start owner; prior LIBRARY class was incorrect. */
extern void k_msleep_ticks32768_d(int);
extern int get_device_type(void);
extern unsigned int get_device_serial_buf(void);
extern char *__strcpy_chk(char *, const char *, size_t);
extern void vdprintf_to_fd(uintptr_t, ...);
extern size_t strlen(const char *);
extern unsigned int bt_set_name_internal(unsigned int);
extern int bt_le_adv_start(void *, uintptr_t, uint32_t, uintptr_t, uint32_t);

#define INFO_BYTE(offset) (*(volatile uint8_t *)(get_device_info() + (offset)))

int bt_start(void)
{
    volatile uint8_t *busy = (volatile uint8_t *)(uintptr_t)((unsigned long)&g_2000ff72) /*=0x2000ff72*/;
    while (*busy != 0u) k_msleep_ticks32768_d(1u);
    *busy = 1u;
    int result;
    uintptr_t info = get_device_info();
    uint8_t state = *(volatile uint8_t *)(info + 0x1058u);
    if (state == 2u) { result = 0; goto out; }
    info = get_device_info();
    if (*(volatile uint8_t *)(info + 0x1058u) == 0u) { result = 0; goto out; }

    volatile uint8_t *adv = (volatile uint8_t *)(uintptr_t)((unsigned long)&g_20002358) /*=0x20002358*/;
    volatile uint8_t *name_data = (volatile uint8_t *)(uintptr_t)((unsigned long)&g_2000ff73) /*=0x2000ff73*/;
    *(volatile uint16_t *)(adv + 8u) = 0x14ffu;
    uint32_t device_kind = get_device_type() == 1 ? 1u : 2u;
    *(volatile uintptr_t *)(adv + 0x0cu) = (uintptr_t)name_data;
    *name_data = (uint8_t)device_kind;
    __strcpy_chk((void *)(name_data + 1u), (const void *)get_device_serial_buf(), 0x13u);
    log_message(((unsigned long)"c->esb_channel %d\r\n") /*=0x9ac4c*/, INFO_BYTE(2u), 19u, device_kind);

    int left = get_device_type() == 1;
    int critical = is_battery_critical() == 1;
    const uintptr_t name = ((unsigned long)&g_2000ff87) /*=0x2000ff87*/;
    const uintptr_t base = ((unsigned long)&rodata_9ac7c) /*=0x9ac7c*/;
    uint8_t id = INFO_BYTE(2u);
    if (left) {
        if (critical) {
            if (id != 0xffu) {
                id=INFO_BYTE(2u);
                uint8_t a=INFO_BYTE(0xfdcu), b=INFO_BYTE(0xfdbu), c=INFO_BYTE(0xfdau);
                vdprintf_to_fd(name,0u,0x20u,((unsigned long)"%sV%d%d%d_%d_R_%02X%02X%02X") /*=0x9ac60*/,base,1u,4u,5u,id,a,b,c);
            } else {
                uint8_t a=INFO_BYTE(0xfdcu), b=INFO_BYTE(0xfdbu), c=INFO_BYTE(0xfdau);
                vdprintf_to_fd(name,0u,0x20u,((unsigned long)"%sV%d%d%d_R_%02X%02X%02X") /*=0x9ac84*/,base,1u,4u,5u,a,b,c);
            }
        } else if (id != 0xffu) {
            id=INFO_BYTE(2u);
            uint8_t a=INFO_BYTE(0xfdcu), b=INFO_BYTE(0xfdbu), c=INFO_BYTE(0xfdau);
            vdprintf_to_fd(name,0u,0x20u,((unsigned long)"%s_%d_R_%02X%02X%02X") /*=0x9ac9d*/,base,id,a,b,c);
        } else {
            uint8_t a=INFO_BYTE(0xfdcu), b=INFO_BYTE(0xfdbu), c=INFO_BYTE(0xfdau);
            vdprintf_to_fd(name,0u,0x20u,((unsigned long)"%s_R_%02X%02X%02X") /*=0x9acb2*/,base,a,b,c);
        }
    } else {
        if (critical) {
            if (id != 0xffu) {
                id=INFO_BYTE(2u);
                uint8_t a=INFO_BYTE(0xfe2u), b=INFO_BYTE(0xfe1u), c=INFO_BYTE(0xfe0u);
                vdprintf_to_fd(name,0u,0x20u,((unsigned long)"%sV%d%d%d_%d_L_%02X%02X%02X") /*=0x9acc4*/,base,1u,4u,5u,id,a,b,c);
            } else {
                uint8_t a=INFO_BYTE(0xfe2u), b=INFO_BYTE(0xfe1u), c=INFO_BYTE(0xfe0u);
                vdprintf_to_fd(name,0u,0x20u,((unsigned long)"%sV%d%d%d_L_%02X%02X%02X") /*=0x9ace0*/,base,1u,4u,5u,a,b,c);
            }
        } else if (id != 0xffu) {
            id=INFO_BYTE(2u);
            uint8_t a=INFO_BYTE(0xfe2u), b=INFO_BYTE(0xfe1u), c=INFO_BYTE(0xfe0u);
            vdprintf_to_fd(name,0u,0x20u,((unsigned long)"%s_%d_L_%02X%02X%02X") /*=0x9acf9*/,base,id,a,b,c);
        } else {
            uint8_t a=INFO_BYTE(0xfe2u), b=INFO_BYTE(0xfe1u), c=INFO_BYTE(0xfe0u);
            vdprintf_to_fd(name,0u,0x20u,((unsigned long)"%s_L_%02X%02X%02X") /*=0x9ad0e*/,base,a,b,c);
        }
    }

    volatile uint8_t *name_ad = (volatile uint8_t *)(uintptr_t)((unsigned long)&g_20002350) /*=0x20002350*/;
    *(volatile uintptr_t *)(name_ad + 4u) = name;
    *(volatile uint8_t *)(name_ad + 1u) = (uint8_t)strlen(name);
    result = bt_set_name_internal(name);
    if (result != 0) {
        if (*(volatile int32_t *)(uintptr_t)((unsigned long)&g_log_level) /*=0x2000230c*/ > 0) {
            if (*(volatile uint32_t *)(uintptr_t)((unsigned long)&g_log_use_alt_sink) /*=0x20007554*/ == 0u)
                log_message(((unsigned long)"%s(): Failed to set device name (err %d)\n\n") /*=0x9ad20*/,((unsigned long)"bt_start") /*=0x9b13f*/,result);
            else debug_print(((unsigned long)"%s(): Failed to set device name (err %d)\n\n") /*=0x9ad20*/,((unsigned long)"bt_start") /*=0x9b13f*/,result);
        }
        goto out;
    }

    uint32_t params[5];
    const volatile uint32_t *defaults=(const volatile uint32_t *)(uintptr_t)((unsigned long)&rodata_8839c) /*=0x8839c*/;
    for (unsigned i=0;i<5;i++) params[i]=defaults[i];
    result = bt_le_adv_start(params,((unsigned long)&g_20002358) /*=0x20002358*/,2u,((unsigned long)&g_20002350) /*=0x20002350*/,1u);
    if (result == 0) {
        info=get_device_info();
        *(volatile uint8_t *)(info+0x1058u)=2u;
        uint64_t ms=(uptime_ticks_get()*1000u+0x7fffu)>>15;
        log_message(((unsigned long)"Advertising %s successfully started uptime %lld\n") /*=0x9ad4b*/,name,(uint32_t)ms,(uint32_t)(ms>>32));
    }
out:
    *busy=0u;
    return result;
}

/* ---- flash_settings_read.c ---- */
/* readable reconstruction; identity: FUN_000225b4 @ 0x000225b4
 * public-name: flash_settings_read
 * durable-map: recon/catalogs/function_names_app.json
 * callees (readable <= raw @ address):
 *   get_device_info                          <= FUN_000167a8 @ 0x000167a8
 *   debug_print                              <= FUN_00019c70 @ 0x00019c70
 *   k_sleep                                  <= FUN_00074844 @ 0x00074844
 *   log_message                              <= FUN_0007dda4 @ 0x0007dda4
 *   z_device_is_ready                        <= FUN_0008638c @ 0x0008638c
 * address symbols (name @ address):
 *   rodata_87bf0                             @ 0x00087bf0
 *   rodata_9e2da                             @ 0x0009e2da   [INLINED -- G6 literal batch]
 *   rodata_9e2f1                             @ 0x0009e2f1   [INLINED -- G6 literal batch]
 *   rodata_9e528                             @ 0x0009e528   [INLINED -- G6 literal batch]
 *   rodata_a40ec                             @ 0x000a40ec
 *   g_log_level                              @ 0x2000230c
 *   g_log_use_alt_sink                       @ 0x20007554
 */
/* Reconstructed flash_settings_read @ 0x225b4  (CFG-directed candidate) */


extern _Bool z_device_is_ready(const struct device *);
extern int32_t k_sleep(k_timeout_t);

typedef int (*flash_read_api_t)(uintptr_t device, uint32_t address,
                                void *destination, uint32_t length);

int flash_settings_read(uint32_t address, void *destination, uint32_t length)
{
    unsigned int retry = 0;
    int result;

    for (;;) {
        if (!z_device_is_ready((const void *)((unsigned long)&rodata_87bf0) /*=0x87bf0*/)) {
            log_message(((unsigned long)&rodata_a40ec) /*=0xa40ec*/,
                         *(volatile uint32_t *)((unsigned long)&rodata_87bf0) /*=0x87bf0*/);
            result = -1;
        } else {
            uintptr_t info = get_device_info();
            flash_read_api_t read_api =
                *(flash_read_api_t *)(info + 0x1030U);
            uintptr_t device = get_device_info();

            result = read_api(device, address, destination, length);
            if (result == 0) {
                return 0;
            }
            log_message(((unsigned long)"Flash read failed! %d\n") /*=0x9e2da*/, result);
        }

        if (retry == 10U) {
            return result;
        }
        k_sleep(0x0ccdU, 0U);
        ++retry;

        if (*(volatile int32_t *)((unsigned long)&g_log_level) /*=0x2000230c*/ > 0) {
            G1_LOG_ROUTE(*(volatile uint32_t *)((unsigned long)&g_log_use_alt_sink) /*=0x20007554*/ == 0U, ((unsigned long)"%s(): flash read fail, retry again, retry time %d\n") /*=0x9e2f1*/, ((unsigned long)"flash_settings_read") /*=0x9e528*/, retry);
        }
    }
}

/* ---- flash_settings_write_and_verify.c ---- */
/* readable reconstruction; identity: FUN_00022658 @ 0x00022658
 * public-name: flash_settings_write_and_verify
 * durable-map: recon/catalogs/function_names_app.json
 * callees (readable <= raw @ address):
 *   get_device_info                          <= FUN_000167a8 @ 0x000167a8
 *   debug_print                              <= FUN_00019c70 @ 0x00019c70
 *   malloc                                   <= FUN_00076d6c @ 0x00076d6c
 *   free                                     <= FUN_00076d7c @ 0x00076d7c
 *   log_message                              <= FUN_0007dda4 @ 0x0007dda4
 *   z_device_is_ready                        <= FUN_0008638c @ 0x0008638c
 *   memcmp                                   <= FUN_00086be4 @ 0x00086be4
 *   safe_memcpy_checked                      <= FUN_00086c1e @ 0x00086c1e
 *   memset_bytes                             <= FUN_00086c78 @ 0x00086c78
 * address symbols (name @ address):
 *   rodata_87bf0                             @ 0x00087bf0
 *   rodata_9e2da                             @ 0x0009e2da   [INLINED -- G6 literal batch]
 *   rodata_9e324                             @ 0x0009e324   [INLINED -- G6 literal batch]
 *   rodata_9e345                             @ 0x0009e345   [INLINED -- G6 literal batch]
 *   rodata_9e36d                             @ 0x0009e36d   [INLINED -- G6 literal batch]
 *   rodata_9e385                             @ 0x0009e385   [INLINED -- G6 literal batch]
 *   rodata_9e3af                             @ 0x0009e3af   [INLINED -- G6 literal batch]
 *   rodata_9e3c6                             @ 0x0009e3c6   [INLINED -- G6 literal batch]
 *   rodata_9e508                             @ 0x0009e508   [INLINED -- G6 literal batch]
 *   rodata_a40ec                             @ 0x000a40ec
 *   g_log_use_alt_sink                       @ 0x20007554
 */
/* Reconstructed flash_settings_write_and_verify @ 0x00022658 (FUN_00022658; CFG-verified). */
/* Firmware application owner; the prior LIBRARY classification was incorrect. */
extern void *malloc(size_t);
extern void free(void *);
extern int memcmp(const void *, const void *, size_t);
extern void safe_memcpy_checked(void *, const void *, size_t, size_t);
typedef int (*flash_read_t)(uintptr_t, uint32_t, void *, uint32_t);
typedef int (*flash_erase_t)(uintptr_t, uint32_t, uint32_t);
typedef int (*flash_write_t)(uintptr_t, uint32_t, const void *, uint32_t);

int flash_settings_write_and_verify(uint32_t address, const void *source,
                                    uint32_t length, uint32_t unused)
{
    (void)unused;
    uint8_t *buffer = malloc(0x1000u);
    if (buffer == 0) {
        if (*(volatile uint32_t *)(uintptr_t)((unsigned long)&g_log_use_alt_sink) /*=0x20007554*/ == 0u)
            log_message(((unsigned long)"[%s-%d]error, have no memory ! \n") /*=0x9e324*/, ((unsigned long)"flash_settings_write_and_verify") /*=0x9e508*/, 0xd2u, 0u);
        else
            debug_print(((unsigned long)"[%s-%d]error, have no memory ! \n") /*=0x9e324*/, ((unsigned long)"flash_settings_write_and_verify") /*=0x9e508*/, 0xd2u, 0u);
        return -1;
    }

    int result;
    const uintptr_t flash_device = ((unsigned long)&rodata_87bf0) /*=0x87bf0*/;
    if (z_device_is_ready((const void *)flash_device) == 0) {
        log_message(((unsigned long)&rodata_a40ec) /*=0xa40ec*/,
                     *(volatile uint32_t *)(uintptr_t)flash_device);
        result = -1;
        goto out;
    }

    memset_bytes(buffer, 0, 0x1000u);
    uintptr_t info = get_device_info();
    flash_read_t read = *(flash_read_t *)(info + 0x1030u);
    info = get_device_info();
    result = read(info, address, buffer, 0x1000u);
    if (result != 0) {
        log_message(((unsigned long)"Flash read failed! %d\n") /*=0x9e2da*/, result);
        goto out;
    }
    if (memcmp(source, buffer, length) == 0) {
        log_message(((unsigned long)"write data and read data is same, exit\n") /*=0x9e345*/);
        result = 0;
        goto out;
    }

    info = get_device_info();
    flash_erase_t erase = *(flash_erase_t *)(info + 0x1038u);
    info = get_device_info();
    int status = erase(info, address, 0x1000u);
    if (status != 0) {
        log_message(((unsigned long)"Flash erase failed! %d\n") /*=0x9e36d*/, status);
        result = status;
        goto out;
    }

    memset_bytes(buffer, 0, 0x1000u);
    safe_memcpy_checked(buffer, source, length, 0x1000u);
    info = get_device_info();
    flash_write_t write = *(flash_write_t *)(info + 0x1034u);
    info = get_device_info();
    status = write(info, address, buffer, 0x1000u);
    if (status != 0) {
        log_message(((unsigned long)"Flash write failed! %d addr %08X size %d\n") /*=0x9e385*/, status, address, length);
        result = status;
        goto out;
    }

    info = get_device_info();
    read = *(flash_read_t *)(info + 0x1030u);
    info = get_device_info();
    status = read(info, address, buffer, 0x1000u);
    if (status != 0) {
        log_message(((unsigned long)"Flash read failed! %d\n") /*=0x9e2da*/, status);
        result = status;
        goto out;
    }
    if (memcmp(source, buffer, length) != 0) {
        log_message(((unsigned long)"flash verify failed\n") /*=0x9e3c6*/);
        result = 1;
        goto out;
    }
    log_message(((unsigned long)"flash verify success!\n") /*=0x9e3af*/);
    result = 0;
out:
    free(buffer);
    return result;
}

/* ---- crc32_table_init.c ---- */
/* readable reconstruction; identity: FUN_000235dc @ 0x000235dc
 * public-name: crc32_table_init
 * durable-map: recon/catalogs/function_names_app.json
 * callees (readable <= raw @ address):
 *   crc32_table_init                         <= FUN_000235dc @ 0x000235dc
 * address symbols (name @ address):
 *   g_crc32_table                            @ 0x200075a0
 */
/* Reconstructed FUN_000235dc @ 0x235dc  (parity: 300/300 trials, PROVEN) */

void crc32_table_init(void)
{
  volatile uint32_t *puVar2 = (volatile uint32_t *)((unsigned long)&g_crc32_table) /*=0x200075a0*/;
  unsigned int uVar1 = 0xedb88320UL;
  unsigned int uVar4 = 0;
  do {
    int iVar3 = 8;
    unsigned int uVar5 = uVar4;
    do {
      unsigned int uVar6 = uVar5 & 1;
      uVar5 = uVar5 >> 1;
      if (uVar6 != 0) uVar5 = uVar5 ^ uVar1;
      iVar3 = iVar3 - 1;
    } while (iVar3 != 0);
    uVar4 = uVar4 + 1;
    *puVar2 = uVar5;
    puVar2 = puVar2 + 1;
  } while (uVar4 != 0x100);
}

/* ---- crc32_update.c ---- */
/* readable reconstruction; identity: FUN_0002360c @ 0x0002360c
 * public-name: crc32_update
 * durable-map: recon/catalogs/function_names_app.json
 * callees (readable <= raw @ address):
 *   crc32_update                             <= FUN_0002360c @ 0x0002360c
 * address symbols (name @ address):
 *   g_crc32_table                            @ 0x200075a0
 */
/* Reconstructed FUN_0002360c @ 0x2360c  (parity: 300/300 trials, PROVEN) */

unsigned int crc32_update(unsigned int param_1, unsigned char *param_2, int param_3)
{
  unsigned char *pbVar1;
  volatile unsigned int *tbl = (volatile unsigned int *)((unsigned long)&g_crc32_table) /*=0x200075a0*/;
  param_1 = ~param_1;
  pbVar1 = param_2 + param_3;
  for (; param_2 != pbVar1; param_2 = param_2 + 1) {
    param_1 = tbl[(*param_2 ^ param_1) & 0xff] ^ (param_1 >> 8);
  }
  return ~param_1;
}

/* ---- adc_nfc_init.c ---- */
/* readable reconstruction; identity: FUN_00024b98 @ 0x00024b98
 * public-name: adc_nfc_init
 * durable-map: recon/catalogs/function_names_app.json
 * callees (readable <= raw @ address):
 *   debug_print                              <= FUN_00019c70 @ 0x00019c70
 *   log_message                              <= FUN_0007dda4 @ 0x0007dda4
 *   z_device_is_ready                        <= FUN_0008638c @ 0x0008638c
 * address symbols (name @ address):
 *   rodata_87c20                             @ 0x00087c20
 *   rodata_88a2a                             @ 0x00088a2a
 *   rodata_9f0b0                             @ 0x0009f0b0   [INLINED -- G6 literal batch]
 *   rodata_9f0db                             @ 0x0009f0db   [INLINED -- G6 literal batch]
 *   rodata_9f1cf                             @ 0x0009f1cf   [INLINED -- G6 literal batch]
 *   g_log_level                              @ 0x2000230c
 *   g_log_use_alt_sink                       @ 0x20007554
 */
/* Reconstructed application adc_nfc_init @ 0x00024b98.
 * Raw/address back-map: FUN_00024b98 / 0x00024b98.
 */

struct device_raw {
    const char *name;
    const void *config;
    const void *api;
};

struct adc_api_raw {
    int (*channel_setup)(const struct device_raw *, const void *);
};


int adc_nfc_init(void)
{
    const struct device_raw *device =
        (const struct device_raw *)((unsigned long)&rodata_87c20) /*=0x87c20*/;

    if (z_device_is_ready(device) != 0) {
        const struct adc_api_raw *api =
            (const struct adc_api_raw *)device->api;
        int result = api->channel_setup(device, (const void *)((unsigned long)&rodata_88a2a) /*=0x88a2a*/);
        if (result < 0 && *(volatile int32_t *)((unsigned long)&g_log_level) /*=0x2000230c*/ > 0) {
            if (*(volatile uint32_t *)((unsigned long)&g_log_use_alt_sink) /*=0x20007554*/ == 0u) {
                log_message((const void *)((unsigned long)"%s(): Could not setup channel #%d (%d)\n\n") /*=0x9f0db*/,
                             (const void *)((unsigned long)"adc_nfc_init") /*=0x9f1cf*/);
            } else {
                debug_print((const void *)((unsigned long)"%s(): Could not setup channel #%d (%d)\n\n") /*=0x9f0db*/,
                             (const void *)((unsigned long)"adc_nfc_init") /*=0x9f1cf*/, 0);
            }
        }
    } else if (*(volatile int32_t *)((unsigned long)&g_log_level) /*=0x2000230c*/ > 0) {
        G1_LOG_ROUTE(*(volatile uint32_t *)((unsigned long)&g_log_use_alt_sink) /*=0x20007554*/ == 0u, (const void *)((unsigned long)"%s(): ADC controller device %s not ready\n\n") /*=0x9f0b0*/,
                         (const void *)((unsigned long)"adc_nfc_init") /*=0x9f1cf*/, device->name);
    }
    return 0;
}

/* ================================================================ */
/* member unit: g1_lib_68.c */
/* ================================================================ */
/*
 * Cohesive translation unit for the `lib' module.
 *
 * GENERATED by recon/refactor/transforms/t04_cohesive_tu.py.  Do not
 * edit: a stage tree is regenerated, never hand-patched
 * (recon/refactor/README.md C4).
 *
 * The 2 functions below were 2 separate translation units until this
 * stage.  Each one's text is reproduced VERBATIM and in the order the
 * generated source list gave it, and they were CONSECUTIVE in that list.
 * They were proven able to share a translation unit: no symbol is
 * declared here with two types, no identifier has internal linkage in one
 * member and is named by another, and no local typedef, macro, struct tag
 * or enum constant of one member is visible to a member that names it.
 *
 * members, in link order:
 *   att_chan_reset.c
 *   smp_c1.c
 */
/* ---- att_chan_reset.c ---- */
#include "g1_app_symbols.h"
#include <stdint.h>
/* readable reconstruction; identity: FUN_00083204 @ 0x00083204
 * public-name: att_chan_reset
 * durable-map: recon/catalogs/function_names_app.json
 * callees (readable <= raw @ address):
 *   k_work_cancel_delayable                  <= FUN_00073518 @ 0x00073518
 *   atomic_set_bit                           <= FUN_00083090 @ 0x00083090
 *   att_chan_reset                           <= FUN_00083204 @ 0x00083204
 */
/* Reconstructed FUN_00083204 @ 0x83204  (parity: 300/300 trials, PROVEN) */

extern void k_work_cancel_delayable(unsigned int *, unsigned int, unsigned int,
                         unsigned int *exchange_word);
extern void atomic_set_bit(int, int);

void att_chan_reset(unsigned int *param_1, unsigned int param_2, unsigned int param_3, unsigned int param_4)
{
  unsigned int uVar1 = __atomic_exchange_n(param_1 + 1, 0,
                                            __ATOMIC_ACQ_REL);
  k_work_cancel_delayable(param_1 + 0x82, 0, uVar1, param_1 + 1);
  *(volatile unsigned char *)(param_1 + 2) = 0;
  (void)__atomic_exchange_n(param_1, 0, __ATOMIC_ACQ_REL);
  atomic_set_bit(param_1, 1);
}

/* ---- smp_c1.c ---- */
/* readable reconstruction; identity: FUN_0008323a @ 0x0008323a
 * public-name: smp_c1
 * durable-map: recon/catalogs/function_names_app.json
 * callees (readable <= raw @ address):
 *   smp_c1                                   <= FUN_0008323a @ 0x0008323a
 */
/* CPUAPP Zephyr Bluetooth smp_c1 @ 0x0008323a.
 * Raw/address back-map: FUN_0008323a / 0x0008323a.
 */
extern unsigned int bt_encrypt_le(int, int, int); /* FUN_00081326 */
#define smp_c1 smp_c1

int smp_c1(const uint8_t key[16], const uint8_t random[16],
                 const uint8_t preq[7], const uint8_t pres[7],
                 const uint8_t *initiator_addr, const uint8_t *responder_addr,
                 uint8_t encrypted[16])
{
    uint8_t p1[16];
    p1[0] = initiator_addr[0];
    p1[1] = responder_addr[0];
    for (unsigned i = 0; i < 7; ++i) p1[2 + i] = preq[i];
    for (unsigned i = 0; i < 7; ++i) p1[9 + i] = pres[i];
    for (unsigned i = 0; i < 16; ++i) encrypted[i] = random[i] ^ p1[i];
    int status = bt_encrypt_le(key, encrypted, encrypted);
    if (status != 0)
        return status;
    uint8_t p2[16];
    for (unsigned i = 0; i < 6; ++i) p2[i] = responder_addr[1 + i];
    for (unsigned i = 0; i < 6; ++i) p2[6 + i] = initiator_addr[1 + i];
    for (unsigned i = 12; i < 16; ++i) p2[i] = 0;
    for (unsigned i = 0; i < 16; ++i) encrypted[i] ^= p2[i];
    return bt_encrypt_le(key, encrypted, encrypted);
}

