/*
 * Cohesive translation unit for the `lib' module.
 *
 * GENERATED by recon/refactor/transforms/t04_cohesive_tu.py.  Do not
 * edit: a stage tree is regenerated, never hand-patched
 * (recon/refactor/README.md C4).
 *
 * The 3 functions below were 3 separate translation units until this
 * stage.  Each one's text is reproduced VERBATIM and in the order the
 * generated source list gave it, and they were CONSECUTIVE in that list.
 * They were proven able to share a translation unit: no symbol is
 * declared here with two types, no identifier has internal linkage in one
 * member and is named by another, and no local typedef, macro, struct tag
 * or enum constant of one member is visible to a member that names it.
 *
 * members, in link order:
 *   __ieee754_log10f.c
 *   rint.c
 *   atanf.c
 */
/* ---- __ieee754_log10f.c ---- */
#include "g1_app_symbols.h"
/* readable reconstruction; identity: FUN_00076718 @ 0x00076718
 * public-name: __ieee754_log10f
 * durable-map: recon/catalogs/function_names_app.json
 * callees (readable <= raw @ address):
 *   __ieee754_logf                           <= FUN_00076538 @ 0x00076538
 *   __ieee754_log10f                         <= FUN_00076718 @ 0x00076718
 */
/* Reconstructed FUN_00076718 @ 0x76718  (parity: 300/300 trials, PROVEN) */
#include <stdint.h>
#include "g1_lib.h"
extern float __ieee754_logf(float);
static inline int fbits(float f){ union{float f;int i;}u; u.f=f; return u.i; }
static inline float mkf(int b){ union{int i;float f;}u; u.i=b; return u.f; }
float __ieee754_log10f(float param_1){
    int r3 = fbits(param_1);
    int r2 = r3 & 0x7fffffff;
    float s14;
    if(r2 != 0){
        if(r3 >= 0){
            if(r3 >= 0x7f800000) return param_1 + param_1;
            int iVar2;
            if(r3 < 0x800000){
                iVar2 = -0x19;
                param_1 = param_1 * mkf(0x4c000000);
                r2 = fbits(param_1);
            } else {
                iVar2 = 0;
                r2 = r3;
            }
            int e = (r2 >> 0x17) - 0x7f + iVar2;
            int r1 = (int)((unsigned)e >> 0x1f);
            int emant = e + (int)((unsigned)e >> 31);
            float fVar4 = (float)emant;
            int mant = r2 & 0x7fffff;
            int expo = 0x7f - r1;
            float x = mkf(mant | (expo << 23));
            float fVar3 = __ieee754_logf(x);
            float result = fVar3 * mkf(0x3ede5bd9);
            result = __builtin_fmaf(fVar4, mkf(0x355427db), result);
            result = __builtin_fmaf(fVar4, mkf(0x3e9a2080), result);
            return result;
        } else {
            s14 = param_1 - param_1;
        }
    } else {
        s14 = mkf(0xcc000000);
    }
    return s14 / mkf(0x00000000);
}

/* ---- rint.c ---- */
/* readable reconstruction; identity: FUN_000767c8 @ 0x000767c8
 * public-name: rint
 * durable-map: recon/catalogs/function_names_app.json
 * callees (readable <= raw @ address):
 *   dcmp_negate_rhs                          <= FUN_0000d588 @ 0x0000d588
 *   __aeabi_dadd                             <= FUN_0000d58c @ 0x0000d58c
 *   rint                                     <= FUN_000767c8 @ 0x000767c8
 * address symbols (name @ address):
 *   rodata_40000                             @ 0x00040000
 *   rodata_888a8                             @ 0x000888a8
 */
/* Reconstructed FUN_000767c8 @ 0x767c8  (parity: 300/300 trials, PROVEN) */
extern long long __aeabi_dadd(unsigned, unsigned, unsigned, unsigned);
double rint(double dd, unsigned param_1, unsigned param_2, unsigned param_3)
{
  union { double d; unsigned long long u; struct{unsigned lo,hi;} w; } in, out;
  in.d = dd;
  unsigned uVar5 = in.w.hi, uVar4 = in.w.lo;
  unsigned uVar2 = (uVar5 << 1) >> 0x15;
  int iVar1 = (int)uVar5 >> 0x1f;
  unsigned uVar6 = uVar2 - 0x3ff;
  volatile unsigned *puVar3;
  long long uVar9, uVar10;
  unsigned uVar7, uVar8;
  if ((int)uVar6 < 0x14) {
    if ((int)uVar6 < 0) {
      if ((in.u & 0x7fffffff00000000ULL)==0 && uVar4==0) return in.d;
      puVar3 = (volatile unsigned*)(((unsigned long)&rodata_888a8) /*=0x888a8*/ + iVar1*-8);
      uVar7=puVar3[0]; uVar8=puVar3[1];
      unsigned mantissa = (uVar5 & 0xfffffu) | uVar4;
      unsigned normalized_high = (uVar5 & 0xfffe0000u) |
          ((((0u - mantissa) | mantissa) >> 12) & 0x80000u);
      uVar9 = __aeabi_dadd(uVar7,uVar8,uVar4,normalized_high);
      uVar9 = dcmp_negate_rhs((int)uVar9,(int)((unsigned long long)uVar9>>32),uVar7,uVar8);
      out.w.lo = (unsigned)uVar9;
      out.w.hi = (uVar5 & 0x80000000) | ((unsigned)((unsigned long long)uVar9>>32) & 0x7fffffff);
      return out.d;
    }
    uVar2 = 0xfffff >> (uVar6 & 0xff);
    if ((uVar2 & uVar5)==0 && uVar4==0) return in.d;
    uVar4 = uVar4 | (uVar5 & (uVar2 >> 1));
    if (uVar4 != 0) {
      uVar5 = (((unsigned long)&rodata_40000) /*=0x40000*/ >> (uVar6&0xff)) | (uVar5 & ~(uVar2>>1));
      uVar4 = (unsigned)(uVar6==0x13)*0x80000000U;
    }
  } else {
    if (0x33 < (int)uVar6) {
      if (uVar6 != 0x400) return in.d;
      uVar10 = __aeabi_dadd(uVar4,uVar5,uVar4,uVar5);
      out.w.lo=(unsigned)uVar10; out.w.hi=(unsigned)((unsigned long long)uVar10>>32);
      return out.d;
    }
    uVar2 = uVar2 - 0x413;
    uVar6 = 0xffffffff >> (uVar2&0xff);
    if ((uVar4 & uVar6)==0) return in.d;
    if ((uVar4 & (uVar6>>1))!=0) uVar4 = (0x40000000 >> (uVar2&0xff)) | (uVar4 & ~(uVar6>>1));
  }
  puVar3 = (volatile unsigned*)(((unsigned long)&rodata_888a8) /*=0x888a8*/ + iVar1*-8);
  uVar7=puVar3[0]; uVar8=puVar3[1];
  uVar9 = __aeabi_dadd(uVar7,uVar8,uVar4,uVar5);
  uVar10 = dcmp_negate_rhs((int)uVar9,(int)((unsigned long long)uVar9>>32),uVar7,uVar8);
  out.w.lo=(unsigned)uVar10; out.w.hi=(unsigned)((unsigned long long)uVar10>>32);
  return out.d;
}

/* ---- atanf.c ---- */
/* readable reconstruction; identity: FUN_000768e0 @ 0x000768e0
 * public-name: atanf
 * durable-map: recon/catalogs/function_names_app.json
 * callees (readable <= raw @ address):
 *   atanf                                    <= FUN_000768e0 @ 0x000768e0
 *   fabsf                                    <= FUN_000868ee @ 0x000868ee
 */
/* Reconstructed FUN_000768e0 @ 0x768e0 */

typedef unsigned uint;
extern float fabsf(float);
static inline uint bits(float f) { union { float f; uint u; } v = { f }; return v.u; }
static inline int sbits(float f) { union { float f; int i; } v = { f }; return v.i; }
static inline float fp(uint u) { union { uint u; float f; } v = { u }; return v.f; }

float atanf(float x)
{
    float ax = fp(bits(x) & 0x7fffffffU);
    float reduced, square, fourth, odd, even;
    int octant;

    if (bits(ax) < 0x50800000U) {
        if (bits(ax) > 0x3edfffffU) {
            reduced = fabsf(x);
            if (bits(ax) > 0x3f97ffffU) {
                if (bits(ax) > 0x401bffffU) {
                    octant = 3;
                    reduced = -1.0f / reduced;
                } else {
                    octant = 2;
                    reduced = (reduced - 1.5f) / __builtin_fmaf(reduced, 1.5f, 1.0f);
                }
            } else if (bits(ax) > 0x3f2fffffU) {
                octant = 1;
                reduced = (reduced - 1.0f) / (reduced + 1.0f);
            } else {
                octant = 0;
                reduced = __builtin_fmaf(reduced, 2.0f, -1.0f) / (reduced + 2.0f);
            }
        } else {
            if (bits(ax) < 0x31000000U) {
                float rounded = x + fp(0x7149f2ca);
                if (rounded != 1.0f && ((rounded < 1.0f) == (rounded != rounded)))
                    return x;
            }
            octant = -1;
            reduced = x;
        }

        square = reduced * reduced;
        fourth = square * square;
        /* shipped 0x76966..0x769b6: both Horner chains are vfma.f32 */
        odd = __builtin_fmaf(fourth, fp(0x3c8569d7), fp(0x3d4bda59));
        odd = __builtin_fmaf(fourth, odd, fp(0x3d886b35));
        odd = __builtin_fmaf(fourth, odd, fp(0x3dba2e6e));
        odd = __builtin_fmaf(fourth, odd, fp(0x3e124925));
        odd = __builtin_fmaf(fourth, odd, fp(0x3eaaaaab));
        even = __builtin_fmaf(fourth, fp(0xbd15a221), fp(0xbd6ef16b));
        even = __builtin_fmaf(fourth, even, fp(0xbd9d8795));
        even = __builtin_fmaf(fourth, even, fp(0xbde38e38));
        even = fourth * __builtin_fmaf(fourth, even, fp(0xbe4ccccd));
        /* shipped 0x769be `vmul s14,s14,s13` then 0x769c2 `vfma.f32 s14,s11,s12`:
         * the (odd + even) sum is itself ONE fused op, `even + odd_inner*square`,
         * and `odd` is never multiplied out on its own.  Everything after it --
         * 0x769c6 vmul / 0x769cc vsub / 0x76a22..0x76a2e vsub -- is UNFUSED in
         * the shipped image, so those must stay plain `a - b*c`. */
        {
            const float sum = __builtin_fmaf(odd, square, even);
            if (octant == -1) {
                return reduced - reduced * sum;
            }
            reduced = *(volatile float *)(0x000986cc + octant * 4) -
                      ((reduced * sum -
                        *(volatile float *)(0x000986bc + octant * 4)) - reduced);
        }
        {
            if (sbits(x) < 0)
                reduced = -reduced;
        }
        return reduced;
    }
    if (bits(ax) < 0x7f800001U)
        return sbits(x) > 0 ? fp(0x3fc90fdb) : fp(0xbfc90fdb);
    return x + x;
}

