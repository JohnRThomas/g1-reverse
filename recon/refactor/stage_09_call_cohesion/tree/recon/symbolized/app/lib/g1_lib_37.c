/*
 * Cohesive translation unit for the `lib' module.
 *
 * GENERATED by recon/refactor/transforms/t04_cohesive_tu.py.  Do not
 * edit: a stage tree is regenerated, never hand-patched
 * (recon/refactor/README.md C4).
 *
 * The 2 functions below were 2 separate translation units until this
 * stage.  Each one's text is reproduced VERBATIM and in the order the
 * generated source list gave it, and they were CONSECUTIVE in that list.
 * They were proven able to share a translation unit: no symbol is
 * declared here with two types, no identifier has internal linkage in one
 * member and is named by another, and no local typedef, macro, struct tag
 * or enum constant of one member is visible to a member that names it.
 *
 * members, in link order:
 *   nrf_gpio_pin_reconfigure.c
 *   twim_configure.c
 */

/* File-scope forward declarations for every struct/union tag this
 * unit names.  Without them a tag whose only appearance in a member
 * is inside a parameter list has PARAMETER-LIST scope, so two
 * textually IDENTICAL declarations in two members declare two
 * different incomplete types and the second is a conflicting
 * redeclaration (C11 6.2.1p7).  Incomplete-type forward
 * declarations emit no code. */
struct nrfx_twim_config_raw;
struct nrfx_twim_instance_raw;
/* ---- nrf_gpio_pin_reconfigure.c ---- */
#include "g1_app_symbols.h"
#include "../../../headers/g1_nrf_regs.h"
#include "../../../headers/g1_log.h"
/* readable reconstruction; identity: FUN_00067548 @ 0x00067548
 * public-name: nrf_gpio_pin_reconfigure
 * durable-map: recon/catalogs/function_names_app.json
 * callees (readable <= raw @ address):
 *   nrf_gpio_pin_reconfigure                 <= FUN_00067548 @ 0x00067548
 *   assert_post_action                       <= FUN_0007e2ec @ 0x0007e2ec
 *   printk                                   <= FUN_0007e2fa @ 0x0007e2fa
 * address symbols (name @ address):
 *   rodata_99cbd                             @ 0x00099cbd   [INLINED -- G6 literal batch]
 *   rodata_f09d1                             @ 0x000f09d1
 *   rodata_f0a04                             @ 0x000f0a04   [INLINED -- G6 literal batch]
 */
/* Reconstructed FUN_00067548 @ 0x67548  (parity: 300/300 trials, PROVEN) */
extern long long assert_post_action(unsigned,unsigned);
static void nrf_gpio_pin_reconfigure(unsigned param_1, unsigned param_2, unsigned param_3, unsigned param_4){
    unsigned r0v=param_1, r1v=param_2, r2v=param_3, r3v=param_4;
    unsigned uVar2; int iVar1;
    if ((param_1 >> 5) == 0) goto L_6a;
    if ((param_1 >> 5) == 1) goto L_94;
L_52:
    printk(((unsigned long)"ASSERTION FAIL [%s] @ %s:%d\n") /*=0x99cbd*/,((unsigned long)"nrf_gpio_pin_present_check(*p_pin)") /*=0xf0a04*/,((unsigned long)&rodata_f09d1) /*=0xf09d1*/,0x32f);
    r2v = ((unsigned long)&rodata_f09d1) /*=0xf09d1*/; r3v = 0x32f;
    { long long r=assert_post_action(((unsigned long)&rodata_f09d1) /*=0xf09d1*/,0x32f); r0v=(unsigned)r; r1v=(unsigned)((unsigned long long)r>>32); }
L_6a:
    { unsigned s=r0v & 0xff; uVar2=(s>=32)?0u:(0xffffffffu>>s); }
    iVar1 = G1_NRF_P0_S_BASE;
    if ((int)(uVar2<<0x1f) >= 0) goto L_52;
    goto L_join;
L_94:
    r0v = param_1 & 0x1f;
    uVar2 = 0xffffu >> r0v;
    iVar1 = G1_NRF_P1_S_BASE;
    if ((int)(uVar2<<0x1f) >= 0) goto L_52;
L_join:
    {
        volatile unsigned* addr = (volatile unsigned*)(iVar1 + (r0v<<2) + 0x200);
        *addr = (r3v<<8) | (r2v<<2) | (r1v<<1) | (0xfffcf0f0 & *addr);
    }
}

/* ---- twim_configure.c ---- */
/* readable reconstruction; identity: FUN_000675c0 @ 0x000675c0
 * public-name: twim_configure
 * durable-map: recon/catalogs/function_names_app.json
 * callees (readable <= raw @ address):
 *   arch_irq_enable                          <= FUN_000500ac @ 0x000500ac
 * address symbols (name @ address):
 *   g_nrfx_twim_cb                           @ 0x2000b3cc
 */
/* Reconstructed nrfx_twim twim_configure @ 0x000675c0.
 * Raw/address back-map: FUN_000675c0 / 0x000675c0.
 */
#include <stdint.h>

struct nrfx_twim_instance_raw {
    volatile uint8_t *peripheral;
    uint8_t driver_index;
};

struct nrfx_twim_config_raw {
    uint32_t scl_pin;
    uint32_t sda_pin;
    uint32_t frequency;
    uint8_t interrupt_priority;
    uint8_t hold_bus_uninit;
    uint8_t reserved;
    uint8_t skip_psel_cfg;
};

extern void arch_irq_enable(unsigned int);

static void twim_configure(const struct nrfx_twim_instance_raw *instance,
                    const struct nrfx_twim_config_raw *config)
{
    volatile uint8_t *peripheral = instance->peripheral;

    if (config->skip_psel_cfg == 0u) {
        *(volatile uint32_t *)(peripheral + 0x508) = config->scl_pin;
        *(volatile uint32_t *)(peripheral + 0x50c) = config->sda_pin;
    }
    *(volatile uint32_t *)(peripheral + 0x524) = config->frequency;

    volatile uint32_t *handlers = (volatile uint32_t *)((unsigned long)&g_nrfx_twim_cb) /*=0x2000b3cc*/;
    if (handlers[(uint32_t)instance->driver_index * 10u] != 0u) {
        arch_irq_enable(((uint32_t)(uintptr_t)peripheral >> 12) & 0xffu);
    }
}

