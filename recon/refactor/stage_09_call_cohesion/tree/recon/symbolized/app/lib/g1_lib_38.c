/*
 * Cohesive translation unit for the `lib' module.
 *
 * GENERATED by recon/refactor/transforms/t04_cohesive_tu.py.  Do not
 * edit: a stage tree is regenerated, never hand-patched
 * (recon/refactor/README.md C4).
 *
 * The 2 functions below were 2 separate translation units until this
 * stage.  Each one's text is reproduced VERBATIM and in the order the
 * generated source list gave it, and they were CONSECUTIVE in that list.
 * They were proven able to share a translation unit: no symbol is
 * declared here with two types, no identifier has internal linkage in one
 * member and is named by another, and no local typedef, macro, struct tag
 * or enum constant of one member is visible to a member that names it.
 *
 * members, in link order:
 *   nrfx_wdt_reload_value_set.c
 *   nrfx_wdt_channel_enable.c
 */
/* ---- nrfx_wdt_reload_value_set.c ---- */
#include "g1_app_symbols.h"
/* readable reconstruction; identity: FUN_00067d84 @ 0x00067d84
 * public-name: nrfx_wdt_reload_value_set
 * durable-map: recon/catalogs/function_names_app.json
 * callees (readable <= raw @ address):
 *   __aeabi_uldivmod                         <= FUN_0000e244 @ 0x0000e244
 *   arch_irq_enable                          <= FUN_000500ac @ 0x000500ac
 *   nrfx_wdt_reload_value_set                <= FUN_00067d84 @ 0x00067d84
 *   assert_post_action                       <= FUN_0007e2ec @ 0x0007e2ec
 *   printk                                   <= FUN_0007e2fa @ 0x0007e2fa
 * address symbols (name @ address):
 *   rodata_99cbd                             @ 0x00099cbd   [INLINED -- G6 literal batch]
 *   rodata_f79c8                             @ 0x000f79c8
 *   rodata_f7a03                             @ 0x000f7a03
 *   m_dppi_channels                          @ 0x2000b41c
 */
/* Full reconstruction FUN_00067d84 @ 0x67d84, exact extent 102 bytes. */
#include <stdint.h>
#include "../../../headers/g1_log.h"
#include "../../../headers/g1_dedupe.h"
extern uint64_t __aeabi_uldivmod(uint32_t,uint32_t,uint32_t,uint32_t);
extern __attribute__((noreturn)) void assert_post_action(uintptr_t,uint32_t);
extern void arch_irq_enable(int32_t,uint32_t,uint32_t,uint32_t);
static void nrfx_wdt_reload_value_set(uintptr_t *device,const uint32_t *ticks){
 uint32_t upper=ticks[1]>>17;
 uint64_t scaled=__aeabi_uldivmod(ticks[1]<<15,upper,1000,0);
 if(upper>=1000){G1_ASSERT_FAIL((((unsigned long)"ASSERTION FAIL [%s] @ %s:%d\n") /*=0x99cbd*/,((unsigned long)&rodata_f7a03) /*=0xf7a03*/,((unsigned long)&rodata_f79c8) /*=0xf79c8*/,0x3f), (((unsigned long)&rodata_f79c8) /*=0xf79c8*/,0x3f));}
 uintptr_t registers=*device;*(volatile uint32_t *)(registers+0x50c)=ticks[0];
 *(volatile uint32_t *)(registers+0x504)=(uint32_t)scaled;
 uint32_t channel=((const uint8_t*)device)[4];
 if(*(volatile uint32_t *)(((unsigned long)&m_dppi_channels) /*=0x2000b41c*/+channel*8u+4)!=0){
  *(volatile uint32_t *)(registers+0x100)=0;
  arch_irq_enable((int32_t)(registers<<12)>>24,(uint32_t)(scaled>>32),channel,0);
  *(volatile uint32_t *)(registers+0x304)=1;
 }
}

/* ---- nrfx_wdt_channel_enable.c ---- */
/* readable reconstruction; identity: FUN_00067e30 @ 0x00067e30
 * public-name: nrfx_wdt_channel_enable
 * durable-map: recon/catalogs/function_names_app.json
 * callees (readable <= raw @ address):
 *   nrfx_wdt_channel_enable                  <= FUN_00067e30 @ 0x00067e30
 *   assert_post_action                       <= FUN_0007e2ec @ 0x0007e2ec
 *   printk                                   <= FUN_0007e2fa @ 0x0007e2fa
 * address symbols (name @ address):
 *   rodata_99cbd                             @ 0x00099cbd   [INLINED -- G6 literal batch]
 *   rodata_f7052                             @ 0x000f7052
 *   rodata_f79c8                             @ 0x000f79c8
 *   rodata_f7a1b                             @ 0x000f7a1b
 *   m_dppi_channels                          @ 0x2000b41c
 */
/* Full reconstruction FUN_00067e30 @ 0x67e30, exact extent 70 bytes. */
static void nrfx_wdt_channel_enable(uintptr_t *device,uint32_t a,uint32_t b,uint32_t context){
 (void)a;(void)b;uint32_t ch=((uint8_t*)device)[4];volatile uint8_t *s=(volatile uint8_t*)(((unsigned long)&m_dppi_channels) /*=0x2000b41c*/+ch*8u);
 if(s[1]==0){G1_ASSERT_FAIL((((unsigned long)"ASSERTION FAIL [%s] @ %s:%d\n") /*=0x99cbd*/,((unsigned long)&rodata_f7a1b) /*=0xf7a1b*/,((unsigned long)&rodata_f79c8) /*=0xf79c8*/,0x8c,context), (((unsigned long)&rodata_f79c8) /*=0xf79c8*/,0x8c));}
 if(s[0]==1){*(volatile uint32_t *)*device=1;s[0]=2;return;}
 G1_ASSERT_FAIL((((unsigned long)"ASSERTION FAIL [%s] @ %s:%d\n") /*=0x99cbd*/,((unsigned long)&rodata_f7052) /*=0xf7052*/,((unsigned long)&rodata_f79c8) /*=0xf79c8*/,0x8d,context), (((unsigned long)&rodata_f79c8) /*=0xf79c8*/,0x8d));
}

