/*
 * Cohesive translation unit for the `lib' module.
 *
 * GENERATED by recon/refactor/transforms/t04_cohesive_tu.py.  Do not
 * edit: a stage tree is regenerated, never hand-patched
 * (recon/refactor/README.md C4).
 *
 * The 3 functions below were 3 separate translation units until this
 * stage.  Each one's text is reproduced VERBATIM and in the order the
 * generated source list gave it, and they were CONSECUTIVE in that list.
 * They were proven able to share a translation unit: no symbol is
 * declared here with two types, no identifier has internal linkage in one
 * member and is named by another, and no local typedef, macro, struct tag
 * or enum constant of one member is visible to a member that names it.
 *
 * members, in link order:
 *   k_current_get.c
 *   k_uptime_ticks_impl.c
 *   z_heap_aligned_alloc.c
 */

/* File-scope forward declarations for every struct/union tag this
 * unit names.  Without them a tag whose only appearance in a member
 * is inside a parameter list has PARAMETER-LIST scope, so two
 * textually IDENTICAL declarations in two members declare two
 * different incomplete types and the second is a conflicting
 * redeclaration (C11 6.2.1p7).  Incomplete-type forward
 * declarations emit no code. */
struct k_spinlock;
/* ---- k_current_get.c ---- */
#include "g1_app_symbols.h"
/* readable reconstruction; identity: FUN_000748ac @ 0x000748ac
 * public-name: k_current_get
 * durable-map: recon/catalogs/function_names_app.json
 * callees (readable <= raw @ address):
 *   k_current_get                            <= FUN_000748ac @ 0x000748ac
 * address symbols (name @ address):
 *   g_current_thread_ptr                     @ 0x2000b450
 */
/* Reconstructed FUN_000748ac @ 0x748ac  (parity: 300/300 trials, PROVEN) */

#include <stdint.h>
int k_current_get(void) {
    return *(volatile uint32_t *)((unsigned long)&g_current_thread_ptr) /*=0x2000b450*/;
}

/* ---- k_uptime_ticks_impl.c ---- */
/* readable reconstruction; identity: FUN_00074f68 @ 0x00074f68
 * public-name: k_uptime_ticks_impl
 * durable-map: recon/catalogs/function_names_app.json
 * callees (readable <= raw @ address):
 *   z_spin_lock_valid                        <= FUN_00072040 @ 0x00072040
 *   z_spin_unlock_valid                      <= FUN_0007205c @ 0x0007205c
 *   z_spin_lock_set_owner                    <= FUN_00072078 @ 0x00072078
 *   rtc_get_elapsed_cycles_since_baseline    <= FUN_00074b68 @ 0x00074b68
 *   k_uptime_ticks_impl                      <= FUN_00074f68 @ 0x00074f68
 *   assert_post_action                       <= FUN_0007e2ec @ 0x0007e2ec
 *   printk                                   <= FUN_0007e2fa @ 0x0007e2fa
 * address symbols (name @ address):
 *   rodata_99cbd                             @ 0x00099cbd   [INLINED -- G6 literal batch]
 *   rodata_f08c7                             @ 0x000f08c7
 *   rodata_f08f4                             @ 0x000f08f4   [INLINED -- G6 literal batch]
 *   rodata_f090b                             @ 0x000f090b   [INLINED -- G6 literal batch]
 *   rodata_f0920                             @ 0x000f0920   [INLINED -- G6 literal batch]
 *   rodata_f0935                             @ 0x000f0935   [INLINED -- G6 literal batch]
 *   g_curr_tick_lo                           @ 0x200069e0
 *   g_curr_tick_hi                           @ 0x200069e4
 *   g_timeout_list_spinlock                  @ 0x2000b498
 */
/* Reconstructed FUN_00074f68 @ 0x74f68  (parity: 80/80 trials, PROVEN) */
#include "../../../headers/g1_log.h"
#include "../../../headers/g1_dedupe.h"
extern _Bool z_spin_lock_valid(struct k_spinlock *);
extern void z_spin_lock_set_owner(struct k_spinlock *);
extern unsigned int rtc_get_elapsed_cycles_since_baseline(void);
extern _Bool z_spin_unlock_valid(struct k_spinlock *);
extern void assert_post_action(const char *, unsigned int);
unsigned long long k_uptime_ticks_impl(void){
  unsigned int uVar6=0;
  int iVar2=z_spin_lock_valid(((unsigned long)&g_timeout_list_spinlock) /*=0x2000b498*/);
  if(iVar2==0){
    printk(((unsigned long)"ASSERTION FAIL [%s] @ %s:%d\n") /*=0x99cbd*/,((unsigned long)"z_spin_lock_valid(l)") /*=0xf0920*/,((unsigned long)&rodata_f08c7) /*=0xf08c7*/,0x72);
    G1_ASSERT_FAIL((((unsigned long)"\tInvalid spinlock %p\n") /*=0xf0935*/,((unsigned long)&g_timeout_list_spinlock) /*=0x2000b498*/), (((unsigned long)&rodata_f08c7) /*=0xf08c7*/,0x72));
  }
  z_spin_lock_set_owner(((unsigned long)&g_timeout_list_spinlock) /*=0x2000b498*/);
  unsigned int uVar3=rtc_get_elapsed_cycles_since_baseline();
  unsigned int uVar4=*(volatile unsigned int *)((unsigned long)&g_curr_tick_lo) /*=0x200069e0*/;
  unsigned int uVar5=*(volatile unsigned int *)((unsigned long)&g_curr_tick_hi) /*=0x200069e4*/;
  int iVar2b=z_spin_unlock_valid(((unsigned long)&g_timeout_list_spinlock) /*=0x2000b498*/);
  if(iVar2b==0){
    printk(((unsigned long)"ASSERTION FAIL [%s] @ %s:%d\n") /*=0x99cbd*/,((unsigned long)"z_spin_unlock_valid(l)") /*=0xf08f4*/,((unsigned long)&rodata_f08c7) /*=0xf08c7*/,0xf0);
    G1_ASSERT_FAIL((((unsigned long)"\tNot my spinlock %p\n") /*=0xf090b*/,((unsigned long)&g_timeout_list_spinlock) /*=0x2000b498*/), (((unsigned long)&rodata_f08c7) /*=0xf08c7*/,0xf0));
  }
  (void)uVar6;
  unsigned int r0res=uVar3+uVar4;
  unsigned int r1res=uVar5 + (unsigned int)((int)uVar3>>31) + (unsigned int)(((unsigned long long)uVar3+uVar4)>>32);
  return ((unsigned long long)r1res<<32)|r0res;
}

/* ---- z_heap_aligned_alloc.c ---- */
/* readable reconstruction; identity: FUN_00075864 @ 0x00075864
 * public-name: z_heap_aligned_alloc
 * durable-map: recon/catalogs/function_names_app.json
 * callees (readable <= raw @ address):
 *   k_heap_alloc                             <= FUN_000719f4 @ 0x000719f4
 *   assert_post_action                       <= FUN_0007e2ec @ 0x0007e2ec
 *   printk                                   <= FUN_0007e2fa @ 0x0007e2fa
 * address symbols (name @ address):
 *   rodata_99cbd                             @ 0x00099cbd   [INLINED -- G6 literal batch]
 *   rodata_f891e                             @ 0x000f891e
 *   rodata_f8942                             @ 0x000f8942
 *   rodata_f8974                             @ 0x000f8974
 */
/* Reconstructed z_heap_aligned_alloc @ 0x00075864 from Zephyr mempool.c.
 * Raw backmap: FUN_00075864@0x00075864. */

#include <stddef.h>

extern void *k_heap_alloc(void *heap, size_t alignment, size_t size,
                          uint64_t timeout);

#define k_heap_aligned_alloc k_heap_alloc
void *z_heap_aligned_alloc(void *heap, size_t alignment, size_t size)
{
    size_t adjusted_size = size + sizeof(void *);
    if (adjusted_size < size) {
        return 0;
    }

    void *allocation = k_heap_aligned_alloc(
        heap, alignment | sizeof(void *), adjusted_size, 0u);
    if (allocation == 0) {
        return 0;
    }

    *(void **)allocation = heap;
    void *result = (uint8_t *)allocation + sizeof(void *);
    if (alignment != 0u &&
        (((uintptr_t)result & (alignment - 1u)) != 0u)) {
        printk(((unsigned long)"ASSERTION FAIL [%s] @ %s:%d\n") /*=0x99cbd*/, ((unsigned long)&rodata_f8942) /*=0xf8942*/, ((unsigned long)&rodata_f891e) /*=0xf891e*/, 0x25u);
        G1_ASSERT_FAIL((((unsigned long)&rodata_f8974) /*=0xf8974*/, result, alignment), (((unsigned long)&rodata_f891e) /*=0xf891e*/, 0x25u));
        return 0;
    }
    return result;
}

