/*
 * Cohesive translation unit for the `lib' module.
 *
 * GENERATED by recon/refactor/transforms/t04_cohesive_tu.py.  Do not
 * edit: a stage tree is regenerated, never hand-patched
 * (recon/refactor/README.md C4).
 *
 * The 4 functions below were 4 separate translation units until this
 * stage.  Each one's text is reproduced VERBATIM and in the order the
 * generated source list gave it, and they were CONSECUTIVE in that list.
 * They were proven able to share a translation unit: no symbol is
 * declared here with two types, no identifier has internal linkage in one
 * member and is named by another, and no local typedef, macro, struct tag
 * or enum constant of one member is visible to a member that names it.
 *
 * members, in link order:
 *   bt_conn_get_field_0x90.c
 *   net_buf_frags_len.c
 *   l2cap_lookup_chan_by_ident.c
 *   att_create_pdu_reserve4.c
 */

/* File-scope forward declarations for every struct/union tag this
 * unit names.  Without them a tag whose only appearance in a member
 * is inside a parameter list has PARAMETER-LIST scope, so two
 * textually IDENTICAL declarations in two members declare two
 * different incomplete types and the second is a conflicting
 * redeclaration (C11 6.2.1p7).  Incomplete-type forward
 * declarations emit no code. */
struct configured_net_buf_view;
/* ---- bt_conn_get_field_0x90.c ---- */
#include "g1_app_symbols.h"
/* readable reconstruction; identity: FUN_00081526 @ 0x00081526
 * public-name: bt_conn_get_field_0x90
 * durable-map: recon/catalogs/function_names_app.json
 * callees (readable <= raw @ address):
 *   bt_conn_get_field_0x90                   <= FUN_00081526 @ 0x00081526
 */
/* Reconstructed FUN_00081526 @ 0x81526  (parity: 300/300 trials, PROVEN) */

int bt_conn_get_field_0x90(int param_1) {
    return param_1 + 0x90;
}

/* ---- net_buf_frags_len.c ---- */
/* readable reconstruction; identity: FUN_00081616 @ 0x00081616
 * public-name: net_buf_frags_len
 * durable-map: recon/catalogs/function_names_app.json
 */
/* Reconstructed net_buf_frags_len @ 0x00081616 from configured Zephyr 3.4.99 net/buf.h.
 * Identity/backmap: FUN_00081616.
 */
#include <stddef.h>
#include <stdint.h>

struct configured_net_buf_view {
    void *node_next;
    struct configured_net_buf_view *frags;
    uint8_t ref;
    uint8_t flags;
    uint8_t pool_id;
    uint8_t user_data_size;
    uint8_t *data;
    uint16_t len;
};

size_t net_buf_frags_len(struct configured_net_buf_view *buf)
{
    size_t bytes = 0;
    while (buf != 0) {
        bytes += buf->len;
        buf = buf->frags;
    }
    return bytes;
}

/* ---- l2cap_lookup_chan_by_ident.c ---- */
/* readable reconstruction; identity: FUN_00081626 @ 0x00081626
 * public-name: l2cap_lookup_chan_by_ident
 * durable-map: recon/catalogs/function_names_app.json
 * callees (readable <= raw @ address):
 *   slist_unlink_after                       <= FUN_000815f6 @ 0x000815f6
 *   l2cap_lookup_chan_by_ident               <= FUN_00081626 @ 0x00081626
 */
/* Reconstructed FUN_00081626 @ 0x81626  (parity: 300/300 trials, PROVEN) */

extern void slist_unlink_after(int a, int *b, int *c, int d, unsigned int e);

int *l2cap_lookup_chan_by_ident(int param_1, unsigned int param_2, int param_3, unsigned int param_4)
{
    int *piVar1;
    int *piVar2;
    int *piVar3;

    piVar1 = *(int **)(param_1 + 0x54);
    if (piVar1 != (int *)0) {
        piVar3 = (int *)0;
        piVar2 = piVar1;
        do {
            if (*(volatile unsigned char *)((int)piVar2 + 0xb8) == param_2) {
                if (param_3 == 0) {
                    return piVar2 + -2;
                }
                slist_unlink_after(param_1 + 0x54, (int*)piVar3, (int*)piVar2, param_1, param_4);
                return piVar2 + -2;
            }
            piVar1 = (int *)*piVar2;
            piVar3 = piVar2;
            piVar2 = piVar1;
        } while (piVar1 != (int *)0);
    }
    return piVar1;
}

/* ---- att_create_pdu_reserve4.c ---- */
/* readable reconstruction; identity: FUN_0008181a @ 0x0008181a
 * public-name: att_create_pdu_reserve4
 * durable-map: recon/catalogs/function_names_app.json
 * callees (readable <= raw @ address):
 *   bt_conn_create_pdu_timeout               <= FUN_000569ec @ 0x000569ec
 *   att_create_pdu_reserve4                  <= FUN_0008181a @ 0x0008181a
 */
/* Reconstructed FUN_0008181a @ 0x8181a  (parity: 300/300 trials, PROVEN) */

extern void bt_conn_create_pdu_timeout(unsigned int, int);
void att_create_pdu_reserve4(unsigned int param_1, int param_2)
{
    bt_conn_create_pdu_timeout(param_1, param_2 + 4);
}

