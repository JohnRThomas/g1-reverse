/*
 * Call-cohesive translation unit for the `lib' module.
 *
 * GENERATED by recon/refactor/transforms/t09_call_cohesion.py.  Do
 * not edit: a stage tree is regenerated, never hand-patched
 * (recon/refactor/README.md C4).
 *
 * The 3 translation units below were grouped because they CALL ONE
 * ANOTHER, not because they were adjacent in the generated source
 * list.  Each member's text is reproduced VERBATIM.  Every member was
 * checked pairwise against every other member already in this unit by
 * stage 04's seven refusal rules, unchanged: no symbol is declared
 * here with two types, no identifier has internal linkage in one
 * member and is named by another, and no local typedef, macro, struct
 * tag or enum constant of one member is visible to a member that
 * names it.
 *
 * members, in generated-source-list order:
 *   gatt_parse_find_by_type_rsp.c
 *   g1_lib_65.c
 *   gatt_store_ccc_cf.c
 *
 * call edges inside this unit (caller -> callee): 2
 *   gatt_parse_find_by_type_rsp.c -> g1_lib_65.c
 *   gatt_store_ccc_cf.c -> g1_lib_65.c
 */
/* ================================================================ */
/* member unit: gatt_parse_find_by_type_rsp.c */
/* ================================================================ */
#include "g1_app_symbols.h"
/* readable reconstruction; identity: FUN_0005bbf4 @ 0x0005bbf4
 * public-name: gatt_parse_find_by_type_rsp
 * durable-map: recon/catalogs/function_names_app.json
 * callees (readable <= raw @ address):
 *   gatt_parse_find_by_type_rsp              <= FUN_0005bbf4 @ 0x0005bbf4
 *   log_msg_create_3arg                      <= FUN_00082a42 @ 0x00082a42
 *   gatt_discover_next                       <= FUN_00082d2e @ 0x00082d2e
 *   memset_bytes                             <= FUN_00086c78 @ 0x00086c78
 * address symbols (name @ address):
 *   rodata_88128                             @ 0x00088128
 *   rodata_f4ca8                             @ 0x000f4ca8
 */
/* Reconstructed FUN_0005bbf4 @ 0x5bbf4  (parity: 300/300 trials, PROVEN) */
#include <stdint.h>
extern void log_msg_create_3arg(unsigned,unsigned,void*);
extern void gatt_discover_next(unsigned long, unsigned long, void*);
extern void memset_bytes(void*,int,int);
typedef int (*fp_t)(unsigned,void*,void*);

void gatt_parse_find_by_type_rsp(unsigned param_1, int param_2, unsigned char *param_3, int param_4, char *param_5){
  fp_t pcVar6;
  if(param_2 != 0){
    pcVar6 = *(fp_t*)(param_5+4);
    pcVar6(param_1, 0, param_5);
    return;
  }
  unsigned uVar3 = *param_3;
  char cVar2 = 0;
  if(uVar3 != 6){
    if(uVar3 == 0x14){ cVar2 = 2; }
    else {
      unsigned st[8];
      st[0]=3; st[5]=((unsigned long)&rodata_f4ca8) /*=0xf4ca8*/; st[6]=uVar3;
      log_msg_create_3arg(((unsigned long)&rodata_88128) /*=0x88128*/, 0x1840, st);
      goto LAB_bc40;
    }
  }
  {
    char local_50 = cVar2;
    unsigned short uVar9 = 0, uVar1;
    unsigned short *puVar10 = (unsigned short*)(param_3 + 1);
    unsigned char blk[0x14];
    unsigned uVar3b = (unsigned)(param_4 - 1);
    while((uVar3b = uVar3b & 0xffff), *param_3 <= uVar3b){
      memset_bytes(blk, 0, 0x14);
      uVar1 = *puVar10;
      if(uVar1==0 || (uVar9=puVar10[1], uVar9==0) || uVar9 < uVar1) goto LAB_bc40;
      volatile unsigned short sink = 0;
      if(local_50 == 0){ sink = puVar10[2]; }
      else if(local_50 == 2){ for(int i=0;i<4;i++) sink = puVar10[2+i]; }
      (void)sink;
      int iVar4 = (*(fp_t*)(param_5+4))(param_1, blk, param_5);
      if(iVar4 == 0) return;
      puVar10 = (unsigned short*)((int)puVar10 + *param_3);
      uVar3b = uVar3b - *param_3;
    }
    if(uVar3b == 0 && uVar9 != 0){
      gatt_discover_next(param_1, uVar9, param_5);
      return;
    }
  }
LAB_bc40:
  pcVar6 = *(fp_t*)(param_5+4);
  pcVar6(param_1, 0, param_5);
}

/* ================================================================ */
/* member unit: g1_lib_65.c */
/* ================================================================ */
/*
 * Cohesive translation unit for the `lib' module.
 *
 * GENERATED by recon/refactor/transforms/t04_cohesive_tu.py.  Do not
 * edit: a stage tree is regenerated, never hand-patched
 * (recon/refactor/README.md C4).
 *
 * The 8 functions below were 8 separate translation units until this
 * stage.  Each one's text is reproduced VERBATIM and in the order the
 * generated source list gave it, and they were CONSECUTIVE in that list.
 * They were proven able to share a translation unit: no symbol is
 * declared here with two types, no identifier has internal linkage in one
 * member and is named by another, and no local typedef, macro, struct tag
 * or enum constant of one member is visible to a member that names it.
 *
 * members, in link order:
 *   atomic_or_0.c
 *   atomic_and_4.c
 *   gatt_foreach_iter.c
 *   gatt_sc_ctx_clear.c
 *   gatt_req_send.c
 *   bt_gatt_foreach_attr_0.c
 *   gatt_discover_next.c
 *   l2cap_reassemble_frag.c
 */
/* ---- atomic_or_0.c ---- */
#include "g1_app_symbols.h"
/* readable reconstruction; identity: FUN_000826e0 @ 0x000826e0
 * public-name: atomic_or_0
 * durable-map: recon/catalogs/function_names_app.json
 */
/* Reconstructed atomic_or_0 @ 0x826e0  (CFG-directed candidate) */
#include <stdint.h>
#include "g1_lib.h"

/* Pinned Zephyr 3.4.99 atomic_builtin.h semantics. */
int atomic_or_0(volatile int32_t *target, int32_t value)
{
    return __atomic_fetch_or(target, value, __ATOMIC_SEQ_CST);
}

/* ---- atomic_and_4.c ---- */
/* readable reconstruction; identity: FUN_000826f6 @ 0x000826f6
 * public-name: atomic_and_4
 * durable-map: recon/catalogs/function_names_app.json
 */
/* Reconstructed atomic_and_4 @ 0x000826f6 from Zephyr atomic_builtin.h.
 * Raw backmap: FUN_000826f6@0x000826f6. */

int32_t atomic_and_4(volatile int32_t *target, int32_t value)
{
    return __atomic_fetch_and(target, value, __ATOMIC_SEQ_CST);
}

/* ---- gatt_foreach_iter.c ---- */
/* readable reconstruction; identity: FUN_00082712 @ 0x00082712
 * public-name: gatt_foreach_iter
 * durable-map: recon/catalogs/function_names_app.json
 * callees (readable <= raw @ address):
 *   bt_uuid_cmp                              <= FUN_00080d3e @ 0x00080d3e
 *   gatt_foreach_iter                        <= FUN_00082712 @ 0x00082712
 */
/* Reconstructed FUN_00082712 @ 0x82712  (parity: 300/300 trials, PROVEN) */

typedef unsigned int (*fn8_82712)(void*, unsigned int, unsigned int);
extern int bt_uuid_cmp(int a, unsigned int b, unsigned int c, unsigned int d, unsigned int e);

static unsigned int gatt_foreach_iter(unsigned int *param_1, unsigned int param_2, unsigned int param_3, unsigned int param_4, int param_5, int param_6, short *param_7, fn8_82712 param_8, unsigned int param_9)
{
  unsigned int uVar1;
  int iVar2;

  if (param_2 <= param_4) {
    if (((param_2 < param_3) ||
        ((param_5 != 0) &&
         (iVar2 = bt_uuid_cmp(param_5,*param_1,param_3,param_4,param_4), iVar2 != 0))) ||
       ((param_6 != 0) && ((int)param_1[3] != param_6))) {
      return 1;
    }
    *param_7 = *param_7 - 1;
    uVar1 = (*param_8)(param_1,param_2,param_9);
    if (*param_7 != 0) {
      return uVar1;
    }
  }
  return 0;
}

/* ---- gatt_sc_ctx_clear.c ---- */
/* readable reconstruction; identity: FUN_00082928 @ 0x00082928
 * public-name: gatt_sc_ctx_clear
 * durable-map: recon/catalogs/function_names_app.json
 * callees (readable <= raw @ address):
 *   gatt_sc_ctx_clear                        <= FUN_00082928 @ 0x00082928
 */
/* Reconstructed FUN_00082928 @ 0x82928  (parity: 300/300 trials, PROVEN) */

void gatt_sc_ctx_clear(unsigned int *param_1)
{
  param_1[0] = 0;
  param_1[1] = 0;
  param_1[2] = 0;
}

/* ---- gatt_req_send.c ---- */
/* readable reconstruction; identity: FUN_00082aee @ 0x00082aee
 * public-name: gatt_req_send
 * durable-map: recon/catalogs/function_names_app.json
 * callees (readable <= raw @ address):
 *   bt_att_create_pdu                        <= FUN_00058eb0 @ 0x00058eb0
 *   bt_att_req_alloc                         <= FUN_000596c0 @ 0x000596c0
 *   bt_att_req_free                          <= FUN_00059708 @ 0x00059708
 *   bt_att_req_send                          <= FUN_00059a90 @ 0x00059a90
 *   bt_att_set_tx_meta_data                  <= FUN_000825ac @ 0x000825ac
 * address symbols (name @ address):
 *   rodata_f0000                             @ 0x000f0000
 */
/* Reconstructed gatt_req_send @ 0x00082aee (FUN_00082aee; CFG-verified). */
/* Pinned Zephyr 3.4.99 owner: subsys/bluetooth/host/gatt.c. */
extern uintptr_t bt_att_req_alloc(uint32_t timeout, uint32_t unused);
extern void bt_att_req_free(uintptr_t req);
extern int bt_att_create_pdu(int, int, int);
extern void bt_att_set_tx_meta_data(int, int, int, int);
typedef int (*encode_t)(uintptr_t buf, uint32_t len, uintptr_t params);
int gatt_req_send(uintptr_t conn, uintptr_t callback, uintptr_t params,
                  encode_t encode, uint32_t op, uint32_t len)
{
    uint32_t opcode = (uint8_t)op;
    uintptr_t req = bt_att_req_alloc(((unsigned long)&rodata_f0000) /*=0xf0000*/, 0u);
    if (req == 0u) return -12;
    *(volatile uintptr_t *)(req + 4u) = callback;
    *(volatile uint8_t *)(req + 0x11u) = (uint8_t)opcode;
    *(volatile uint32_t *)(req + 0x14u) = len;
    *(volatile encode_t *)(req + 0x0cu) = encode;
    *(volatile uintptr_t *)(req + 0x18u) = params;
    uintptr_t buf = bt_att_create_pdu(conn, opcode, len);
    if (buf == 0u) {
        bt_att_req_free(req);
        return -12;
    }
    bt_att_set_tx_meta_data(buf, 0u, 0u, 1u);
    *(volatile uintptr_t *)(req + 8u) = buf;
    int err = encode(buf, len, params);
    if (err == 0) err = bt_att_req_send(conn, req);
    if (err != 0) bt_att_req_free(req);
    return err;
}

/* ---- bt_gatt_foreach_attr_0.c ---- */
/* readable reconstruction; identity: FUN_00082c9c @ 0x00082c9c
 * public-name: bt_gatt_foreach_attr_0
 * durable-map: recon/catalogs/function_names_app.json
 */
/* Reconstructed bt_gatt_foreach_attr_0 @ 0x00082c9c from Zephyr gatt.h.
 * Raw backmap: FUN_00082c9c@0x00082c9c. */

typedef uint8_t (*bt_gatt_attr_func_t)(const void *, void *);
extern void bt_gatt_foreach_attr_type(uint16_t start, uint16_t end,
                                      const void *uuid, const void *data,
                                      uint16_t matches,
                                      bt_gatt_attr_func_t callback,
                                      void *user_data);
void bt_gatt_foreach_attr_0(unsigned short start, unsigned short end, void*callback, void*user_data) {
    bt_gatt_foreach_attr_type(start, end, 0, 0, 0, callback, user_data);
}

/* ---- gatt_discover_next.c ---- */
/* readable reconstruction; identity: FUN_00082d2e @ 0x00082d2e
 * public-name: gatt_discover_next
 * durable-map: recon/catalogs/function_names_app.json
 * callees (readable <= raw @ address):
 *   bt_gatt_discover                         <= FUN_0005b9cc @ 0x0005b9cc
 */
/* Reconstructed gatt_discover_next @ 0x00082d2e (FUN_00082d2e; CFG-verified). */
/* Pinned Zephyr 3.4.99 owner: subsys/bluetooth/host/gatt.c. */
typedef void (*discover_cb_t)(void *, const void *, void *);
void gatt_discover_next(unsigned long conn, unsigned long last_handle, void*opaque) {
    volatile uint8_t *params = (volatile uint8_t *)opaque;
    if (last_handle != 0) {
        if (last_handle == UINT16_MAX) {
            *(volatile uint16_t *)(params + 8) = UINT16_MAX;
        } else {
            uint16_t next = (uint16_t)(last_handle + 1u);
            *(volatile uint16_t *)(params + 8) = next;
            if (next <= *(volatile uint16_t *)(params + 14)) {
                if (bt_gatt_discover(conn, opaque) == 0) return;
            }
        }
    } else if (bt_gatt_discover(conn, opaque) == 0) {
        return;
    }
    ((discover_cb_t)*(volatile uintptr_t *)(params + 4))(conn, 0, opaque);
}

/* ---- l2cap_reassemble_frag.c ---- */
/* readable reconstruction; identity: FUN_00082e04 @ 0x00082e04
 * public-name: l2cap_reassemble_frag
 * durable-map: recon/catalogs/function_names_app.json
 * callees (readable <= raw @ address):
 *   gatt_prepare_write_rsp                   <= FUN_0005c310 @ 0x0005c310
 *   l2cap_reassemble_frag                    <= FUN_00082e04 @ 0x00082e04
 */
/* Reconstructed FUN_00082e04 @ 0x82e04  (parity: 300/300 trials, PROVEN) */
extern void gatt_prepare_write_rsp(int,int,int,void*);
void l2cap_reassemble_frag(int param_1,int param_2,int param_3,int param_4,void **param_5){
  (void)param_4;
  if (param_2 != 0){
    (*(void(*)(int,int,void*))*param_5)(param_1,param_2,param_5);
  } else {
    gatt_prepare_write_rsp(param_1,param_3,param_4,param_5);
  }
}

/* ================================================================ */
/* member unit: gatt_store_ccc_cf.c */
/* ================================================================ */
#include "g1_app_symbols.h"
/* readable reconstruction; identity: FUN_00082f3a @ 0x00082f3a
 * public-name: gatt_store_ccc_cf
 * durable-map: recon/catalogs/function_names_app.json
 * callees (readable <= raw @ address):
 *   read_struct_first_word                   <= FUN_0008270c @ 0x0008270c
 *   gatt_store_ccc_cf                        <= FUN_00082f3a @ 0x00082f3a
 */
/* Reconstructed gatt_store_ccc_cf @ 0x00082f3a from NCS 2.5.1 gatt.c.
 * Raw backmap: FUN_00082f3a@0x00082f3a. */

#include <stdint.h>
#define gatt_store_ccc_cf gatt_store_ccc_cf
extern uint8_t *find_sc_cfg_59b94(uint32_t id,const void *peer);
extern int bt_addr_le_is_bonded(uint32_t id,const void *peer);
extern int32_t atomic_and_4(volatile int32_t *target,int32_t value);
extern void bt_gatt_store_ccc(uint32_t id,const void *peer);
extern void bt_gatt_store_cf(uint32_t id,const void *peer);
extern int32_t read_struct_first_word(volatile int32_t *target); /* atomic_get */
void gatt_store_ccc_cf(uint32_t id,const void *peer)
{
 uint8_t *entry=find_sc_cfg_59b94(id,peer);
 if(bt_addr_le_is_bonded(id,peer)!=0 && entry!=0){
  volatile int32_t *flags=(volatile int32_t*)(entry+8u);
  if((atomic_and_4(flags,-2)&1)!=0)bt_gatt_store_ccc(id,peer);
  if((atomic_and_4(flags,-3)&2)!=0)bt_gatt_store_cf(id,peer);
  if(read_struct_first_word(flags)==0){
   entry[0]=0;*(uint32_t*)(entry+1u)=0;*(uint32_t*)(entry+4u)=0;
   __atomic_store_n(flags,0,__ATOMIC_SEQ_CST);
  }
 }
}

