/*
 * Cohesive translation unit for the `lib' module.
 *
 * GENERATED by recon/refactor/transforms/t04_cohesive_tu.py.  Do not
 * edit: a stage tree is regenerated, never hand-patched
 * (recon/refactor/README.md C4).
 *
 * The 6 functions below were 6 separate translation units until this
 * stage.  Each one's text is reproduced VERBATIM and in the order the
 * generated source list gave it, and they were CONSECUTIVE in that list.
 * They were proven able to share a translation unit: no symbol is
 * declared here with two types, no identifier has internal linkage in one
 * member and is named by another, and no local typedef, macro, struct tag
 * or enum constant of one member is visible to a member that names it.
 *
 * members, in link order:
 *   bt_conn_tx_process.c
 *   smp_pairing_event_cnt_inc.c
 *   l2cap_tx_meta_free.c
 *   att_alloc_pdu_with_hdr.c
 *   l2cap_accept_no_ctx.c
 *   l2cap_accept.c
 */
/* ---- bt_conn_tx_process.c ---- */
#include "g1_app_symbols.h"
/* readable reconstruction; identity: FUN_000571e8 @ 0x000571e8
 * public-name: bt_conn_tx_process
 * durable-map: recon/catalogs/function_names_app.json
 * callees (readable <= raw @ address):
 *   net_buf_destroy                          <= FUN_00056080 @ 0x00056080
 *   conn_tx_send_to_driver                   <= FUN_000560cc @ 0x000560cc
 *   bt_conn_tx_drain_and_reset               <= FUN_00056300 @ 0x00056300
 *   bt_conn_frag_buf_destroy                 <= FUN_000571dc @ 0x000571dc
 *   bt_conn_tx_process                       <= FUN_000571e8 @ 0x000571e8
 *   net_buf_unref                            <= FUN_0005f24c @ 0x0005f24c
 *   net_buf_ref                              <= FUN_0005f2d4 @ 0x0005f2d4
 *   printk                                   <= FUN_0007e2fa @ 0x0007e2fa
 *   atomic_and_2                             <= FUN_000813b4 @ 0x000813b4
 *   k_fifo_peek_head_impl                    <= FUN_0008652c @ 0x0008652c
 * address symbols (name @ address):
 *   rodata_99cbd                             @ 0x00099cbd   [INLINED -- G6 literal batch]
 *   rodata_f3a5d                             @ 0x000f3a5d
 *   rodata_f45be                             @ 0x000f45be
 *   g_bt_dev_hci_buf_ready                   @ 0x20002104
 */
/* Full reconstruction of FUN_000571e8 @ 0x571e8 (owned code: 258 bytes). */
#include <stdint.h>
#include "../../../headers/g1_log.h"

typedef struct {
    uint8_t reserved_00[0x0d];
    uint8_t state;
    uint8_t reserved_0e[0x2a];
    uint8_t queue[1];
} stream_owner_t;

typedef struct {
    uint8_t reserved_00[0x10];
    uint16_t length;
    uint8_t reserved_12[6];
    void *pending;
    uint8_t split;
    uint8_t tag;
} stream_fragment_t;

extern int atomic_and_2(volatile long*, long);
extern void bt_conn_tx_drain_and_reset(stream_owner_t *owner);
extern void *k_fifo_peek_head_impl(void *queue);
extern stream_fragment_t *net_buf_ref(void *object);
extern stream_fragment_t *bt_conn_frag_buf_destroy(unsigned kind, int a, int b, int c);
extern int conn_tx_send_to_driver(stream_owner_t *owner, stream_fragment_t *source,
                        stream_fragment_t *destination, unsigned mode);
extern void net_buf_unref(int);
extern void net_buf_destroy(stream_owner_t *owner, void *pending);

static void bt_conn_tx_process(stream_owner_t *owner)
{
    stream_fragment_t *fragment;
    int result;
    uint8_t split;

    if (owner->state == 0 &&
        ((uint32_t)atomic_and_2((uint8_t *)owner + 4, -65) & 0x40u) != 0) {
        bt_conn_tx_drain_and_reset(owner);
        return;
    }

    void *queued = k_fifo_peek_head_impl(owner->queue);
    if (queued == 0) {
        printk(((unsigned long)"ASSERTION FAIL [%s] @ %s:%d\n") /*=0x99cbd*/, ((unsigned long)&rodata_f45be) /*=0xf45be*/, ((unsigned long)&rodata_f3a5d) /*=0xf3a5d*/, 0x397u);
        /* The following BASEPRI/SVC fatal path does not return in firmware. */
        return;
    }

    fragment = net_buf_ref(queued);
    split = fragment->split;

    if (fragment->length <= *(volatile uint16_t *)((unsigned long)&g_bt_dev_hci_buf_ready) /*=0x20002104*/ && split == 0) {
        result = conn_tx_send_to_driver(owner, fragment, 0, 2);
    } else {
        for (;;) {
            if (fragment->length <= *(volatile uint16_t *)((unsigned long)&g_bt_dev_hci_buf_ready) /*=0x20002104*/) {
                fragment->split = 1;
                result = conn_tx_send_to_driver(owner, fragment, 0, 3);
                break;
            }

            stream_fragment_t *part = bt_conn_frag_buf_destroy(0, -1, -1, -1);
            if (owner->state != 7) {
                net_buf_unref(part);
                net_buf_unref(fragment);
                return;
            }

            part->pending = 0;
            part->split = 0;
            part->tag = fragment->tag;
            result = conn_tx_send_to_driver(owner, fragment, part, split);
            if (result != 0) {
                fragment->split = split & 1u;
                net_buf_unref(part);
                break;
            }
            split = 1;
        }
    }

    net_buf_unref(fragment);
    if (result == -5) {
        void *pending = fragment->pending;
        fragment->pending = 0;
        net_buf_unref(fragment);
        if (pending != 0)
            net_buf_destroy(owner, pending);
    }
}

/* ---- smp_pairing_event_cnt_inc.c ---- */
/* readable reconstruction; identity: FUN_00057394 @ 0x00057394
 * public-name: smp_pairing_event_cnt_inc
 * durable-map: recon/catalogs/function_names_app.json
 * callees (readable <= raw @ address):
 *   smp_pairing_event_cnt_inc                <= FUN_00057394 @ 0x00057394
 * address symbols (name @ address):
 *   g_smp_pairing_event_cnt                  @ 0x2001d531
 */
/* Reconstructed FUN_00057394 @ 0x57394  (parity: 300/300 trials, PROVEN) */

int smp_pairing_event_cnt_inc(void) {
    unsigned char v = *(volatile unsigned char *)((unsigned long)&g_smp_pairing_event_cnt) /*=0x2001d531*/;
    v = v + 1;
    if (v < 1) v = 1;
    *(volatile unsigned char *)((unsigned long)&g_smp_pairing_event_cnt) /*=0x2001d531*/ = v;
}

/* ---- l2cap_tx_meta_free.c ---- */
/* readable reconstruction; identity: FUN_000573ac @ 0x000573ac
 * public-name: l2cap_tx_meta_free
 * durable-map: recon/catalogs/function_names_app.json
 * callees (readable <= raw @ address):
 *   l2cap_tx_meta_free                       <= FUN_000573ac @ 0x000573ac
 *   net_pkt_skip                             <= FUN_00086502 @ 0x00086502
 *   memset_bytes                             <= FUN_00086c78 @ 0x00086c78
 * address symbols (name @ address):
 *   free_l2cap_tx_meta_data                  @ 0x20003a44
 */
/* Reconstructed FUN_000573ac @ 0x573ac  (parity: 300/300 trials, PROVEN) */

extern void memset_bytes(void*, int, int);
extern void net_pkt_skip(unsigned int, unsigned int);

void l2cap_tx_meta_free(unsigned int param_1)
{
    memset_bytes(param_1, 0, 0x10);
    net_pkt_skip(((unsigned long)&free_l2cap_tx_meta_data) /*=0x20003a44*/, param_1);
}

/* ---- att_alloc_pdu_with_hdr.c ---- */
/* readable reconstruction; identity: FUN_000573f4 @ 0x000573f4
 * public-name: att_alloc_pdu_with_hdr
 * durable-map: recon/catalogs/function_names_app.json
 * callees (readable <= raw @ address):
 *   bt_conn_create_pdu_timeout               <= FUN_000569ec @ 0x000569ec
 *   log_bt_buf_alloc_failure                 <= FUN_000573c8 @ 0x000573c8
 *   att_alloc_pdu_with_hdr                   <= FUN_000573f4 @ 0x000573f4
 *   net_buf_simple_add                       <= FUN_0005f5d0 @ 0x0005f5d0
 * address symbols (name @ address):
 *   rodata_10000                             @ 0x00010000
 */
/* Reconstructed FUN_000573f4 @ 0x573f4  (parity: 300/300 trials, PROVEN) */

extern int bt_conn_create_pdu_timeout(int, int, unsigned int, unsigned int);
extern void* net_buf_simple_add(int,int);
extern int log_bt_buf_alloc_failure(int);
int att_alloc_pdu_with_hdr(int param_1, unsigned char param_2, unsigned short param_3, unsigned param_4){
  unsigned uVar1 = 0x20003ab0;
  if(param_1!=6) uVar1=0;
  int iVar2 = bt_conn_create_pdu_timeout(uVar1,4,((unsigned long)&rodata_10000) /*=0x10000*/,0);
  if(iVar2==0){ return log_bt_buf_alloc_failure(param_1); }
  unsigned char* puVar3 = (unsigned char*)net_buf_simple_add(iVar2+0xc,4);
  *puVar3=(unsigned char)param_1;
  puVar3[1]=param_2;
  *(unsigned short*)(puVar3+2)=param_3;
  return iVar2;
}

/* ---- l2cap_accept_no_ctx.c ---- */
/* readable reconstruction; identity: FUN_00057438 @ 0x00057438
 * public-name: l2cap_accept_no_ctx
 * durable-map: recon/catalogs/function_names_app.json
 * callees (readable <= raw @ address):
 *   l2cap_accept_no_ctx                      <= FUN_00057438 @ 0x00057438
 *   log_msg_3arg_thunk                       <= FUN_00081746 @ 0x00081746
 * address symbols (name @ address):
 *   rodata_88160                             @ 0x00088160
 *   rodata_f3eea                             @ 0x000f3eea
 */
/* Reconstructed FUN_00057438 @ 0x57438  (parity: 300/300 trials, PROVEN) */

extern void log_msg_3arg_thunk(unsigned int a0, unsigned int a1, void *a2);

static unsigned int l2cap_accept_no_ctx(unsigned int param_1)
{
  unsigned int local[3];
  local[0] = 3;
  local[1] = ((unsigned long)&rodata_f3eea) /*=0xf3eea*/;
  local[2] = param_1;
  log_msg_3arg_thunk(((unsigned long)&rodata_88160) /*=0x88160*/, 0x1840, local);
  return 0xfffffff4;
}

/* ---- l2cap_accept.c ---- */
/* readable reconstruction; identity: FUN_00057468 @ 0x00057468
 * public-name: l2cap_accept
 * durable-map: recon/catalogs/function_names_app.json
 * callees (readable <= raw @ address):
 *   l2cap_accept_no_ctx                      <= FUN_00057438 @ 0x00057438
 *   l2cap_accept                             <= FUN_00057468 @ 0x00057468
 * address symbols (name @ address):
 *   rodata_8b264                             @ 0x0008b264
 *   g_l2cap_fixed_chan_ctx                   @ 0x20006210
 */
/* Reconstructed FUN_00057468 @ 0x57468  (parity: 300/300 trials, PROVEN) */

static unsigned int l2cap_accept_no_ctx(unsigned int);

static uint32_t l2cap_accept(uint32_t param_1, int *param_2)
{
    volatile uint32_t *p = (volatile uint32_t *)((unsigned long)&g_l2cap_fixed_chan_ctx) /*=0x20006210*/;
    if (p[0] != 0) {
        return l2cap_accept_no_ctx(param_1);
    }
    p[1] = ((unsigned long)&rodata_8b264) /*=0x8b264*/;
    *param_2 = (int)(uintptr_t)p;
    return 0;
}

