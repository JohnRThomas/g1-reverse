/*
 * Cohesive translation unit for the `lib' module.
 *
 * GENERATED by recon/refactor/transforms/t04_cohesive_tu.py.  Do not
 * edit: a stage tree is regenerated, never hand-patched
 * (recon/refactor/README.md C4).
 *
 * The 3 functions below were 3 separate translation units until this
 * stage.  Each one's text is reproduced VERBATIM and in the order the
 * generated source list gave it, and they were CONSECUTIVE in that list.
 * They were proven able to share a translation unit: no symbol is
 * declared here with two types, no identifier has internal linkage in one
 * member and is named by another, and no local typedef, macro, struct tag
 * or enum constant of one member is visible to a member that names it.
 *
 * members, in link order:
 *   gpio_nrfx_configure_pin_list.c
 *   uarte_nrfx_configure.c
 *   compare_set.c
 */

/* File-scope forward declarations for every struct/union tag this
 * unit names.  Without them a tag whose only appearance in a member
 * is inside a parameter list has PARAMETER-LIST scope, so two
 * textually IDENTICAL declarations in two members declare two
 * different incomplete types and the second is a conflicting
 * redeclaration (C11 6.2.1p7).  Incomplete-type forward
 * declarations emit no code. */
struct compare_channel;
struct device_raw;
struct uart_config_raw;
struct uarte_config_raw;
struct uarte_data_raw;
/* ---- gpio_nrfx_configure_pin_list.c ---- */
#include "g1_app_symbols.h"
/* readable reconstruction; identity: FUN_000620cc @ 0x000620cc
 * public-name: gpio_nrfx_configure_pin_list
 * durable-map: recon/catalogs/function_names_app.json
 * callees (readable <= raw @ address):
 *   gpio_nrfx_configure_pin_list             <= FUN_000620cc @ 0x000620cc
 *   assert_post_action                       <= FUN_0007e2ec @ 0x0007e2ec
 *   printk                                   <= FUN_0007e2fa @ 0x0007e2fa
 *   z_device_is_ready                        <= FUN_0008638c @ 0x0008638c
 * address symbols (name @ address):
 *   rodata_99c53                             @ 0x00099c53
 *   rodata_99c84                             @ 0x00099c84   [INLINED -- G6 literal batch]
 *   rodata_99cbd                             @ 0x00099cbd   [INLINED -- G6 literal batch]
 *   rodata_99cda                             @ 0x00099cda   [INLINED -- G6 literal batch]
 *   rodata_99dad                             @ 0x00099dad   [INLINED -- G6 literal batch]
 *   rodata_99de0                             @ 0x00099de0   [INLINED -- G6 literal batch]
 *   rodata_99e1e                             @ 0x00099e1e   [INLINED -- G6 literal batch]
 */
/* Reconstructed FUN_000620cc @ 0x620cc  (parity: 300/300 trials, PROVEN) */

#include <stdint.h>
#include "../../../headers/g1_log.h"
extern void assert_post_action(const char *, unsigned int);
extern int z_device_is_ready(void);

static int gpio_nrfx_configure_pin_list(int param_1){
    int iVar5 = *(volatile int *)(param_1+4);
    int iVar6 = iVar5 + 0x28;
    int iVar2; uint32_t uVar7; uint8_t bVar1; volatile uint32_t *puVar8;
    uint32_t uVar9, uVar4, uVar3;
    while (1) {
        if (*(volatile int *)(iVar5+4) != 0){
            iVar2 = z_device_is_ready();
            if (iVar2==0) return -0x13;
            uVar7 = *(volatile uint16_t *)(iVar5+10);
            iVar2 = *(volatile int *)(iVar5+4);
            bVar1 = *(volatile uint8_t *)(iVar5+8);
            puVar8 = *(volatile uint32_t* volatile*)(iVar2+8);
            if ((uVar7 & 0x30)==0x30){
                printk(((unsigned long)"ASSERTION FAIL [%s] @ %s:%d\n") /*=0x99cbd*/,((unsigned long)"(flags & ((1 << 4) | (1 << 5))) != ((1 << 4) | (1 << 5))") /*=0x99c84*/,((unsigned long)&rodata_99c53) /*=0x99c53*/,0x3ca);
                printk(((unsigned long)"\tPull Up and Pull Down should not be enabled simultaneously\n") /*=0x99cda*/);
                uVar3 = 0x3ca; goto L62124;
            }
          L6212a:
            if ((uVar7 & 6)==4){
                printk(((unsigned long)"ASSERTION FAIL [%s] @ %s:%d\n") /*=0x99cbd*/,((unsigned long)"(flags & (1 << 1)) != 0 || (flags & (1 << 2)) == 0") /*=0x99dad*/,((unsigned long)&rodata_99c53) /*=0x99c53*/,0x3d1);
                uVar3 = 0x3d1; goto L62124;
            }
            uVar9 = 1u << bVar1;
            if ((uVar9 & **(volatile uint32_t* volatile*)(iVar2+4))==0){
                printk(((unsigned long)"ASSERTION FAIL [%s] @ %s:%d\n") /*=0x99cbd*/,((unsigned long)"(cfg->port_pin_mask & (gpio_port_pins_t)(1UL << (pin))) != 0U") /*=0x99de0*/,((unsigned long)&rodata_99c53) /*=0x99c53*/,0x3e4);
                printk(((unsigned long)"\tUnsupported pin\n") /*=0x99e1e*/);
                uVar3 = 0x3e4; goto L62124;
            }
            uVar4 = **(volatile uint32_t* volatile*)(iVar2+0x10);
            if ((int)(uVar7 << 0x1f) < 0) uVar9 = uVar9 | uVar4;
            else uVar9 = uVar4 & ~uVar9;
            **(volatile uint32_t* volatile*)(iVar2+0x10) = uVar9;
            iVar2 = ((int(*)(int,uint32_t,uint32_t))(*puVar8))(iVar2,(uint32_t)bVar1, uVar7|0x20000);
            if (iVar2 != 0) return iVar2;
        }
        iVar5 = iVar5 + 8;
        if (iVar6 == iVar5) return 0;
        continue;
      L62124:
        assert_post_action(((unsigned long)&rodata_99c53) /*=0x99c53*/, uVar3);
        goto L6212a;
    }
}

/* ---- uarte_nrfx_configure.c ---- */
/* readable reconstruction; identity: FUN_00062ad8 @ 0x00062ad8
 * public-name: uarte_nrfx_configure
 * durable-map: recon/catalogs/function_names_app.json
 * address symbols (name @ address):
 *   rodata_9d000                             @ 0x0009d000
 */
/* Reconstructed uarte_nrfx_configure @ 0x00062ad8.
 * Raw/address back-map: FUN_00062ad8 / 0x00062ad8.
 */

struct device_raw {
    const char *name;
    const void *config;
    const void *api;
    void *state;
    void *data;
};

struct uarte_config_raw {
    volatile uint8_t *peripheral;
};

struct uarte_data_raw {
    uint32_t reserved;
    uint32_t baudrate;
    uint8_t parity;
    uint8_t stop_bits;
    uint8_t data_bits;
    uint8_t flow_ctrl;
};

struct uart_config_raw {
    uint32_t baudrate;
    uint8_t parity;
    uint8_t stop_bits;
    uint8_t data_bits;
    uint8_t flow_ctrl;
};

static uint32_t baudrate_register(uint32_t baudrate)
{
    switch (baudrate) {
    case 300: return 0x00014000u;
    case 600: return 0x00027000u;
    case 1200: return 0x0004f000u;
    case 2400: return ((unsigned long)&rodata_9d000) /*=0x9d000*/;
    case 4800: return 0x0013b000u;
    case 9600: return 0x00275000u;
    case 14400: return 0x003af000u;
    case 19200: return 0x004ea000u;
    case 28800: return 0x0075c000u;
    case 31250: return 0x00800000u;
    case 38400: return 0x009d0000u;
    case 56000: return 0x00e50000u;
    case 57600: return 0x00eb0000u;
    case 76800: return 0x013a9000u;
    case 115200: return 0x01d60000u;
    case 230400: return 0x03b00000u;
    case 250000: return 0x04000000u;
    case 460800: return 0x07400000u;
    case 921600: return 0x0f000000u;
    case 1000000: return 0x10000000u;
    default: return 0u;
    }
}

int uarte_nrfx_configure(const struct device_raw *device,
                         const struct uart_config_raw *config)
{
    uint32_t stop;
    uint32_t parity = 0;
    uint32_t hwfc;

    if (config->stop_bits == 1u) {
        stop = 0;
    } else if (config->stop_bits == 3u) {
        stop = 0x10u;
    } else {
        return -134;
    }
    if (config->data_bits != 3u) {
        return -134;
    }
    if (config->flow_ctrl > 1u) {
        return -134;
    }
    hwfc = config->flow_ctrl;

    if (config->parity == 0u) {
        parity = 0;
    } else if (config->parity == 1u) {
        parity = 0x100u;
    } else if (config->parity == 2u) {
        parity = 0;
    } else {
        return -134;
    }
    if (config->parity != 0u) {
        parity |= 0x0eu;
    }

    uint32_t baud = baudrate_register(config->baudrate);
    if (baud == 0u) {
        return -134;
    }

    const struct uarte_config_raw *dev_config =
        (const struct uarte_config_raw *)device->config;
    *(volatile uint32_t *)(dev_config->peripheral + 0x524) = baud;
    *(volatile uint32_t *)(dev_config->peripheral + 0x56c) =
        stop | parity | hwfc;

    struct uarte_data_raw *data = (struct uarte_data_raw *)device->data;
    *(uint64_t *)&data->baudrate = *(const uint64_t *)config;
    return 0;
}

/* ---- compare_set.c ---- */
/* readable reconstruction; identity: FUN_00063654 @ 0x00063654
 * public-name: compare_set
 * durable-map: recon/catalogs/function_names_app.json
 * address symbols (name @ address):
 *   rodata_10000                             @ 0x00010000
 *   g_20006690                               @ 0x20006690
 *   g_gpio_pin_latch_mask                    @ 0x2000b2d0
 *   g_gpio_pin_enabled_mask                  @ 0x2000b2d8
 */
/* compare_set @ 0x00063654; raw FUN_00063654 */

typedef void (*compare_handler_t)(int32_t, uint64_t, void *);

struct compare_channel {
    compare_handler_t callback;
    void *context;
    uint64_t target;
};

#ifdef G1_APP_SDK_INLINE_COHESION
/* Exact Zephyr 3.4.99 nrf_rtc_timer.c local owners (receipt baa02453..., lines
 * 155 and 83). The event readback is required by the Nordic HAL contract. */
static __attribute__((always_inline)) inline int
g1_compare_int_lock_inline(int32_t channel)
{
    uint32_t bit = 1U << channel;
    uint32_t previous = __atomic_fetch_and((uint32_t *)((unsigned long)&g_gpio_pin_enabled_mask) /*=0x2000b2d8*/, ~bit,
                                           __ATOMIC_SEQ_CST);
    *(volatile uint32_t *)(0x50015000U + 0x308U) = ((unsigned long)&rodata_10000) /*=0x10000*/ << channel;
    __asm__ volatile("dmb sy" ::: "memory");
    __asm__ volatile("isb sy" ::: "memory");
    return (previous & bit) != 0U;
}

static __attribute__((always_inline)) inline void
g1_event_clear_inline(int32_t channel)
{
    volatile uint32_t *event =
        (volatile uint32_t *)(0x50015000U + 0x140U + (uint32_t)channel * 4U);
    *event = 0U;
    (void)*event;
}
#define compare_int_lock g1_compare_int_lock_inline
#define event_clear g1_event_clear_inline
#else
extern int compare_int_lock(int32_t); /* FUN_0006349c */
extern void event_clear(int32_t); /* FUN_00084c5e */
#endif
extern uint64_t rtc_read_extended_cycle_count(void); /* FUN_00063610 */
extern void compare_int_unlock(int32_t, int); /* FUN_00063524 */

int compare_set(int32_t channel, uint64_t target, compare_handler_t callback,
                void *context, int exact)
{
    int key = compare_int_lock(channel);
    uint64_t current = rtc_read_extended_cycle_count();
    int result = 0;
    struct compare_channel *channels =
        (struct compare_channel *)((unsigned long)&g_20006690) /*=0x20006690*/;
    volatile uint32_t *rtc = (volatile uint32_t *)0x50015000u;

    if (current < target) {
        if (target - current > 0x800000u) {
            result = -22;
            goto out;
        }
        if (target != channels[channel].target) {
            uint32_t interrupt = ((unsigned long)&rodata_10000) /*=0x10000*/ << channel;
            uint32_t requested = (uint32_t)target & 0xffffffu;
            uint32_t increment = 3;

            rtc[0x348 / 4] = interrupt;
            event_clear(channel);
            for (;;) {
                rtc[(0x540 / 4) + channel] = requested;
                rtc[0x344 / 4] = interrupt;
                uint32_t now = rtc[0x504 / 4];

                if (((requested - now - 3u) & 0xffffffu) <= 0x7ffffdu) {
                    break;
                }
                if (rtc[(0x140 / 4) + channel] != 0) {
                    now = rtc[0x504 / 4];
                    if (((now - ((uint32_t)target & 0xffffffu)) & 0xffffffu) <
                        0x800001u) {
                        break;
                    }
                    event_clear(channel);
                }
                if (exact) {
                    result = -22;
                    goto out;
                }
                requested = (now + increment) & 0xffffffu;
                increment++;
            }
        }
    } else if (!exact) {
        __atomic_fetch_or((uint32_t *)((unsigned long)&g_gpio_pin_latch_mask) /*=0x2000b2d0*/, 1u << channel,
                          __ATOMIC_RELAXED);
    } else {
        result = -22;
        goto out;
    }

    channels[channel].callback = callback;
    channels[channel].target = target;
    channels[channel].context = context;
out:
    compare_int_unlock(channel, key);
    return result;
}

