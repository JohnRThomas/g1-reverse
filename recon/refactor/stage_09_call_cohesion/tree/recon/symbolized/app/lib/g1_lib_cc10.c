/*
 * Call-cohesive translation unit for the `lib' module.
 *
 * GENERATED by recon/refactor/transforms/t09_call_cohesion.py.  Do
 * not edit: a stage tree is regenerated, never hand-patched
 * (recon/refactor/README.md C4).
 *
 * The 3 translation units below were grouped because they CALL ONE
 * ANOTHER, not because they were adjacent in the generated source
 * list.  Each member's text is reproduced VERBATIM.  Every member was
 * checked pairwise against every other member already in this unit by
 * stage 04's seven refusal rules, unchanged: no symbol is declared
 * here with two types, no identifier has internal linkage in one
 * member and is named by another, and no local typedef, macro, struct
 * tag or enum constant of one member is visible to a member that
 * names it.
 *
 * members, in generated-source-list order:
 *   g1_lib_32.c
 *   g1_lib_34.c
 *   gpiote_in_event_enable.c
 *
 * call edges inside this unit (caller -> callee): 2
 *   g1_lib_34.c -> g1_lib_32.c
 *   gpiote_in_event_enable.c -> g1_lib_34.c
 */
/* ================================================================ */
/* member unit: g1_lib_32.c */
/* ================================================================ */
/*
 * Cohesive translation unit for the `lib' module.
 *
 * GENERATED by recon/refactor/transforms/t04_cohesive_tu.py.  Do not
 * edit: a stage tree is regenerated, never hand-patched
 * (recon/refactor/README.md C4).
 *
 * The 2 functions below were 2 separate translation units until this
 * stage.  Each one's text is reproduced VERBATIM and in the order the
 * generated source list gave it, and they were CONSECUTIVE in that list.
 * They were proven able to share a translation unit: no symbol is
 * declared here with two types, no identifier has internal linkage in one
 * member and is named by another, and no local typedef, macro, struct tag
 * or enum constant of one member is visible to a member that names it.
 *
 * members, in link order:
 *   cjson_strdup.c
 *   cjson_add_item_to_object.c
 */
/* ---- cjson_strdup.c ---- */
#include "g1_app_symbols.h"
#include <stddef.h>
#include "g1_lib.h"
/* readable reconstruction; identity: FUN_00064640 @ 0x00064640
 * public-name: cjson_strdup
 * durable-map: recon/catalogs/function_names_app.json
 * callees (readable <= raw @ address):
 *   strlen                                   <= FUN_0000ef12 @ 0x0000ef12
 *   cjson_strdup                             <= FUN_00064640 @ 0x00064640
 *   memcpy                                   <= FUN_00086c04 @ 0x00086c04
 * address symbols (name @ address):
 *   g_cjson_hooks                            @ 0x20002bac
 */
/* Reconstructed FUN_00064640 @ 0x64640  (parity: 300/300 trials, PROVEN) */

extern size_t strlen(const char *);
extern void memcpy(int, int, int);

int cjson_strdup(int param_1)
{
    int iVar1;
    int iVar2;
    if (param_1 != 0) {
        iVar1 = strlen(param_1);
        iVar2 = ((int(*)(int))(*(volatile unsigned int *)((unsigned long)&g_cjson_hooks) /*=0x20002bac*/))(iVar1 + 1);
        if (iVar2 != 0) {
            memcpy(iVar2, param_1, iVar1 + 1);
            return iVar2;
        }
    }
    return 0;
}

/* ---- cjson_add_item_to_object.c ---- */
/* readable reconstruction; identity: FUN_0006466c @ 0x0006466c
 * public-name: cjson_add_item_to_object
 * durable-map: recon/catalogs/function_names_app.json
 * callees (readable <= raw @ address):
 *   cjson_strdup                             <= FUN_00064640 @ 0x00064640
 *   cjson_add_item_to_object                 <= FUN_0006466c @ 0x0006466c
 *   sllist_insert_after                      <= FUN_00084f2e @ 0x00084f2e
 * address symbols (name @ address):
 *   g_cjson_free_hook                        @ 0x20002bb0
 */
/* Reconstructed FUN_0006466c @ 0x6466c  (parity: 300/300 trials, PROVEN) */

extern int sllist_insert_after(int a, int b);

typedef void (*fn0_t)(void);

int cjson_add_item_to_object(int param_1, int param_2, int param_3, int param_4)
{
    unsigned int uVar2;
    if (param_1 != 0 && param_2 != 0 && param_3 != 0 && param_1 != param_3) {
        if (param_4 == 0) {
            param_2 = cjson_strdup(param_2);
            if (param_2 == 0) {
                return 0;
            }
            uVar2 = *(unsigned int *)(param_3 + 0xc) & 0xfffffdff;
        } else {
            uVar2 = *(unsigned int *)(param_3 + 0xc) | 0x200;
        }
        {
            int shifted = (*(int *)(param_3 + 0xc)) << 0x16;
            if (shifted >= 0 && *(int *)(param_3 + 0x20) != 0) {
                fn0_t f = *(volatile fn0_t *)((unsigned long)&g_cjson_free_hook) /*=0x20002bb0*/;
                f();
            }
        }
        *(int *)(param_3 + 0x20) = param_2;
        *(unsigned int *)(param_3 + 0xc) = uVar2;
        return sllist_insert_after(param_1, param_3);
    }
    return 0;
}

/* ================================================================ */
/* member unit: g1_lib_34.c */
/* ================================================================ */
/*
 * Cohesive translation unit for the `lib' module.
 *
 * GENERATED by recon/refactor/transforms/t04_cohesive_tu.py.  Do not
 * edit: a stage tree is regenerated, never hand-patched
 * (recon/refactor/README.md C4).
 *
 * The 5 functions below were 5 separate translation units until this
 * stage.  Each one's text is reproduced VERBATIM and in the order the
 * generated source list gave it, and they were CONSECUTIVE in that list.
 * They were proven able to share a translation unit: no symbol is
 * declared here with two types, no identifier has internal linkage in one
 * member and is named by another, and no local typedef, macro, struct tag
 * or enum constant of one member is visible to a member that names it.
 *
 * members, in link order:
 *   cjson_create_bool.c
 *   cjson_create_string.c
 *   cjson_create_array.c
 *   cjson_create_object.c
 *   get_pin_idx.c
 */
/* ---- cjson_create_bool.c ---- */
#include "g1_app_symbols.h"
#include "g1_lib.h"
#include <stdint.h>
/* readable reconstruction; identity: FUN_00064c3c @ 0x00064c3c
 * public-name: cjson_create_bool
 * durable-map: recon/catalogs/function_names_app.json
 * callees (readable <= raw @ address):
 *   cjson_create_bool                        <= FUN_00064c3c @ 0x00064c3c
 *   alloc_zeroed_node                        <= FUN_00084fd4 @ 0x00084fd4
 * address symbols (name @ address):
 *   g_cjson_hooks                            @ 0x20002bac
 */
/* Reconstructed FUN_00064c3c @ 0x64c3c  (parity: 300/300 trials, PROVEN) */

extern int alloc_zeroed_node(unsigned int);
void cjson_create_bool(int param_1)
{
  int iVar1;
  unsigned int uVar2;
  iVar1 = alloc_zeroed_node(*(volatile unsigned int *)((unsigned long)&g_cjson_hooks) /*=0x20002bac*/);
  if (iVar1 != 0) {
    if (param_1 == 0) {
      uVar2 = 1;
    } else {
      uVar2 = 2;
    }
    *(volatile unsigned int *)(iVar1 + 0xc) = uVar2;
  }
}

/* ---- cjson_create_string.c ---- */
/* readable reconstruction; identity: FUN_00064c5c @ 0x00064c5c
 * public-name: cjson_create_string
 * durable-map: recon/catalogs/function_names_app.json
 * callees (readable <= raw @ address):
 *   cjson_strdup                             <= FUN_00064640 @ 0x00064640
 *   cjson_delete                             <= FUN_00064b1c @ 0x00064b1c
 *   cjson_create_string                      <= FUN_00064c5c @ 0x00064c5c
 *   alloc_zeroed_node                        <= FUN_00084fd4 @ 0x00084fd4
 * address symbols (name @ address):
 *   g_cjson_hooks                            @ 0x20002bac
 */
/* Reconstructed FUN_00064c5c @ 0x64c5c  (parity: 300/300 trials, PROVEN) */


int cjson_create_string(unsigned int param_1)
{
    int iVar1, iVar2;
    iVar1 = alloc_zeroed_node(*(volatile unsigned int *)((unsigned long)&g_cjson_hooks) /*=0x20002bac*/);
    if (iVar1 != 0) {
        *(volatile int *)(iVar1 + 0xc) = 0x10;
        iVar2 = cjson_strdup(param_1);
        *(volatile int *)(iVar1 + 0x10) = iVar2;
        if (iVar2 != 0) {
            return iVar1;
        }
        cjson_delete(iVar1);
    }
    return 0;
}

/* ---- cjson_create_array.c ---- */
/* readable reconstruction; identity: FUN_00064c8c @ 0x00064c8c
 * public-name: cjson_create_array
 * durable-map: recon/catalogs/function_names_app.json
 * callees (readable <= raw @ address):
 *   cjson_create_array                       <= FUN_00064c8c @ 0x00064c8c
 *   alloc_zeroed_node                        <= FUN_00084fd4 @ 0x00084fd4
 * address symbols (name @ address):
 *   g_cjson_hooks                            @ 0x20002bac
 */
/* Reconstructed FUN_00064c8c @ 0x64c8c  (parity: 300/300 trials, PROVEN) */


void cjson_create_array(void)
{
    unsigned int v = *(volatile unsigned int *)((unsigned long)&g_cjson_hooks) /*=0x20002bac*/;
    unsigned int r = alloc_zeroed_node(v);
    if (r != 0) {
        *(volatile unsigned int *)(r + 0xc) = 0x20;
    }
}

/* ---- cjson_create_object.c ---- */
/* readable reconstruction; identity: FUN_00064ca4 @ 0x00064ca4
 * public-name: cjson_create_object
 * durable-map: recon/catalogs/function_names_app.json
 * callees (readable <= raw @ address):
 *   cjson_create_object                      <= FUN_00064ca4 @ 0x00064ca4
 *   alloc_zeroed_node                        <= FUN_00084fd4 @ 0x00084fd4
 * address symbols (name @ address):
 *   g_cjson_hooks                            @ 0x20002bac
 */
/* Reconstructed FUN_00064ca4 @ 0x64ca4  (parity: 300/300 trials, PROVEN) */


void cjson_create_object(void)
{
    unsigned int v = *(volatile unsigned int *)((unsigned long)&g_cjson_hooks) /*=0x20002bac*/;
    unsigned int r = alloc_zeroed_node(v);
    if (r != 0) {
        *(volatile unsigned int *)(r + 0xc) = 0x40;
    }
}

/* ---- get_pin_idx.c ---- */
/* readable reconstruction; identity: FUN_00065434 @ 0x00065434
 * public-name: get_pin_idx
 * durable-map: recon/catalogs/function_names_app.json
 * address symbols (name @ address):
 *   rodata_f6ba7                             @ 0x000f6ba7
 */
/* Reconstructed get_pin_idx @ 0x65434  (CFG-directed candidate) */
unsigned long get_pin_idx(unsigned long pin) {
    const volatile uint8_t *port_offset = (const volatile uint8_t *)((unsigned long)&rodata_f6ba7) /*=0xf6ba7*/;
    return (uint8_t)(port_offset[pin >> 5] + (pin & 0x1fu));
}

/* ================================================================ */
/* member unit: gpiote_in_event_enable.c */
/* ================================================================ */
#include "g1_app_symbols.h"
/* readable reconstruction; identity: FUN_000659e4 @ 0x000659e4
 * public-name: gpiote_in_event_enable
 * durable-map: recon/catalogs/function_names_app.json
 * callees (readable <= raw @ address):
 *   get_pin_idx                              <= FUN_00065434 @ 0x00065434
 *   pin_in_use_by_te                         <= FUN_00065460 @ 0x00065460
 *   gpiote_pin_sense_is_enabled              <= FUN_00065478 @ 0x00065478
 *   pin_is_output                            <= FUN_00065494 @ 0x00065494
 *   pin_te_get                               <= FUN_000654ac @ 0x000654ac
 *   gpio_port_base_from_pin                  <= FUN_00065584 @ 0x00065584
 *   gpiote_in_event_reg_offset               <= FUN_000655ec @ 0x000655ec
 *   gpiote_in_event_enable                   <= FUN_000659e4 @ 0x000659e4
 *   assert_post_action                       <= FUN_0007e2ec @ 0x0007e2ec
 *   printk                                   <= FUN_0007e2fa @ 0x0007e2fa
 *   nrf_gpio_cfg_sense_set                   <= FUN_000851ca @ 0x000851ca
 * address symbols (name @ address):
 *   rodata_99cbd                             @ 0x00099cbd   [INLINED -- G6 literal batch]
 *   rodata_f6b00                             @ 0x000f6b00
 *   rodata_f6b87                             @ 0x000f6b87   [INLINED -- G6 literal batch]
 *   rodata_f6b9c                             @ 0x000f6b9c   [INLINED -- G6 literal batch]
 *   g_gpiote_cb                              @ 0x20002bc0
 */
/* Reconstructed FUN_000659e4 @ 0x659e4  (parity: 300/300 trials, PROVEN) */
#include <stdint.h>
#include "../../../headers/g1_log.h"
#include "../../../headers/g1_dedupe.h"
extern unsigned long get_pin_idx(unsigned long);
extern unsigned int pin_in_use_by_te(unsigned int);
extern int gpiote_pin_sense_is_enabled(void);
extern int pin_is_output(uint32_t);
extern int pin_te_get(uint32_t);
extern int gpio_port_base_from_pin(void*);
extern int gpiote_in_event_reg_offset(void);
extern __attribute__((noreturn)) void assert_post_action(uint32_t,uint32_t);
extern void nrf_gpio_cfg_sense_set(unsigned long, unsigned char);

void gpiote_in_event_enable(uint32_t param_1, uint32_t param_2){
    int iVar1;
    uint32_t uVar2 = param_1;
    iVar1 = gpiote_pin_sense_is_enabled();
    if (iVar1 == 0){
        G1_ASSERT_FAIL((((unsigned long)"ASSERTION FAIL [%s] @ %s:%d\n") /*=0x99cbd*/,((unsigned long)"pin_has_trigger(pin)") /*=0xf6b87*/,((unsigned long)&rodata_f6b00) /*=0xf6b00*/,0x364,uVar2), (((unsigned long)&rodata_f6b00) /*=0xf6b00*/,0x364));
    }
  L_a08:
    iVar1 = pin_in_use_by_te(param_1);
    if (iVar1 != 0 && (iVar1 = pin_is_output(param_1)) == 0){
        uVar2 = pin_te_get(param_1);
        iVar1 = gpiote_in_event_reg_offset();
        *(volatile uint32_t *)((uint32_t)iVar1 + 0x5000d000UL) = 0;
        int t = (int)(int16_t)uVar2 * 4;
        *(volatile uint32_t *)((uint32_t)t + 0x5000d510UL) |= 1;
        if (param_2 != 0){
            *(volatile int *)(0x5000d000UL + 0x304) = 1 << (uVar2 & 0xff);
        }
        return;
    }
    if (param_2 != 0){
        int r = get_pin_idx(param_1);
        uint32_t s = ((uint32_t)*(volatile uint16_t *)(((unsigned long)g_gpiote_cb) /*=0x20002bc0*/ + (uint32_t)(r + 8) * 2) << 0x1b) >> 0x1d;
        int iv;
        if (s == 4) iv = 3;
        else if (s == 5) iv = 2;
        else {
            uint32_t local_14 = param_1;
            int q = gpio_port_base_from_pin(&local_14);
            iv = (int)((*(volatile uint32_t *)(q + 0x10) >> (local_14 & 0xff)) & 1) + 2;
        }
        nrf_gpio_cfg_sense_set(param_1, iv);
        return;
    }
    G1_ASSERT_FAIL((((unsigned long)"ASSERTION FAIL [%s] @ %s:%d\n") /*=0x99cbd*/,((unsigned long)"int_enable") /*=0xf6b9c*/,((unsigned long)&rodata_f6b00) /*=0xf6b00*/,0x373,uVar2), (((unsigned long)&rodata_f6b00) /*=0xf6b00*/,0x373));
}

