/*
 * Cohesive translation unit for the `lib' module.
 *
 * GENERATED by recon/refactor/transforms/t04_cohesive_tu.py.  Do not
 * edit: a stage tree is regenerated, never hand-patched
 * (recon/refactor/README.md C4).
 *
 * The 3 functions below were 3 separate translation units until this
 * stage.  Each one's text is reproduced VERBATIM and in the order the
 * generated source list gave it, and they were CONSECUTIVE in that list.
 * They were proven able to share a translation unit: no symbol is
 * declared here with two types, no identifier has internal linkage in one
 * member and is named by another, and no local typedef, macro, struct tag
 * or enum constant of one member is visible to a member that names it.
 *
 * members, in link order:
 *   __ieee754_atan2f.c
 *   __ieee754_expf.c
 *   __ieee754_logf.c
 */

/* File-scope forward declarations for every struct/union tag this
 * unit names.  Without them a tag whose only appearance in a member
 * is inside a parameter list has PARAMETER-LIST scope, so two
 * textually IDENTICAL declarations in two members declare two
 * different incomplete types and the second is a conflicting
 * redeclaration (C11 6.2.1p7).  Incomplete-type forward
 * declarations emit no code. */
union U;
/* ---- __ieee754_atan2f.c ---- */
#include "g1_app_symbols.h"
/* readable reconstruction; identity: FUN_00076154 @ 0x00076154
 * public-name: __ieee754_atan2f
 * durable-map: recon/catalogs/function_names_app.json
 * callees (readable <= raw @ address):
 *   __ieee754_atan2f                         <= FUN_00076154 @ 0x00076154
 *   atanf                                    <= FUN_000768e0 @ 0x000768e0
 *   fabsf                                    <= FUN_000868ee @ 0x000868ee
 * address symbols (name @ address):
 *   rodata_98684                             @ 0x00098684
 *   rodata_98690                             @ 0x00098690
 */
/* Reconstructed FUN_00076154 @ 0x76154  (parity: 300/300 trials, PROVEN) */
#include <stdint.h>
extern float atanf(void);
extern void fabsf(float);
union U{float f; unsigned u; int i;};
static float fb(unsigned u){union U x; x.u=u; return x.f;}
static unsigned bf(float f){union U x; x.f=f; return x.u;}

float __ieee754_atan2f(float param_1, float param_2){
  unsigned b1 = bf(param_1), b2 = bf(param_2);
  unsigned a2 = b2 & 0x7fffffff;
  unsigned a1 = b1 & 0x7fffffff;
  if(a2 < 0x7f800001 && a1 < 0x7f800001){
    if(b2 == 0x3f800000){
      return atanf();
    }
    unsigned uVar4 = (((int)b2 >> 30) & 2) | (b1 >> 31);
    if(a1 == 0){
      if(uVar4 == 2) return fb(0x40490fdb);
      return fb(uVar4==3 ? 0xc0490fdb : b1);
    }
    if(a2 != 0){
      if(a2 == 0x7f800000){
        unsigned fbits = 0x00000000; int iVar1 = ((unsigned long)&rodata_98684) /*=0x98684*/;
        if(a1 == 0x7f800000){ fbits = 0x3f490fdb; iVar1 = ((unsigned long)&rodata_98690) /*=0x98690*/; }
        if((uVar4 - 1) > 2) return fb(fbits);
        return *(float*)(iVar1 + (int)((uVar4-1)*4));
      }
      if(a1 != 0x7f800000){
        int diff = (int)a1 - (int)a2;
        int iVar1 = diff >> 0x17;
        float fVar5 = fb(0x3fc90fdb);
        if(diff < 0x1e800000 && ((int)b2 >= 0 || (fVar5 = fb(0x00000000), (iVar1 + 0x3c) >= 0))){
          fabsf(param_1 / param_2);
          fVar5 = atanf();
        }
        if(uVar4 == 1) return fb(bf(fVar5) + 0x80000000);
        if(uVar4 == 2) return fb(0x40490fdb) - (fVar5 + fb(0x33bbbd2e));
        if(uVar4 == 0) return fVar5;
        return (fVar5 + fb(0x33bbbd2e)) - fb(0x40490fdb);
      }
    }
    return fb(((int)b1 >= 0) ? 0x3fc90fdb : 0xbfc90fdb);
  }
  return param_1 + param_2;
}

/* ---- __ieee754_expf.c ---- */
/* readable reconstruction; identity: FUN_00076290 @ 0x00076290
 * public-name: __ieee754_expf
 * durable-map: recon/catalogs/function_names_app.json
 * callees (readable <= raw @ address):
 *   __ieee754_expf                           <= FUN_00076290 @ 0x00076290
 * address symbols (name @ address):
 *   rodata_9869c                             @ 0x0009869c
 *   rodata_986a4                             @ 0x000986a4
 *   rodata_986ac                             @ 0x000986ac
 */
/* Reconstructed FUN_00076290 @ 0x76290 */

typedef unsigned uint;
static inline uint bits(float f) { union { float f; uint u; } v = { f }; return v.u; }
static inline int sbits(float f) { union { float f; int i; } v = { f }; return v.i; }
static inline float fp(uint u) { union { uint u; float f; } v = { u }; return v.f; }
static inline int signed_add_overflows(int a, int b)
{
    uint sum = (uint)a + (uint)b;
    return (int)(~((uint)a ^ (uint)b) & ((uint)a ^ sum)) < 0;
}

float __ieee754_expf(float x)
{
    float ax = fp(bits(x) & 0x7fffffffU);
    int reduction;
    float high = 0.0f, low = 0.0f;

    if (bits(ax) > 0x7f800000U)
        return x + x;
    if (bits(ax) == 0x7f800000U)
        return sbits(x) >= 0 ? x : 0.0f;
    if (sbits(x) > 0x42b17217) {
        float huge = fp(0x7149f2ca);
        return huge * huge;
    }
    if (sbits(x) < 0 && bits(ax) > 0x42cff1b5U)
        return 0.0f;

    if (bits(ax) > 0x3eb17218U) {
        int table_offset = (sbits(x) >> 31) * -4;
        if (bits(ax) > 0x3f851591U) {
            float t;
            /* shipped 0x762fa vfma.f32, 0x76308 vfms.f32 */
            reduction = (int)__builtin_fmaf(x, fp(0x3fb8aa3b),
                              *(volatile float *)(((unsigned long)&rodata_986ac) /*=0x986ac*/ + table_offset));
            t = (float)reduction;
            high = __builtin_fmaf(-t, fp(0x3f317180), x);
            low = t * fp(0x3717f7d1);
        } else {
            high = x - *(volatile float *)(((unsigned long)&rodata_986a4) /*=0x986a4*/ + table_offset);
            reduction = (sbits(x) >> 31) * 2 + 1;
            low = *(volatile float *)(((unsigned long)&rodata_9869c) /*=0x9869c*/ + table_offset);
        }
        x = high - low;
    } else {
        if (bits(ax) < 0x31800000U) {
            float rounded = x + fp(0x7149f2ca);
            if (rounded != 1.0f && ((rounded < 1.0f) == (rounded != rounded)))
                return x + 1.0f;
        }
        reduction = 0;
    }

    /* shipped 0x76340..0x7635c: vfma.f32 x4 (Horner) then vfms.f32 (the x - P*s) */
    float square = x * x;
    float horner = __builtin_fmaf(square, fp(0x3331bb4c), fp(0xb5ddea0e));
    horner = __builtin_fmaf(horner, square, fp(0x388ab355));
    horner = __builtin_fmaf(horner, square, fp(0xbb360b61));
    horner = __builtin_fmaf(horner, square, fp(0x3e2aaaab));
    float poly = __builtin_fmaf(-horner, square, x);

    if (reduction != 0) {
        int overflow = signed_add_overflows(reduction, 0x7d);
        int negative = reduction + 0x7d < 0;
        if (negative != overflow)
            reduction += 100;
        poly = 1.0f - ((low - (x * poly) / (2.0f - poly)) - high);
        poly = fp((uint)(sbits(poly) + reduction * 0x800000));
        if (negative != overflow)
            poly *= fp(0x0d800000);
        return poly;
    }
    return 1.0f - ((x * poly) / (poly - 2.0f) - x);
}

/* ---- __ieee754_logf.c ---- */
/* readable reconstruction; identity: FUN_00076538 @ 0x00076538
 * public-name: __ieee754_logf
 * durable-map: recon/catalogs/function_names_app.json
 * callees (readable <= raw @ address):
 *   __ieee754_logf                           <= FUN_00076538 @ 0x00076538
 */
/* Reconstructed FUN_00076538 @ 0x76538  (parity: 300/300 trials, PROVEN) */
static inline float F(uint32_t b){ union{float f;uint32_t u;}x; x.u=b; return x.f; }
static inline uint32_t B(float f){ union{float f;uint32_t u;}x; x.f=f; return x.u; }

float __ieee754_logf(float param_1)
{
    uint32_t r3bits = B(param_1);
    uint32_t r2 = r3bits & 0x7fffffff;
    volatile float zero = 0.0f;

    if (r2 == 0) { float s14 = F(0xcc000000); return s14 / zero; }
    if ((int32_t)r3bits < 0) { float s14 = param_1 - param_1; return s14 / zero; }
    if ((int32_t)r3bits >= 0x7f800000) return param_1 + param_1;

    int32_t r1e;
    uint32_t r2v;
    if ((int32_t)r3bits < 0x800000) {
        float s = param_1 * F(0x4c000000);
        r1e = -0x19;
        r2v = B(s);
    } else {
        r1e = 0;
        r2v = r3bits;
    }
    int32_t r3s = (int32_t)r2v >> 0x17;
    uint32_t uVar2 = r2v & 0x7fffff;
    r3s = r3s - 0x7f;
    uint32_t r0 = 0x004afb20 + uVar2;
    r3s = r3s + r1e;
    uint32_t r1m = (r0 & 0x800000) ^ 0x3f800000;
    r3s = r3s + (int32_t)(r0 >> 23);
    uint32_t r0b = uVar2 + 0xf;
    r1m = r1m | uVar2;
    float fVar3 = F(r1m) - 1.0f;
    uint32_t r1chk = 0x007ffff0 & r0b;

    if (r1chk == 0) {
        if (fVar3 == 0.0f) {
            if (r3s == 0) return F(0x00000000);
            float f = (float)r3s;
            return __builtin_fmaf(f, F(0x3f317180), f * F(0x3717f7d1));
        }
        float s14 = fVar3 * fVar3;
        float s15 = __builtin_fmaf(-fVar3, F(0x3eaaaaab), 0.5f);
        float fVar7 = s14 * s15;
        if (r3s == 0) return fVar3 - fVar7;
        float f = (float)r3s;
        float t = __builtin_fmaf(-f, F(0x3717f7d1), fVar7);
        float u = t - fVar3;
        return __builtin_fmaf(f, F(0x3f317180), -u);
    }

    /* POLY */
    uint32_t r1a = 0xffcf5c30 + uVar2;
    int32_t r2b = (int32_t)(((uint32_t)(0x35c288 - uVar2)) | r1a);
    float fVar5 = fVar3 / (fVar3 + 2.0f);
    float fVar6 = (float)r3s;
    float s10 = fVar5 * fVar5;
    float s14 = s10 * s10;
    float s15 = __builtin_fmaf(s14, F(0x3e1cd04f), F(0x3e638e29));
    float s11 = __builtin_fmaf(s15, s14, F(0x3ecccccd));
    s15 = __builtin_fmaf(s14, F(0x3e178897), F(0x3e3a3325));
    float s9 = __builtin_fmaf(s15, s14, F(0x3e924925));
    s15 = __builtin_fmaf(s9, s14, F(0x3f2aaaab));
    s15 = s15 * s10;
    s15 = __builtin_fmaf(s11, s14, s15);

    if (r2b > 0) {
        float s14b = fVar3 * 0.5f;
        s14b = s14b * fVar3;
        s15 = s15 + s14b;
        s15 = s15 * fVar5;
        if (r3s == 0) {
            float fv7 = s14b - s15;
            return fVar3 - fv7;
        }
        s15 = __builtin_fmaf(fVar6, F(0x3717f7d1), s15);
        s14b = s14b - s15;
        float s0v = s14b - fVar3;
        return __builtin_fmaf(fVar6, F(0x3f317180), -s0v);
    } else {
        s15 = (fVar3 - s15) * fVar5;
        if (r3s == 0) return fVar3 - s15;
        s15 = __builtin_fmaf(-fVar6, F(0x3717f7d1), s15);
        float s0v = s15 - fVar3;
        return __builtin_fmaf(fVar6, F(0x3f317180), -s0v);
    }
}

