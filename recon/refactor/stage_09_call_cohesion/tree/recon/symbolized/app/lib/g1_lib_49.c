/*
 * Cohesive translation unit for the `lib' module.
 *
 * GENERATED by recon/refactor/transforms/t04_cohesive_tu.py.  Do not
 * edit: a stage tree is regenerated, never hand-patched
 * (recon/refactor/README.md C4).
 *
 * The 6 functions below were 6 separate translation units until this
 * stage.  Each one's text is reproduced VERBATIM and in the order the
 * generated source list gave it, and they were CONSECUTIVE in that list.
 * They were proven able to share a translation unit: no symbol is
 * declared here with two types, no identifier has internal linkage in one
 * member and is named by another, and no local typedef, macro, struct tag
 * or enum constant of one member is visible to a member that names it.
 *
 * members, in link order:
 *   k_msleep_ticks32768_b.c
 *   k_msleep_ticks32768_c.c
 *   k_uptime_get_5.c
 *   k_uptime_get_6.c
 *   k_uptime_get_8.c
 *   md5_update.c
 */
/* ---- k_msleep_ticks32768_b.c ---- */
#include "g1_app_symbols.h"
#include <stdint.h>
#include "g1_lib.h"
/* readable reconstruction; identity: FUN_0007d14a @ 0x0007d14a
 * public-name: k_msleep_ticks32768_b
 * durable-map: recon/catalogs/function_names_app.json
 * callees (readable <= raw @ address):
 *   __aeabi_uldivmod                         <= FUN_0000e244 @ 0x0000e244
 *   k_sleep                                  <= FUN_00074844 @ 0x00074844
 *   k_msleep_ticks32768_b                    <= FUN_0007d14a @ 0x0007d14a
 */
/* Reconstructed FUN_0007d14a @ 0x7d14a  (parity: 300/300 trials, PROVEN) */

extern void __aeabi_uldivmod(int,int,int,int);
extern int32_t k_sleep(k_timeout_t);
void k_msleep_ticks32768_b(int param_1)
{
  __aeabi_uldivmod(param_1 * 0x8000 + 999, param_1 >> 0x11, 1000, 0);
  k_sleep();
  return;
}

/* ---- k_msleep_ticks32768_c.c ---- */
/* readable reconstruction; identity: FUN_0007d194 @ 0x0007d194
 * public-name: k_msleep_ticks32768_c
 * durable-map: recon/catalogs/function_names_app.json
 * callees (readable <= raw @ address):
 *   __aeabi_uldivmod                         <= FUN_0000e244 @ 0x0000e244
 *   k_sleep                                  <= FUN_00074844 @ 0x00074844
 *   k_msleep_ticks32768_c                    <= FUN_0007d194 @ 0x0007d194
 */
/* Reconstructed FUN_0007d194 @ 0x7d194  (parity: 300/300 trials, PROVEN) */

void k_msleep_ticks32768_c(int param_1)
{
  __aeabi_uldivmod(param_1 * 0x8000 + 999, param_1 >> 0x11, 1000, 0);
  k_sleep();
  return;
}

/* ---- k_uptime_get_5.c ---- */
/* readable reconstruction; identity: FUN_0007d2d8 @ 0x0007d2d8
 * public-name: k_uptime_get_5
 * durable-map: recon/catalogs/function_names_app.json
 */
/* Reconstructed k_uptime_get_5 @ 0x0007d2d8 from Zephyr kernel.h.
 * Raw backmap: FUN_0007d2d8@0x0007d2d8. */

int64_t k_uptime_get_5(void){ return (int64_t)((uptime_ticks_get()*UINT64_C(1000))>>15); }

/* ---- k_uptime_get_6.c ---- */
/* readable reconstruction; identity: FUN_0007d33a @ 0x0007d33a
 * public-name: k_uptime_get_6
 * durable-map: recon/catalogs/function_names_app.json
 */
/* Reconstructed k_uptime_get_6 @ 0x0007d33a from configured Zephyr 3.4.99 kernel.h.
 * Identity/backmap: FUN_0007d33a.
 */


int64_t k_uptime_get_6(void)
{
    return (int64_t)((uptime_ticks_get() * UINT64_C(1000)) >> 15);
}

/* ---- k_uptime_get_8.c ---- */
/* readable reconstruction; identity: FUN_0007d382 @ 0x0007d382
 * public-name: k_uptime_get_8
 * durable-map: recon/catalogs/function_names_app.json
 */
/* Reconstructed k_uptime_get_8 @ 0x0007d382 from configured Zephyr 3.4.99 kernel.h.
 * Identity/backmap: FUN_0007d382.
 */


unsigned long long k_uptime_get_8(void) {
    return (int64_t)((uptime_ticks_get() * UINT64_C(1000)) >> 15);
}

/* ---- md5_update.c ---- */
/* readable reconstruction; identity: FUN_0007d8f4 @ 0x0007d8f4
 * public-name: md5_update
 * durable-map: recon/catalogs/function_names_app.json
 * callees (readable <= raw @ address):
 *   md5_process_block                        <= FUN_00049acc @ 0x00049acc
 *   md5_update                               <= FUN_0007d8f4 @ 0x0007d8f4
 *   memcpy                                   <= FUN_00086c04 @ 0x00086c04
 */
/* FUN_0007d8f4 @ 0x7d8f4 */

extern void memcpy(void *destination, const void *source, uint32_t length);
extern void md5_process_block(volatile unsigned int *, void *);

/* Feed bytes into a 64-byte block hash state while maintaining bit count. */
void md5_update(uint32_t *state, const uint8_t *input, uint32_t length)
{
    uint32_t used = (state[0] >> 3) & 0x3f;
    uint32_t old_low = state[0];
    state[0] = old_low + (length << 3);
    if (state[0] < old_low)
        state[1]++;
    state[1] += length >> 29;

    uint32_t consumed = 0;
    uint32_t space = 64 - used;
    if (length >= space) {
        memcpy((uint8_t *)state + 0x18 + used, input, space);
        md5_process_block(state + 2, state + 6);
        consumed = space;
        while (consumed + 64 <= length) {
            md5_process_block(state + 2, input + consumed);
            consumed += 64;
        }
        used = 0;
    }
    memcpy((uint8_t *)state + 0x18 + used,
                 input + consumed, length - consumed);
}

