/*
 * Call-cohesive translation unit for the `lib' module.
 *
 * GENERATED by recon/refactor/transforms/t09_call_cohesion.py.  Do
 * not edit: a stage tree is regenerated, never hand-patched
 * (recon/refactor/README.md C4).
 *
 * The 3 translation units below were grouped because they CALL ONE
 * ANOTHER, not because they were adjacent in the generated source
 * list.  Each member's text is reproduced VERBATIM.  Every member was
 * checked pairwise against every other member already in this unit by
 * stage 04's seven refusal rules, unchanged: no symbol is declared
 * here with two types, no identifier has internal linkage in one
 * member and is named by another, and no local typedef, macro, struct
 * tag or enum constant of one member is visible to a member that
 * names it.
 *
 * members, in generated-source-list order:
 *   net_buf_pool_get_727ac.c
 *   g1_recon_tagged_heap_node_release.c
 *   k_fifo_peek_head_impl.c
 *
 * call edges inside this unit (caller -> callee): 2
 *   k_fifo_peek_head_impl.c -> g1_recon_tagged_heap_node_release.c
 *   net_buf_pool_get_727ac.c -> g1_recon_tagged_heap_node_release.c
 */

/* File-scope forward declarations for every struct/union tag this
 * unit names.  Without them a tag whose only appearance in a member
 * is inside a parameter list has PARAMETER-LIST scope, so two
 * textually IDENTICAL declarations in two members declare two
 * different incomplete types and the second is a conflicting
 * redeclaration (C11 6.2.1p7).  Incomplete-type forward
 * declarations emit no code. */
struct k_spinlock;
/* ================================================================ */
/* member unit: net_buf_pool_get_727ac.c */
/* ================================================================ */
#include "g1_app_symbols.h"
/* readable reconstruction; identity: FUN_000727ac @ 0x000727ac
 * public-name: net_buf_pool_get_727ac
 * durable-map: recon/catalogs/function_names_app.json
 * callees (readable <= raw @ address):
 *   z_spin_lock_valid                        <= FUN_00072040 @ 0x00072040
 *   z_spin_unlock_valid                      <= FUN_0007205c @ 0x0007205c
 *   z_spin_lock_set_owner                    <= FUN_00072078 @ 0x00072078
 *   net_buf_pool_get_727ac                   <= FUN_000727ac @ 0x000727ac
 *   z_pend_curr                              <= FUN_00073f6c @ 0x00073f6c
 *   assert_post_action                       <= FUN_0007e2ec @ 0x0007e2ec
 *   printk                                   <= FUN_0007e2fa @ 0x0007e2fa
 * address symbols (name @ address):
 *   rodata_99cbd                             @ 0x00099cbd   [INLINED -- G6 literal batch]
 *   rodata_f08c7                             @ 0x000f08c7
 *   rodata_f08f4                             @ 0x000f08f4   [INLINED -- G6 literal batch]
 *   rodata_f090b                             @ 0x000f090b   [INLINED -- G6 literal batch]
 *   rodata_f0920                             @ 0x000f0920   [INLINED -- G6 literal batch]
 *   rodata_f0935                             @ 0x000f0935   [INLINED -- G6 literal batch]
 *   _kernel                                  @ 0x2000b448
 */
/* Reconstructed FUN_000727ac @ 0x727ac  (parity: 300/300 trials, PROVEN) */
#include <stdint.h>
#include "../../../headers/g1_log.h"
#include "g1_lib.h"
extern _Bool z_spin_lock_valid(struct k_spinlock *);
extern _Bool z_spin_unlock_valid(struct k_spinlock *);
extern void z_spin_lock_set_owner(struct k_spinlock *);
extern int z_pend_curr(void*,unsigned,void*,unsigned,unsigned,unsigned,unsigned);
extern void assert_post_action(const char *, unsigned int);

uint32_t net_buf_pool_get_727ac(unsigned *param_1, unsigned param_2, unsigned param_3, unsigned param_4){
    unsigned *puVar7 = param_1 + 2;
    unsigned uVar8 = 0;
    int iVar2 = z_spin_lock_valid(puVar7);
    if (iVar2 == 0){
        printk(((unsigned long)"ASSERTION FAIL [%s] @ %s:%d\n") /*=0x99cbd*/, ((unsigned long)"z_spin_lock_valid(l)") /*=0xf0920*/, ((unsigned long)&rodata_f08c7) /*=0xf08c7*/, 0x72);
        printk(((unsigned long)"\tInvalid spinlock %p\n") /*=0xf0935*/, puVar7);
        uVar8=0x72;
        assert_post_action(((unsigned long)&rodata_f08c7) /*=0xf08c7*/, uVar8);
        return 0x72;
    }
    z_spin_lock_set_owner(puVar7);
    unsigned *puVar6 = (unsigned*)*param_1;
    unsigned uVar3;
    if (puVar6 == 0){
        uVar3 = 0;
        if ((param_3 | param_4) != 0){
            int r = z_pend_curr(puVar7, uVar8, param_1+3, param_3|param_4, param_3, param_4, param_3);
            if (r != 0) return 0;
            return *(uint32_t*)(*(int*)(((unsigned long)&_kernel) /*=0x2000b448*/+8)+0x14);
        }
    } else {
        unsigned *puVar4 = (unsigned*)param_1[1];
        unsigned uVar5 = *puVar6 & 0xfffffffc;
        *param_1 = uVar5;
        if (puVar6 == puVar4){
            param_1[1] = uVar5;
        }
        uVar3 = (unsigned)g1_recon_tagged_heap_node_release(puVar6, 1);
    }
    iVar2 = z_spin_unlock_valid(puVar7);
    if (iVar2 != 0){
        return uVar3;
    }
    printk(((unsigned long)"ASSERTION FAIL [%s] @ %s:%d\n") /*=0x99cbd*/, ((unsigned long)"z_spin_unlock_valid(l)") /*=0xf08f4*/, ((unsigned long)&rodata_f08c7) /*=0xf08c7*/, 0xf0);
    printk(((unsigned long)"\tNot my spinlock %p\n") /*=0xf090b*/, puVar7);
    uVar8=0xf0;
    assert_post_action(((unsigned long)&rodata_f08c7) /*=0xf08c7*/, uVar8);
    return uVar3;
}

/* ================================================================ */
/* member unit: g1_recon_tagged_heap_node_release.c */
/* ================================================================ */
#include "g1_app_symbols.h"
/* readable reconstruction; identity: FUN_000864d0 @ 0x000864d0
 * public-name: g1_recon_tagged_heap_node_release
 * durable-map: recon/catalogs/function_names_app.json
 */
/* Reconstructed g1_recon_tagged_heap_node_release @ 0x000864d0.
 * Raw backmap: FUN_000864d0@0x000864d0. */

#include <stdint.h>

extern void g1_recon_k_free(void *allocation);

uintptr_t g1_recon_tagged_heap_node_release(unsigned *node, int release)
{
    uintptr_t result = (uintptr_t)node;

    if (node != 0 && ((*node & 3u) != 0u)) {
        result = node[1];
        if (release != 0) {
            g1_recon_k_free(node);
        }
    }
    return result;
}

/* ================================================================ */
/* member unit: k_fifo_peek_head_impl.c */
/* ================================================================ */
#include "g1_app_symbols.h"
/* readable reconstruction; identity: FUN_0008652c @ 0x0008652c
 * public-name: k_fifo_peek_head_impl
 * durable-map: recon/catalogs/function_names_app.json
 * callees (readable <= raw @ address):
 *   k_fifo_peek_head_impl                    <= FUN_0008652c @ 0x0008652c
 */
/* Reconstructed FUN_0008652c @ 0x8652c  (parity: 300/300 trials, PROVEN) */

#include <stdint.h>
#include "g1_lib.h"

void k_fifo_peek_head_impl(unsigned int *param_1)
{
    (void)g1_recon_tagged_heap_node_release((unsigned *)(uintptr_t)*param_1, 0);
}

