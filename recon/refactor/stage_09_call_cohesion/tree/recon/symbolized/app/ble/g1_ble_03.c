/*
 * Cohesive translation unit for the `ble' module.
 *
 * GENERATED by recon/refactor/transforms/t04_cohesive_tu.py.  Do not
 * edit: a stage tree is regenerated, never hand-patched
 * (recon/refactor/README.md C4).
 *
 * The 7 functions below were 7 separate translation units until this
 * stage.  Each one's text is reproduced VERBATIM and in the order the
 * generated source list gave it, and they were CONSECUTIVE in that list.
 * They were proven able to share a translation unit: no symbol is
 * declared here with two types, no identifier has internal linkage in one
 * member and is named by another, and no local typedef, macro, struct tag
 * or enum constant of one member is visible to a member that names it.
 *
 * members, in link order:
 *   subcontracing_send_data_pkcs7.c
 *   ble_packet_receive_dispatch.c
 *   ble_work_thread.c
 *   refresh_and_read_box_field_timer.c
 *   set_box_link_state_flag.c
 *   cleanStocksIndex.c
 *   cleanNewsIndex.c
 */
/* ---- subcontracing_send_data_pkcs7.c ---- */
#include "g1_app_symbols.h"
/* readable reconstruction; identity: FUN_00021a40 @ 0x00021a40
 * public-name: subcontracing_send_data_pkcs7
 * durable-map: recon/catalogs/function_names_app.json
 * callees (readable <= raw @ address):
 *   debug_print                              <= FUN_00019c70 @ 0x00019c70
 *   subcontracing_send_data_pkcs7            <= FUN_00021a40 @ 0x00021a40
 *   debug_print_hex_dump                     <= FUN_0004a424 @ 0x0004a424
 *   safe_memcpy_checked                      <= FUN_00086c1e @ 0x00086c1e
 *   memset_bytes                             <= FUN_00086c78 @ 0x00086c78
 * address symbols (name @ address):
 *   rodata_9d6a1                             @ 0x0009d6a1   [INLINED -- G6 literal batch]
 *   rodata_9d6d8                             @ 0x0009d6d8   [INLINED -- G6 literal batch]
 *   rodata_9d6ee                             @ 0x0009d6ee
 *   rodata_9d6f3                             @ 0x0009d6f3   [INLINED -- G6 literal batch]
 *   rodata_9d70f                             @ 0x0009d70f
 *   rodata_9d714                             @ 0x0009d714   [INLINED -- G6 literal batch]
 *   rodata_9d734                             @ 0x0009d734   [INLINED -- G6 literal batch]
 *   rodata_9e014                             @ 0x0009e014   [INLINED -- G6 literal batch]
 *   g_log_level                              @ 0x2000230c
 *   g_log_use_alt_sink                       @ 0x20007554
 */
/* Reconstructed FUN_00021a40 @ 0x21a40. */
#include <stdint.h>
#include "../../../headers/g1_log.h"
#include "g1_ble.h"

extern void safe_memcpy_checked(void *destination, const void *source,
                         unsigned int count, unsigned int record_size);
extern void memset_bytes(void*, int, int);

uint32_t subcontracing_send_data_pkcs7(const uint8_t *source, int byte_count,
                      uint8_t record_type,
                      void (*send_record)(void *, unsigned int))
{
    volatile int *const log_level = (volatile int *)((unsigned long)&g_log_level) /*=0x2000230c*/;
    volatile int *const alternate_log = (volatile int *)((unsigned long)&g_log_use_alt_sink) /*=0x20007554*/;
    uint8_t record[20];
    int full_records = byte_count / 17;
    int remainder = byte_count - full_records * 17;
    int record_count = full_records + 1;
    int index;
    int level;

    *(uint32_t *)record = 0;
    memset_bytes(record + 4, 0, 16);
    record[0] = record_type;
    record[1] = (uint8_t)record_count;

    if (*log_level > 2) {
        if (*alternate_log == 0)
            log_message(((unsigned long)"%s(): integer_num: %d, tail_len: %d, raw_data_len: %d\n") /*=0x9d6a1*/, ((unsigned long)"subcontracing_send_data_pkcs7") /*=0x9e014*/, record_count,
                        remainder, byte_count);
        else
            debug_print(((unsigned long)"%s(): integer_num: %d, tail_len: %d, raw_data_len: %d\n") /*=0x9d6a1*/, ((unsigned long)"subcontracing_send_data_pkcs7") /*=0x9e014*/, record_count,
                         remainder, byte_count);
    }

    for (index = 0;; ++index) {
        level = *log_level;
        if (index >= full_records)
            break;

        record[2] = (uint8_t)index;
        __builtin_memcpy(record + 3, source + index * 17, 17);
        if (level > 2) {
            if (*alternate_log == 0)
                log_message(((unsigned long)"%s(): #\345\217\221\351\200\201: %d/%d\n") /*=0x9d6d8*/, ((unsigned long)"subcontracing_send_data_pkcs7") /*=0x9e014*/,
                            index + 1, record_count);
            else
                debug_print(((unsigned long)"%s(): #\345\217\221\351\200\201: %d/%d\n") /*=0x9d6d8*/, ((unsigned long)"subcontracing_send_data_pkcs7") /*=0x9e014*/,
                             index + 1, record_count);
        }
        debug_print_hex_dump(((unsigned long)&rodata_9d6ee) /*=0x9d6ee*/, record, sizeof(record));
        send_record(record, sizeof(record));
    }

    index = full_records & ~(full_records >> 31);
    record[2] = (uint8_t)index;
    if (remainder == 0) {
        memset_bytes(record + 3, 17, 17);
        if (level > 2) {
            if (*alternate_log == 0)
                log_message(((unsigned long)"%s(): PKCS-7#\345\217\221\351\200\201: %d/%d\n") /*=0x9d6f3*/, ((unsigned long)"subcontracing_send_data_pkcs7") /*=0x9e014*/,
                            index + 1, record_count);
            else
                debug_print(((unsigned long)"%s(): PKCS-7#\345\217\221\351\200\201: %d/%d\n") /*=0x9d6f3*/, ((unsigned long)"subcontracing_send_data_pkcs7") /*=0x9e014*/,
                             index + 1, record_count);
        }
    } else {
        memset_bytes(record + 3 + remainder, 17 - remainder,
                     17 - remainder);
        safe_memcpy_checked(record + 3, source + full_records * 17,
                     (unsigned int)remainder, 17);
        if (level > 2) {
            if (*alternate_log == 0)
                log_message(((unsigned long)"%s(): PKCS-7#\345\217\221\351\200\201tail: %d/%d\n") /*=0x9d714*/, ((unsigned long)"subcontracing_send_data_pkcs7") /*=0x9e014*/,
                            index + 1, record_count);
            else
                debug_print(((unsigned long)"%s(): PKCS-7#\345\217\221\351\200\201tail: %d/%d\n") /*=0x9d714*/, ((unsigned long)"subcontracing_send_data_pkcs7") /*=0x9e014*/,
                             index + 1, record_count);
        }
    }

    debug_print_hex_dump(((unsigned long)&rodata_9d70f) /*=0x9d70f*/, record, sizeof(record));
    if (*log_level > 2) {
        if (*alternate_log == 0)
            log_message(((unsigned long)"%s(): total-size:%d\n") /*=0x9d734*/, ((unsigned long)"subcontracing_send_data_pkcs7") /*=0x9e014*/, byte_count);
        else
            debug_print(((unsigned long)"%s(): total-size:%d\n") /*=0x9d734*/, ((unsigned long)"subcontracing_send_data_pkcs7") /*=0x9e014*/, byte_count);
    }
    send_record(record, sizeof(record));
    return 0;
}

/* ---- ble_packet_receive_dispatch.c ---- */
/* readable reconstruction; identity: FUN_00021d78 @ 0x00021d78
 * public-name: ble_packet_receive_dispatch
 * durable-map: recon/catalogs/function_names_app.json
 * callees (readable <= raw @ address):
 *   ble_packet_receive_dispatch              <= FUN_00021d78 @ 0x00021d78
 *   debug_print_hex_dump                     <= FUN_0004a424 @ 0x0004a424
 *   ble_requeue_command_via_dispatch         <= FUN_0007c244 @ 0x0007c244
 * address symbols (name @ address):
 *   rodata_9dec8                             @ 0x0009dec8   [INLINED -- G6 literal batch]
 */
/* Reconstructed FUN_00021d78 @ 0x21d78  (parity: 300/300 trials, PROVEN) */

extern int spec_ble_command_hook(unsigned int a, unsigned int b);
extern void ble_requeue_command_via_dispatch(unsigned int a, unsigned int b);

static void ble_packet_receive_dispatch(unsigned int param_1, unsigned int param_2, int param_3)
{
    int iVar1;
    if (param_3 != 0) {
        debug_print_hex_dump(((unsigned long)"BLE-rec") /*=0x9dec8*/, param_1, param_2);
    }
    iVar1 = spec_ble_command_hook(param_1, param_2);
    if (iVar1 != 0) {
        ble_requeue_command_via_dispatch(param_1, param_2);
    }
}

/* ---- ble_work_thread.c ---- */
/* readable reconstruction; identity: FUN_00021da8 @ 0x00021da8
 * public-name: ble_work_thread
 * durable-map: recon/catalogs/function_names_app.json
 * callees (readable <= raw @ address):
 *   get_device_info                          <= FUN_000167a8 @ 0x000167a8
 *   dequeue_bt_data                          <= FUN_000181b8 @ 0x000181b8
 *   bt_start                                 <= FUN_00019308 @ 0x00019308
 *   ancs_main                                <= FUN_00019950 @ 0x00019950
 *   debug_log_queue_init                     <= FUN_00019bd0 @ 0x00019bd0
 *   debug_print                              <= FUN_00019c70 @ 0x00019c70
 *   ble_packet_receive_dispatch              <= FUN_00021d78 @ 0x00021d78
 *   z_impl_k_sem_take                        <= FUN_00072908 @ 0x00072908
 *   k_sleep                                  <= FUN_00074844 @ 0x00074844
 *   malloc                                   <= FUN_00076d6c @ 0x00076d6c
 *   device_resume_state_advance              <= FUN_0007c108 @ 0x0007c108
 *   memcpy                                   <= FUN_00086c04 @ 0x00086c04
 *   memset_bytes                             <= FUN_00086c78 @ 0x00086c78
 * address symbols (name @ address):
 *   rodata_9ded0                             @ 0x0009ded0   [INLINED -- G6 literal batch]
 *   rodata_9dede                             @ 0x0009dede   [INLINED -- G6 literal batch]
 *   rodata_9deed                             @ 0x0009deed   [INLINED -- G6 literal batch]
 *   rodata_9df00                             @ 0x0009df00   [INLINED -- G6 literal batch]
 *   rodata_9df28                             @ 0x0009df28   [INLINED -- G6 literal batch]
 *   rodata_9df51                             @ 0x0009df51   [INLINED -- G6 literal batch]
 *   rodata_9df99                             @ 0x0009df99   [INLINED -- G6 literal batch]
 *   g_log_level                              @ 0x2000230c
 *   g_send_event_pending_id                  @ 0x2000302e
 *   g_ring_log_pending                       @ 0x20007550
 *   g_log_use_alt_sink                       @ 0x20007554
 *   g_20018da9                               @ 0x20018da9
 */
/* Full reconstruction ble_work_thread @ 0x21da8, exact extent 578 bytes.
 * CFG_VERIFY_PREFIX_FIRST CFG_VERIFY_PREFIX_K=80 */
extern int ancs_main(uintptr_t);
extern void debug_log_queue_init(void);
extern void *malloc(size_t);
extern int get_device_info(void);
extern int32_t k_sleep(k_timeout_t);
extern uint64_t dequeue_bt_data(void*);
extern void z_impl_k_sem_take(uintptr_t,uint32_t,uint32_t,uint32_t);
static void ble_packet_receive_dispatch(unsigned int, unsigned int, int);
extern int device_resume_state_advance(void);
extern int bt_start(void);
extern void memcpy(int, int, int);

static __attribute__((always_inline)) inline void
ble_log(uintptr_t format, uint32_t value, int threshold)
{
    if (*(volatile int *)((unsigned long)&g_log_level) /*=0x2000230c*/ > threshold) {
        int alternate=*(volatile int *)((unsigned long)&g_log_use_alt_sink) /*=0x20007554*/;
        if (alternate) debug_print(format,((unsigned long)"ble_work_thread") /*=0x9df99*/,value,(uint32_t)alternate);
        else log_message(format,((unsigned long)"ble_work_thread") /*=0x9df99*/,value,(uint32_t)alternate);
    }
}

/* Zephyr thread entries have the p1/p2/p3 ABI even though this worker uses
 * only p1.  The first diagnostic leaves incoming r2 intact, so name p3 and
 * forward it rather than manufacturing a padding value. */
void ble_work_thread(uintptr_t context, uintptr_t unused_p2, uint32_t p3)
{
    (void)unused_p2;
    ble_log(((unsigned long)"%s(): start\n\n") /*=0x9ded0*/,p3,2);
    int rc=ancs_main(context);
    debug_log_queue_init();
    if(rc) ble_log(((unsigned long)"%s(): err:%d\n\n") /*=0x9dede*/,(uint32_t)rc,2);
    *(volatile uintptr_t *)(context+0x10)=malloc(0x2b8);
    ble_log(((unsigned long)"%s(): tx_size:%d\n\n") /*=0x9deed*/,0x2b8,2);

    uint8_t packet[260];
    for (;;) {
        uintptr_t owner;
        do {
            owner=get_device_info();
            if ((int32_t)((uint32_t)*(volatile uint16_t *)(owner+0x105c)<<24)>=0)
                k_sleep(0x8000,0);
            else break;
        } while(1);

        uint64_t received=dequeue_bt_data(packet);
        if ((uint32_t)received==0) {
            uint32_t length=packet[0];
            if(length<0x15) {
                memcpy(*(void**)(context+0x254),packet+1,length);
                *(volatile uint32_t *)(context+0x35c)=1;
                *(volatile uint32_t *)(context+0x358)=0;
                *(volatile uint32_t *)(context+0x360)=length;
            } else {
                memcpy((void*)(context+0x258),packet+1,length);
                *(volatile uint32_t *)(context+0x358)=length;
            }
        } else {
            *(volatile uint8_t *)(context+0x248)=0;
            z_impl_k_sem_take(context+0x218,(uint32_t)(received>>32),0xffffffffu,0xffffffffu);
            *(volatile uint8_t *)(context+0x248)=1;
            if (*(volatile uint32_t *)(context+0x35c)==0 &&
                *(volatile uint32_t *)(context+0x358)==0) {
                uint8_t pending=*(volatile uint8_t *)((unsigned long)&g_send_event_pending_id) /*=0x2000302e*/;
                uint8_t *out=*(uint8_t**)(context+0x254);
                if(pending!=0xff) {
                    *(volatile uint32_t *)(context+0x35c)=1;
                    out[0]=0xf5; out[1]=pending;
                    *(volatile uint8_t *)((unsigned long)&g_send_event_pending_id) /*=0x2000302e*/=0xff;
                    out[2]=0xcb;
                    *(volatile uint32_t *)(context+0x358)=0;
                    *(volatile uint32_t *)(context+0x360)=3;
                    if((uint8_t)(pending-9)<2) out[2]=*(uint8_t*)(context+0x18);
                } else if(*(volatile uint8_t *)((unsigned long)&g_20018da9) /*=0x20018da9*/) {
                    *(volatile uint32_t *)(context+0x35c)=1;
                    out[0]=0xf1;
                    *(volatile uint8_t *)((unsigned long)&g_20018da9) /*=0x20018da9*/=0;
                    out[1]=0; out[2]=0xcc;
                    *(volatile uint32_t *)(context+0x358)=0;
                } else if(*(volatile uint32_t *)((unsigned long)&g_ring_log_pending) /*=0x20007550*/) {
                    *(volatile uint32_t *)(context+0x35c)=1;
                    out[0]=0xf4; out[1]=0; out[2]=0xcb;
                    *(volatile uint32_t *)((unsigned long)&g_ring_log_pending) /*=0x20007550*/=0;
                    *(volatile uint32_t *)(context+0x358)=0;
                } else continue;
            }
        }

        if (*(volatile uint8_t *)(context+0x364)==0) {
            uint32_t long_length=*(volatile uint32_t *)(context+0x358);
            if(long_length) {
                ble_packet_receive_dispatch((void*)(context+0x258),long_length,0);
                memset_bytes((void*)(context+0x258),0,0x100);
            } else {
                uint32_t slot=*(volatile uint32_t *)(context+0x35c);
                void *buffer=*(void**)(context+0x250+slot*4);
                ble_packet_receive_dispatch(buffer,*(volatile uint32_t *)(context+0x360),0);
            }
            *(volatile uint32_t *)(context+0x358)=0;
            *(volatile uint32_t *)(context+0x35c)=0;
        } else {
            int state=device_resume_state_advance();
            if(state==0) {
                ble_log(((unsigned long)"%s(): charge plug off, call bt_start. \n\n") /*=0x9df28*/,0,2);
                int error=bt_start();
                if(error) log_message(((unsigned long)"Advertising failed to start (err %d)\n") /*=0x9df51*/,(uint32_t)error,0,
                                      *(volatile uint32_t *)((unsigned long)&g_log_use_alt_sink) /*=0x20007554*/);
            } else {
                ble_log(((unsigned long)"%s(): bt_le_adv_stop failed!!! err=%d\n\n") /*=0x9df00*/,(uint32_t)state,1);
            }
            *(volatile uint8_t *)(context+0x364)=0;
        }
    }
}

/* ---- refresh_and_read_box_field_timer.c ---- */
/* readable reconstruction; identity: FUN_00025448 @ 0x00025448
 * public-name: refresh_and_read_box_field_timer
 * durable-map: recon/catalogs/function_names_app.json
 * callees (readable <= raw @ address):
 *   refresh_box_field_timer                  <= FUN_0002542c @ 0x0002542c
 *   refresh_and_read_box_field_timer         <= FUN_00025448 @ 0x00025448
 * address symbols (name @ address):
 *   g_box_field_timer                        @ 0x20007a24
 */
/* Reconstructed FUN_00025448 @ 0x25448  (parity: 300/300 trials, PROVEN) */

extern void refresh_box_field_timer(void);
unsigned int refresh_and_read_box_field_timer(void)
{
  refresh_box_field_timer();
  return *(volatile unsigned int *)((unsigned long)&g_box_field_timer) /*=0x20007a24*/;
}

/* ---- set_box_link_state_flag.c ---- */
/* readable reconstruction; identity: FUN_0002efe4 @ 0x0002efe4
 * public-name: set_box_link_state_flag
 * durable-map: recon/catalogs/function_names_app.json
 * callees (readable <= raw @ address):
 *   get_device_info                          <= FUN_000167a8 @ 0x000167a8
 *   set_box_link_state_flag                  <= FUN_0002efe4 @ 0x0002efe4
 * address symbols (name @ address):
 *   g_low_battery_sync_flag                  @ 0x2000302f
 */
/* Reconstructed FUN_0002efe4 @ 0x2efe4  (parity: 300/300 trials, PROVEN) */


unsigned int set_box_link_state_flag(int param_1)
{
  unsigned char *pcVar1;

  pcVar1 = (unsigned char *)get_device_info();
  if (*pcVar1 == 1) {
    if (param_1 == 0) {
      *(volatile unsigned char *)((unsigned long)&g_low_battery_sync_flag) /*=0x2000302f*/ = 0;
    }
    else {
      *(volatile unsigned char *)((unsigned long)&g_low_battery_sync_flag) /*=0x2000302f*/ = 2;
    }
  }
  return 0;
}

/* ---- cleanStocksIndex.c ---- */
/* readable reconstruction; identity: FUN_00037154 @ 0x00037154
 * public-name: cleanStocksIndex
 * durable-map: recon/catalogs/function_names_app.json
 * callees (readable <= raw @ address):
 *   debug_print                              <= FUN_00019c70 @ 0x00019c70
 * address symbols (name @ address):
 *   rodata_a8ff3                             @ 0x000a8ff3   [INLINED -- G6 literal batch]
 *   rodata_a95b8                             @ 0x000a95b8   [INLINED -- G6 literal batch]
 *   g_log_level                              @ 0x2000230c
 *   g_dashboard_widget_state                 @ 0x20004950
 *   g_log_use_alt_sink                       @ 0x20007554
 *   g_stocks_widget_index_raw                @ 0x2001b815
 */
/* Reconstructed cleanStocksIndex @ 0x37154  (parity: 300/300 trials, PROVEN) */


void cleanStocksIndex(void)
{
  *(volatile uint8_t *)(((unsigned long)&g_dashboard_widget_state) /*=0x20004950*/+3) = 0;
  *(volatile uint8_t *)((unsigned long)&g_stocks_widget_index_raw) /*=0x2001b815*/ = 0;
  if (*(volatile int32_t *)((unsigned long)&g_log_level) /*=0x2000230c*/ <= 2) {
    return;
  }
  if (*(volatile int32_t *)((unsigned long)&g_log_use_alt_sink) /*=0x20007554*/ != 0) {
    debug_print(((unsigned long)"%s():  %s index = %d\n") /*=0xa8ff3*/, ((unsigned long)"cleanStocksIndex") /*=0xa95b8*/, ((unsigned long)"cleanStocksIndex") /*=0xa95b8*/, 0);
    return;
  }
  log_message(((unsigned long)"%s():  %s index = %d\n") /*=0xa8ff3*/, ((unsigned long)"cleanStocksIndex") /*=0xa95b8*/, ((unsigned long)"cleanStocksIndex") /*=0xa95b8*/, 0);
}

/* ---- cleanNewsIndex.c ---- */
/* readable reconstruction; identity: FUN_00037234 @ 0x00037234
 * public-name: cleanNewsIndex
 * durable-map: recon/catalogs/function_names_app.json
 * callees (readable <= raw @ address):
 *   debug_print                              <= FUN_00019c70 @ 0x00019c70
 * address symbols (name @ address):
 *   rodata_a8ff3                             @ 0x000a8ff3   [INLINED -- G6 literal batch]
 *   rodata_a958f                             @ 0x000a958f   [INLINED -- G6 literal batch]
 *   g_log_level                              @ 0x2000230c
 *   g_dashboard_widget_state                 @ 0x20004950
 *   g_log_use_alt_sink                       @ 0x20007554
 *   g_news_widget_index_raw                  @ 0x2001b814
 */
/* Reconstructed cleanNewsIndex @ 0x37234  (parity: 300/300 trials, PROVEN) */


void cleanNewsIndex(void)
{
  *(volatile uint8_t *)(((unsigned long)&g_dashboard_widget_state) /*=0x20004950*/+5) = 0;
  *(volatile uint8_t *)((unsigned long)&g_news_widget_index_raw) /*=0x2001b814*/ = 0;
  if (*(volatile int32_t *)((unsigned long)&g_log_level) /*=0x2000230c*/ <= 2) {
    return;
  }
  if (*(volatile int32_t *)((unsigned long)&g_log_use_alt_sink) /*=0x20007554*/ != 0) {
    debug_print(((unsigned long)"%s():  %s index = %d\n") /*=0xa8ff3*/, ((unsigned long)"cleanNewsIndex") /*=0xa958f*/, ((unsigned long)"cleanNewsIndex") /*=0xa958f*/, 0);
    return;
  }
  log_message(((unsigned long)"%s():  %s index = %d\n") /*=0xa8ff3*/, ((unsigned long)"cleanNewsIndex") /*=0xa958f*/, ((unsigned long)"cleanNewsIndex") /*=0xa958f*/, 0);
}

