/*
 * Call-cohesive translation unit for the `ble' module.
 *
 * GENERATED by recon/refactor/transforms/t09_call_cohesion.py.  Do
 * not edit: a stage tree is regenerated, never hand-patched
 * (recon/refactor/README.md C4).
 *
 * The 2 translation units below were grouped because they CALL ONE
 * ANOTHER, not because they were adjacent in the generated source
 * list.  Each member's text is reproduced VERBATIM.  Every member was
 * checked pairwise against every other member already in this unit by
 * stage 04's seven refusal rules, unchanged: no symbol is declared
 * here with two types, no identifier has internal linkage in one
 * member and is named by another, and no local typedef, macro, struct
 * tag or enum constant of one member is visible to a member that
 * names it.
 *
 * members, in generated-source-list order:
 *   g1_ble_04.c
 *   g1_ble_09.c
 *
 * call edges inside this unit (caller -> callee): 1
 *   g1_ble_04.c -> g1_ble_09.c
 */

/* File-scope forward declarations for every struct/union tag this
 * unit names.  Without them a tag whose only appearance in a member
 * is inside a parameter list has PARAMETER-LIST scope, so two
 * textually IDENTICAL declarations in two members declare two
 * different incomplete types and the second is a conflicting
 * redeclaration (C11 6.2.1p7).  Incomplete-type forward
 * declarations emit no code. */
struct auth_listener;
struct auth_node;
struct hci_command_log_record;
struct k_work;
struct k_work_delayable;
/* ================================================================ */
/* member unit: g1_ble_04.c */
/* ================================================================ */
/*
 * Cohesive translation unit for the `ble' module.
 *
 * GENERATED by recon/refactor/transforms/t04_cohesive_tu.py.  Do not
 * edit: a stage tree is regenerated, never hand-patched
 * (recon/refactor/README.md C4).
 *
 * The 7 functions below were 7 separate translation units until this
 * stage.  Each one's text is reproduced VERBATIM and in the order the
 * generated source list gave it, and they were CONSECUTIVE in that list.
 * They were proven able to share a translation unit: no symbol is
 * declared here with two types, no identifier has internal linkage in one
 * member and is named by another, and no local typedef, macro, struct tag
 * or enum constant of one member is visible to a member that names it.
 *
 * members, in link order:
 *   rate_limited_elapsed_seconds_tick.c
 *   get_synced_clock_time.c
 *   active_transfer_conn_match.c
 *   store_gatt_db_hash_setting.c
 *   unpair.c
 *   hci_cmd_alloc_failure_log.c
 *   log_unhandled_hci_event.c
 */

/* File-scope forward declarations for every struct/union tag this
 * unit names.  Without them a tag whose only appearance in a member
 * is inside a parameter list has PARAMETER-LIST scope, so two
 * textually IDENTICAL declarations in two members declare two
 * different incomplete types and the second is a conflicting
 * redeclaration (C11 6.2.1p7).  Incomplete-type forward
 * declarations emit no code. */
struct auth_listener;
struct auth_node;
struct hci_command_log_record;
/* ---- rate_limited_elapsed_seconds_tick.c ---- */
#include "g1_app_symbols.h"
#include "g1_ble.h"
/* readable reconstruction; identity: FUN_0004a46c @ 0x0004a46c
 * public-name: rate_limited_elapsed_seconds_tick
 * durable-map: recon/catalogs/function_names_app.json
 * callees (readable <= raw @ address):
 *   rate_limited_elapsed_seconds_tick        <= FUN_0004a46c @ 0x0004a46c
 *   k_uptime_get_9                           <= FUN_0007d9a4 @ 0x0007d9a4
 * address symbols (name @ address):
 *   g_progress_tick_ms                       @ 0x2000a0a0
 */
/* Reconstructed FUN_0004a46c @ 0x4a46c  (parity: 300/300 trials, PROVEN) */


void rate_limited_elapsed_seconds_tick(int *param_1, int param_2, int param_3)
{
    volatile int *arr = (volatile int*)((unsigned long)&g_progress_tick_ms) /*=0x2000a0a0*/;
    int iVar3;
    if (param_3 == 0) {
        iVar3 = k_uptime_get_9();
        int iVar4 = arr[param_2];
        if (iVar4 == 0) {
            arr[param_2] = iVar3;
        } else if ((unsigned int)(iVar3 - iVar4) > 999) {
            unsigned int uVar5 = (unsigned int)(iVar3-iVar4)/1000;
            int iv = *param_1;
            arr[param_2] = uVar5*1000 + iVar4;
            *param_1 = iv + uVar5;
        }
    } else {
        int uVar2 = k_uptime_get_9();
        arr[param_2] = uVar2;
    }
}

/* ---- get_synced_clock_time.c ---- */
/* readable reconstruction; identity: FUN_0004a4d0 @ 0x0004a4d0
 * public-name: get_synced_clock_time
 * durable-map: recon/catalogs/function_names_app.json
 * callees (readable <= raw @ address):
 *   get_synced_clock_time                    <= FUN_0004a4d0 @ 0x0004a4d0
 *   k_uptime_get_9                           <= FUN_0007d9a4 @ 0x0007d9a4
 * address symbols (name @ address):
 *   g_dashboard_startup_snapshot             @ 0x20004df0
 *   g_sync_baseline_timestamp                @ 0x20004df8
 */
/* Reconstructed FUN_0004a4d0 @ 0x4a4d0  (parity: 300/300 trials, PROVEN) */


void get_synced_clock_time(long long *param_1)
{
  long long lVar1;
  lVar1 = k_uptime_get_9();
  *param_1 = (lVar1 - *(volatile long long *)((unsigned long)&g_sync_baseline_timestamp) /*=0x20004df8*/) + *(volatile long long *)((unsigned long)&g_dashboard_startup_snapshot) /*=0x20004df0*/;
}

/* ---- active_transfer_conn_match.c ---- */
/* readable reconstruction; identity: FUN_000527dc @ 0x000527dc
 * public-name: active_transfer_conn_match
 * durable-map: recon/catalogs/function_names_app.json
 * callees (readable <= raw @ address):
 *   active_transfer_conn_match               <= FUN_000527dc @ 0x000527dc
 * address symbols (name @ address):
 *   g_active_transfer_conn                   @ 0x20005cb0
 */
/* Reconstructed FUN_000527dc @ 0x527dc  (parity: 300/300 trials, PROVEN) */

#include <stdint.h>
int* active_transfer_conn_match(int param_1)
{
  volatile int *p = (volatile int*)((unsigned long)&g_active_transfer_conn) /*=0x20005cb0*/;
  if (*p != param_1) {
    return (int*)0;
  }
  return (int*)p;
}

/* ---- store_gatt_db_hash_setting.c ---- */
/* readable reconstruction; identity: FUN_0005307c @ 0x0005307c
 * public-name: store_gatt_db_hash_setting
 * durable-map: recon/catalogs/function_names_app.json
 * callees (readable <= raw @ address):
 *   bt_settings_store                        <= FUN_00052f18 @ 0x00052f18
 *   store_gatt_db_hash_setting               <= FUN_0005307c @ 0x0005307c
 * address symbols (name @ address):
 *   rodata_f4a01                             @ 0x000f4a01
 */
/* Reconstructed FUN_0005307c @ 0x5307c  (parity: 300/300 trials, PROVEN) */

extern void bt_settings_store(unsigned int, unsigned int, unsigned int, unsigned int, unsigned int, unsigned int, unsigned int);

void store_gatt_db_hash_setting(unsigned int param_1, unsigned int param_2, unsigned int param_3)
{
    bt_settings_store(((unsigned long)&rodata_f4a01) /*=0xf4a01*/, 0, 0, param_1, param_2, param_2, param_3);
}

/* ---- unpair.c ---- */
/* readable reconstruction; identity: FUN_00053380 @ 0x00053380
 * public-name: unpair
 * durable-map: recon/catalogs/function_names_app.json
 * address symbols (name @ address):
 *   g_bt_conn_auth_info_cb_list              @ 0x2000ad20
 */
/* unpair @ 0x00053380; raw FUN_00053380 */

struct auth_node {
    struct auth_node *next;
};

struct auth_listener {
    uint8_t reserved[8];
    void (*bond_deleted)(uint8_t, const void *);
    struct auth_node node;
};

extern uint8_t *bt_conn_lookup_addr_le(uint8_t, const void *); /* FUN_00056e74 */
extern int bt_conn_disconnect(void *, uint8_t); /* FUN_00056a68 */
extern void ble_conn_unref(int); /* FUN_000566a4 */
extern void *bt_keys_find_addr(uint8_t, const void *); /* FUN_0005e938 */
extern void bt_keys_clear(void *); /* FUN_0005ea18 */
extern void bt_gatt_clear(uint8_t, const void *); /* FUN_0005c8d8 */

void unpair(uint8_t identity, const void *address)
{
    void *keys = 0;
    uint8_t *connection = bt_conn_lookup_addr_le(identity, address);

    if (connection) {
        if (connection[2] == 1) {
            keys = *(void **)(connection + 0xc0);
            *(void **)(connection + 0xc0) = 0;
        }
        bt_conn_disconnect(connection, 0x13);
        ble_conn_unref(connection);
    }
    if (!keys) {
        keys = bt_keys_find_addr(identity, address);
    }
    if (keys) {
        bt_keys_clear(keys);
    }

    bt_gatt_clear(identity, address);

    struct auth_node *node = *(struct auth_node **)((unsigned long)&g_bt_conn_auth_info_cb_list) /*=0x2000ad20*/;
    while (node) {
        struct auth_listener *listener =
            (struct auth_listener *)((uint8_t *)node - 12);
        node = node->next;
        if (listener->bond_deleted) {
            listener->bond_deleted(identity, address);
        }
    }
}

/* ---- hci_cmd_alloc_failure_log.c ---- */
/* readable reconstruction; identity: FUN_000534a8 @ 0x000534a8
 * public-name: hci_cmd_alloc_failure_log
 * durable-map: recon/catalogs/function_names_app.json
 * callees (readable <= raw @ address):
 *   hci_cmd_alloc_failure_log                <= FUN_000534a8 @ 0x000534a8
 *   bt_log_forward_3arg                      <= FUN_00080ea2 @ 0x00080ea2
 * address symbols (name @ address):
 *   rodata_88138                             @ 0x00088138
 *   rodata_f2d9d                             @ 0x000f2d9d   [INLINED -- G6 literal batch]
 */
/* Reconstructed FUN_000534a8 @ 0x534a8
 * CFG_VERIFY_CALL_ARITIES=3
 * Readable identity: le_conn_param_neg_reply_alloc_failed_log.
 * Raw/address backmap: FUN_000534a8 @ 0x000534a8.
 */
extern void bt_log_forward_3arg(uint32_t, uint32_t, const void *);
void hci_cmd_alloc_failure_log(void)
{
    const uint32_t package[2] = { 2U, ((unsigned long)"Unable to allocate buffer") /*=0xf2d9d*/ };
    bt_log_forward_3arg(((unsigned long)&rodata_88138) /*=0x88138*/, 0x1040U, package);
}

/* ---- log_unhandled_hci_event.c ---- */
/* readable reconstruction; identity: FUN_00053580 @ 0x00053580
 * public-name: log_unhandled_hci_event
 * durable-map: recon/catalogs/function_names_app.json
 * callees (readable <= raw @ address):
 *   log_unhandled_hci_event                  <= FUN_00053580 @ 0x00053580
 * address symbols (name @ address):
 *   rodata_88138                             @ 0x00088138
 *   rodata_f2df8                             @ 0x000f2df8   [INLINED -- G6 literal batch]
 */
/* Reconstructed FUN_00053580 @ 0x00053580. */
#include "../../../headers/g1_log.h"

extern uint32_t bt_hex(uint32_t value, uint32_t length); /* FUN_00052c98 */
/* FUN_00080ea2 */

struct hci_command_log_record {
    uint32_t argument_count;
    uint32_t format;       /* =0x000f2df8 */
    uint32_t command;
    uint32_t payload_size;
    uint32_t payload_hex;
    uint16_t opcode;
};

void log_unhandled_hci_event(uint32_t command, const uint8_t *packet)
{
    uint16_t payload_size = *(const uint16_t *)(packet + 0x10);
    struct hci_command_log_record record = {
        .argument_count = 0x01000005u,
        .format = ((unsigned long)"Unhandled event 0x%02x len %u: %s") /*=0xf2df8*/,
        .command = command,
        .payload_size = payload_size,
        .payload_hex = bt_hex(*(const uint32_t *)(packet + 0x0c), payload_size),
        .opcode = 0x0402u,
    };

    log_message(((unsigned long)&rodata_88138) /*=0x88138*/, 0x2c80u, &record);
}

/* ================================================================ */
/* member unit: g1_ble_09.c */
/* ================================================================ */
/*
 * Cohesive translation unit for the `ble' module.
 *
 * GENERATED by recon/refactor/transforms/t04_cohesive_tu.py.  Do not
 * edit: a stage tree is regenerated, never hand-patched
 * (recon/refactor/README.md C4).
 *
 * The 5 functions below were 5 separate translation units until this
 * stage.  Each one's text is reproduced VERBATIM and in the order the
 * generated source list gave it, and they were CONSECUTIVE in that list.
 * They were proven able to share a translation unit: no symbol is
 * declared here with two types, no identifier has internal linkage in one
 * member and is named by another, and no local typedef, macro, struct tag
 * or enum constant of one member is visible to a member that names it.
 *
 * members, in link order:
 *   hci_le_generate_dhkey.c
 *   conn_tx_send_to_driver.c
 *   ble_conn_pool_alloc.c
 *   ble_conn_ref.c
 *   ble_conn_unref.c
 */

/* File-scope forward declarations for every struct/union tag this
 * unit names.  Without them a tag whose only appearance in a member
 * is inside a parameter list has PARAMETER-LIST scope, so two
 * textually IDENTICAL declarations in two members declare two
 * different incomplete types and the second is a conflicting
 * redeclaration (C11 6.2.1p7).  Incomplete-type forward
 * declarations emit no code. */
struct k_work;
struct k_work_delayable;
/* ---- hci_le_generate_dhkey.c ---- */
#include "g1_app_symbols.h"
/* readable reconstruction; identity: FUN_00055e74 @ 0x00055e74
 * public-name: hci_le_generate_dhkey
 * durable-map: recon/catalogs/function_names_app.json
 * callees (readable <= raw @ address):
 *   z_log_msg_runtime_create                 <= FUN_0004d944 @ 0x0004d944
 *   bt_hci_cmd_create                        <= FUN_00053cd4 @ 0x00053cd4
 *   bt_hci_cmd_send_sync                     <= FUN_00053d70 @ 0x00053d70
 *   hci_le_generate_dhkey                    <= FUN_00055e74 @ 0x00055e74
 *   net_buf_simple_add                       <= FUN_0005f5d0 @ 0x0005f5d0
 * address symbols (name @ address):
 *   rodata_88120                             @ 0x00088120
 *   rodata_f39f4                             @ 0x000f39f4
 *   g_ble_dev_ncmd_sem                       @ 0x200020d4
 *   g_bt_dh_key_cb                           @ 0x2000ac70
 */
/* Reconstructed FUN_00055e74 @ 0x55e74  (parity: 300/300 trials, PROVEN) */

#include <stdint.h>
extern void z_log_msg_runtime_create(uint32_t,int,void*,int);
extern int bt_hci_cmd_create(int,int);
extern int bt_hci_cmd_send_sync(int,int,int);
extern void* net_buf_simple_add(int,int);

int hci_le_generate_dhkey(uint32_t *param_1, int param_2, uint32_t param_3, uint32_t param_4){
  volatile int *piVar1 = (volatile int*)((unsigned long)&g_bt_dh_key_cb) /*=0x2000ac70*/;
  int iVar2;
  volatile uint32_t *puVar3;
  uint32_t *puVar4, *puVar5;
  volatile uint32_t local_28, local_24, uStack_18;
  volatile int iStack_20;
  if (*(volatile int *)((unsigned long)&g_bt_dh_key_cb) /*=0x2000ac70*/ == param_2) return -0x78;
  if ((*(volatile int *)((unsigned long)&g_bt_dh_key_cb) /*=0x2000ac70*/ == 0) && ((*(volatile int *)((unsigned long)&g_ble_dev_ncmd_sem) /*=0x200020d4*/ << 0x1a) >= 0)){
    if ((*(volatile int *)((unsigned long)&g_ble_dev_ncmd_sem) /*=0x200020d4*/ << 0x1b) >= 0) return -0x7d;
    *(volatile int *)((unsigned long)&g_bt_dh_key_cb) /*=0x2000ac70*/ = param_2;
    uStack_18 = param_4;
    iVar2 = bt_hci_cmd_create(0x2026,0x40);
    if (iVar2 == 0){
      iVar2 = -0x69;
    } else {
      puVar3 = (volatile uint32_t*)net_buf_simple_add(iVar2+0xc,0x40);
      puVar4 = param_1;
      do {
        puVar5 = puVar4 + 1;
        *puVar3 = *puVar4;
        puVar3 = puVar3 + 1;
        puVar4 = puVar5;
      } while (puVar5 != param_1 + 0x10);
      iVar2 = bt_hci_cmd_send_sync(0x2026, iVar2, 0);
      if (iVar2 == 0) return 0;
    }
    *piVar1 = 0;
    local_24 = ((unsigned long)&rodata_f39f4) /*=0xf39f4*/;
    local_28 = 3;
    iStack_20 = iVar2;
    z_log_msg_runtime_create(((unsigned long)&rodata_88120) /*=0x88120*/, 0x1880, (void*)&local_28, 0);
    return iVar2;
  }
  return -0x10;
}

/* ---- conn_tx_send_to_driver.c ---- */
/* readable reconstruction; identity: FUN_000560cc @ 0x000560cc
 * public-name: conn_tx_send_to_driver
 * durable-map: recon/catalogs/function_names_app.json
 * callees (readable <= raw @ address):
 *   bt_hci_driver_send                       <= FUN_000543c8 @ 0x000543c8
 *   net_buf_destroy                          <= FUN_00056080 @ 0x00056080
 *   conn_tx_send_to_driver                   <= FUN_000560cc @ 0x000560cc
 *   net_buf_simple_push                      <= FUN_0005f518 @ 0x0005f518
 *   net_buf_simple_pull_5f558                <= FUN_0005f558 @ 0x0005f558
 *   k_sem_give                               <= FUN_00072880 @ 0x00072880
 *   z_impl_k_sem_take                        <= FUN_00072908 @ 0x00072908
 *   assert_post_action                       <= FUN_0007e2ec @ 0x0007e2ec
 *   printk                                   <= FUN_0007e2fa @ 0x0007e2fa
 *   sys_slist_find_and_remove                <= FUN_0008137e @ 0x0008137e
 *   bt_conn_call_4arg_zero                   <= FUN_000813ca @ 0x000813ca
 *   net_buf_get                              <= FUN_000836e8 @ 0x000836e8
 *   net_buf_simple_tailroom                  <= FUN_00083730 @ 0x00083730
 *   net_buf_simple_add_mem                   <= FUN_00083740 @ 0x00083740
 * address symbols (name @ address):
 *   g_ble_dev_state                          @ 0x20002000
 */
/* Reconstructed FUN_000560cc @ 0x560cc  (parity: 300/300 trials, PROVEN) */
#include "../../../headers/g1_log.h"
#include "../../../headers/g1_dedupe.h"
extern unsigned long bt_hci_driver_send(void);
extern void net_buf_destroy(void);
extern int net_buf_simple_push(void);
extern void net_buf_simple_pull_5f558(void);
extern void k_sem_give(void);
extern int z_impl_k_sem_take(void);
extern void assert_post_action(const char *, unsigned int);
extern void sys_slist_find_and_remove(void);
extern void bt_conn_call_4arg_zero(void);
extern int net_buf_simple_tailroom(void);
extern void net_buf_simple_add_mem(void);
extern int net_buf_get(void);

#define S16(a) (*(volatile int16_t *)(a))
#define U16(a) (*(volatile uint16_t *)(a))
#define U32(a) (*(volatile uint32_t *)(a))
#define I32(a) (*(volatile int32_t *)(a))

unsigned conn_tx_send_to_driver(int param_1, int param_2, int param_3, unsigned param_4)
{
    int iVar2 = ((unsigned long)&g_ble_dev_state) /*=0x20002000*/;
    int iVar4;
    unsigned uVar8;
    int puVar9;
    int unaff_r10 = 0;

    iVar4 = (U16(iVar2 + 0x104) == 0) ? 0 : (iVar2 + 0x108);
    (void)iVar4;
    if (z_impl_k_sem_take() != 0) {
        return 0xffffff97;
    }
    if (param_3 == 0) {
        param_3 = net_buf_get();
    } else {
        unsigned local_2c = U16(iVar2 + 0x104);
        int iVar4b = param_3 + 0xc;
        unsigned uVar5 = (unsigned)net_buf_simple_tailroom();
        uint16_t uVar3;
        if (uVar5 <= local_2c) {
            uVar3 = (uint16_t)net_buf_simple_tailroom();
        } else {
            uVar3 = U16(iVar2 + 0x104);
        }
        (void)uVar3;
        net_buf_simple_add_mem();
        net_buf_simple_pull_5f558();
    }
    puVar9 = (int)U32(param_3 + 0x18);
    if (*(volatile int8_t *)(param_1 + 0xd) == 7) {
        if (puVar9 == 0) {
            int v = (int)U32(param_1 + 0x18);
            int iVar4c;
            if (v == 0) {
                unaff_r10 = param_1 + 0x1c;
                iVar4c = I32(param_1 + 0x1c);
            } else {
                unaff_r10 = v + 0xc;
                iVar4c = I32(v + 0xc);
            }
            I32(unaff_r10) = iVar4c + 1;
        } else {
            U32(puVar9) = 0;
            if (U32(param_1 + 0x18) == 0) {
                U32(param_1 + 0x14) = (uint32_t)puVar9;
                U32(param_1 + 0x18) = (uint32_t)puVar9;
            } else {
                U32(U32(param_1 + 0x18)) = (uint32_t)puVar9;
                U32(param_1 + 0x18) = (uint32_t)puVar9;
            }
        }
        int puVar6 = net_buf_simple_push();
        U16(puVar6) = (uint16_t)(U16(param_1) | ((param_4 & 0xfd) << 0xc));
        U16(puVar6 + 2) = (uint16_t)(S16(param_3 + 0x10) - 4);
        *(volatile uint8_t *)(param_3 + 0x18) = 2;
        if (bt_hci_driver_send() == 0) {
            return 0;
        }
        bt_conn_call_4arg_zero();
        if (puVar9 == 0) {
            if (I32(unaff_r10) == 0) {
                G1_ASSERT_FAIL((((unsigned long)"ASSERTION FAIL [%s] @ %s:%d\n"), ((unsigned long)"*pending_no_cb > 0"), ((unsigned long)"WEST_TOPDIR/zephyr/subsys/bluetooth/host/conn.c"), 627), (((unsigned long)"WEST_TOPDIR/zephyr/subsys/bluetooth/host/conn.c"), 627));
            }
            I32(unaff_r10) = I32(unaff_r10) - 1;
        } else {
            sys_slist_find_and_remove();
        }
        uVar8 = 0xfffffffb;
    } else {
        uVar8 = 0xffffff80;
    }
    k_sem_give();
    if (puVar9 != 0) {
        U32(param_3 + 0x18) = 0;
        net_buf_destroy();
    }
    return uVar8;
}

/* ---- ble_conn_pool_alloc.c ---- */
/* readable reconstruction; identity: FUN_000562a4 @ 0x000562a4
 * public-name: ble_conn_pool_alloc
 * durable-map: recon/catalogs/function_names_app.json
 * callees (readable <= raw @ address):
 *   ble_conn_pool_alloc                      <= FUN_000562a4 @ 0x000562a4
 *   k_work_init                              <= FUN_00072e50 @ 0x00072e50
 *   k_work_init_delayable                    <= FUN_000732d4 @ 0x000732d4
 *   memset_bytes                             <= FUN_00086c78 @ 0x00086c78
 * address symbols (name @ address):
 *   ADDR_ble_conn_process_complete_or_disconnect_THUMB @ 0x000570a1
 *   rodata_813d1                             @ 0x000813d1
 */
/* Reconstructed FUN_000562a4 @ 0x562a4  (parity: 300/300 trials, PROVEN) */
extern void k_work_init(struct k_work *, void (*)(struct k_work *));
extern void k_work_init_delayable(struct k_work_delayable *, void (*)(struct k_work *));
extern void memset_bytes(void*, int, int);
int ble_conn_pool_alloc(int param_1, int param_2, int param_3, int param_4){
  int iVar1 = 0;
  volatile int *piVar2;
  while(1){
    if(iVar1==param_2) return 0;
    piVar2 = (volatile int*)(param_1+0xd0);
    int expected = 0;
    if (__atomic_compare_exchange_n(piVar2, &expected, 1, 0,
                                    __ATOMIC_ACQUIRE, __ATOMIC_RELAXED))
      break;
    param_1 += 0xd8;
    iVar1 += 1;
  }
  if(param_1==0) return 0;
  memset_bytes((void *)param_1,0,0xd0);
  k_work_init_delayable(param_1+0x60, ADDR_ble_conn_process_complete_or_disconnect_THUMB /*=0x570a1*/);
  k_work_init(param_1+0x28, ((unsigned long)&rodata_813d1) /*=0x813d1*/);
  return param_1;
}

/* ---- ble_conn_ref.c ---- */
/* readable reconstruction; identity: FUN_00056654 @ 0x00056654
 * public-name: ble_conn_ref
 * durable-map: recon/catalogs/function_names_app.json
 * callees (readable <= raw @ address):
 *   ble_conn_ref                             <= FUN_00056654 @ 0x00056654
 *   assert_post_action                       <= FUN_0007e2ec @ 0x0007e2ec
 *   printk                                   <= FUN_0007e2fa @ 0x0007e2fa
 * address symbols (name @ address):
 *   rodata_99cbd                             @ 0x00099cbd   [INLINED -- G6 literal batch]
 *   rodata_f3a5d                             @ 0x000f3a5d
 *   rodata_f3ebd                             @ 0x000f3ebd
 */
/* Reconstructed FUN_00056654 @ 0x56654  (parity: 300/300 trials, PROVEN) */


int ble_conn_ref(int param_1)
{
    int *counter;
    int old_value;
    if (param_1 == 0) {
        G1_ASSERT_FAIL((((unsigned long)"ASSERTION FAIL [%s] @ %s:%d\n") /*=0x99cbd*/, ((unsigned long)&rodata_f3ebd) /*=0xf3ebd*/, ((unsigned long)&rodata_f3a5d) /*=0xf3a5d*/, 0x509), (((unsigned long)&rodata_f3a5d) /*=0xf3a5d*/, 0x509));
        return 0x509;
    }
    counter = (int *)(param_1 + 0xd0);
    for (;;) {
        old_value = __atomic_load_n(counter, __ATOMIC_ACQUIRE);
        if (old_value == 0)
            return 0;
        {
            int expected = old_value;
            if (__atomic_compare_exchange_n(counter, &expected, old_value + 1,
                                            1, __ATOMIC_ACQ_REL,
                                            __ATOMIC_ACQUIRE))
                return param_1;
        }
    }
}

/* ---- ble_conn_unref.c ---- */
/* readable reconstruction; identity: FUN_000566a4 @ 0x000566a4
 * public-name: ble_conn_unref
 * durable-map: recon/catalogs/function_names_app.json
 * callees (readable <= raw @ address):
 *   legacy_advertising_connection_restart    <= FUN_00055aac @ 0x00055aac
 *   ble_conn_unref                           <= FUN_000566a4 @ 0x000566a4
 *   assert_post_action                       <= FUN_0007e2ec @ 0x0007e2ec
 *   printk                                   <= FUN_0007e2fa @ 0x0007e2fa
 * address symbols (name @ address):
 *   rodata_99cbd                             @ 0x00099cbd   [INLINED -- G6 literal batch]
 *   rodata_f3a5d                             @ 0x000f3a5d
 *   rodata_f3c07                             @ 0x000f3c07   [INLINED -- G6 literal batch]
 *   rodata_f3c0f                             @ 0x000f3c0f   [INLINED -- G6 literal batch]
 */
/* Reconstructed FUN_000566a4 @ 0x566a4  true code extent: 0x50 bytes */

extern void legacy_advertising_connection_restart(void *object);

void ble_conn_unref(int object) {
    uint32_t *references = (uint32_t *)(object + 0xd0);
    uint32_t previous = __atomic_fetch_sub(references, 1, __ATOMIC_ACQ_REL);

    if ((int32_t)previous <= 0) {
        printk(((unsigned long)"ASSERTION FAIL [%s] @ %s:%d\n") /*=0x99cbd*/, ((unsigned long)"old > 0") /*=0xf3c07*/, ((unsigned long)&rodata_f3a5d) /*=0xf3a5d*/, 0x525);
        G1_ASSERT_FAIL((((unsigned long)"\tConn reference counter is 0\n") /*=0xf3c0f*/), (((unsigned long)&rodata_f3a5d) /*=0xf3a5d*/, 0x525));
    }

    if (*(volatile uint16_t *)(object + 2) == 0x101 &&
        __atomic_load_n(references, __ATOMIC_ACQUIRE) == 0)
        legacy_advertising_connection_restart(object);
}

