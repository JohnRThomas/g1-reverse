/*
 * Call-cohesive translation unit for the `sensors/input' module.
 *
 * GENERATED by recon/refactor/transforms/t09_call_cohesion.py.  Do
 * not edit: a stage tree is regenerated, never hand-patched
 * (recon/refactor/README.md C4).
 *
 * The 2 translation units below were grouped because they CALL ONE
 * ANOTHER, not because they were adjacent in the generated source
 * list.  Each member's text is reproduced VERBATIM.  Every member was
 * checked pairwise against every other member already in this unit by
 * stage 04's seven refusal rules, unchanged: no symbol is declared
 * here with two types, no identifier has internal linkage in one
 * member and is named by another, and no local typedef, macro, struct
 * tag or enum constant of one member is visible to a member that
 * names it.
 *
 * members, in generated-source-list order:
 *   g1_sensors_input_03.c
 *   update_touch_key_flag.c
 *
 * call edges inside this unit (caller -> callee): 1
 *   update_touch_key_flag.c -> g1_sensors_input_03.c
 */
/* ================================================================ */
/* member unit: g1_sensors_input_03.c */
/* ================================================================ */
/*
 * Cohesive translation unit for the `sensors/input' module.
 *
 * GENERATED by recon/refactor/transforms/t04_cohesive_tu.py.  Do not
 * edit: a stage tree is regenerated, never hand-patched
 * (recon/refactor/README.md C4).
 *
 * The 5 functions below were 5 separate translation units until this
 * stage.  Each one's text is reproduced VERBATIM and in the order the
 * generated source list gave it, and they were CONSECUTIVE in that list.
 * They were proven able to share a translation unit: no symbol is
 * declared here with two types, no identifier has internal linkage in one
 * member and is named by another, and no local typedef, macro, struct tag
 * or enum constant of one member is visible to a member that names it.
 *
 * members, in link order:
 *   trigger_touch_key_hw_reset.c
 *   touch_key_thread.c
 *   check_sw0_status.c
 *   wait_touch_key_release_or_timeout.c
 *   get_message_type_param.c
 */
/* ---- trigger_touch_key_hw_reset.c ---- */
#include "g1_app_symbols.h"
/* readable reconstruction; identity: FUN_0002a0c0 @ 0x0002a0c0
 * public-name: trigger_touch_key_hw_reset
 * durable-map: recon/catalogs/function_names_app.json
 * callees (readable <= raw @ address):
 *   trigger_touch_key_hw_reset               <= FUN_0002a0c0 @ 0x0002a0c0
 * address symbols (name @ address):
 *   g_some_module_sem                        @ 0x20007b1c
 *   g_some_module_init_done_flag             @ 0x20018d8a
 */
/* Reconstructed FUN_0002a0c0 @ 0x2a0c0  (parity: 300/300 trials, PROVEN) */

#include <stdint.h>
#include "../../../../headers/g1_log.h"
#include "../../../../headers/g1_dedupe.h"
#include "g1_input.h"
extern unsigned long process_sync_buffer(unsigned int, ...);
static void trigger_touch_key_hw_reset(void)
{
  if (*(volatile uint8_t *)((unsigned long)&g_some_module_init_done_flag) /*=0x20018d8a*/ != 0) {
    process_sync_buffer(((unsigned long)&g_some_module_sem) /*=0x20007b1c*/);
    return;
  }
  return;
}

/* ---- touch_key_thread.c ---- */
/* readable reconstruction; identity: FUN_0002a0d8 @ 0x0002a0d8
 * public-name: touch_key_thread
 * durable-map: recon/catalogs/function_names_app.json
 * address symbols (name @ address):
 *   rodata_a15d6                             @ 0x000a15d6   [INLINED -- G6 literal batch]
 *   rodata_a1626                             @ 0x000a1626   [INLINED -- G6 literal batch]
 *   rodata_a1681                             @ 0x000a1681   [INLINED -- G6 literal batch]
 *   rodata_a172a                             @ 0x000a172a   [INLINED -- G6 literal batch]
 *   rodata_a1a76                             @ 0x000a1a76   [INLINED -- G6 literal batch]
 *   g_log_level                              @ 0x2000230c
 *   g_touch_key_irq_pending                  @ 0x20006a00
 *   g_log_use_alt_sink                       @ 0x20007554
 *   g_touch_key_reset_reason                 @ 0x20007b18
 *   g_touch_key_press_active                 @ 0x20018d89
 *   g_touch_key_irq_line_status              @ 0x20019dac
 */
/* Reconstructed touch_key_thread @ 0x0002a0d8.
 * Back-map: FUN_0002a0d8.  Executable extent [0x0002a0d8,0x0002a4a0)
 * includes the internal switch/literal islands; 0x0002a4a0 begins the
 * trailing literal pool.
 */

/* FUN_0007dda4 */
extern int get_device_info(void);                        /* FUN_000167a8 */
/* FUN_00019c70 */
static void trigger_touch_key_hw_reset(void);                  /* FUN_0002a0c0 */
extern void handle_touch_key_irq(void);                        /* FUN_00030af0 */
extern int32_t k_msleep(int32_t);                    /* FUN_0007cb8e */
extern int32_t get_uptime_ms(void);                            /* FUN_00086690 */
extern int k_sem_take(void *semaphore, int64_t timeout);       /* FUN_0007cb48 */
extern void reset_all_usr_data(unsigned char *, int);  /* FUN_0002316c */
extern int send_touch_click_event(unsigned long);             /* FUN_0007c058 */
extern void touch_pmic_reset_assert(void);                     /* FUN_00017a28 */
extern void touch_pmic_reset_deassert(void);                   /* FUN_00017a34 */

#define TOUCH_IRQ_PENDING \
    (*(volatile int32_t *)((unsigned long)&g_touch_key_irq_pending) /*=0x20006a00*/) /* g_touch_key_irq_pending */
#define TOUCH_IRQ_LINE_STATUS \
    (*(volatile uint8_t *)((unsigned long)&g_touch_key_irq_line_status) /*=0x20019dac*/) /* g_touch_key_irq_line_status */
#define TOUCH_PRESS_ACTIVE \
    (*(volatile uint8_t *)((unsigned long)&g_touch_key_press_active) /*=0x20018d89*/) /* g_touch_key_press_active */
#define TOUCH_RESET_REASON \
    (*(volatile int32_t *)((unsigned long)&g_touch_key_reset_reason) /*=0x20007b18*/) /* g_touch_key_reset_reason */
#define LOG_LEVEL (*(volatile int32_t *)((unsigned long)&g_log_level) /*=0x2000230c*/)
#define LOG_ALTERNATE_SINK (*(volatile int32_t *)((unsigned long)&g_log_use_alt_sink) /*=0x20007554*/)

void touch_key_thread(char *context)
{
  volatile int32_t *log_level_ptr;
  volatile int32_t *alternate_sink_ptr;
  int32_t event_time;
  int32_t now;
  int32_t since_release;
  uint32_t format_string;
  uint32_t reset_reason;
  int32_t click_count;
  int32_t event_count;
  int32_t release_time;
  int32_t long_press_armed;
  int32_t press_time;
  int32_t short_stuck_timeout;
  int32_t held_time;
  uint8_t irq_line_status;

  /* Persistent loop state: long-press arm, release time, click count,
   * previous press time, and the shortened stuck-key timeout selector. */
  long_press_armed = 0;
  release_time = 0;
  click_count = 0;
  press_time = 0;
  short_stuck_timeout = 0;
event_loop:
  do {
    while ((k_sem_take(context + 0xb0, 0x2000), *(char *)(context + 1) == '\x01' ||
            ((event_time = (int32_t)get_device_info(), *(char *)(event_time + 1) == '\b')))) {
      k_msleep(5000);
    }
    if (TOUCH_IRQ_PENDING != 0) {
      handle_touch_key_irq();
      TOUCH_IRQ_PENDING = 0;
    }
  } while (-1 < (int32_t)((uint32_t)*(uint16_t *)(context + 0x105c) << 0x1f));
  irq_line_status = TOUCH_IRQ_LINE_STATUS;
  if (irq_line_status == 1) {
    event_time = get_uptime_ms();
    read_rtc_counter_ms(context + 0x1078);
    if (10000 < event_time - press_time) {
      release_time = 0;
      click_count = release_time;
    }
    event_count = click_count + 1;
    TOUCH_IRQ_LINE_STATUS = 0;
  }
  else {
    event_count = click_count;
    event_time = press_time;
    if (irq_line_status == 2) {
      release_time = get_uptime_ms();
      TOUCH_IRQ_LINE_STATUS = 0;
      TOUCH_PRESS_ACTIVE = 0;
    }
  }
  now = get_uptime_ms();
  since_release = get_uptime_ms();
  alternate_sink_ptr = &LOG_ALTERNATE_SINK;
  log_level_ptr = &LOG_LEVEL;
  since_release = since_release - release_time;
  held_time = release_time - event_time;
  click_count = event_count;
  press_time = event_time;
  if (event_count != 1) goto check_multi_click;
  now = now - event_time;
  if (long_press_armed != 0) {
    if (release_time == 0) {
check_stuck_key:
      if (short_stuck_timeout == 0) {
        click_count = 0x23;
      }
      else {
        click_count = 3;
      }
      if (click_count * 30000 < now) {
        if (0 < *log_level_ptr) {
          G1_LOG_ROUTE(*alternate_sink_ptr == 0, ((unsigned long)"%s(): #############################Long press timeout %d################################\n\n") /*=0xa1626*/, ((unsigned long)"touch_key_thread") /*=0xa1a76*/, short_stuck_timeout);
        }
        long_press_armed = 0;
        TOUCH_RESET_REASON = 6;
        trigger_touch_key_hw_reset();
        click_count = 0;
        short_stuck_timeout = long_press_armed;
        goto event_loop;
      }
      if (event_time < 0) goto check_completed_press;
    }
    else {
      click_count = long_press_armed;
      if (release_time <= event_time) goto event_loop;
check_completed_press:
      if (10000 < since_release) {
        if (15000 < held_time) {
          long_press_armed = 1;
          goto check_long_hold;
        }
        goto emit_single_click;
      }
    }
    long_press_armed = 1;
    click_count = event_count;
    goto event_loop;
  }
  if (release_time == 0) {
    read_rtc_counter_ms(context + 0x1078);
    if (((int32_t)0xffffb1e1 <= *(int32_t *)(context + 0x1078)) &&
        (*(int32_t *)(context + 0x1078) < 20000)) {
      click_count = 0;
      goto event_loop;
    }
    if (15000 < now) {
      if (0 < *log_level_ptr) {
        G1_LOG_ROUTE(*alternate_sink_ptr == 0, ((unsigned long)"%s(): ########################turn on the mic and start to speak! holdtime %d\n\n") /*=0xa15d6*/, ((unsigned long)"touch_key_thread") /*=0xa1a76*/, now);
      }
      TOUCH_RESET_REASON = 4;
      trigger_touch_key_hw_reset();
      goto check_stuck_key;
    }
    if (-1 < event_time) {
      long_press_armed = 0;
      goto event_loop;
    }
  }
  else if (release_time <= event_time) goto event_loop;
  if (10000 < since_release) {
    if (15000 < held_time) goto check_long_hold;
emit_single_click:
    if (0 < *log_level_ptr) {
      if (*alternate_sink_ptr == 0) {
        log_message(((unsigned long)"%s(): #############################single click %d################################\n\n") /*=0xa172a*/, ((unsigned long)"touch_key_thread") /*=0xa1a76*/, *(uint32_t *)(context + 0x1078));
      }
      else {
        debug_print(0,0,0);
      }
    }
    reset_reason = 1;
    goto publish_reset_reason;
  }
  goto event_loop;
check_multi_click:
  if (((event_count == 0) || (release_time <= event_time)) || (since_release < 0x2711)) goto event_loop;
  if (15000 < held_time) {
check_long_hold:
    if (held_time <= (int32_t)0x11940) {
      if (0 < *log_level_ptr) {
        G1_LOG_ROUTE(*alternate_sink_ptr == 0, 0,0,0);
      }
      release_time = 0;
      click_count = event_count;
      short_stuck_timeout = 1;
      goto event_loop;
    }
    if (0 < *log_level_ptr) {
      G1_LOG_ROUTE(*alternate_sink_ptr == 0, ((unsigned long)"%s(): #############################Long press end################################\n\n") /*=0xa1681*/, ((unsigned long)"touch_key_thread") /*=0xa1a76*/);
    }
    reset_reason = 5;
    goto publish_reset_reason;
  }
  switch (event_count) {
  case 2:
    if (0 < *log_level_ptr) {
      if (*alternate_sink_ptr == 0) {
        log_message(0xa177f, ((unsigned long)"touch_key_thread") /*=0xa1a76*/);
      }
      else {
        debug_print(0,0,0);
      }
    }
    reset_reason = 2;
    goto publish_reset_reason;
  case 3:
    if (0 < *log_level_ptr) {
      if (*alternate_sink_ptr == 0) {
        log_message(0xa17d1, ((unsigned long)"touch_key_thread") /*=0xa1a76*/);
      }
      else {
        debug_print(0,0,0);
      }
    }
    reset_reason = 3;
publish_reset_reason:
    TOUCH_RESET_REASON = reset_reason;
    trigger_touch_key_hw_reset();
    break;
  case 5:
    goto five_click_reboot;
  case 10:
    reset_all_usr_data(context, 1);
    break;
  case 0xf:
    send_touch_click_event(10);
    if (0 < LOG_LEVEL) {
      if (LOG_ALTERNATE_SINK == 0) {
        log_message(0xa1823, ((unsigned long)"touch_key_thread") /*=0xa1a76*/, 0xf);
      }
      else {
        debug_print(0,0,0);
      }
    }
  }
  long_press_armed = 0;
  click_count = long_press_armed;
  goto event_loop;
five_click_reboot:
  if (0 < LOG_LEVEL) {
    format_string = 0xa184b;
    if (LOG_ALTERNATE_SINK == 0) goto log_directly;
    debug_print(0xa184b, ((unsigned long)"touch_key_thread") /*=0xa1a76*/, 5);
  }
  do {
    touch_pmic_reset_assert();
    if (0 < LOG_LEVEL) {
      if (LOG_ALTERNATE_SINK == 0) {
        log_message(0xa1868, ((unsigned long)"touch_key_thread") /*=0xa1a76*/);
      }
      else {
        debug_print(0,0,0);
      }
    }
    touch_pmic_reset_deassert();
    if (0 < LOG_LEVEL) {
      if (LOG_ALTERNATE_SINK == 0) {
        log_message(0xa187e, ((unsigned long)"touch_key_thread") /*=0xa1a76*/);
      }
      else {
        debug_print(0,0,0);
      }
      if (0 < LOG_LEVEL) {
        if (LOG_ALTERNATE_SINK == 0) {
          log_message(0xa0c6c, ((unsigned long)"touch_key_thread") /*=0xa1a76*/, 5);
        }
        else {
          debug_print(0,0,0);
        }
      }
    }
    k_msleep(500);
    format_string = sys_reboot(1);
log_directly:
    log_message(format_string);
  } while (1);
}

/* ---- check_sw0_status.c ---- */
/* readable reconstruction; identity: FUN_0002a868 @ 0x0002a868
 * public-name: check_sw0_status
 * durable-map: recon/catalogs/function_names_app.json
 * callees (readable <= raw @ address):
 *   read_sw0_pin                             <= FUN_00017e30 @ 0x00017e30
 *   debug_print                              <= FUN_00019c70 @ 0x00019c70
 *   pt_nfc_eeprom_link_start                 <= FUN_00030c90 @ 0x00030c90
 * address symbols (name @ address):
 *   rodata_a18cd                             @ 0x000a18cd   [INLINED -- G6 literal batch]
 *   rodata_a18ea                             @ 0x000a18ea   [INLINED -- G6 literal batch]
 *   rodata_a19af                             @ 0x000a19af   [INLINED -- G6 literal batch]
 *   g_log_level                              @ 0x2000230c
 *   g_log_use_alt_sink                       @ 0x20007554
 *   g_sw0_irq_low_cnt                        @ 0x20007af0
 */
/* Reconstructed check_sw0_status @ 0x2a868  (parity: 300/300 trials, PROVEN) */

extern int read_sw0_pin(void);
extern void pt_nfc_eeprom_link_start(void);

void check_sw0_status(void)
{
    int iVar3 = read_sw0_pin();
    volatile int *piVar2 = (volatile int *)((unsigned long)&g_log_level) /*=0x2000230c*/;
    volatile int *piVar1 = (volatile int *)((unsigned long)&g_sw0_irq_low_cnt) /*=0x20007af0*/;

    if (iVar3 == 0) {
        if (*piVar2 > 1) {
            G1_LOG_ROUTE(*(volatile int *)((unsigned long)&g_log_use_alt_sink) /*=0x20007554*/ == 0, ((unsigned long)"%s(): interrupt line low!!!\n") /*=0xa18cd*/, ((unsigned long)"check_sw0_status") /*=0xa19af*/);
        }
        iVar3 = *piVar1 + 1;
        *piVar1 = iVar3;
        if (iVar3 > 3) {
            if (*piVar2 > 1) {
                G1_LOG_ROUTE(*(volatile int *)((unsigned long)&g_log_use_alt_sink) /*=0x20007554*/ == 0, ((unsigned long)"%s(): interrupt line abnormal, now reset\n") /*=0xa18ea*/, ((unsigned long)"check_sw0_status") /*=0xa19af*/);
            }
            pt_nfc_eeprom_link_start();
            return;
        }
    } else {
        *piVar1 = 0;
    }
    return;
}

/* ---- wait_touch_key_release_or_timeout.c ---- */
/* readable reconstruction; identity: FUN_0002c2b0 @ 0x0002c2b0
 * public-name: wait_touch_key_release_or_timeout
 * durable-map: recon/catalogs/function_names_app.json
 * callees (readable <= raw @ address):
 *   get_device_info                          <= FUN_000167a8 @ 0x000167a8
 *   debug_print                              <= FUN_00019c70 @ 0x00019c70
 *   sync_message_signal_to_slave             <= FUN_0002c224 @ 0x0002c224
 *   wait_touch_key_release_or_timeout        <= FUN_0002c2b0 @ 0x0002c2b0
 *   msg_count_dec                            <= FUN_00034274 @ 0x00034274
 *   get_message_pending_state                <= FUN_00034410 @ 0x00034410
 *   set_message_pending_state                <= FUN_0003443c @ 0x0003443c
 *   is_msg_expiration                        <= FUN_0003444c @ 0x0003444c
 * address symbols (name @ address):
 *   rodata_a26cb                             @ 0x000a26cb   [INLINED -- G6 literal batch]
 *   g_log_use_alt_sink                       @ 0x20007554
 */
/* Reconstructed FUN_0002c2b0 @ 0x2c2b0  (parity: 300/300 trials, PROVEN) */
extern int is_msg_expiration(void);
extern int sync_message_signal_to_slave(int);
extern void set_message_pending_state(int);
void wait_touch_key_release_or_timeout(void){
  volatile int *piVar1 = (volatile int*)((unsigned long)&g_log_use_alt_sink) /*=0x20007554*/;
  while(get_message_pending_state()==5 && is_msg_expiration()==2){
    G1_LOG_ROUTE(*piVar1==0, ((unsigned long)"[csh_debug_msg] check showing msg timeout \n") /*=0xa26cb*/);
    int iVar2 = sync_message_signal_to_slave(2);
    if(iVar2 <= 3000){
      msg_count_dec();
      int r = get_device_info();
      if(*(volatile uint8_t *)(r+0xdd)==0){
        set_message_pending_state(0);
        return;
      }
      set_message_pending_state(6);
    }
  }
}

/* ---- get_message_type_param.c ---- */
/* readable reconstruction; identity: FUN_0002c30c @ 0x0002c30c
 * public-name: get_message_type_param
 * durable-map: recon/catalogs/function_names_app.json
 * callees (readable <= raw @ address):
 *   get_message_type_param                   <= FUN_0002c30c @ 0x0002c30c
 */
/* Reconstructed FUN_0002c30c @ 0x2c30c  (parity: 300/300 trials, PROVEN) */

unsigned int get_message_type_param(int param_1,unsigned int param_2)
{
  if (param_1 != 0xb) {
    if (param_1 == 0xc) {
      param_2 = 1;
    }
    return param_2;
  }
  return 0x01e13380UL;
}

/* ================================================================ */
/* member unit: update_touch_key_flag.c */
/* ================================================================ */
#include "g1_app_symbols.h"
#include "../../../../headers/g1_log.h"
#include "g1_input.h"
/* readable reconstruction; identity: FUN_0002c324 @ 0x0002c324
 * public-name: update_touch_key_flag
 * durable-map: recon/catalogs/function_names_app.json
 * callees (readable <= raw @ address):
 *   get_device_info                          <= FUN_000167a8 @ 0x000167a8
 *   debug_print                              <= FUN_00019c70 @ 0x00019c70
 *   trigger_screen_state_change              <= FUN_0002bc2c @ 0x0002bc2c
 *   get_message_type_param                   <= FUN_0002c30c @ 0x0002c30c
 *   update_touch_key_flag                    <= FUN_0002c324 @ 0x0002c324
 *   clear_timeout_message                    <= FUN_00033d58 @ 0x00033d58
 *   msg_count_dec                            <= FUN_00034274 @ 0x00034274
 *   push_message_3439c                       <= FUN_0003439c @ 0x0003439c
 *   get_message_pending_state                <= FUN_00034410 @ 0x00034410
 *   set_message_pending_state                <= FUN_0003443c @ 0x0003443c
 *   k_uptime_get_2                           <= FUN_0007ce40 @ 0x0007ce40
 * address symbols (name @ address):
 *   rodata_a26f7                             @ 0x000a26f7   [INLINED -- G6 literal batch]
 *   rodata_a2733                             @ 0x000a2733
 *   g_log_use_alt_sink                       @ 0x20007554
 *   g_pending_message_flag                   @ 0x20018d9e
 */
/* Reconstructed FUN_0002c324 @ 0x2c324  (parity: 300/300 trials, PROVEN) */

extern int get_device_info(void);
extern void trigger_screen_state_change(unsigned a, int b, int c);
extern unsigned int get_message_type_param(int, unsigned int);
extern void clear_timeout_message(int);
extern void push_message_3439c(void);
extern void set_message_pending_state(int a);
extern void k_uptime_get_2(void);
void update_touch_key_flag(void){
    k_uptime_get_2();
    if (*(volatile int *)((unsigned long)&g_log_use_alt_sink) /*=0x20007554*/ == 0){
        unsigned u = get_message_pending_state();
        log_message(((unsigned long)"[csh_debug_msg] set touch key flag get_msg_show_state() %d\n") /*=0xa26f7*/, u);
    } else {
        unsigned u = get_message_pending_state();
        debug_print(((unsigned long)"[csh_debug_msg] set touch key flag get_msg_show_state() %d\n") /*=0xa26f7*/, u);
    }
    int iVar3 = get_message_pending_state();
    if (iVar3 == 2 || get_message_pending_state() == 4){
        msg_count_dec();
        int t = get_device_info();
        unsigned uVar1 = get_message_type_param(*(volatile unsigned char *)(t + 0xfea), 0xf);
        t = get_device_info();
        *(volatile unsigned char *)(t + 0xdb) = (unsigned char)uVar1;
    }
    int t = get_device_info();
    unsigned char dd = *(volatile unsigned char *)(t + 0xdd);
    if (dd != 0){
        clear_timeout_message(1);
        push_message_3439c();
        *(volatile unsigned char *)((unsigned long)&g_pending_message_flag) /*=0x20018d9e*/ = 1;
        return;
    }
    set_message_pending_state(0);
    t = get_device_info();
    if (*(volatile unsigned char *)(t + 0xd5) == 1) return;
    t = get_device_info();
    if (*(volatile unsigned char *)(t + 0xee4) != 2) return;
    t = get_device_info();
    *(volatile unsigned char *)(t + 0xdb) = 0;
    t = get_device_info();
    trigger_screen_state_change(((unsigned long)&rodata_a2733) /*=0xa2733*/, t, 1);
    return;
}

