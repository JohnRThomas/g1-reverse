/*
 * Cohesive translation unit for the `sensors/power' module.
 *
 * GENERATED by recon/refactor/transforms/t04_cohesive_tu.py.  Do not
 * edit: a stage tree is regenerated, never hand-patched
 * (recon/refactor/README.md C4).
 *
 * The 7 functions below were 7 separate translation units until this
 * stage.  Each one's text is reproduced VERBATIM and in the order the
 * generated source list gave it, and they were CONSECUTIVE in that list.
 * They were proven able to share a translation unit: no symbol is
 * declared here with two types, no identifier has internal linkage in one
 * member and is named by another, and no local typedef, macro, struct tag
 * or enum constant of one member is visible to a member that names it.
 *
 * members, in link order:
 *   consume_pending_event_and_refresh_flag.c
 *   opt3001_chip_init.c
 *   lock_device_mutex.c
 *   unlock_device_mutex.c
 *   set_shutdown_flag.c
 *   sensor_channel_get_trampoline.c
 *   product_code_is_supported_egp_family.c
 */

/* File-scope forward declarations for every struct/union tag this
 * unit names.  Without them a tag whose only appearance in a member
 * is inside a parameter list has PARAMETER-LIST scope, so two
 * textually IDENTICAL declarations in two members declare two
 * different incomplete types and the second is a conflicting
 * redeclaration (C11 6.2.1p7).  Incomplete-type forward
 * declarations emit no code. */
struct device;
/* ---- consume_pending_event_and_refresh_flag.c ---- */
#include "g1_app_symbols.h"
#include "g1_power.h"
/* readable reconstruction; identity: FUN_0003b800 @ 0x0003b800
 * public-name: consume_pending_event_and_refresh_flag
 * durable-map: recon/catalogs/function_names_app.json
 * callees (readable <= raw @ address):
 *   mark_master_or_low_battery_flag          <= FUN_0002efc0 @ 0x0002efc0
 *   stopAudioStreamRecord                    <= FUN_0002f80c @ 0x0002f80c
 *   consume_pending_event_and_refresh_flag   <= FUN_0003b800 @ 0x0003b800
 * address symbols (name @ address):
 *   g_pending_event_word                     @ 0x20007b78
 */
/* Reconstructed FUN_0003b800 @ 0x3b800  (parity: 300/300 trials, PROVEN) */

extern void stopAudioStreamRecord(unsigned int, unsigned int);

void consume_pending_event_and_refresh_flag(void)
{
  unsigned int uVar1;

  uVar1 = __atomic_exchange_n((unsigned int*)((unsigned long)&g_pending_event_word) /*=0x20007b78*/, 0,
                              __ATOMIC_SEQ_CST);
  stopAudioStreamRecord(0,uVar1);
  mark_master_or_low_battery_flag();
  return;
}

/* ---- opt3001_chip_init.c ---- */
/* readable reconstruction; identity: FUN_00062930 @ 0x00062930
 * public-name: opt3001_chip_init
 * durable-map: recon/catalogs/function_names_app.json
 * callees (readable <= raw @ address):
 *   z_log_msg_runtime_create                 <= FUN_0004d944 @ 0x0004d944
 *   opt3001_chip_init                        <= FUN_00062930 @ 0x00062930
 *   i2c_read_reg16_be                        <= FUN_000847d8 @ 0x000847d8
 *   z_device_is_ready                        <= FUN_0008638c @ 0x0008638c
 * address symbols (name @ address):
 *   rodata_88250                             @ 0x00088250
 *   rodata_f6521                             @ 0x000f6521   [INLINED -- G6 literal batch]
 *   rodata_f6539                             @ 0x000f6539   [INLINED -- G6 literal batch]
 *   rodata_f6552                             @ 0x000f6552   [INLINED -- G6 literal batch]
 *   rodata_f6565                             @ 0x000f6565   [INLINED -- G6 literal batch]
 */
/* Full reconstruction FUN_00062930 @ 0x62930, exact extent 222 bytes. */
#include <stdint.h>
extern int z_log_msg_runtime_create(uintptr_t,uint32_t,void*,...);
extern int i2c_read_reg16_be(void*,uint32_t,void*,int);
extern _Bool z_device_is_ready(const struct device *);
typedef int (*transfer_fn)(uintptr_t,void*,uint32_t,int16_t);

static __attribute__((always_inline)) inline void
report_descriptor(uint8_t frame[32], uint32_t flags, uintptr_t text, uint32_t value)
{
    *(uint32_t *)(frame+0)=flags;
    *(uintptr_t *)(frame+4)=text;
    *(uint32_t *)(frame+8)=value;
    z_log_msg_runtime_create(((unsigned long)&rodata_88250) /*=0x88250*/,flags==3?0x1840:0x1040,frame);
}

static uint32_t opt3001_chip_init(uintptr_t request)
{
    uint8_t frame[32];
    void *device=*(void **)(request+4);
    uintptr_t instance=*(uintptr_t *)device;
    if(z_device_is_ready(instance)==0) {
        *(uint32_t *)(frame+24)=2;
        *(uintptr_t *)(frame+28)=((unsigned long)"Bus device is not ready") /*=0xf6521*/;
        z_log_msg_runtime_create(((unsigned long)&rodata_88250) /*=0x88250*/,0x1040,frame+24,0);
        return 0xffffffea;
    }
    uint16_t value;
    if(i2c_read_reg16_be(device,0x7e,&value,1)!=0) return 0xffffffea;
    if(value!=0x5449) { report_descriptor(frame,3,((unsigned long)"Bad manufacturer id 0x%x") /*=0xf6539*/,value); return 0xffffffea; }
    if(i2c_read_reg16_be(device,0x7f,&value,0)!=0) return 0xffffffea;
    if(value!=0x3001) { report_descriptor(frame,3,((unsigned long)"Bad device id 0x%x") /*=0xf6552*/,value); return 0xffffffea; }
    if(i2c_read_reg16_be(device,1,&value,0)==0) {
        frame[4]=1;
        frame[5]=(uint8_t)(((value&0xf9ffu)>>8)|6u);
        frame[6]=(uint8_t)(value&0xf9ffu);
        void *payload=frame+4;
        *(void **)(frame+8)=payload;
        *(uint32_t *)(frame+12)=3;
        frame[16]=2;
        uintptr_t vtable=*(uintptr_t *)(instance+8);
        transfer_fn transfer=*(transfer_fn *)(vtable+8);
        if(transfer(instance,frame+8,1,(int16_t)*(uint32_t *)((uint8_t*)device+4))==0)
            return 0;
    }
    *(uint32_t *)(frame+24)=2;
    *(uintptr_t *)(frame+28)=((unsigned long)"Failed to set mode to continuous conversion") /*=0xf6565*/;
    z_log_msg_runtime_create(((unsigned long)&rodata_88250) /*=0x88250*/,0x1040,frame+24,0);
    return 0xffffffea;
}

/* ---- lock_device_mutex.c ---- */
/* readable reconstruction; identity: FUN_0007c8b0 @ 0x0007c8b0
 * public-name: lock_device_mutex
 * durable-map: recon/catalogs/function_names_app.json
 * callees (readable <= raw @ address):
 *   lock_device_mutex                        <= FUN_0007c8b0 @ 0x0007c8b0
 */
/* Reconstructed FUN_0007c8b0 @ 0x7c8b0  (parity: 300/300 trials, PROVEN) */

extern void thunk_FUN_000723b8(unsigned int a, unsigned int b, unsigned int c, unsigned int d, unsigned int e);

void lock_device_mutex(int param_1, unsigned int param_2, unsigned int param_3, unsigned int param_4)
{
    if (param_1 != 0) {
        thunk_FUN_000723b8(*(unsigned int *)(param_1 + 0x10), param_2, 0xffffffffU, 0xffffffffU, param_4);
    }
}

/* ---- unlock_device_mutex.c ---- */
/* readable reconstruction; identity: FUN_0007c8c4 @ 0x0007c8c4
 * public-name: unlock_device_mutex
 * durable-map: recon/catalogs/function_names_app.json
 * callees (readable <= raw @ address):
 *   unlock_device_mutex                      <= FUN_0007c8c4 @ 0x0007c8c4
 */
/* Reconstructed FUN_0007c8c4 @ 0x7c8c4  (parity: 300/300 trials, PROVEN) */

extern void thunk_FUN_00072558(unsigned int);
void unlock_device_mutex(int param_1)
{
  if (param_1 != 0) {
    thunk_FUN_00072558(*(volatile uint32_t *)(param_1 + 0x10));
  }
  return;
}

/* ---- set_shutdown_flag.c ---- */
/* readable reconstruction; identity: FUN_0007cbfe @ 0x0007cbfe
 * public-name: set_shutdown_flag
 * durable-map: recon/catalogs/function_names_app.json
 * callees (readable <= raw @ address):
 *   display_panel_is_secondary               <= FUN_0002bed0 @ 0x0002bed0
 *   update_persist_task_status_to_idle       <= FUN_0002c0e8 @ 0x0002c0e8
 *   mark_master_or_low_battery_flag          <= FUN_0002efc0 @ 0x0002efc0
 *   reset_esb_sync_state                     <= FUN_0007ce60 @ 0x0007ce60
 *   memset_bytes                             <= FUN_00086c78 @ 0x00086c78
 */
/* Reconstructed set_shutdown_flag @ 0x7cbfe  (parity: 300/300 trials, PROVEN) */
extern int display_panel_is_secondary(unsigned long);
extern int update_persist_task_status_to_idle(int);
extern void reset_esb_sync_state(int);
extern void send_event(int);
void set_shutdown_flag(int param_1, int param_2)
{
  int iVar1; char *pcVar2; char cVar3;
  iVar1 = display_panel_is_secondary(param_1);
  if (iVar1 == 0) return;
  if ((*(volatile char *)(*(int*)(param_1+0x1004)+6) != 0) ||
      (cVar3 = *(volatile char *)(*(int*)(param_1+0x1008)+6), cVar3 != 0)) {
    mark_master_or_low_battery_flag();
    memset_bytes(*(int*)(param_1+0x1008)+6, 0, 400);
    memset_bytes(*(int*)(param_1+0x1004)+6, 0, 400);
    cVar3 = 1;
  }
  if (**(char**)(param_1+0x1000) != 0) { **(volatile char**)(param_1+0x1000) = 0; cVar3 = 1; }
  if (*(char*)(*(int*)(param_1+0xffc)+1) != 0) { mark_master_or_low_battery_flag(); *(volatile char *)(*(int*)(param_1+0xffc)+1) = 0; cVar3 = 1; }
  if (**(char**)(param_1+0x1020) != 0) { mark_master_or_low_battery_flag(); **(volatile char**)(param_1+0x1020) = 0; cVar3 = 1; }
  if (*(char*)(param_1+0xd5) == 6) { cVar3 = 1; }
  else if (*(char*)(param_1+0xd5) == 4) { cVar3 = 1; }
  if (**(char**)(param_1+0x1014) != 0) { **(volatile char**)(param_1+0x1014) = 0; cVar3 = 1; }
  if (**(char**)(param_1+0x1018) != 0) { **(volatile char**)(param_1+0x1018) = 0; cVar3 = 1; }
  if (*(char*)(*(int*)(param_1+0x100c)+7) == 0) {
    pcVar2 = *(char**)(param_1+0x101c);
    if (*pcVar2 == 0) {
      if (cVar3 == 0) return;
      goto LAB;
    }
  } else {
    mark_master_or_low_battery_flag();
    reset_esb_sync_state(1);
    pcVar2 = *(char**)(param_1+0x101c);
    if (*pcVar2 == 0) goto LAB;
  }
  *(volatile char *)pcVar2 = 0;
LAB:
  if (param_2 != 0) send_event(0);
  update_persist_task_status_to_idle(param_1);
  memset_bytes(param_1+0xef, 0, 0x5dc);
  return;
}

/* ---- sensor_channel_get_trampoline.c ---- */
/* readable reconstruction; identity: FUN_0007cef6 @ 0x0007cef6
 * public-name: sensor_channel_get_trampoline
 * durable-map: recon/catalogs/function_names_app.json
 * callees (readable <= raw @ address):
 *   sensor_channel_get_trampoline            <= FUN_0007cef6 @ 0x0007cef6
 */
/* Reconstructed FUN_0007cef6 @ 0x7cef6  (parity: 300/300 trials, PROVEN) */

typedef void (*fn_t)(void);
void sensor_channel_get_trampoline(int param_1)
{
    fn_t f = *(fn_t*)(*(int*)(param_1 + 8) + 0x10);
    f();
}

/* ---- product_code_is_supported_egp_family.c ---- */
/* readable reconstruction; identity: FUN_0007cefc @ 0x0007cefc
 * public-name: product_code_is_supported_egp_family
 * durable-map: recon/catalogs/function_names_app.json
 * callees (readable <= raw @ address):
 *   get_product_code_buf                     <= FUN_000232b8 @ 0x000232b8
 *   product_code_is_supported_egp_family     <= FUN_0007cefc @ 0x0007cefc
 */
/* Reconstructed FUN_0007cefc @ 0x7cefc  (parity: 300/300 trials, PROVEN) */

extern unsigned int get_product_code_buf(void);

int product_code_is_supported_egp_family(void)
{
  char *iVar1;
  iVar1 = get_product_code_buf();
  if (iVar1[4] == (char)0x45 && iVar1[5] == (char)0x47 && iVar1[6] == (char)0x50) {
    if (iVar1[7] == (char)0x30) return 1;
    if (iVar1[7] == (char)0x31) {
      if ((unsigned char)(iVar1[8] - 0x30) < 4) return 1;
      return 0;
    }
  }
  return 0;
}

