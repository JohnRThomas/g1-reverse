/*
 * Cohesive translation unit for the `sensors/power' module.
 *
 * GENERATED by recon/refactor/transforms/t04_cohesive_tu.py.  Do not
 * edit: a stage tree is regenerated, never hand-patched
 * (recon/refactor/README.md C4).
 *
 * The 6 functions below were 6 separate translation units until this
 * stage.  Each one's text is reproduced VERBATIM and in the order the
 * generated source list gave it, and they were CONSECUTIVE in that list.
 * They were proven able to share a translation unit: no symbol is
 * declared here with two types, no identifier has internal linkage in one
 * member and is named by another, and no local typedef, macro, struct tag
 * or enum constant of one member is visible to a member that names it.
 *
 * members, in link order:
 *   get_lux_info.c
 *   get_ambient_light_sensor_ready_flag.c
 *   build_status_notify_packet.c
 *   load_usr_setting.c
 *   get_product_code_buf.c
 *   opt3001_reg_read.c
 */

/* File-scope forward declarations for every struct/union tag this
 * unit names.  Without them a tag whose only appearance in a member
 * is inside a parameter list has PARAMETER-LIST scope, so two
 * textually IDENTICAL declarations in two members declare two
 * different incomplete types and the second is a conflicting
 * redeclaration (C11 6.2.1p7).  Incomplete-type forward
 * declarations emit no code. */
struct device;
struct io_part;
struct user_settings_record;
/* ---- get_lux_info.c ---- */
#include "g1_app_symbols.h"
/* readable reconstruction; identity: FUN_00010fc8 @ 0x00010fc8
 * public-name: get_lux_info
 * durable-map: recon/catalogs/function_names_app.json
 * callees (readable <= raw @ address):
 *   __floatunsidf                            <= FUN_0000d804 @ 0x0000d804
 *   __extendsfdf2                            <= FUN_0000d848 @ 0x0000d848
 *   __muldf3                                 <= FUN_0000d8f8 @ 0x0000d8f8
 *   __divdf3                                 <= FUN_0000db4c @ 0x0000db4c
 *   __fixunsdfsi                             <= FUN_0000dea8 @ 0x0000dea8
 *   get_lux_info                             <= FUN_00010fc8 @ 0x00010fc8
 *   get_device_info                          <= FUN_000167a8 @ 0x000167a8
 *   debug_print                              <= FUN_00019c70 @ 0x00019c70
 *   opt3001_read_lux_raw                     <= FUN_0002e648 @ 0x0002e648
 * address symbols (name @ address):
 *   g_log_level                              @ 0x2000230c
 *   g_log_use_alt_sink                       @ 0x20007554
 */
/* Reconstructed FUN_00010fc8 @ 0x10fc8 */
#include <stdint.h>
#include "../../../../headers/g1_log.h"
#include "g1_power.h"

extern uint64_t __floatunsidf(uint32_t);
extern uint64_t __extendsfdf2(uint32_t);
extern void __muldf3(uint32_t, uint32_t, uint32_t, uint32_t);
extern uint64_t __divdf3(uint32_t, uint32_t, uint32_t, uint32_t);
extern uint32_t __fixunsdfsi(void);
extern uint32_t opt3001_read_lux_raw(uint32_t);

uint32_t get_lux_info(uint32_t request, uint32_t context,
                      uint32_t *buffer_slot, uint8_t *encoded_size)
{
    /* G7-B2 defect fix.  Both of these formats are argument-free:
     *   0xa6a28 = "###################################join in get_lux_info\n"
     *   0xa6a61 = "get_lux_info para is NULL\n"
     * and the shipped image loads ONLY r0 at 0x10fce and 0x10fda before each
     * `bl 0x7dda4`.  The four-argument spelling this body used to carry, and
     * in particular the `uint64_t debug_state` it assigned from the call and
     * then fed back as argument 2, were decompiler artefacts of r1..r3 being
     * live scratch across a `void` variadic callee.  log_message returns
     * nothing (see recon/headers/g1_log.h). */
    log_message(0x000a6a28u);
    if (buffer_slot == 0 || encoded_size == 0) {
        log_message(0x000a6a61u);
        return UINT32_MAX;
    }

    uint8_t *out = (uint8_t *)(uintptr_t)*buffer_slot;
    *(volatile uint8_t *)(out + 1) = 1;
    *(volatile uint8_t *)(out + 0) = 0x20;
    *(volatile uint8_t *)(out + 2) = 3;
    *(volatile uint8_t *)(out + 3) = 0x20;

    uint32_t ticks = opt3001_read_lux_raw(0);
    *(uint32_t *)(out + 4) = ticks;
    *(uint32_t *)(out + 8)  = *(volatile uint32_t *)(get_device_info() + 0xfa0);
    *(uint32_t *)(out + 12) = *(volatile uint32_t *)(get_device_info() + 0xfa4);
    *(uint32_t *)(out + 16) = *(volatile uint32_t *)(get_device_info() + 0xfa8);
    *(uint32_t *)(out + 20) = *(volatile uint32_t *)(get_device_info() + 0xf94);
    *(uint32_t *)(out + 24) = *(volatile uint32_t *)(get_device_info() + 0xfb0);
    *(uint32_t *)(out + 28) = *(volatile uint32_t *)(get_device_info() + 0xfb4);

    int32_t counter = *(volatile int32_t *)(get_device_info() + 0xfb0);
    union { float f; uint32_t u; } converted = { .f = (float)counter };
    uint64_t scaled = __extendsfdf2(converted.u);
    scaled = __divdf3((uint32_t)scaled, (uint32_t)(scaled >> 32),
                          0, 0x412e8480u);
    uint64_t tick_value = __floatunsidf(ticks);
    __muldf3((uint32_t)scaled, (uint32_t)(scaled >> 32),
                 (uint32_t)tick_value, (uint32_t)(tick_value >> 32));

    uint32_t value = __fixunsdfsi();
    *(uint32_t *)(out + 32) = value;
    if (*(volatile int32_t *)((unsigned long)&g_log_level) /*=0x2000230c*/ > 2) {
        /* 0xa6a7c = "%s(): curve_lux:0x%x\n\n" -- two specifiers, so three
         * arguments.  0x11086..0x1108c load exactly r0/r1/r2 and then branch
         * to either sink; the r3 the old spelling passed was the
         * g_log_use_alt_sink value the branch itself had just loaded. */
        if (*(volatile int32_t *)((unsigned long)&g_log_use_alt_sink) /*=0x20007554*/ == 0)
            log_message(0x000a6a7cu, 0x000a76beu, value);
        else
            debug_print(0x000a6a7cu, 0x000a76beu, value);
    }
    *encoded_size = 0x24;
    (void)request;
    return 0;
}

/* ---- get_ambient_light_sensor_ready_flag.c ---- */
/* readable reconstruction; identity: FUN_0001655c @ 0x0001655c
 * public-name: get_ambient_light_sensor_ready_flag
 * durable-map: recon/catalogs/function_names_app.json
 * callees (readable <= raw @ address):
 *   get_ambient_light_sensor_ready_flag      <= FUN_0001655c @ 0x0001655c
 * address symbols (name @ address):
 *   g_ambient_light_sensor_ready             @ 0x200069f8
 */
/* Reconstructed FUN_0001655c @ 0x1655c  (parity: 300/300 trials, PROVEN) */

unsigned int get_ambient_light_sensor_ready_flag(void)
{
    return *(volatile unsigned int *)((unsigned long)&g_ambient_light_sensor_ready) /*=0x200069f8*/;
}

/* ---- build_status_notify_packet.c ---- */
/* readable reconstruction; identity: FUN_00021334 @ 0x00021334
 * public-name: build_status_notify_packet
 * durable-map: recon/catalogs/function_names_app.json
 * address symbols (name @ address):
 *   g_ble_xfer_seq_prev                      @ 0x20018d99
 *   g_ble_xfer_seq_cur                       @ 0x20018d9a
 */
/* Recovered build_status_notify_packet <= FUN_00021334 @ 0x00021334.
 *
 * The raw entry-point spelling is retained for the parity/link pipeline while
 * the implementation uses the protocol-facing name.  Address and callee
 * back-mapping live in recon/catalogs/function_names_app.json.
 */

extern uint8_t get_glassbox_charge_status(void);   /* FUN_00032784 @ 0x32784 */
extern uint8_t get_glassbox_charge_percent(void);  /* FUN_000327c4 @ 0x327c4 */

typedef int (*status_packet_sink_fn)(const void *packet, uint32_t length);

/* Only the fields owned by this routine are named.  The object passed by the
 * BLE dispatcher is much larger and is shared with the PUT/GET handlers. */
enum status_context_offset {
    STATUS_SINK_OFFSET                 = 0x000c,
    STATUS_RIGHT_TRANSFER_ID_OFFSET    = -0x06b0,
    STATUS_LEFT_TRANSFER_ID_OFFSET     = -0x06af,
    STATUS_BRIGHTNESS_LEVEL_OFFSET     = 0x0759,
    STATUS_BOX_STATE_OFFSET            = 0x0844,
    STATUS_BOX_STATE_VARIANT_OFFSET    = 0x0846,
};

enum status_query_selector {
    STATUS_QUERY_ECHO                  = 0x09,
    STATUS_QUERY_BOX_STATE             = 0x0a,
    STATUS_QUERY_BOX_CHARGE_STATE      = 0x0e,
    STATUS_QUERY_BOX_CHARGE_PERCENT    = 0x0f,
    STATUS_QUERY_BRIGHTNESS_LEVEL      = 0x12,
    STATUS_QUERY_C9_0D                 = 0xf0,
    STATUS_QUERY_C9_0F                 = 0xf1,
    STATUS_QUERY_C9_4E                 = 0xf2,
};

typedef struct __attribute__((packed)) {
    uint16_t response_code;
    uint8_t value;
    uint8_t transfer_sequence;
    uint8_t previous_transfer_sequence;
    uint8_t reserved[16];
} status_notify_packet_t;

static volatile uint8_t *const ble_xfer_seq_prev_reg =
    (volatile uint8_t *)(uintptr_t)((unsigned long)&g_ble_xfer_seq_prev) /*=0x20018d99*/; /* original literal @ 0x2145c */
static volatile uint8_t *const ble_xfer_seq_cur_reg =
    (volatile uint8_t *)(uintptr_t)((unsigned long)&g_ble_xfer_seq_cur) /*=0x20018d9a*/; /* original literal @ 0x21458 */

static inline uint8_t status_context_byte(const void *context, int offset)
{
    return *((const uint8_t *)context + offset);
}

static inline status_packet_sink_fn status_context_sink(const void *context)
{
    return *(status_packet_sink_fn const *)
        ((const uint8_t *)context + STATUS_SINK_OFFSET);
}

/* The box-state byte uses 0x5d..0x60 as internal states.  The wire protocol
 * separates the two transitional states with the adjacent variant flag and
 * folds every later state into 0x64. */
static uint8_t encode_box_state(const void *context)
{
    uint8_t state = status_context_byte(context, STATUS_BOX_STATE_OFFSET);
    uint8_t variant =
        status_context_byte(context, STATUS_BOX_STATE_VARIANT_OFFSET);

    if (state == 0x5d)
        return variant == 0 ? 0x5e : 0x5f;
    if (state == 0x5e)
        return variant == 0 ? 0x60 : 0x61;
    if (state == 0x5f)
        return 0x62;
    if (state == 0x60)
        return 0x63;
    if (state > 0x60)
        return 0x64;
    return state;
}

uint32_t build_status_notify_packet(void *context,
                                    const uint8_t *request)
{
    status_notify_packet_t packet;
    uint8_t selector;

    /* The firmware clears the first word separately, then the remaining
     * seventeen transmitted bytes through its byte memset helper. */
    *(uint32_t *)(void *)&packet = 0;
    memset_bytes((uint8_t *)&packet + 4, 0, 17);

    selector = request[1];
    if (selector > STATUS_QUERY_BRIGHTNESS_LEVEL) {
        switch (selector) {
        case STATUS_QUERY_C9_0F:
            packet.response_code = 0xc90f;
            packet.value = status_context_byte(
                context, STATUS_RIGHT_TRANSFER_ID_OFFSET);
            break;
        case STATUS_QUERY_C9_4E:
            packet.response_code = 0xc94e;
            packet.value = status_context_byte(
                context, STATUS_RIGHT_TRANSFER_ID_OFFSET);
            break;
        case STATUS_QUERY_C9_0D:
            packet.response_code = 0xc90d;
            packet.value = status_context_byte(
                context, STATUS_LEFT_TRANSFER_ID_OFFSET);
            break;
        default:
            packet.response_code = (uint16_t)(0x00f5u |
                                              ((uint16_t)selector << 8));
            goto publish;
        }

        packet.transfer_sequence = *ble_xfer_seq_cur_reg;
        *ble_xfer_seq_cur_reg = 0;
        packet.previous_transfer_sequence = *ble_xfer_seq_prev_reg;
        *ble_xfer_seq_prev_reg = 0;
        goto publish;
    }

    switch (selector) {
    case STATUS_QUERY_ECHO:
        packet.response_code = *(const uint16_t *)(const void *)request;
        packet.value = request[2];
        break;
    case STATUS_QUERY_BOX_STATE:
        packet.response_code = 0x0af5;
        packet.value = encode_box_state(context);
        break;
    case STATUS_QUERY_BOX_CHARGE_STATE:
        packet.response_code = 0x0ef5;
        packet.value = get_glassbox_charge_status();
        break;
    case STATUS_QUERY_BOX_CHARGE_PERCENT:
        packet.response_code = 0x0ff5;
        packet.value = get_glassbox_charge_percent();
        break;
    case STATUS_QUERY_BRIGHTNESS_LEVEL:
        packet.response_code = 0x12f5;
        packet.value = status_context_byte(
            context, STATUS_BRIGHTNESS_LEVEL_OFFSET);
        break;
    default:
        packet.response_code = (uint16_t)(0x00f5u |
                                          ((uint16_t)selector << 8));
        break;
    }

publish:
    status_context_sink(context)(&packet, 21);
    return 0;
}

/* ---- load_usr_setting.c ---- */
/* readable reconstruction; identity: FUN_00022e78 @ 0x00022e78
 * public-name: load_usr_setting
 * durable-map: recon/catalogs/function_names_app.json
 * callees (readable <= raw @ address):
 *   debug_print                              <= FUN_00019c70 @ 0x00019c70
 *   flash_settings_read                      <= FUN_000225b4 @ 0x000225b4
 *   reset_usr_setting                        <= FUN_00022ddc @ 0x00022ddc
 *   is_battery_critical                      <= FUN_00032ee4 @ 0x00032ee4
 *   set_test_mode                            <= FUN_00032ef0 @ 0x00032ef0
 *   save_usr_setting                         <= FUN_0007c28e @ 0x0007c28e
 *   memset_bytes                             <= FUN_00086c78 @ 0x00086c78
 * address symbols (name @ address):
 *   rodata_9e60c                             @ 0x0009e60c   [INLINED -- G6 literal batch]
 *   rodata_9e632                             @ 0x0009e632   [INLINED -- G6 literal batch]
 *   rodata_9e7a6                             @ 0x0009e7a6   [INLINED -- G6 literal batch]
 *   g_log_level                              @ 0x2000230c
 *   g_log_use_alt_sink                       @ 0x20007554
 */
/* Reconstructed load_usr_setting @ 0x22e78 */

#include "../../../../headers/g1_dedupe.h"

struct __attribute__((packed)) user_settings_record {
    uint8_t display_mode;
    uint8_t language;
    uint8_t secondary_language;
    uint8_t interaction_mode;
    uint32_t timeout;
    uint8_t brightness;
    uint8_t gesture_mode;
    uint8_t auxiliary_mode;
    uint8_t primary_index;
    uint32_t identifier;
    uint16_t interval;
    uint8_t identifier_tail;
    uint8_t language_extension;
    uint8_t boolean_mode;
    uint8_t option_a;
    uint8_t option_b;
    uint8_t critical_mode;
    uint8_t secondary_index;
    uint8_t reserved[3];
    uint32_t counter;
};

extern int flash_settings_read(uint32_t address, void *destination, uint32_t length);
extern unsigned long reset_usr_setting(unsigned char*);
extern void set_test_mode(unsigned int);
extern void save_usr_setting(void *settings, uint32_t value);

int load_usr_setting(uint8_t *settings)
{
    struct user_settings_record record;

    memset_bytes(&record, 0, sizeof(record));
    if (flash_settings_read(0x00134000UL, &record, sizeof(record)) != 0) {
        if (*(volatile int32_t *)((unsigned long)&g_log_level) /*=0x2000230c*/ > 1) {
            G1_LOG_ROUTE(*(volatile uint32_t *)((unsigned long)&g_log_use_alt_sink) /*=0x20007554*/ == 0, ((unsigned long)"%s(): usr_flash_settings_read error!\n") /*=0x9e60c*/, ((unsigned long)"load_usr_setting") /*=0x9e7a6*/);
        }
        return -1;
    }

    if (*(volatile int32_t *)((unsigned long)&g_log_level) /*=0x2000230c*/ > 1) {
        G1_LOG_ROUTE(*(volatile uint32_t *)((unsigned long)&g_log_use_alt_sink) /*=0x20007554*/ == 0, ((unsigned long)"%s(): read user settings success!\n") /*=0x9e632*/, ((unsigned long)"load_usr_setting") /*=0x9e7a6*/);
    }

    settings[0xed5] = record.language;
    settings[0xef4] = record.secondary_language;
    *(uint32_t *)(settings + 0xf6c) =
        record.timeout == 0 ? 400 : record.timeout;
    settings[0xfea] = record.display_mode;
    settings[0xf98] = record.brightness;
    settings[0xf60] = record.interaction_mode;
    settings[0x1070] = record.gesture_mode;
    settings[0x108d] = record.auxiliary_mode;
    settings[0xec0] = record.primary_index;
    *(uint32_t *)(settings + 0x1069) = record.identifier;
    settings[0x106f] = record.identifier_tail;
    *(uint16_t *)(settings + 0x106d) = record.interval;
    settings[0xef5] = record.language_extension;
    settings[0x108f] = record.boolean_mode < 2 ? record.boolean_mode : 0;
    settings[0x1090] = record.option_a;
    settings[0x1091] = record.option_b;
    settings[0xec1] = record.secondary_index;
    *(uint32_t *)(settings + 0xf68) = record.counter;

    if ((uint8_t)(record.display_mode & record.interaction_mode) == 0xff) {
        reset_usr_setting(settings);
    }
    if (settings[0xec0] > 8) {
        settings[0xec0] = 3;
    }
    if ((uint32_t)(settings[0xec1] - 1) > 8) {
        settings[0xec1] = 3;
    }
    if ((int8_t)settings[0xfea] == 11) {
        settings[0xfea] = 10;
        save_usr_setting(settings, 0);
    }

    set_test_mode(record.critical_mode < 2 ? record.critical_mode : 0);
    if (is_battery_critical() == 1) {
        settings[0xf98] = 0;
        settings[0xfea] = 11;
        settings[0xed5] = 0x15;
        *(uint16_t *)(settings + 0xec0) = 0x303;
    } else {
        settings[0xfea] = 10;
    }
    if (*(int32_t *)(settings + 0xf68) == -1) {
        *(uint32_t *)(settings + 0xf68) = 0;
    }
    return 0;
}

/* ---- get_product_code_buf.c ---- */
/* readable reconstruction; identity: FUN_000232b8 @ 0x000232b8
 * public-name: get_product_code_buf
 * durable-map: recon/catalogs/function_names_app.json
 * callees (readable <= raw @ address):
 *   get_product_code_buf                     <= FUN_000232b8 @ 0x000232b8
 * address symbols (name @ address):
 *   g_product_code_buf                       @ 0x20002fe3
 */
/* Reconstructed FUN_000232b8 @ 0x232b8  (parity: 300/300 trials, PROVEN) */

unsigned int get_product_code_buf(void){
  return ((unsigned long)&g_product_code_buf) /*=0x20002fe3*/;
}

/* ---- opt3001_reg_read.c ---- */
/* readable reconstruction; identity: FUN_0002e594 @ 0x0002e594
 * public-name: opt3001_reg_read
 * durable-map: recon/catalogs/function_names_app.json
 * callees (readable <= raw @ address):
 *   debug_print                              <= FUN_00019c70 @ 0x00019c70
 *   opt3001_reg_read                         <= FUN_0002e594 @ 0x0002e594
 *   z_device_is_ready                        <= FUN_0008638c @ 0x0008638c
 * address symbols (name @ address):
 *   rodata_a3af8                             @ 0x000a3af8   [INLINED -- G6 literal batch]
 *   rodata_a3b17                             @ 0x000a3b17   [INLINED -- G6 literal batch]
 *   rodata_a3d26                             @ 0x000a3d26   [INLINED -- G6 literal batch]
 *   g_log_level                              @ 0x2000230c
 *   g_opt3007_bus_dev                        @ 0x200023fc
 *   g_log_use_alt_sink                       @ 0x20007554
 */
/* Reconstructed FUN_0002e594 @ 0x2e594 */

extern _Bool z_device_is_ready(const struct device *);

struct io_part { void *data; uint32_t length; uint8_t type; };
typedef int (*transfer_fn)(uint32_t, struct io_part *, uint32_t, uint32_t);

int opt3001_reg_read(uint8_t request, uint16_t *result)
{
    volatile uint32_t *device_slot = (volatile uint32_t *)((unsigned long)&g_opt3007_bus_dev) /*=0x200023fc*/;
    uint32_t device = *device_slot;
    uint16_t response = 0;
    if (z_device_is_ready(device) == 0) {
        if (*(volatile int *)((unsigned long)&g_log_level) /*=0x2000230c*/ > 0) {
            if (*(volatile int *)((unsigned long)&g_log_use_alt_sink) /*=0x20007554*/ == 0)
                log_message(((unsigned long)"%s(): Bus device is not ready\n") /*=0xa3af8*/, ((unsigned long)"opt3001_reg_read") /*=0xa3d26*/);
            else
                debug_print(((unsigned long)"%s(): Bus device is not ready\n") /*=0xa3af8*/, ((unsigned long)"opt3001_reg_read") /*=0xa3d26*/);
        }
        return -19;
    }
    struct { struct io_part tx, rx; } parts = {
        { &request, 1, 0 }, { &response, 2, 7 }
    };
    transfer_fn transfer = *(transfer_fn *)(uintptr_t)(*(uint32_t *)(device + 8) + 8);
    int status = transfer(device, &parts.tx, 2, 0x45);
    if (status < 0) {
        if (*(volatile int *)((unsigned long)&g_log_level) /*=0x2000230c*/ > 0) {
            if (*(volatile int *)((unsigned long)&g_log_use_alt_sink) /*=0x20007554*/ == 0)
                log_message(((unsigned long)"%s(): ERR: opt3007 i2c read addr=0x%x,\n") /*=0xa3b17*/, ((unsigned long)"opt3001_reg_read") /*=0xa3d26*/, 0x45);
            else
                debug_print(((unsigned long)"%s(): ERR: opt3007 i2c read addr=0x%x,\n") /*=0xa3b17*/, ((unsigned long)"opt3001_reg_read") /*=0xa3d26*/, 0x45);
        }
        return -2;
    }
    *result = (uint16_t)((response << 8) | (response >> 8));
    return 0;
}

