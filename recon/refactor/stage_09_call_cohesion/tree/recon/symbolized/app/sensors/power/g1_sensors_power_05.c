/*
 * Cohesive translation unit for the `sensors/power' module.
 *
 * GENERATED by recon/refactor/transforms/t04_cohesive_tu.py.  Do not
 * edit: a stage tree is regenerated, never hand-patched
 * (recon/refactor/README.md C4).
 *
 * The 8 functions below were 8 separate translation units until this
 * stage.  Each one's text is reproduced VERBATIM and in the order the
 * generated source list gave it, and they were CONSECUTIVE in that list.
 * They were proven able to share a translation unit: no symbol is
 * declared here with two types, no identifier has internal linkage in one
 * member and is named by another, and no local typedef, macro, struct tag
 * or enum constant of one member is visible to a member that names it.
 *
 * members, in link order:
 *   fuel_gauge_poll_should_stop.c
 *   get_glassbox_charge_status.c
 *   get_glassbox_charge_percent.c
 *   set_glassbox_charge_percent.c
 *   is_battery_critical.c
 *   fuel_gauge_dev_register.c
 *   fuel_gauge_lock.c
 *   fuel_gauge_unlock.c
 */
/* ---- fuel_gauge_poll_should_stop.c ---- */
#include "g1_app_symbols.h"
#include "../../../../headers/g1_log.h"
#include "../../../../headers/g1_dedupe.h"
#include <stdint.h>
/* readable reconstruction; identity: FUN_00030cac @ 0x00030cac
 * public-name: fuel_gauge_poll_should_stop
 * durable-map: recon/catalogs/function_names_app.json
 * callees (readable <= raw @ address):
 *   fuel_gauge_poll_should_stop              <= FUN_00030cac @ 0x00030cac
 * address symbols (name @ address):
 *   g_fuel_gauge_poll_stop_flag              @ 0x20019dae
 */
/* Reconstructed FUN_00030cac @ 0x30cac  (parity: 300/300 trials, PROVEN) */

unsigned char fuel_gauge_poll_should_stop(void) {
    return *(volatile unsigned char *)((unsigned long)&g_fuel_gauge_poll_stop_flag) /*=0x20019dae*/;
}

/* ---- get_glassbox_charge_status.c ---- */
/* readable reconstruction; identity: FUN_00032784 @ 0x00032784
 * public-name: get_glassbox_charge_status
 * durable-map: recon/catalogs/function_names_app.json
 * callees (readable <= raw @ address):
 *   debug_print                              <= FUN_00019c70 @ 0x00019c70
 * address symbols (name @ address):
 *   rodata_a7411                             @ 0x000a7411   [INLINED -- G6 literal batch]
 *   rodata_a7751                             @ 0x000a7751   [INLINED -- G6 literal batch]
 *   g_log_level                              @ 0x2000230c
 *   g_log_use_alt_sink                       @ 0x20007554
 *   g_glassbox_charge_status_byte            @ 0x20019ef4
 */
/* Reconstructed get_glassbox_charge_status @ 0x32784  (parity: 300/300 trials, PROVEN) */

unsigned char get_glassbox_charge_status(void){
    volatile unsigned char *pbVar1 = (volatile unsigned char*)((unsigned long)&g_glassbox_charge_status_byte) /*=0x20019ef4*/;
    if(*(volatile int *)((unsigned long)&g_log_level) /*=0x2000230c*/ > 2){
        unsigned int sink = *(volatile unsigned int *)((unsigned long)&g_log_use_alt_sink) /*=0x20007554*/;
        G1_LOG_ROUTE(sink == 0, ((unsigned long)"%s(): bIsCharging is :%d \n\n") /*=0xa7411*/, ((unsigned long)"get_glassbox_charge_status") /*=0xa7751*/,
                        (unsigned int)(*pbVar1 >> 7),sink);
    }
    return *pbVar1 >> 7;
}

/* ---- get_glassbox_charge_percent.c ---- */
/* readable reconstruction; identity: FUN_000327c4 @ 0x000327c4
 * public-name: get_glassbox_charge_percent
 * durable-map: recon/catalogs/function_names_app.json
 * callees (readable <= raw @ address):
 *   debug_print                              <= FUN_00019c70 @ 0x00019c70
 * address symbols (name @ address):
 *   rodata_a742d                             @ 0x000a742d   [INLINED -- G6 literal batch]
 *   rodata_a7735                             @ 0x000a7735   [INLINED -- G6 literal batch]
 *   g_log_level                              @ 0x2000230c
 *   g_log_use_alt_sink                       @ 0x20007554
 *   g_glassbox_charge_status_byte            @ 0x20019ef4
 */
/* Reconstructed get_glassbox_charge_percent @ 0x327c4. */


uint8_t get_glassbox_charge_percent(void)
{
    uint8_t percent = *(volatile uint8_t *)((unsigned long)&g_glassbox_charge_status_byte) /*=0x20019ef4*/ & 0x7f;

    if (2 < *(volatile int *)((unsigned long)&g_log_level) /*=0x2000230c*/) {
        if (*(volatile uint32_t *)((unsigned long)&g_log_use_alt_sink) /*=0x20007554*/ == 0)
            log_message(((unsigned long)"%s(): batterPercent is :%d \n\n") /*=0xa742d*/, ((unsigned long)"get_glassbox_charge_percent") /*=0xa7735*/, percent);
        else
            debug_print(((unsigned long)"%s(): batterPercent is :%d \n\n") /*=0xa742d*/, ((unsigned long)"get_glassbox_charge_percent") /*=0xa7735*/, percent);
    }
    /* The firmware deliberately reloads after the diagnostic call.  The
       status byte is volatile and may be updated while the logger runs. */
    return *(volatile uint8_t *)((unsigned long)&g_glassbox_charge_status_byte) /*=0x20019ef4*/ & 0x7f;
}

/* ---- set_glassbox_charge_percent.c ---- */
/* readable reconstruction; identity: FUN_00032808 @ 0x00032808
 * public-name: set_glassbox_charge_percent
 * durable-map: recon/catalogs/function_names_app.json
 * callees (readable <= raw @ address):
 *   set_glassbox_charge_percent              <= FUN_00032808 @ 0x00032808
 * address symbols (name @ address):
 *   g_glassbox_charge_status_byte            @ 0x20019ef4
 */
/* Reconstructed FUN_00032808 @ 0x32808  (parity: 300/300 trials, PROVEN) */

unsigned int set_glassbox_charge_percent(unsigned int param_1) {
  volatile unsigned char *p = (volatile unsigned char*)((unsigned long)&g_glassbox_charge_status_byte) /*=0x20019ef4*/;
  unsigned char v = *p;
  v = (v & 0x80) | (param_1 & 0x7f);
  *p = v;
  return param_1 & 0x7f;
}

/* ---- is_battery_critical.c ---- */
/* readable reconstruction; identity: FUN_00032ee4 @ 0x00032ee4
 * public-name: is_battery_critical
 * durable-map: recon/catalogs/function_names_app.json
 * address symbols (name @ address):
 *   g_test_mode_flag                         @ 0x20019ef3
 */
/* Reconstructed is_battery_critical @ 0x32ee4  (parity: 300/300 trials, PROVEN) */
typedef unsigned char u8;u8 is_battery_critical(void){return *(volatile u8 *)((unsigned long)&g_test_mode_flag) /*=0x20019ef3*/;}

/* ---- fuel_gauge_dev_register.c ---- */
/* readable reconstruction; identity: FUN_00033088 @ 0x00033088
 * public-name: fuel_gauge_dev_register
 * durable-map: recon/catalogs/function_names_app.json
 * callees (readable <= raw @ address):
 *   fuel_gauge_dev_register                  <= FUN_00033088 @ 0x00033088
 * address symbols (name @ address):
 *   g_fuel_gauge_dev                         @ 0x20002424
 */
/* Reconstructed FUN_00033088 @ 0x33088  (parity: 300/300 trials, PROVEN) */

int fuel_gauge_dev_register(int param_1)
{
  int iVar1 = ((unsigned long)&g_fuel_gauge_dev) /*=0x20002424*/;
  if (param_1 != 0) {
    if (*(volatile int *)(((unsigned long)&g_fuel_gauge_dev) /*=0x20002424*/ + 4) != param_1) {
      *(volatile int *)(((unsigned long)&g_fuel_gauge_dev) /*=0x20002424*/ + 4) = param_1;
    }
    *(volatile unsigned char *)(iVar1 + 8) = 1;
    return 0;
  }
  return -1;
}

/* ---- fuel_gauge_lock.c ---- */
/* readable reconstruction; identity: FUN_000330c4 @ 0x000330c4
 * public-name: fuel_gauge_lock
 * durable-map: recon/catalogs/function_names_app.json
 * callees (readable <= raw @ address):
 *   fuel_gauge_lock                          <= FUN_000330c4 @ 0x000330c4
 *   lock_device_mutex                        <= FUN_0007c8b0 @ 0x0007c8b0
 * address symbols (name @ address):
 *   g_fuel_gauge_dev                         @ 0x20002424
 */
/* ABI-faithful reconstruction of FUN_000330c4 @ 0x330c4 (16 bytes). */

extern void lock_device_mutex(uint32_t enabled, uint32_t inherited_r1,
                         uint32_t inherited_r2, uint32_t inherited_r3);

uint32_t fuel_gauge_lock(uint32_t ignored, uint32_t inherited_r1,
                      uint32_t inherited_r2, uint32_t inherited_r3)
{
    (void)ignored;
    uint32_t enabled = *(volatile uint32_t *)((unsigned long)&g_fuel_gauge_dev) /*=0x20002424*/;
    if (enabled != 0)
        lock_device_mutex(enabled, inherited_r1, inherited_r2, ((unsigned long)&g_fuel_gauge_dev) /*=0x20002424*/);
    return 0;
}

/* ---- fuel_gauge_unlock.c ---- */
/* readable reconstruction; identity: FUN_000330d8 @ 0x000330d8
 * public-name: fuel_gauge_unlock
 * durable-map: recon/catalogs/function_names_app.json
 * callees (readable <= raw @ address):
 *   fuel_gauge_unlock                        <= FUN_000330d8 @ 0x000330d8
 *   unlock_device_mutex                      <= FUN_0007c8c4 @ 0x0007c8c4
 * address symbols (name @ address):
 *   g_fuel_gauge_dev                         @ 0x20002424
 */
/* Reconstructed FUN_000330d8 @ 0x330d8  (parity: 300/300 trials, PROVEN) */

extern void unlock_device_mutex(int);

unsigned int fuel_gauge_unlock(void) {
  unsigned int value = *(volatile unsigned int *)((unsigned long)&g_fuel_gauge_dev) /*=0x20002424*/;
  if (value != 0) {
    unlock_device_mutex((int)value);
  }
  return 0;
}

