/*
 * Cohesive translation unit for the `sensors/power' module.
 *
 * GENERATED by recon/refactor/transforms/t04_cohesive_tu.py.  Do not
 * edit: a stage tree is regenerated, never hand-patched
 * (recon/refactor/README.md C4).
 *
 * The 6 functions below were 6 separate translation units until this
 * stage.  Each one's text is reproduced VERBATIM and in the order the
 * generated source list gave it, and they were CONSECUTIVE in that list.
 * They were proven able to share a translation unit: no symbol is
 * declared here with two types, no identifier has internal linkage in one
 * member and is named by another, and no local typedef, macro, struct tag
 * or enum constant of one member is visible to a member that names it.
 *
 * members, in link order:
 *   opt3007_chip_init.c
 *   opt3007_chip_deinit.c
 *   opt3007_init_ctx_setup.c
 *   fuel_gauge_read_voltage_current_temp.c
 *   fuel_gauge_sample_init_timestamp.c
 *   get_low_battery_flag_if_master.c
 */

/* File-scope forward declarations for every struct/union tag this
 * unit names.  Without them a tag whose only appearance in a member
 * is inside a parameter list has PARAMETER-LIST scope, so two
 * textually IDENTICAL declarations in two members declare two
 * different incomplete types and the second is a conflicting
 * redeclaration (C11 6.2.1p7).  Incomplete-type forward
 * declarations emit no code. */
struct device;
struct opt3007_init_frame;
struct opt3007_transfer;
/* ---- opt3007_chip_init.c ---- */
#include "g1_app_symbols.h"
/* readable reconstruction; identity: FUN_0002e67c @ 0x0002e67c
 * public-name: opt3007_chip_init
 * durable-map: recon/catalogs/function_names_app.json
 * callees (readable <= raw @ address):
 *   get_device_info                          <= FUN_000167a8 @ 0x000167a8
 *   debug_print                              <= FUN_00019c70 @ 0x00019c70
 *   opt3001_reg_read                         <= FUN_0002e594 @ 0x0002e594
 *   z_device_is_ready                        <= FUN_0008638c @ 0x0008638c
 * address symbols (name @ address):
 *   rodata_a3af8                             @ 0x000a3af8   [INLINED -- G6 literal batch]
 *   rodata_a3b3f                             @ 0x000a3b3f   [INLINED -- G6 literal batch]
 *   rodata_a3b5a                             @ 0x000a3b5a
 *   rodata_a3b7a                             @ 0x000a3b7a   [INLINED -- G6 literal batch]
 *   rodata_a3b8e                             @ 0x000a3b8e
 *   rodata_a3bd6                             @ 0x000a3bd6   [INLINED -- G6 literal batch]
 *   rodata_a3c0c                             @ 0x000a3c0c   [INLINED -- G6 literal batch]
 *   rodata_a3c2d                             @ 0x000a3c2d   [INLINED -- G6 literal batch]
 *   rodata_a3c68                             @ 0x000a3c68   [INLINED -- G6 literal batch]
 *   rodata_a3cee                             @ 0x000a3cee   [INLINED -- G6 literal batch]
 *   rodata_a3d00                             @ 0x000a3d00   [INLINED -- G6 literal batch]
 *   g_log_level                              @ 0x2000230c
 *   g_opt3007_bus_dev                        @ 0x200023fc
 *   g_log_use_alt_sink                       @ 0x20007554
 *   g_opt3007_dev                            @ 0x20007b6c
 *   g_opt3007_chip_ready                     @ 0x20018da1
 */
/* Reconstructed opt3007_chip_init @ 0x2e67c  (parity: 300/300 trials, PROVEN) */
#include <stdint.h>
#include "../../../../headers/g1_log.h"
#include "g1_power.h"
typedef uint32_t u32; typedef unsigned char byte;
extern int opt3001_reg_read(unsigned char, unsigned short*);
extern _Bool z_device_is_ready(const struct device *);
#define FLAG (*(volatile int *)((unsigned long)&g_log_use_alt_sink) /*=0x20007554*/)

struct opt3007_transfer {
    byte *data;
    u32 length;
    byte type;
};

struct opt3007_init_frame {
    unsigned short chip_id;
    unsigned short configuration;
    byte payload[3];
    byte reserved;
    struct opt3007_transfer transfer;
};

u32 opt3007_chip_init(int param_1){
    struct opt3007_init_frame frame;
    int iVar5; u32 uVar6=0; u32 uVar4;
    volatile int *piVar1 = (volatile int*)((unsigned long)&g_log_level) /*=0x2000230c*/;
    volatile int *piVar2 = (volatile int*)((unsigned long)&g_opt3007_dev) /*=0x20007b6c*/;
    volatile int *piVar3;

    frame.chip_id = 0;
    if (param_1 == 0) { param_1 = get_device_info(); param_1 = param_1 + 0xf80; }
    iVar5 = *piVar1;
    *piVar2 = param_1;
    if (2 < iVar5) {
        if (FLAG == 0) log_message(((unsigned long)"%s(): opt3007 init start:\n") /*=0xa3b3f*/, ((unsigned long)"opt3007_chip_init") /*=0xa3d00*/);
        else debug_print(((unsigned long)"%s(): opt3007 init start:\n") /*=0xa3b3f*/, ((unsigned long)"opt3007_chip_init") /*=0xa3d00*/);
    }
    iVar5 = opt3001_reg_read(0x7e, &frame.chip_id);
    if (iVar5 == 0) {
        uVar6 = frame.chip_id;
        if (1 < *piVar1) {
            if (FLAG == 0) log_message(((unsigned long)"%s(): mfg_id=0x%x,\n") /*=0xa3b7a*/, ((unsigned long)"opt3007_chip_init") /*=0xa3d00*/, uVar6);
            else debug_print(((unsigned long)"%s(): mfg_id=0x%x,\n") /*=0xa3b7a*/, ((unsigned long)"opt3007_chip_init") /*=0xa3d00*/, uVar6);
        }
        if (uVar6 == 0x5449) {
            iVar5 = opt3001_reg_read(0x7f, &frame.chip_id);
            if (iVar5 != 0) {
                if (*piVar1 < 1) return 0xfffffffbUL;
                iVar5 = FLAG; uVar4 = 0xa3bb6; goto LAB_0002e6c8;
            }
            uVar6 = frame.chip_id;
            if (1 < *piVar1) {
                if (FLAG == 0) log_message(((unsigned long)"%s(): dev_id=0x%x,\n") /*=0xa3bd6*/, ((unsigned long)"opt3007_chip_init") /*=0xa3d00*/, uVar6);
                else debug_print(((unsigned long)"%s(): dev_id=0x%x,\n") /*=0xa3bd6*/, ((unsigned long)"opt3007_chip_init") /*=0xa3d00*/, uVar6);
            }
            if (uVar6 == 0x3001) {
                iVar5 = opt3001_reg_read(1, &frame.configuration);
                piVar3 = (volatile int*)((unsigned long)&g_opt3007_bus_dev) /*=0x200023fc*/;
                if (iVar5 == 0) {
                    unsigned short configuration = frame.configuration & 63999;
                    frame.payload[0] = 1;
                    frame.payload[1] = (byte)((configuration >> 8) | 6);
                    frame.payload[2] = (byte)configuration;
                    iVar5 = z_device_is_ready((u32)*piVar3);
                    if (iVar5 == 0) {
                        if (*piVar1 < 1) return 0xfffffffbUL;
                        if (FLAG == 0) log_message(((unsigned long)"%s(): Bus device is not ready\n") /*=0xa3af8*/, ((unsigned long)"opt3001_reg_write") /*=0xa3cee*/);
                        else debug_print(((unsigned long)"%s(): Bus device is not ready\n") /*=0xa3af8*/, ((unsigned long)"opt3001_reg_write") /*=0xa3cee*/);
                    } else {
                        int obj, vt; int (*f)(int,void*,int,int);
                        frame.transfer.data = frame.payload;
                        frame.transfer.length = 3;
                        frame.transfer.type = 2;
                        obj = *piVar3;
                        vt = *(int*)(uintptr_t)(obj + 8);
                        f = *(int(**)(int,void*,int,int))(uintptr_t)(vt + 8);
                        iVar5 = f(obj, &frame.transfer, 1, 0x45);
                        if (-1 < iVar5) {
                            if (*piVar2 != 0) *(volatile u32 *)(uintptr_t)(*piVar2 + 0x10) = 1;
                            if (2 < *piVar1) {
                                if (FLAG == 0) log_message(((unsigned long)"%s(): opt3007 init done!\n") /*=0xa3c68*/, ((unsigned long)"opt3007_chip_init") /*=0xa3d00*/);
                                else debug_print(((unsigned long)"%s(): opt3007 init done!\n") /*=0xa3c68*/, ((unsigned long)"opt3007_chip_init") /*=0xa3d00*/);
                            }
                            *(volatile byte *)((unsigned long)&g_opt3007_chip_ready) /*=0x20018da1*/ = 1;
                            return 0;
                        }
                        if (*piVar1 < 1) return 0xfffffffbUL;
                        if (FLAG == 0) log_message(((unsigned long)"%s(): opt3007 i2c write err=%d,\n") /*=0xa3c0c*/, ((unsigned long)"opt3001_reg_write") /*=0xa3cee*/);
                        else debug_print(((unsigned long)"%s(): opt3007 i2c write err=%d,\n") /*=0xa3c0c*/, ((unsigned long)"opt3001_reg_write") /*=0xa3cee*/);
                    }
                }
                if (*piVar1 < 1) return 0xfffffffbUL;
                if (FLAG != 0) { debug_print(((unsigned long)"%s(): opt3007 Failed to set mode to continuous conversion\n") /*=0xa3c2d*/, ((unsigned long)"opt3007_chip_init") /*=0xa3d00*/); return 0xfffffffbUL; }
                log_message(((unsigned long)"%s(): opt3007 Failed to set mode to continuous conversion\n") /*=0xa3c2d*/, ((unsigned long)"opt3007_chip_init") /*=0xa3d00*/);
                return 0xfffffffbUL;
            }
            if (*piVar1 < 1) return 0xffffff7aUL;
            iVar5 = FLAG; uVar4 = 0xa3bea;
        } else {
            if (*piVar1 < 1) return 0xffffff7aUL;
            iVar5 = FLAG; uVar4 = ((unsigned long)&rodata_a3b8e) /*=0xa3b8e*/;
        }
        if (iVar5 == 0) log_message(uVar4, ((unsigned long)"opt3007_chip_init") /*=0xa3d00*/, uVar6);
        else debug_print(uVar4, ((unsigned long)"opt3007_chip_init") /*=0xa3d00*/, uVar6);
        return 0xffffff7aUL;
    }
    if (*piVar1 < 1) return 0xfffffffbUL;
    iVar5 = FLAG; uVar4 = ((unsigned long)&rodata_a3b5a) /*=0xa3b5a*/;
LAB_0002e6c8:
    if (iVar5 == 0) log_message(uVar4, ((unsigned long)"opt3007_chip_init") /*=0xa3d00*/, (u32)frame.chip_id);
    else debug_print(uVar4, ((unsigned long)"opt3007_chip_init") /*=0xa3d00*/, (u32)frame.chip_id);
    return 0xfffffffbUL;
}

/* ---- opt3007_chip_deinit.c ---- */
#include "../../../../headers/g1_dedupe.h"
/* readable reconstruction; identity: FUN_0002e8b4 @ 0x0002e8b4
 * public-name: opt3007_chip_deinit
 * durable-map: recon/catalogs/function_names_app.json
 * callees (readable <= raw @ address):
 *   debug_print                              <= FUN_00019c70 @ 0x00019c70
 * address symbols (name @ address):
 *   rodata_a3cb9                             @ 0x000a3cb9   [INLINED -- G6 literal batch]
 *   rodata_a3cda                             @ 0x000a3cda   [INLINED -- G6 literal batch]
 *   g_log_level                              @ 0x2000230c
 *   g_log_use_alt_sink                       @ 0x20007554
 *   g_opt3007_dev                            @ 0x20007b6c
 *   g_opt3007_chip_ready                     @ 0x20018da1
 */
/* Reconstructed opt3007_chip_deinit @ 0x2e8b4  (parity: 300/300 trials, PROVEN) */

void opt3007_chip_deinit(unsigned int param_1,unsigned int param_2,unsigned int param_3,unsigned int param_4){
    unsigned int v = *(volatile unsigned int *)((unsigned long)&g_opt3007_dev) /*=0x20007b6c*/;
    if(v != 0){
        param_3 = 0;
        *(volatile unsigned int *)(v + 0x10) = 0;
    }
    if(*(volatile int *)((unsigned long)&g_log_level) /*=0x2000230c*/ > 2){
        G1_LOG_ROUTE(*(volatile unsigned int *)((unsigned long)&g_log_use_alt_sink) /*=0x20007554*/==0, ((unsigned long)"%s(): opt3007_chip_deinit done!\n") /*=0xa3cb9*/,((unsigned long)"opt3007_chip_deinit") /*=0xa3cda*/,param_3,0,param_4);
    }
    *(volatile unsigned char *)((unsigned long)&g_opt3007_chip_ready) /*=0x20018da1*/ = 0;
}

/* ---- opt3007_init_ctx_setup.c ---- */
/* readable reconstruction; identity: FUN_0002e8fc @ 0x0002e8fc
 * public-name: opt3007_init_ctx_setup
 * durable-map: recon/catalogs/function_names_app.json
 * callees (readable <= raw @ address):
 *   opt3007_init_ctx_setup                   <= FUN_0002e8fc @ 0x0002e8fc
 * address symbols (name @ address):
 *   ADDR_opt3001_read_lux_raw_THUMB          @ 0x0002e649
 *   ADDR_opt3007_chip_init_THUMB             @ 0x0002e67d
 */
/* Reconstructed FUN_0002e8fc @ 0x2e8fc  (parity: 300/300 trials, PROVEN) */

void opt3007_init_ctx_setup(unsigned int *param_1) {
  param_1[7] = (unsigned int)param_1 - 0x430;
  param_1[0] = ADDR_opt3007_chip_init_THUMB /*=0x2e67d*/;
  param_1[3] = ADDR_opt3001_read_lux_raw_THUMB /*=0x2e649*/;
}

/* ---- fuel_gauge_read_voltage_current_temp.c ---- */
/* readable reconstruction; identity: FUN_0002e988 @ 0x0002e988
 * public-name: fuel_gauge_read_voltage_current_temp
 * durable-map: recon/catalogs/function_names_app.json
 * callees (readable <= raw @ address):
 *   fuel_gauge_read_voltage_current_temp     <= FUN_0002e988 @ 0x0002e988
 *   sensor_channel_get_trampoline            <= FUN_0007cef6 @ 0x0007cef6
 */
/* Reconstructed FUN_0002e988 @ 0x2e988  (parity: 300/300 trials, PROVEN) */
typedef uint32_t u32;
typedef int (*fp)(int,int);
extern void sensor_channel_get_trampoline(int,int,void*);
static inline float mkf(int b){ union{int i;float f;}u; u.i=b; return u.f; }
int fuel_gauge_read_voltage_current_temp(int param_1, float* param_2, float* param_3, float* param_4){
    int local[2];
    int iVar2 = (*(fp*)(*(int*)(param_1+8)+0xc))(param_1, 0x3a);
    if(iVar2 >= 0){
        float f = mkf(0x49742400);
        sensor_channel_get_trampoline(param_1, 0x28, local);
        *param_2 = (float)(int)local[1] / f + (float)(int)local[0];
        sensor_channel_get_trampoline(param_1, 0x2c, local);
        *param_4 = (float)(int)local[1] / f + (float)(int)local[0];
        sensor_channel_get_trampoline(param_1, 0x29, local);
        iVar2 = 0;
        *param_3 = (float)(int)local[1] / f + (float)(int)local[0];
    }
    return iVar2;
}

/* ---- fuel_gauge_sample_init_timestamp.c ---- */
/* readable reconstruction; identity: FUN_0002ea28 @ 0x0002ea28
 * public-name: fuel_gauge_sample_init_timestamp
 * durable-map: recon/catalogs/function_names_app.json
 * callees (readable <= raw @ address):
 *   batt_soc_curve_estimate                  <= FUN_0000e2b4 @ 0x0000e2b4
 *   fuel_gauge_read_voltage_current_temp     <= FUN_0002e988 @ 0x0002e988
 *   fuel_gauge_sample_init_timestamp         <= FUN_0002ea28 @ 0x0002ea28
 *   k_uptime_get_3                           <= FUN_0007ceda @ 0x0007ceda
 *   sensor_channel_get_trampoline            <= FUN_0007cef6 @ 0x0007cef6
 * address symbols (name @ address):
 *   g_fuel_gauge_init_timestamp              @ 0x20004790
 *   rodata_88a50                             @ 0x00088a50
  *
 * ITERATION 39 DEFECT FIX — the request record handed to batt_soc_curve_estimate
 * is FOUR words, not three.  Shipped prologue:
 *
 *   0002ea2c  ldr  r3, [pc, #0x40]   ; literal @0x2ea70 = 0x00088a50
 *   0002ea30  str  r3, [sp, #0x14]   ; <<< request[3] = the battery curve table
 *   0002ea3a  strd r4, r4, [sp, #8]  ; request[0] = request[1] = 0
 *   0002ea3e  str  r4, [sp, #0x10]   ; request[2] = 0
 *   0002ea40  bl   #0x2e988          ; read v/i/t into sp+8 / sp+0xc / sp+0x10
 *   0002ea54  add  r0, sp, #8        ; r0 = request
 *   0002ea56  bl   #0xe2b4
 *
 * batt_soc_curve_estimate NULL-checks word 3 (`ldr r3,[r0,#0xc]` / `cbz r3` ->
 * -EINVAL) and forwards it in r1 to battery_soc_curve_model_init, which
 * memcpy's 0x1600 bytes out of it into the estimator workspace.  Omitting the
 * store left a stale stack word there (measured 0x0009d5ba), which is
 * non-NULL, so the guard passed and 5632 bytes of unrelated .rodata became the
 * battery curve: the EKF covariance went to NaN and device_info[0xfc0] stuck
 * at 0 for the whole run, which held the `> 0x1d` gate in
 * handle_box_placement_event shut and suppressed both the SAADC's third
 * per-tick conversion call site and the ST25DV NDEF/WLC record write.
*/
/* Reconstructed FUN_0002ea28 @ 0x2ea28  (parity: 300/300 trials, PROVEN) */

extern int batt_soc_curve_estimate(void*, int);
extern int fuel_gauge_read_voltage_current_temp(int, float*, float*, float*);
extern unsigned long long k_uptime_get_3(void);

int fuel_gauge_sample_init_timestamp(int param_1)
{
    struct {
        unsigned char event[8];
        int first;
        int second;
        int third;
        const void *curve_table;
    } frame;
    int iVar1;

    frame.curve_table = (const void *)((unsigned long)&rodata_88a50) /*=0x88a50*/;
    frame.first = 0;
    frame.second = 0;
    frame.third = 0;
    iVar1 = fuel_gauge_read_voltage_current_temp(param_1, &frame.first, &frame.second, &frame.third);
    if (iVar1 >= 0) {
        sensor_channel_get_trampoline(param_1, 0x39, frame.event);
        iVar1 = batt_soc_curve_estimate(&frame.first, 0);
        if (iVar1 >= 0) {
            unsigned long long uVar2 = k_uptime_get_3();
            *(volatile unsigned long long *)((unsigned long)&g_fuel_gauge_init_timestamp) /*=0x20004790*/ = uVar2;
            iVar1 = 0;
        }
    }
    return iVar1;
}

/* ---- get_low_battery_flag_if_master.c ---- */
/* readable reconstruction; identity: FUN_0002efa8 @ 0x0002efa8
 * public-name: get_low_battery_flag_if_master
 * durable-map: recon/catalogs/function_names_app.json
 * callees (readable <= raw @ address):
 *   get_device_info                          <= FUN_000167a8 @ 0x000167a8
 *   get_low_battery_flag_if_master           <= FUN_0002efa8 @ 0x0002efa8
 * address symbols (name @ address):
 *   g_low_battery_sync_flag                  @ 0x2000302f
 */
/* Reconstructed FUN_0002efa8 @ 0x2efa8  (parity: 300/300 trials, PROVEN) */


unsigned char get_low_battery_flag_if_master(void)
{
    unsigned char *pcVar2 = get_device_info();
    unsigned char uVar1;
    if (*pcVar2 == 1) {
        uVar1 = *(volatile unsigned char *)((unsigned long)&g_low_battery_sync_flag) /*=0x2000302f*/;
    } else {
        uVar1 = 0;
    }
    return uVar1;
}

