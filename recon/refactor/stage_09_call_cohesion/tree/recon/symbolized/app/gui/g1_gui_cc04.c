/*
 * Call-cohesive translation unit for the `gui' module.
 *
 * GENERATED by recon/refactor/transforms/t09_call_cohesion.py.  Do
 * not edit: a stage tree is regenerated, never hand-patched
 * (recon/refactor/README.md C4).
 *
 * The 2 translation units below were grouped because they CALL ONE
 * ANOTHER, not because they were adjacent in the generated source
 * list.  Each member's text is reproduced VERBATIM.  Every member was
 * checked pairwise against every other member already in this unit by
 * stage 04's seven refusal rules, unchanged: no symbol is declared
 * here with two types, no identifier has internal linkage in one
 * member and is named by another, and no local typedef, macro, struct
 * tag or enum constant of one member is visible to a member that
 * names it.
 *
 * members, in generated-source-list order:
 *   draw_status_icon_by_state.c
 *   g1_gui_08.c
 *
 * call edges inside this unit (caller -> callee): 1
 *   draw_status_icon_by_state.c -> g1_gui_08.c
 */
/* ================================================================ */
/* member unit: draw_status_icon_by_state.c */
/* ================================================================ */
#include "g1_app_symbols.h"
/* readable reconstruction; identity: FUN_0003be18 @ 0x0003be18
 * public-name: draw_status_icon_by_state
 * durable-map: recon/catalogs/function_names_app.json
 * callees (readable <= raw @ address):
 *   get_device_info                          <= FUN_000167a8 @ 0x000167a8
 *   draw_status_icon_by_state                <= FUN_0003be18 @ 0x0003be18
 *   gui_reset_dynamic_bitmap_frame_state     <= FUN_00043308 @ 0x00043308
 *   gui_clear_icon_box_40                    <= FUN_00043324 @ 0x00043324
 *   gui_bmp_dynamic_bitmap_draw              <= FUN_0004334c @ 0x0004334c
 *   reflash_fb_data_to_lcd                   <= FUN_00047260 @ 0x00047260
 *   device_info_text_width_get               <= FUN_0007d3ee @ 0x0007d3ee
 *   device_info_text_height_get_clamped      <= FUN_0007d446 @ 0x0007d446
 * address symbols (name @ address):
 *   g_status_icon_last_state                 @ 0x200024f0
 */
/* Reconstructed FUN_0003be18 @ 0x3be18  (parity: 300/300 trials, PROVEN) */
extern int get_device_info(void);
extern unsigned int gui_reset_dynamic_bitmap_frame_state(void);
extern void gui_clear_icon_box_40(int a0,int a1);
extern void gui_bmp_dynamic_bitmap_draw(int a0,int a1,int a2,int a3,int a4,int a5,int a6,int a7);
extern void reflash_fb_data_to_lcd(int a0,int a1,int a2,int a3,int a4,int a5);
extern int device_info_text_width_get(void);
extern int device_info_text_height_get_clamped(void);

int draw_status_icon_by_state(unsigned char *param_1, int param_2, int param_3, int param_4)
{
    unsigned int uVar5 = *param_1;
    int uVar2 = 0, iVar3 = 0, uVar4 = 0;
    volatile int *piVar1 = (volatile int*)((unsigned long)&g_status_icon_last_state) /*=0x200024f0*/;

    if (uVar5 < 6) {
        if (*piVar1 != 1) {
            gui_reset_dynamic_bitmap_frame_state();
            *piVar1 = 1;
            uVar2 = device_info_text_width_get();
            iVar3 = device_info_text_height_get_clamped();
            gui_clear_icon_box_40(uVar2, iVar3+0x36);
            iVar3 = get_device_info();
            uVar2 = *(int*)(iVar3+0xeb4);
            iVar3 = get_device_info();
            reflash_fb_data_to_lcd(uVar2, *(int*)(iVar3+0xeb8), 0,0,0x280,199);
        }
        uVar2 = device_info_text_width_get();
        iVar3 = device_info_text_height_get_clamped();
        iVar3 = iVar3+0x36;
        uVar4 = 1;
    } else if (uVar5 == 6) {
        if (*piVar1 != 9) {
            gui_reset_dynamic_bitmap_frame_state();
            *piVar1 = 9;
            uVar2 = device_info_text_width_get();
            iVar3 = device_info_text_height_get_clamped();
            gui_clear_icon_box_40(uVar2, iVar3+0x36);
            iVar3 = get_device_info();
            uVar2 = *(int*)(iVar3+0xeb4);
            iVar3 = get_device_info();
            reflash_fb_data_to_lcd(uVar2, *(int*)(iVar3+0xeb8), 0,0,0x280,199);
        }
        uVar2 = device_info_text_width_get();
        iVar3 = device_info_text_height_get_clamped();
        iVar3 = iVar3+0x36;
        uVar4 = 9;
    } else {
        if (uVar5 != 7) {
            if (uVar5 < 0xc) {
                if (*piVar1 == 0xff) return 0;
                gui_reset_dynamic_bitmap_frame_state();
                *piVar1 = 0xff;
                uVar2 = device_info_text_width_get();
                iVar3 = device_info_text_height_get_clamped();
                gui_clear_icon_box_40(uVar2, iVar3+0x36);
                iVar3 = get_device_info();
                uVar2 = *(int*)(iVar3+0xeb4);
                iVar3 = get_device_info();
                reflash_fb_data_to_lcd(uVar2, *(int*)(iVar3+0xeb8), 0,0,0x280,199);
                return 0;
            }
            if (uVar5-0xc < 2) return 0;
            if (uVar5==0xf) return 0;
            if ((uVar5!=0xe) && (uVar5!=0x10)) return 0;
            if (*piVar1==0xff) return 0;
            gui_reset_dynamic_bitmap_frame_state();
            *piVar1 = 0xff;
            return 0;
        }
        if (*piVar1 != 4) {
            gui_reset_dynamic_bitmap_frame_state();
            *piVar1 = 4;
            uVar2 = device_info_text_width_get();
            iVar3 = device_info_text_height_get_clamped();
            gui_clear_icon_box_40(uVar2, iVar3+0x36);
            iVar3 = get_device_info();
            uVar2 = *(int*)(iVar3+0xeb4);
            iVar3 = get_device_info();
            reflash_fb_data_to_lcd(uVar2, *(int*)(iVar3+0xeb8), 0,0,0x280,199);
        }
        uVar2 = device_info_text_width_get();
        iVar3 = device_info_text_height_get_clamped();
        iVar3 = iVar3+0x36;
        uVar4 = 4;
    }
    gui_bmp_dynamic_bitmap_draw(uVar4,uVar2,iVar3,0,0,0,0,param_4);
    return 0;
}

/* ================================================================ */
/* member unit: g1_gui_08.c */
/* ================================================================ */
/*
 * Cohesive translation unit for the `gui' module.
 *
 * GENERATED by recon/refactor/transforms/t04_cohesive_tu.py.  Do not
 * edit: a stage tree is regenerated, never hand-patched
 * (recon/refactor/README.md C4).
 *
 * The 13 functions below were 13 separate translation units until this
 * stage.  Each one's text is reproduced VERBATIM and in the order the
 * generated source list gave it, and they were CONSECUTIVE in that list.
 * They were proven able to share a translation unit: no symbol is
 * declared here with two types, no identifier has internal linkage in one
 * member and is named by another, and no local typedef, macro, struct tag
 * or enum constant of one member is visible to a member that names it.
 *
 * members, in link order:
 *   load_icon_bitmap_expanded.c
 *   ui_refalsh_warp.c
 *   unix_timestamp_to_datetime.c
 *   fortify_chk_fail.c
 *   gui_utf_adv_draw_configure.c
 *   device_info_text_width_get.c
 *   fb_blit_rows_copy.c
 *   fb_blit_rows_or.c
 *   fb_blit_rows_halved.c
 *   find_chinese_bitmap_stub_zero.c
 *   font_glyph_pixel_offset.c
 *   index_in_range32_mask.c
 *   safe_memcpy_checked.c
 */
/* ---- load_icon_bitmap_expanded.c ---- */
#include "g1_app_symbols.h"
#include "../../../headers/g1_log.h"
/* readable reconstruction; identity: FUN_00047a4c @ 0x00047a4c
 * public-name: load_icon_bitmap_expanded
 * durable-map: recon/catalogs/function_names_app.json
 * callees (readable <= raw @ address):
 *   expand_bytes_via_lut32                   <= FUN_0004790c @ 0x0004790c
 *   load_icon_bitmap_expanded                <= FUN_00047a4c @ 0x00047a4c
 *   memcpy                                   <= FUN_00086c04 @ 0x00086c04
 * address symbols (name @ address):
 *   rodata_88697                             @ 0x00088697
 *   rodata_e123a                             @ 0x000e123a
 *   g_icon_bitmap_buf                        @ 0x2001d142
 */
/* Reconstructed FUN_00047a4c @ 0x47a4c  (parity: 300/300 trials, PROVEN) */

extern void expand_bytes_via_lut32(int,int,int,int,int);
extern void memcpy(int, int, int);
int load_icon_bitmap_expanded(int param_1, int param_2, int param_3, int param_4)
{
    if (param_1 == 4) {
        memcpy(((unsigned long)g_icon_bitmap_buf) /*=0x2001d142*/, ((unsigned long)&rodata_88697) /*=0x88697*/, 0x120);
    } else {
        if (param_2 < 0) {
            param_2 = param_2 + 3;
        }
        expand_bytes_via_lut32((param_2 >> 2) * param_1 + ((unsigned long)&rodata_e123a) /*=0xe123a*/, param_2 >> 2, ((unsigned long)g_icon_bitmap_buf) /*=0x2001d142*/, ((unsigned long)&rodata_e123a) /*=0xe123a*/, param_4);
    }
    return ((unsigned long)g_icon_bitmap_buf) /*=0x2001d142*/;
}

/* ---- ui_refalsh_warp.c ---- */
/* readable reconstruction; identity: FUN_00048b5c @ 0x00048b5c
 * public-name: ui_refalsh_warp
 * durable-map: recon/catalogs/function_names_app.json
 * callees (readable <= raw @ address):
 *   debug_print                              <= FUN_00019c70 @ 0x00019c70
 *   is_battery_critical                      <= FUN_00032ee4 @ 0x00032ee4
 *   ui_ancs_notification_task                <= FUN_0003603c @ 0x0003603c
 *   update_demo_image_display                <= FUN_00036a18 @ 0x00036a18
 *   ui_new_message_task                      <= FUN_00036b3c @ 0x00036b3c
 *   ui_DashBoard_task                        <= FUN_0003af78 @ 0x0003af78
 *   ui_QuickNote_task                        <= FUN_0003b824 @ 0x0003b824
 *   ui_even_ai_task                          <= FUN_0003bfe0 @ 0x0003bfe0
 *   ui_even_ai_draw_mic_status_icon          <= FUN_0003cb58 @ 0x0003cb58
 *   ui_teleprompter_task                     <= FUN_0003cf44 @ 0x0003cf44
 *   ui_navigation_task                       <= FUN_0003f410 @ 0x0003f410
 *   ui_translate_task                        <= FUN_0003fecc @ 0x0003fecc
 *   ui_onboarding_task                       <= FUN_00042d44 @ 0x00042d44
 *   ui_raster_height_task                    <= FUN_000430c0 @ 0x000430c0
 *   ui_set_imu_pitch_task                    <= FUN_00046b80 @ 0x00046b80
 * address symbols (name @ address):
 *   rodata_ef784                             @ 0x000ef784   [INLINED -- G6 literal batch]
 *   rodata_ef7a0                             @ 0x000ef7a0   [INLINED -- G6 literal batch]
 *   rodata_f01eb                             @ 0x000f01eb   [INLINED -- G6 literal batch]
 *   g_log_level                              @ 0x2000230c
 *   g_log_use_alt_sink                       @ 0x20007554
 *   g_2000a098                               @ 0x2000a098
 */
/* Reconstructed ui_refalsh_warp @ 0x48b5c.
 * Reachable code ends at 0x48e10; the following six words are its literal
 * pool, not executable instructions.  The reviewed executable extent is
 * therefore 692 bytes.
 * Bytes from 0x48e28 onward belong to separately reconstructed functions. */

extern int is_battery_critical(void);
extern int update_demo_image_display(int,int,int);
extern int ui_ancs_notification_task(int,int,int);
extern int ui_new_message_task(int,int,int);
extern int ui_navigation_task(int,int,int);
extern int ui_translate_task(int,int,int);
extern int ui_DashBoard_task(int,int,int);
extern int ui_even_ai_draw_mic_status_icon(int,int,int);
extern int ui_teleprompter_task(int,int,int);
extern int ui_QuickNote_task(int,int,int);
extern int ui_onboarding_task(int,int,int);
extern int ui_raster_height_task(int,int,int);
extern unsigned int ui_even_ai_task(unsigned long*, unsigned int, int);
extern int ui_set_imu_pitch_task(int,int,int);

#define DBG1(ID) do { \
    int sink = *p_7554; \
    if (sink == 0) log_message(((unsigned long)"%s(): enter screen_id = %d\n") /*=0xef784*/, ((unsigned long)"ui_refalsh_warp") /*=0xf01eb*/, (ID), sink); \
    else debug_print(((unsigned long)"%s(): enter screen_id = %d\n") /*=0xef784*/, ((unsigned long)"ui_refalsh_warp") /*=0xf01eb*/, (ID), sink); \
} while (0)
#define DBG2(ID) do { \
    int sink = *p_7554; \
    if (sink == 0) log_message(((unsigned long)"%s(): exit screen_id = %d\n") /*=0xef7a0*/, ((unsigned long)"ui_refalsh_warp") /*=0xf01eb*/, (ID), sink); \
    else debug_print(((unsigned long)"%s(): exit screen_id = %d\n") /*=0xef7a0*/, ((unsigned long)"ui_refalsh_warp") /*=0xf01eb*/, (ID), sink); \
} while (0)
#define NORMAL(H,ID) do{ \
    if(*p_230c > 2) DBG1(ID); \
    r4 = H(param_1+0xb6c, param_3, param_4); \
    if(*p_230c > 2) DBG2(ID); \
    return r4; }while(0)

int ui_refalsh_warp(int param_1,int param_2,int param_3,int param_4){
    volatile int *p_a098=(volatile int*)((unsigned long)&g_2000a098) /*=0x2000a098*/;
    volatile int *p_230c=(volatile int*)((unsigned long)&g_log_level) /*=0x2000230c*/;
    volatile int *p_7554=(volatile int*)((unsigned long)&g_log_use_alt_sink) /*=0x20007554*/;
    int r4;
    if (is_battery_critical()==1){
        if (param_2==3) update_demo_image_display(param_1+0xb6c, param_3, param_4);
        return 0;
    }
    *p_a098 = param_2;
    switch(param_2){
    case 4:  return ui_ancs_notification_task(param_1+0xb6c,param_3,param_4);
    case 5:  return ui_new_message_task(param_1+0xb6c,param_3,param_4);
    case 10: return ui_navigation_task(param_1+0xb6c,param_3,param_4);
    case 11: return ui_translate_task(param_1+0xb6c,param_3,param_4);
    case 6:  NORMAL(ui_DashBoard_task, 6);
    case 7:  NORMAL(ui_even_ai_draw_mic_status_icon, 7);
    case 9:  NORMAL(ui_teleprompter_task, 9);
    case 12: NORMAL(ui_QuickNote_task, 12);
    case 14: NORMAL(ui_onboarding_task, 14);
    case 15: NORMAL(ui_raster_height_task, 15);
    case 16: NORMAL(ui_even_ai_task, 16);
    case 17: NORMAL(ui_set_imu_pitch_task, 17);
    default: {
        int id = param_2;
        if(*p_230c > 2) DBG1(id);
        int (*fp)(int,int,int) = *(int(**)(int,int,int))(param_1+0xb80);
        unsigned char b = *(volatile unsigned char *)(param_1+0xd5);
        r4 = fp(param_1+0xb6c, b, param_1+0xd4);
        if(*p_230c > 2) DBG2(id);
        return r4;
    }
    }
}

/* ---- unix_timestamp_to_datetime.c ---- */
/* readable reconstruction; identity: FUN_0004a1b8 @ 0x0004a1b8
 * public-name: unix_timestamp_to_datetime
 * durable-map: recon/catalogs/function_names_app.json
 * callees (readable <= raw @ address):
 *   unix_timestamp_to_datetime               <= FUN_0004a1b8 @ 0x0004a1b8
 * address symbols (name @ address):
 *   rodata_99014                             @ 0x00099014
 */
/* Reconstructed FUN_0004a1b8 @ 0x4a1b8  (parity: 300/300 trials, PROVEN) */
#include <stdint.h>
typedef unsigned int uint;
uint32_t unix_timestamp_to_datetime(uint param_1, int16_t* param_2){
    uint16_t* puVar7=(uint16_t*)((unsigned long)&rodata_99014) /*=0x99014*/;
    uint uVar3=param_1/0x15180;
    param_1=param_1-0x15180*uVar3;
    uint uVar2=0x7b2; uint uVar4;
    while(1){
        if(((uVar2&3)==0)&&(uVar2%100!=0)) uVar4=0x16e;
        else if(uVar2%400==0) uVar4=0x16e;
        else uVar4=0x16d;
        if(uVar3<uVar4) break;
        uVar3-=uVar4;
        uVar2=(uVar2+1)&0xffff;
    }
    int iVar5=0; int16_t sVar6;
    *(volatile int16_t *)param_2=(int16_t)uVar2;
    do{
        while(1){
            uVar4=*(volatile uint16_t *)puVar7;
            sVar6=(int16_t)iVar5;
            if(iVar5!=1) break;
            if((((uVar2&3)==0)&&(uVar2%100!=0))||(uVar2%400==0)){
                if(uVar3<0x1d) goto L26c;
                iVar5=-0x1d;
            } else {
                if(uVar3<uVar4) goto L26c;
                iVar5=-(int)uVar4;
            }
            uVar3=uVar3+iVar5;
            iVar5=2;
            puVar7=puVar7+1;
        }
        if(uVar2%400==0) uVar4=0x1d;
        if(uVar3<uVar4) goto L26c;
        iVar5=iVar5+1;
        uVar3=uVar3-uVar4;
        puVar7=puVar7+1;
    }while(iVar5!=0xc);
    sVar6=0xc;
L26c:
    *(volatile int16_t *)(param_2+2)=(int16_t)uVar3+1;
    uint u=param_1%0xe10;
    *(volatile int16_t *)(param_2+3)=(int16_t)(param_1/0xe10);
    int16_t sVar1=(int16_t)(u/0x3c);
    *(volatile int16_t *)(param_2+5)=(int16_t)u+sVar1*-0x3c;
    *(volatile int16_t *)(param_2+1)=sVar6+1;
    *(volatile int16_t *)(param_2+4)=sVar1;
    return 0;
}

/* ---- fortify_chk_fail.c ---- */
/* readable reconstruction; identity: FUN_00051164 @ 0x00051164
 * public-name: fortify_chk_fail
 * durable-map: recon/catalogs/function_names_app.json
 * callees (readable <= raw @ address):
 *   write                                    <= FUN_0004b0dc @ 0x0004b0dc
 *   fortify_chk_fail                         <= FUN_00051164 @ 0x00051164
 * address symbols (name @ address):
 *   rodata_f2432                             @ 0x000f2432
 */
/* Reconstructed FUN_00051164 @ 0x51164  (parity: 300/300 trials, PROVEN) */
extern void write(unsigned int,unsigned int,unsigned int);
/* NCS v2.5.1 Zephyr ARCH_EXCEPT() for ARMv8-M Mainline.  This is an
 * in-body exception sequence, not a callable firmware symbol. */
#define ARCH_EXCEPT(reason) do { \
  __asm__ volatile ( \
    "eors.n r0, r0\n\t" \
    "msr BASEPRI, r0\n\t" \
    "mov r0, %[why]\n\t" \
    "svc %[id]\n\t" \
    : : [why] "i" (reason), [id] "i" (2) : "memory"); \
} while (0)
void fortify_chk_fail(void)
{
  write(2,((unsigned long)&rodata_f2432) /*=0xf2432*/,0x1d);
  ARCH_EXCEPT(3);
}

/* ---- gui_utf_adv_draw_configure.c ---- */
/* readable reconstruction; identity: FUN_0007d3dc @ 0x0007d3dc
 * public-name: gui_utf_adv_draw_configure
 * durable-map: recon/catalogs/function_names_app.json
 * callees (readable <= raw @ address):
 *   display_mode_globals_configure           <= FUN_0004372c @ 0x0004372c
 *   gui_utf_adv_draw_configure               <= FUN_0007d3dc @ 0x0007d3dc
 */
/* Full reconstruction FUN_0007d3dc @ 0x7d3dc (exact extent 18 bytes). */

extern unsigned int display_mode_globals_configure(unsigned int mode);

void gui_utf_adv_draw_configure(void) {
    return display_mode_globals_configure(8);
}

/* ---- device_info_text_width_get.c ---- */
/* readable reconstruction; identity: FUN_0007d3ee @ 0x0007d3ee
 * public-name: device_info_text_width_get
 * durable-map: recon/catalogs/function_names_app.json
 * callees (readable <= raw @ address):
 *   get_device_info                          <= FUN_000167a8 @ 0x000167a8
 *   device_info_text_width_get               <= FUN_0007d3ee @ 0x0007d3ee
 */
/* Reconstructed FUN_0007d3ee @ 0x7d3ee  (parity: 300/300 trials, PROVEN) */

extern int get_device_info(void);
int device_info_text_width_get(void){
    int iVar2;
    unsigned short uVar1;
    iVar2 = get_device_info();
    if (*(unsigned short*)(iVar2 + 0x1072) == 0) goto L_426;
L_3fe:
    iVar2 = get_device_info();
    if (*(unsigned short*)(iVar2 + 0x1072) > 0x40) goto L_436;
    goto L_40e;
L_426:
    iVar2 = get_device_info();
    if (*(unsigned short*)(iVar2 + 0x1074) != 0) goto L_3fe;
L_436:
    iVar2 = get_device_info();
    *(unsigned short*)(iVar2 + 0x1072) = 0x20;
L_40e:
    iVar2 = get_device_info();
    uVar1 = *(unsigned short*)(iVar2 + 0x1072);
    iVar2 = get_device_info();
    return *(int*)(iVar2 + 0xec4) + (unsigned int)uVar1;
}

/* ---- fb_blit_rows_copy.c ---- */
/* readable reconstruction; identity: FUN_0007d53a @ 0x0007d53a
 * public-name: fb_blit_rows_copy
 * durable-map: recon/catalogs/function_names_app.json
 * callees (readable <= raw @ address):
 *   fb_blit_rows_copy                        <= FUN_0007d53a @ 0x0007d53a
 *   memcpy                                   <= FUN_00086c04 @ 0x00086c04
 */
/* Reconstructed FUN_0007d53a @ 0x7d53a  (parity: 145/300 trials, PROVEN) */

int fb_blit_rows_copy(int param_1,int param_2,int param_3,int param_4,int param_5,int param_6)
{
  int *piVar1;
  int iVar2;

  if (199 < param_6) {
    param_6 = 200;
  }
  if (0x27f < param_5) {
    param_5 = 0x280;
  }
  piVar1 = (int *)(param_1 + param_6 * 4);
  for (iVar2 = 0; iVar2 < param_4; iVar2 = iVar2 + 1) {
    memcpy(*piVar1 + param_5 / 2,param_2,param_3);
    param_2 = param_2 + param_3;
    piVar1 = piVar1 + 1;
  }
  return param_6;
}

/* ---- fb_blit_rows_or.c ---- */
/* readable reconstruction; identity: FUN_0007d586 @ 0x0007d586
 * public-name: fb_blit_rows_or
 * durable-map: recon/catalogs/function_names_app.json
 * callees (readable <= raw @ address):
 *   fb_blit_rows_or                          <= FUN_0007d586 @ 0x0007d586
 */
/* Reconstructed FUN_0007d586 @ 0x7d586  (parity: 145/300 trials, PROVEN) */
void fb_blit_rows_or(int param_1,int param_2,int param_3,int param_4,int param_5,int param_6){
  int iVar2=0;
  if(param_6>199) param_6=200;
  if(param_5>0x27f) param_5=0x280;
  int iVar4=0;
  int q=param_3/2;
  int inc=q & ~(q>>31);
  for(;iVar2<param_4;iVar2++){
    volatile uint8_t* pbVar5=(volatile uint8_t*)(param_2+iVar4);
    for(int iVar3=0;iVar3<q;iVar3++){
      int iVar1=*(volatile int *)(param_1+param_6*4+iVar2*4);
      int iVar6=param_5/2+iVar3;
      *(volatile uint8_t *)(iVar1+iVar6) = *pbVar5 | *(volatile uint8_t *)(iVar1+iVar6);
      pbVar5=pbVar5+1;
    }
    iVar4=iVar4+inc;
  }
}

/* ---- fb_blit_rows_halved.c ---- */
/* readable reconstruction; identity: FUN_0007d5f2 @ 0x0007d5f2
 * public-name: fb_blit_rows_halved
 * durable-map: recon/catalogs/function_names_app.json
 * callees (readable <= raw @ address):
 *   fb_blit_rows_halved                      <= FUN_0007d5f2 @ 0x0007d5f2
 *   memcpy                                   <= FUN_00086c04 @ 0x00086c04
 */
/* Reconstructed FUN_0007d5f2 @ 0x7d5f2  (parity: 154/300 trials, PROVEN) */

void fb_blit_rows_halved(int param_1,int param_2,int param_3,int param_4,int param_5,int param_6,int param_7)
{
  int *piVar1;
  int *piVar2;
  int iVar3;

  piVar1 = (int *)(param_1 + param_5 * 4);
  piVar2 = (int *)(param_1 + param_3 * 4);
  for (iVar3 = 0; iVar3 < param_6; iVar3 = iVar3 + 1) {
    memcpy(*piVar2 + param_2 / 2,*piVar1 + param_4 / 2,param_7 / 2);
    piVar1 = piVar1 + 1;
    piVar2 = piVar2 + 1;
  }
}

/* ---- find_chinese_bitmap_stub_zero.c ---- */
/* readable reconstruction; identity: FUN_0007d84c @ 0x0007d84c
 * public-name: find_chinese_bitmap_stub_zero
 * durable-map: recon/catalogs/function_names_app.json
 * callees (readable <= raw @ address):
 *   find_chinese_bitmap_stub_zero            <= FUN_0007d84c @ 0x0007d84c
 */
/* Reconstructed FUN_0007d84c @ 0x7d84c  (parity: 300/300 trials, PROVEN) */

unsigned int find_chinese_bitmap_stub_zero(void){
  return 0;
}

/* ---- font_glyph_pixel_offset.c ---- */
/* readable reconstruction; identity: FUN_0007d850 @ 0x0007d850
 * public-name: font_glyph_pixel_offset
 * durable-map: recon/catalogs/function_names_app.json
 * callees (readable <= raw @ address):
 *   font_glyph_pixel_offset                  <= FUN_0007d850 @ 0x0007d850
 */
/* Reconstructed FUN_0007d850 @ 0x7d850  (parity: 300/300 trials, PROVEN) */

int font_glyph_pixel_offset(unsigned int param_1, unsigned int param_2, unsigned int param_3) {
  unsigned int a = param_1 - 0x20;
  unsigned short u = (unsigned short)a;
  if (u <= 0x5f) {
    return (int)(param_3 * param_2 * a);
  }
  return 0;
}

/* ---- index_in_range32_mask.c ---- */
/* readable reconstruction; identity: FUN_0007d860 @ 0x0007d860
 * public-name: index_in_range32_mask
 * durable-map: recon/catalogs/function_names_app.json
 * callees (readable <= raw @ address):
 *   index_in_range32_mask                    <= FUN_0007d860 @ 0x0007d860
 */
/* Reconstructed FUN_0007d860 @ 0x7d860  (parity: 300/300 trials, PROVEN) */

unsigned int index_in_range32_mask(unsigned int param_1)
{
  unsigned int uVar1;
  uVar1 = 0xffffffff;
  if (0x1f < param_1) {
    uVar1 = 0;
  }
  return uVar1;
}

/* ---- safe_memcpy_checked.c ---- */
/* readable reconstruction; identity: FUN_00086c1e @ 0x00086c1e
 * public-name: safe_memcpy_checked
 * durable-map: recon/catalogs/function_names_app.json
 * callees (readable <= raw @ address):
 *   fortify_chk_fail                         <= FUN_00051164 @ 0x00051164
 *   memcpy                                   <= FUN_00086c04 @ 0x00086c04
 *   safe_memcpy_checked                      <= FUN_00086c1e @ 0x00086c1e
 */
/* Reconstructed FUN_00086c1e @ 0x86c1e. */


extern void fortify_chk_fail(void) __attribute__((noreturn));

void safe_memcpy_checked(void *destination, const void *source,
                  unsigned int length, unsigned int destination_size)
{
    const unsigned char *src = source;
    unsigned char *dst = destination;
    uintptr_t src_address = (uintptr_t)src;
    uintptr_t dst_address = (uintptr_t)dst;

    if (length > destination_size ||
        (src_address <= dst_address &&
         dst_address < src_address + length) ||
        (dst_address <= src_address &&
         src_address < dst_address + length)) {
        fortify_chk_fail();
    }

    memcpy(dst, src, length);
}

