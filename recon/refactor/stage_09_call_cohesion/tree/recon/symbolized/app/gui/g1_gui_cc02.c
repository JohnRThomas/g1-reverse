/*
 * Call-cohesive translation unit for the `gui' module.
 *
 * GENERATED by recon/refactor/transforms/t09_call_cohesion.py.  Do
 * not edit: a stage tree is regenerated, never hand-patched
 * (recon/refactor/README.md C4).
 *
 * The 2 translation units below were grouped because they CALL ONE
 * ANOTHER, not because they were adjacent in the generated source
 * list.  Each member's text is reproduced VERBATIM.  Every member was
 * checked pairwise against every other member already in this unit by
 * stage 04's seven refusal rules, unchanged: no symbol is declared
 * here with two types, no identifier has internal linkage in one
 * member and is named by another, and no local typedef, macro, struct
 * tag or enum constant of one member is visible to a member that
 * names it.
 *
 * members, in generated-source-list order:
 *   draw_message.c
 *   gui_bmp_bitmap_draw.c
 *
 * call edges inside this unit (caller -> callee): 1
 *   draw_message.c -> gui_bmp_bitmap_draw.c
 */

/* File-scope forward declarations for every struct/union tag this
 * unit names.  Without them a tag whose only appearance in a member
 * is inside a parameter list has PARAMETER-LIST scope, so two
 * textually IDENTICAL declarations in two members declare two
 * different incomplete types and the second is a conflicting
 * redeclaration (C11 6.2.1p7).  Incomplete-type forward
 * declarations emit no code. */
struct notification_message;
/* ================================================================ */
/* member unit: draw_message.c */
/* ================================================================ */
#include "g1_app_symbols.h"
/* readable reconstruction; identity: FUN_00035afc @ 0x00035afc
 * public-name: draw_message
 * durable-map: recon/catalogs/function_names_app.json
 * address symbols (name @ address):
 *   rodata_a8bcd                             @ 0x000a8bcd   [INLINED -- G6 literal batch]
 *   rodata_a8be6                             @ 0x000a8be6   [INLINED -- G6 literal batch]
 *   rodata_a8c09                             @ 0x000a8c09   [INLINED -- G6 literal batch]
 *   rodata_a8c11                             @ 0x000a8c11   [INLINED -- G6 literal batch]
 *   rodata_a8c34                             @ 0x000a8c34   [INLINED -- G6 literal batch]
 *   rodata_a8c37                             @ 0x000a8c37
 *   rodata_a8c3a                             @ 0x000a8c3a   [INLINED -- G6 literal batch]
 *   rodata_a8ce7                             @ 0x000a8ce7   [INLINED -- G6 literal batch]
 *   rodata_f4ca5                             @ 0x000f4ca5
 *   g_log_use_alt_sink                       @ 0x20007554
 */
/* Reconstructed draw_message @ 0x35afc; reviewed executable extent 0x41e bytes.
 * Raw identity: FUN_00035afc.  The bytes at 0x35f1c..0x35f27 are its literal
 * pool, not executable code. */
#include <stdint.h>

/* Keep stable raw link identities while making the recovered body readable. */
extern void debug_log(uintptr_t format, ...) __asm__("DEBUG_PRINT");
extern void buffered_debug_log(uintptr_t format, ...) __asm__("FUN_00019c70");
extern uint8_t current_notification_slot(void) __asm__("FUN_00034390");
extern int notification_icon_type_from_package(uint32_t slot);
extern void format_message_relative_time(unsigned int, int);
extern int gui_bmp_bitmap_draw(unsigned int, int, int, int, int, int);
extern void gui_utf_draw(uint32_t, const char *, uint32_t, uint32_t, uint32_t,
                         uint32_t, uint32_t, uint32_t, uint32_t, uint32_t,
                         uint32_t, uint32_t);
extern void gui_utf_draw_truncate(uint32_t, const char *, uint32_t, uint32_t,
                                  uint32_t, uint32_t, uint32_t, uint32_t,
                                  uint32_t, uint32_t, uint32_t, uint32_t);
extern void gui_utf_draw_middle(uint32_t, const char *, uint32_t, uint32_t,
                                uint32_t, uint32_t, uint32_t, uint32_t,
                                uint32_t, uint32_t, uint32_t, uint32_t);
extern void gui_utf_Wordwrap_draw(uint32_t, const char *, uint32_t, uint32_t,
                                  uint32_t, uint32_t, uint32_t, uint32_t,
                                  uint32_t, uint32_t, uint32_t, uint32_t);
extern int bounded_snprintf(char *output, uint32_t capacity,
                            uintptr_t format, ...) __asm__("FUN_00077914");
extern uint32_t display_text_width(void) __asm__("FUN_0007d3ee");
extern uint32_t display_text_height(void) __asm__("FUN_0007d446");
extern void clear_bytes(void *output, uint32_t value,
                        uint32_t length) __asm__("FUN_00086c78");
extern void format_uint_bounded(void *output, uint32_t reserved,
                                int32_t capacity, uintptr_t format,
                                uint32_t value) __asm__("FUN_00086f00");

/* Notification record used by the draw queue.  Each text field is a fixed
 * 32-byte slot; retaining the offsets documents every pointer seen in the
 * original code without inventing ownership beyond the last accessed field. */
struct notification_message {
    uint32_t received_at;                 /* +0x00 */
    uint8_t reserved_04[0x2c];
    char title[0x20];                     /* +0x30 */
    char body[0x20];                      /* +0x50 */
    char subtitle[0x20];                  /* +0x70 */
    char package_name[0x20];              /* +0x90 */
};

enum notification_icon_type {
    ICON_TYPE_SMS = 0,
    ICON_TYPE_MISSED_CALL = 1,
    ICON_TYPE_IN_CALL = 2,
    ICON_TYPE_PACKAGE_GROUP_3 = 3,
    ICON_TYPE_PACKAGE_GROUP_4 = 4,
};

enum notification_bitmap {
    BITMAP_IN_CALL = 0x36,
    BITMAP_MISSED_CALL = 0x37,
    BITMAP_SMS_OR_DEFAULT = 0x38,
    BITMAP_PACKAGE_GROUP_4 = 0x39,
    BITMAP_PACKAGE_GROUP_3 = 0x3a,
    BITMAP_CLOCK = 0x3c,
};

#define DEBUG_SINK_MODE (*(volatile uint32_t *)((unsigned long)&g_log_use_alt_sink) /*=0x20007554*/)

#define LOG_FUNCTION_NAME       ((uintptr_t)((unsigned long)"draw_message") /*=0xa8ce7*/) /* "draw_message" */
#define LOG_NULL_MESSAGE        ((uintptr_t)((unsigned long)"[%s-%d]curMsg is NULL !\n") /*=0xa8bcd*/)
#define LOG_MESSAGE_TYPE        ((uintptr_t)((unsigned long)"show msgType is %d unReadCount %d\n") /*=0xa8be6*/)
#define FORMAT_STRING           ((uintptr_t)((unsigned long)&rodata_a8c37) /*=0xa8c37*/) /* "%s" */
#define FORMAT_TITLE_SUBTITLE   ((uintptr_t)((unsigned long)"%s | %s") /*=0xa8c09*/) /* "%s | %s" */
#define LOG_MESSAGE             ((uintptr_t)((unsigned long)"recvTime is %u,curMsg->message %s\n") /*=0xa8c11*/)
#define FORMAT_COUNTER          ((uintptr_t)((unsigned long)&rodata_f4ca5) /*=0xf4ca5*/) /* "%u" */
#define FORMAT_BODY_PACKAGE_NL  ((uintptr_t)((unsigned long)"%s\n%s") /*=0xa8c34*/) /* "%s\n%s" */
#define FORMAT_BODY_PACKAGE_DASH ((uintptr_t)((unsigned long)"%s - %s") /*=0xa8c3a*/) /* "%s - %s" */

void draw_message(uint32_t unread_count, struct notification_message *message)
{
    /* These split initializations reproduce the four firmware-owned local
     * objects exactly: the memset calls begin four bytes into each large
     * buffer, while the leading word is cleared directly. */
    char heading[72];
    char relative_time[32];
    uint32_t count_text[2];
    char body_text[292];
    uint32_t icon_type;
    uint32_t x1, y1, x2, y2;
    const char *heading_source;

    *(uint32_t *)heading = 0;
    clear_bytes(heading + 4, 0, 68);
    *(uint32_t *)relative_time = 0;
    clear_bytes(relative_time + 4, 0, 28);
    count_text[0] = 0;
    count_text[1] = 0;
    *(uint32_t *)body_text = 0;
    clear_bytes(body_text + 4, 0, 0x11f);

    if (message == 0) {
        if (DEBUG_SINK_MODE != 0)
            buffered_debug_log(LOG_NULL_MESSAGE, LOG_FUNCTION_NAME, 0xdb);
        else
            debug_log(LOG_NULL_MESSAGE, LOG_FUNCTION_NAME, 0xdb);
        return;
    }

    icon_type = (uint32_t)notification_icon_type_from_package(
        current_notification_slot());
    if (DEBUG_SINK_MODE == 0)
        debug_log(LOG_MESSAGE_TYPE, icon_type, unread_count);
    else
        buffered_debug_log(LOG_MESSAGE_TYPE, icon_type, unread_count);

    switch (icon_type) {
    case ICON_TYPE_SMS:
        x1 = display_text_width();
        y1 = display_text_height();
        gui_bmp_bitmap_draw(BITMAP_SMS_OR_DEFAULT, x1, y1 + 4, 0, 0, 0);
        clear_bytes(heading, 0, 72);
        heading_source = message->title;
        break;

    case ICON_TYPE_MISSED_CALL:
        x1 = display_text_width();
        y1 = display_text_height();
        gui_bmp_bitmap_draw(BITMAP_MISSED_CALL, x1, y1 + 4, 0, 0, 0);
        clear_bytes(heading, 0, 72);
        heading_source = message->package_name;
        break;

    case ICON_TYPE_IN_CALL:
        clear_bytes(heading, 0, 72);
        bounded_snprintf(heading, 72, FORMAT_STRING, message->package_name);
        x1 = display_text_width();
        y1 = display_text_height();
        x2 = display_text_width();
        y2 = display_text_height();
        gui_utf_draw_middle(0, heading, 0, x1, y1 + 0x36,
                            x2 + 0x240, y2 + 0x51, 1, 0, 0, 0, 0);

        x1 = display_text_width();
        y1 = display_text_height();
        gui_bmp_bitmap_draw(BITMAP_IN_CALL, x1, y1 + 0x3a, 0, 0, 0);

        clear_bytes(body_text, 0, 0x123);
        bounded_snprintf(body_text, 0x123, FORMAT_STRING, message->body);
        if (body_text[0] == '\0')
            return;
        x1 = display_text_width();
        y1 = display_text_height();
        x2 = display_text_width();
        y2 = display_text_height();
        gui_utf_draw_middle(0, body_text, 0, x1, y1 + 0x51,
                            x2 + 0x240, y2 + 0x51, 1, 0, 0, 0, 0);
        return;

    case ICON_TYPE_PACKAGE_GROUP_3:
        x1 = display_text_width();
        y1 = display_text_height();
        gui_bmp_bitmap_draw(BITMAP_PACKAGE_GROUP_3, x1, y1 + 4, 0, 0, 0);
        clear_bytes(heading, 0, 72);
        bounded_snprintf(heading, 72, FORMAT_TITLE_SUBTITLE,
                         message->title, message->subtitle);
        goto draw_heading;

    case ICON_TYPE_PACKAGE_GROUP_4:
        x1 = display_text_width();
        y1 = display_text_height();
        gui_bmp_bitmap_draw(BITMAP_PACKAGE_GROUP_4, x1, y1 + 4, 0, 0, 0);
        clear_bytes(heading, 0, 72);
        heading_source = message->title;
        break;

    default:
        x1 = display_text_width();
        y1 = display_text_height();
        gui_bmp_bitmap_draw(BITMAP_SMS_OR_DEFAULT, x1, y1 + 4, 0, 0, 0);
        clear_bytes(heading, 0, 72);
        if (message->subtitle[0] != '\0') {
            bounded_snprintf(heading, 72, FORMAT_TITLE_SUBTITLE,
                             message->title, message->subtitle);
            goto draw_heading;
        }
        heading_source = message->title;
        break;
    }

    bounded_snprintf(heading, 72, FORMAT_STRING, heading_source);

draw_heading:
    x1 = display_text_width();
    y1 = display_text_height();
    x2 = display_text_width();
    y2 = display_text_height();
    gui_utf_draw_truncate(0, heading, 0, x1 + 0x24, y1,
                          x2 + 0x186, y2 + 0x1b, 1, 0, 0, 0, 0);

    if (DEBUG_SINK_MODE == 0)
        debug_log(LOG_MESSAGE, message->received_at, message->package_name);
    else
        buffered_debug_log(LOG_MESSAGE, message->received_at,
                           message->package_name);

    format_message_relative_time(relative_time, message->received_at);
    x1 = display_text_width();
    y1 = display_text_height();
    gui_bmp_bitmap_draw(BITMAP_CLOCK, x1 + 0x210, y1, 0, 0, 0);

    count_text[0] = 0;
    count_text[1] = 0;
    format_uint_bounded(count_text, 0, 8, FORMAT_COUNTER, unread_count);
    x1 = display_text_width();
    y1 = display_text_height();
    x2 = display_text_width();
    y2 = display_text_height();
    gui_utf_draw(0, (const char *)count_text, 0, x1 + 0x22c, y1,
                 x2 + 0x244, y2 + 0x1b, 1, 0, 0, 0, 0);

    clear_bytes(body_text, 0, 0x123);
    if (icon_type == ICON_TYPE_MISSED_CALL) {
        bounded_snprintf(body_text, 0x123, FORMAT_STRING, message->body);
    } else if (icon_type == ICON_TYPE_PACKAGE_GROUP_4) {
        bounded_snprintf(body_text, 0x123, FORMAT_BODY_PACKAGE_NL,
                         message->body, message->package_name);
    } else if (message->body[0] == '\0') {
        bounded_snprintf(body_text, 0x123, FORMAT_STRING,
                         message->package_name);
    } else {
        bounded_snprintf(body_text, 0x123, FORMAT_BODY_PACKAGE_DASH,
                         message->body, message->package_name);
    }

    if (body_text[0] == '\0')
        return;
    x1 = display_text_width();
    y1 = display_text_height();
    x2 = display_text_width();
    y2 = display_text_height();
    gui_utf_Wordwrap_draw(0, body_text, 0, x1, y1 + 0x36,
                          x2 + 0x240, y2 + 0x87, 3, 0, 0, 0, 0);
}

/* ================================================================ */
/* member unit: gui_bmp_bitmap_draw.c */
/* ================================================================ */
#include "g1_app_symbols.h"
/* readable reconstruction; identity: FUN_00043484 @ 0x00043484
 * public-name: gui_bmp_bitmap_draw
 * durable-map: recon/catalogs/function_names_app.json
 * callees (readable <= raw @ address):
 *   get_device_info                          <= FUN_000167a8 @ 0x000167a8
 *   debug_print                              <= FUN_00019c70 @ 0x00019c70
 *   atomic_get_3_0                           <= FUN_000431a8 @ 0x000431a8
 *   gui_bmp_bitmap_draw                      <= FUN_00043484 @ 0x00043484
 *   resource_manger_get                      <= FUN_0004588c @ 0x0004588c
 *   clean_fb_data                            <= FUN_000471cc @ 0x000471cc
 *   reflash_fb_data_to_lcd                   <= FUN_00047260 @ 0x00047260
 *   load_icon_bitmap_expanded                <= FUN_00047a4c @ 0x00047a4c
 *   fb_blit_rows_copy                        <= FUN_0007d53a @ 0x0007d53a
 * address symbols (name @ address):
 *   rodata_aa8eb                             @ 0x000aa8eb
 *   rodata_aadd0                             @ 0x000aadd0   [INLINED -- G6 literal batch]
 *   g_log_level                              @ 0x2000230c
 *   g_log_use_alt_sink                       @ 0x20007554
 *   g_gui_active_canvas                      @ 0x2000a034
 */
/* Reconstructed FUN_00043484 @ 0x43484  (parity: 300/300 trials, PROVEN) */
#include <stdint.h>
#include "../../../headers/g1_log.h"
#include "../../../headers/g1_dedupe.h"
#include "g1_gui.h"
extern int get_device_info(void);
extern long long atomic_get_3_0(void);
extern int resource_manger_get(int,int,void*,void*,void*,int);
extern int clean_fb_data(int,int,int,int,int,int);
extern int reflash_fb_data_to_lcd(int,int,int,int,int,int);
extern int load_icon_bitmap_expanded(int,int);

int gui_bmp_bitmap_draw(unsigned int param_1, int param_2, int param_3, int param_4, int param_5, int param_6)
{
    volatile uint32_t *puVar1 = (volatile uint32_t *)((unsigned long)&g_gui_active_canvas) /*=0x2000a034*/;
    int iVar2;
    unsigned int uVar3;
    int iVar4, iVar5;
    int uVar6;
    unsigned long long uVar7;
    int local_24;
    int local_20, local_1c;
    volatile int *g5c0 = (volatile int *)((unsigned long)&g_log_level) /*=0x2000230c*/;
    volatile int *g5c4 = (volatile int *)((unsigned long)&g_log_use_alt_sink) /*=0x20007554*/;

    if (((param_4 == 0) && (param_5 == 0)) && (param_6 == 0)) {
        local_20 = param_6;
        local_1c = param_6;
        if (param_1 - 0x16 < 0x67) {
            iVar2 = resource_manger_get(4, param_1, &local_20, &local_1c, &local_24, 0);
            if (iVar2 < 0) {
                if (1 < *g5c0) {
                    G1_LOG_ROUTE(*g5c4 == 0, ((unsigned long)&rodata_aa8eb) /*=0xaa8eb*/, ((unsigned long)"gui_bmp_bitmap_draw") /*=0xaadd0*/);
                }
                return 0xffffffff;
            }
            uVar3 = (unsigned int)atomic_get_3_0();
            if ((uVar3 & 2) != 0) {
                clean_fb_data((int)*puVar1, 0, param_2, param_3, local_20 + 2 + param_2, local_1c + param_3);
            }
            fb_blit_rows_copy((int)*puVar1, local_24, local_20 / 2, local_1c, param_2, param_3);
            iVar2 = (int)atomic_get_3_0();
            if (-1 < iVar2 << 0x1e) {
                return 0;
            }
            iVar2 = get_device_info();
            uVar6 = *(int *)(iVar2 + 0xeb4);
            iVar2 = get_device_info();
            iVar4 = local_1c + param_3;
            iVar5 = local_20 + 2 + param_2;
        } else {
            uVar7 = (unsigned long long)atomic_get_3_0();
            iVar2 = (int)(uVar7 >> 0x20);
            if ((uVar7 & 2) != 0) {
                clean_fb_data((int)*puVar1, 0, iVar2, param_3, iVar2 + 0x18, param_3 + 0x18);
            }
            local_24 = load_icon_bitmap_expanded(param_1 & 0xff, 0x120);
            fb_blit_rows_copy((int)*puVar1, local_24, 0xc, 0x18, param_2, param_3);
            iVar2 = (int)atomic_get_3_0();
            if (-1 < iVar2 << 0x1e) {
                return 0;
            }
            iVar2 = get_device_info();
            uVar6 = *(int *)(iVar2 + 0xeb4);
            iVar2 = get_device_info();
            iVar4 = param_3 + 0x18;
            iVar5 = param_2 + 0x18;
        }
        reflash_fb_data_to_lcd(uVar6, *(int *)(iVar2 + 0xeb8), param_2, param_3, iVar5, iVar4);
    }
    return 0;
}

