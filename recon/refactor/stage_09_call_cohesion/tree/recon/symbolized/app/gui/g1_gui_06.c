/*
 * Cohesive translation unit for the `gui' module.
 *
 * GENERATED by recon/refactor/transforms/t04_cohesive_tu.py.  Do not
 * edit: a stage tree is regenerated, never hand-patched
 * (recon/refactor/README.md C4).
 *
 * The 2 functions below were 2 separate translation units until this
 * stage.  Each one's text is reproduced VERBATIM and in the order the
 * generated source list gave it, and they were CONSECUTIVE in that list.
 * They were proven able to share a translation unit: no symbol is
 * declared here with two types, no identifier has internal linkage in one
 * member and is named by another, and no local typedef, macro, struct tag
 * or enum constant of one member is visible to a member that names it.
 *
 * members, in link order:
 *   clean_fb_data.c
 *   utf8_to_unicode.c
 */
/* ---- clean_fb_data.c ---- */
#include "g1_app_symbols.h"
/* readable reconstruction; identity: FUN_000471cc @ 0x000471cc
 * public-name: clean_fb_data
 * durable-map: recon/catalogs/function_names_app.json
 * callees (readable <= raw @ address):
 *   debug_print                              <= FUN_00019c70 @ 0x00019c70
 *   memset_bytes                             <= FUN_00086c78 @ 0x00086c78
 * address symbols (name @ address):
 *   rodata_d7347                             @ 0x000d7347   [INLINED -- G6 literal batch]
 *   rodata_d7374                             @ 0x000d7374   [INLINED -- G6 literal batch]
 *   g_log_level                              @ 0x2000230c
 *   g_log_use_alt_sink                       @ 0x20007554
 */
/* Reconstructed clean_fb_data @ 0x471cc  (parity: 300/300 trials, PROVEN) */

#include <stdint.h>
#include "../../../headers/g1_log.h"
#include "../../../headers/g1_dedupe.h"
extern void memset_bytes(void*, int, int);

int clean_fb_data(int param_1, void *param_2, int param_3, int param_4, int param_5, int param_6)
{
    int iVar1;
    uintptr_t row;
    uintptr_t end;
    if (0x27f < param_5) param_5 = 0x280;
    if (199 < param_6) param_6 = 200;
    if ((param_5 < param_3) || (param_6 < param_4)) {
        if (*(volatile int *)((unsigned long)&g_log_level) /*=0x2000230c*/ > 0) {
            G1_LOG_ROUTE(*(volatile unsigned int *)((unsigned long)&g_log_use_alt_sink) /*=0x20007554*/ == 0, ((unsigned long)"%s(): clean frame buffer parameter error!!!\n") /*=0xd7347*/, ((unsigned long)"_clean_fb_data") /*=0xd7374*/);
        }
        iVar1 = -1;
    } else {
        param_3 = param_3/2;
        /* Firmware address arithmetic is 32-bit modular arithmetic.  Spell it
           through uintptr_t/uint32_t so negative row indices and wraparound do
           not invoke signed-overflow or out-of-object pointer arithmetic UB. */
        row = (uintptr_t)(uint32_t)param_1 +
              ((uint32_t)param_4 - 1u) * sizeof(uint32_t);
        end = (uintptr_t)(uint32_t)param_1 +
              (uint32_t)param_6 * sizeof(uint32_t);
        while (end != row) {
            row += sizeof(uint32_t);
            uintptr_t clear = (uintptr_t)*(uint32_t*)row +
                              (uint32_t)param_3;
            uint32_t count = 1u - (uint32_t)param_3 +
                             (uint32_t)(param_5/2);
            memset_bytes((int)(uint32_t)clear, param_2, (int)count);
        }
        iVar1 = (int)((uint32_t)(param_5/2) - (uint32_t)param_3 + 1u);
    }
    return iVar1;
}

/* ---- utf8_to_unicode.c ---- */
/* readable reconstruction; identity: FUN_000477a0 @ 0x000477a0
 * public-name: utf8_to_unicode
 * durable-map: recon/catalogs/function_names_app.json
 * callees (readable <= raw @ address):
 *   debug_print                              <= FUN_00019c70 @ 0x00019c70
 *   printf                                   <= FUN_000777f0 @ 0x000777f0
 *   puts                                     <= FUN_000778d4 @ 0x000778d4
 * address symbols (name @ address):
 *   rodata_d7499                             @ 0x000d7499   [INLINED -- G6 literal batch]
 *   rodata_d74af                             @ 0x000d74af   [INLINED -- G6 literal batch]
 *   rodata_d74bd                             @ 0x000d74bd   [INLINED -- G6 literal batch]
 *   rodata_d752a                             @ 0x000d752a   [INLINED -- G6 literal batch]
 *   g_log_level                              @ 0x2000230c
 *   g_log_use_alt_sink                       @ 0x20007554
 */
/* Reconstructed utf8_to_unicode @ 0x477a0  (parity: 300/300 trials, PROVEN) */

typedef unsigned char byte;
typedef unsigned int uint;
extern int printf(const char *, ...);
extern int puts(const char *);

uint utf8_to_unicode(byte *param_1, int param_2)
{
    uint uVar1, uVar2;
    uVar2 = (uint)*param_1;
    if ((uVar2 & 0xf0) == 0xe0) {
        if (param_2 > 2) {
            uVar1 = (param_1[2] & 0x30) | ((param_1[1] & 3) << 6) | (param_1[2] & 0xf);
            uVar2 = ((param_1[1] >> 2) & 0xf) | ((uVar2 & 0xf) << 4);
            return uVar1 | (uVar2 << 8);
        }
        if (*(volatile int *)((unsigned long)&g_log_level) /*=0x2000230c*/ > 3) {
            G1_LOG_ROUTE(*(volatile unsigned int *)((unsigned long)&g_log_use_alt_sink) /*=0x20007554*/ == 0, ((unsigned long)"%s(): length error!\n\n") /*=0xd7499*/, ((unsigned long)"utf8_to_unicode") /*=0xd752a*/);
        }
    } else if ((uVar2 & 0xe0) == 0xc0) {
        if (param_2 > 1) {
            uVar1 = (param_1[1] & 0x3f) | ((uVar2 & 3) << 6);
            uVar2 = (uVar2 >> 2) & 7;
            return uVar1 | (uVar2 << 8);
        }
        puts(((unsigned long)"length error!") /*=0xd74af*/);
    } else {
        printf(((unsigned long)"maybe [%x] not unicode \?\n") /*=0xd74bd*/);
    }
    return 0;
}

