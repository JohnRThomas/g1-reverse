/*
 * Cohesive translation unit for the `audio' module.
 *
 * GENERATED by recon/refactor/transforms/t04_cohesive_tu.py.  Do not
 * edit: a stage tree is regenerated, never hand-patched
 * (recon/refactor/README.md C4).
 *
 * The 4 functions below were 4 separate translation units until this
 * stage.  Each one's text is reproduced VERBATIM and in the order the
 * generated source list gave it, and they were CONSECUTIVE in that list.
 * They were proven able to share a translation unit: no symbol is
 * declared here with two types, no identifier has internal linkage in one
 * member and is named by another, and no local typedef, macro, struct tag
 * or enum constant of one member is visible to a member that names it.
 *
 * members, in link order:
 *   audio_i2s_stop_and_reset_channels.c
 *   audio_i2s_start_channels.c
 *   audio_apply_config_cmd_0xab.c
 *   pinctrl_configure_state.c
 */

/* File-scope forward declarations for every struct/union tag this
 * unit names.  Without them a tag whose only appearance in a member
 * is inside a parameter list has PARAMETER-LIST scope, so two
 * textually IDENTICAL declarations in two members declare two
 * different incomplete types and the second is a conflicting
 * redeclaration (C11 6.2.1p7).  Incomplete-type forward
 * declarations emit no code. */
struct k_sem;
/* ---- audio_i2s_stop_and_reset_channels.c ---- */
#include "g1_app_symbols.h"
/* readable reconstruction; identity: FUN_00083906 @ 0x00083906
 * public-name: audio_i2s_stop_and_reset_channels
 * durable-map: recon/catalogs/function_names_app.json
 * callees (readable <= raw @ address):
 *   z_impl_k_sem_take                        <= FUN_00072908 @ 0x00072908
 *   audio_hw_lock_acquire                    <= FUN_0007ef3e @ 0x0007ef3e
 *   audio_i2s_stop_and_reset_channels        <= FUN_00083906 @ 0x00083906
 * address symbols (name @ address):
 *   NRF_I2S0_CONFIG_CHANNELS                 @ 0x500055b8
 */
/* Reconstructed FUN_00083906 @ 0x83906  (parity: 300/300 trials, PROVEN) */

extern unsigned long long audio_hw_lock_acquire(unsigned long);
extern void z_impl_k_sem_take(int a, int b, unsigned int c, unsigned int d);

void audio_i2s_stop_and_reset_channels(char *param_1)
{
    int iVar1;
    iVar1 = *(volatile int *)(param_1 + 0x10);
    unsigned long long inherited = audio_hw_lock_acquire(param_1);
    z_impl_k_sem_take(iVar1 + 0x18, (unsigned)(inherited >> 32), 0xffffffff, 0xffffffff);
    if (*(volatile unsigned char *)(iVar1 + 0x60) == 0) {
        *(volatile unsigned int *)NRF_I2S0_CONFIG_CHANNELS /*=0x500055b8*/ = 0;
    }
}

/* ---- audio_i2s_start_channels.c ---- */
struct k_sem;
/* readable reconstruction; identity: FUN_0008392e @ 0x0008392e
 * public-name: audio_i2s_start_channels
 * durable-map: recon/catalogs/function_names_app.json
 * callees (readable <= raw @ address):
 *   k_sem_give                               <= FUN_00072880 @ 0x00072880
 *   audio_hw_lock_release                    <= FUN_0007ef56 @ 0x0007ef56
 *   audio_i2s_start_channels                 <= FUN_0008392e @ 0x0008392e
 * address symbols (name @ address):
 *   NRF_I2S0_CONFIG_CHANNELS                 @ 0x500055b8
 */
/* Reconstructed FUN_0008392e @ 0x8392e  (parity: 300/300 trials, PROVEN) */

extern void k_sem_give(struct k_sem *);
extern void audio_hw_lock_release(unsigned char *);

void audio_i2s_start_channels(void*param_1) {
  int base = *(int*)(param_1+0x10);
  if (*(char*)(base+0x60) == 0) {
    *(volatile unsigned int *)NRF_I2S0_CONFIG_CHANNELS /*=0x500055b8*/ = 2;
  }
  k_sem_give(base+0x18);
  audio_hw_lock_release(param_1);
}

/* ---- audio_apply_config_cmd_0xab.c ---- */
#include "g1_audio.h"
/* readable reconstruction; identity: FUN_0008397e @ 0x0008397e
 * public-name: audio_apply_config_cmd_0xab
 * durable-map: recon/catalogs/function_names_app.json
 * callees (readable <= raw @ address):
 *   qspi_nor_send_cinstr                     <= FUN_00060ab0 @ 0x00060ab0
 *   audio_apply_config_cmd_0xab              <= FUN_0008397e @ 0x0008397e
 *   delay_scaled_busy_wait                   <= FUN_00086384 @ 0x00086384
 */
/* Reconstructed FUN_0008397e @ 0x8397e  (parity: 300/300 trials, PROVEN) */

extern int qspi_nor_send_cinstr(void*, unsigned char*, unsigned char);

int audio_apply_config_cmd_0xab(unsigned int param_1)
{
    int iVar1;
    struct {
        unsigned int opcode;
        unsigned int first;
        unsigned int second;
    } request = { 0xab, 0, 0 };
    iVar1 = qspi_nor_send_cinstr(param_1, &request, 0);
    if (-1 < iVar1) {
        delay_scaled_busy_wait(0x23);
        iVar1 = 0;
    }
    return iVar1;
}

/* ---- pinctrl_configure_state.c ---- */
/* readable reconstruction; identity: FUN_00083cde @ 0x00083cde
 * public-name: pinctrl_configure_state
 * durable-map: recon/catalogs/function_names_app.json
 * callees (readable <= raw @ address):
 *   pinctrl_configure_state                  <= FUN_00083cde @ 0x00083cde
 *   pinctrl_lookup_state                     <= FUN_00083eb8 @ 0x00083eb8
 *   dppi_apply_channel_config_table          <= FUN_00083ede @ 0x00083ede
 */
/* Reconstructed FUN_00083cde @ 0x83cde  (parity: 300/300 trials, PROVEN) */

extern int dppi_apply_channel_config_table(const unsigned long*, unsigned int, unsigned int);

void pinctrl_configure_state(unsigned int *param_1, unsigned int *param_2, unsigned int param_3, unsigned int param_4)
{
  int iVar1;
  unsigned int *local_c;

  local_c = param_2;
  iVar1 = pinctrl_lookup_state(param_1,param_2,&local_c,param_4,param_1);
  if (-1 < iVar1) {
    dppi_apply_channel_config_table(*local_c,*(unsigned char *)(local_c + 1),*param_1);
  }
  return;
}

