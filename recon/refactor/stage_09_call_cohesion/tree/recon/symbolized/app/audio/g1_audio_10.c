/*
 * Cohesive translation unit for the `audio' module.
 *
 * GENERATED by recon/refactor/transforms/t04_cohesive_tu.py.  Do not
 * edit: a stage tree is regenerated, never hand-patched
 * (recon/refactor/README.md C4).
 *
 * The 3 functions below were 3 separate translation units until this
 * stage.  Each one's text is reproduced VERBATIM and in the order the
 * generated source list gave it, and they were CONSECUTIVE in that list.
 * They were proven able to share a translation unit: no symbol is
 * declared here with two types, no identifier has internal linkage in one
 * member and is named by another, and no local typedef, macro, struct tag
 * or enum constant of one member is visible to a member that names it.
 *
 * members, in link order:
 *   startAudioStreamRecord.c
 *   stopAudioStreamRecord.c
 *   delAudioStreamRecord.c
 */

/* File-scope forward declarations for every struct/union tag this
 * unit names.  Without them a tag whose only appearance in a member
 * is inside a parameter list has PARAMETER-LIST scope, so two
 * textually IDENTICAL declarations in two members declare two
 * different incomplete types and the second is a conflicting
 * redeclaration (C11 6.2.1p7).  Incomplete-type forward
 * declarations emit no code. */
struct k_msgq;
struct k_sem;
/* ---- startAudioStreamRecord.c ---- */
#include "g1_app_symbols.h"
#include <zephyr/sys_clock.h>
#include "../../../headers/g1_dedupe.h"
struct k_sem;
#include "../../../headers/g1_log.h"
#include "g1_audio.h"
/* readable reconstruction; identity: FUN_0002f764 @ 0x0002f764
 * public-name: startAudioStreamRecord
 * durable-map: recon/catalogs/function_names_app.json
 * callees (readable <= raw @ address):
 *   get_device_info                          <= FUN_000167a8 @ 0x000167a8
 *   debug_print                              <= FUN_00019c70 @ 0x00019c70
 *   display_DelayClose                       <= FUN_000498c0 @ 0x000498c0
 *   k_msgq_put                               <= FUN_000720d0 @ 0x000720d0
 *   k_sem_give                               <= FUN_00072880 @ 0x00072880
 *   log_message                              <= FUN_0007dda4 @ 0x0007dda4
 *   memset_bytes                             <= FUN_00086c78 @ 0x00086c78
 * address symbols (name @ address):
 *   rodata_a4304                             @ 0x000a4304   [INLINED -- G6 literal batch]
 *   rodata_a432a                             @ 0x000a432a   [INLINED -- G6 literal batch]
 *   rodata_a496f                             @ 0x000a496f   [INLINED -- G6 literal batch]
 *   g_log_level                              @ 0x2000230c
 *   g_audio_msgq                             @ 0x20003890
 *   g_log_use_alt_sink                       @ 0x20007554
 *   g_app_language_msgq                      @ 0x200079e4
 */
/* Reconstructed startAudioStreamRecord @ 0x2f764  (parity: 300/300 trials, PROVEN) */

extern void display_DelayClose(unsigned int ms);
extern int k_msgq_put(struct k_msgq *, const void *, k_timeout_t);
extern void k_sem_give(struct k_sem *);
extern void memset_bytes(void *dst, int val, int n);
extern void sync_to_slave(unsigned int a, unsigned int b, void *c, unsigned int d);

unsigned int startAudioStreamRecord(void)
{
    unsigned char buf[208];
    int iVar2;
    unsigned int uVar3;

    memset_bytes(buf + 5, 0, 0xcb);
    buf[4] = 1;
    iVar2 = k_msgq_put(((unsigned long)&g_audio_msgq) /*=0x20003890*/, buf + 4, (k_timeout_t){ .ticks = 0LL });
    if (iVar2 == 0) {
        k_sem_give((void*)((unsigned long)&g_app_language_msgq) /*=0x200079e4*/);
        uVar3 = 0;
    } else {
        if (0 < *(int *)((unsigned long)&g_log_level) /*=0x2000230c*/) {
            G1_LOG_ROUTE(*(int *)((unsigned long)&g_log_use_alt_sink) /*=0x20007554*/ == 0, ((unsigned long)"%s(): start up audio record failed\r\n\n") /*=0xa4304*/, ((unsigned long)"startAudioStreamRecord") /*=0xa496f*/);
        }
        *(unsigned short *)buf = 1;
        uVar3 = get_device_info();
        sync_to_slave(uVar3, 6, buf, 2);
        display_DelayClose(10000);
        if (0 < *(int *)((unsigned long)&g_log_level) /*=0x2000230c*/) {
            G1_LOG_ROUTE(*(int *)((unsigned long)&g_log_use_alt_sink) /*=0x20007554*/ == 0, ((unsigned long)"%s(): because startup auido record failed,exit quicknote ....\n") /*=0xa432a*/, ((unsigned long)"startAudioStreamRecord") /*=0xa496f*/);
        }
        uVar3 = 0xffffffff;
    }
    return uVar3;
}

/* ---- stopAudioStreamRecord.c ---- */
struct k_sem;
/* readable reconstruction; identity: FUN_0002f80c @ 0x0002f80c
 * public-name: stopAudioStreamRecord
 * durable-map: recon/catalogs/function_names_app.json
 * callees (readable <= raw @ address):
 *   debug_print                              <= FUN_00019c70 @ 0x00019c70
 *   k_msgq_put                               <= FUN_000720d0 @ 0x000720d0
 *   k_sem_give                               <= FUN_00072880 @ 0x00072880
 *   log_message                              <= FUN_0007dda4 @ 0x0007dda4
 *   memset_bytes                             <= FUN_00086c78 @ 0x00086c78
 * address symbols (name @ address):
 *   rodata_a3f45                             @ 0x000a3f45   [INLINED -- G6 literal batch]
 *   rodata_a4959                             @ 0x000a4959   [INLINED -- G6 literal batch]
 *   g_log_level                              @ 0x2000230c
 *   g_audio_msgq                             @ 0x20003890
 *   g_log_use_alt_sink                       @ 0x20007554
 *   g_app_language_msgq                      @ 0x200079e4
 */
/* Reconstructed stopAudioStreamRecord @ 0x2f80c  (parity: 300/300 trials, PROVEN) */


unsigned int stopAudioStreamRecord(void)
{
    unsigned char record[208];
    memset_bytes(record + 5, 0, 203);
    record[4] = 3;
    int iVar1 = k_msgq_put(((unsigned long)&g_audio_msgq) /*=0x20003890*/, record + 4, (k_timeout_t){ .ticks = 0LL });
    unsigned int uVar2;
    if (iVar1 == 0) {
        k_sem_give((void *)((unsigned long)&g_app_language_msgq) /*=0x200079e4*/);
        uVar2 = 0;
    } else {
        if (*(volatile int *)((unsigned long)&g_log_level) /*=0x2000230c*/ > 0) {
            G1_LOG_ROUTE(*(volatile unsigned int *)((unsigned long)&g_log_use_alt_sink) /*=0x20007554*/ == 0, ((unsigned long)"%s(): enqueue_dmic failed\r\n\n") /*=0xa3f45*/, ((unsigned long)"stopAudioStreamRecord") /*=0xa4959*/);
        }
        uVar2 = 0xffffffffUL;
    }
    return uVar2;
}

/* ---- delAudioStreamRecord.c ---- */
struct k_sem;
/* readable reconstruction; identity: FUN_0002f878 @ 0x0002f878
 * public-name: delAudioStreamRecord
 * durable-map: recon/catalogs/function_names_app.json
 * callees (readable <= raw @ address):
 *   debug_print                              <= FUN_00019c70 @ 0x00019c70
 *   k_msgq_put                               <= FUN_000720d0 @ 0x000720d0
 *   k_sem_give                               <= FUN_00072880 @ 0x00072880
 *   memset_bytes                             <= FUN_00086c78 @ 0x00086c78
 * address symbols (name @ address):
 *   rodata_a3f45                             @ 0x000a3f45   [INLINED -- G6 literal batch]
 *   rodata_a420e                             @ 0x000a420e   [INLINED -- refactor stage 01]
 *   rodata_a4944                             @ 0x000a4944   [INLINED -- G6 literal batch]
 *   g_log_level                              @ 0x2000230c
 *   g_audio_msgq                             @ 0x20003890
 *   g_log_use_alt_sink                       @ 0x20007554
 *   g_app_language_msgq                      @ 0x200079e4
 */
/* Reconstructed delAudioStreamRecord @ 0x2f878  (parity: 300/300 trials, PROVEN) */


unsigned int delAudioStreamRecord(unsigned char param_1)
{
    int iVar2;
    unsigned int uVar3;
    unsigned char buf[204];

    if (2 < *(volatile int *)((unsigned long)&g_log_level) /*=0x2000230c*/) {
        G1_LOG_ROUTE(*(volatile unsigned int *)((unsigned long)&g_log_use_alt_sink) /*=0x20007554*/ == 0, ((unsigned long)"%s(): received audio delete command\n") /*=0xa420e*/, ((unsigned long)"delAudioStreamRecord") /*=0xa4944*/);
    }
    memset_bytes(buf + 1, 0, 0xcb);
    *(unsigned short*)(buf + 2) = 1;
    buf[0] = 4;
    buf[4] = param_1;
    iVar2 = k_msgq_put(((unsigned long)&g_audio_msgq) /*=0x20003890*/, buf, (k_timeout_t){ .ticks = 0LL });
    if (iVar2 == 0) {
        k_sem_give(((unsigned long)&g_app_language_msgq) /*=0x200079e4*/);
        uVar3 = 0;
    } else {
        if (0 < *(volatile int *)((unsigned long)&g_log_level) /*=0x2000230c*/) {
            G1_LOG_ROUTE(*(volatile unsigned int *)((unsigned long)&g_log_use_alt_sink) /*=0x20007554*/ == 0, ((unsigned long)"%s(): enqueue_dmic failed\r\n\n") /*=0xa3f45*/, ((unsigned long)"delAudioStreamRecord") /*=0xa4944*/);
        }
        uVar3 = 0xffffffff;
    }
    return uVar3;
}

