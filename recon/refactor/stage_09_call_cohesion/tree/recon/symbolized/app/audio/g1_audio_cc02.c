/*
 * Call-cohesive translation unit for the `audio' module.
 *
 * GENERATED by recon/refactor/transforms/t09_call_cohesion.py.  Do
 * not edit: a stage tree is regenerated, never hand-patched
 * (recon/refactor/README.md C4).
 *
 * The 2 translation units below were grouped because they CALL ONE
 * ANOTHER, not because they were adjacent in the generated source
 * list.  Each member's text is reproduced VERBATIM.  Every member was
 * checked pairwise against every other member already in this unit by
 * stage 04's seven refusal rules, unchanged: no symbol is declared
 * here with two types, no identifier has internal linkage in one
 * member and is named by another, and no local typedef, macro, struct
 * tag or enum constant of one member is visible to a member that
 * names it.
 *
 * members, in generated-source-list order:
 *   g1_audio_07.c
 *   qspi_nor_write.c
 *
 * call edges inside this unit (caller -> callee): 1
 *   g1_audio_07.c -> qspi_nor_write.c
 */

/* File-scope forward declarations for every struct/union tag this
 * unit names.  Without them a tag whose only appearance in a member
 * is inside a parameter list has PARAMETER-LIST scope, so two
 * textually IDENTICAL declarations in two members declare two
 * different incomplete types and the second is a conflicting
 * redeclaration (C11 6.2.1p7).  Incomplete-type forward
 * declarations emit no code. */
struct codec_statistics;
struct device;
struct k_sem;
/* ================================================================ */
/* member unit: g1_audio_07.c */
/* ================================================================ */
/*
 * Cohesive translation unit for the `audio' module.
 *
 * GENERATED by recon/refactor/transforms/t04_cohesive_tu.py.  Do not
 * edit: a stage tree is regenerated, never hand-patched
 * (recon/refactor/README.md C4).
 *
 * The 2 functions below were 2 separate translation units until this
 * stage.  Each one's text is reproduced VERBATIM and in the order the
 * generated source list gave it, and they were CONSECUTIVE in that list.
 * They were proven able to share a translation unit: no symbol is
 * declared here with two types, no identifier has internal linkage in one
 * member and is named by another, and no local typedef, macro, struct tag
 * or enum constant of one member is visible to a member that names it.
 *
 * members, in link order:
 *   app_codec_lc3_test.c
 *   erase_audio_buffer.c
 */

/* File-scope forward declarations for every struct/union tag this
 * unit names.  Without them a tag whose only appearance in a member
 * is inside a parameter list has PARAMETER-LIST scope, so two
 * textually IDENTICAL declarations in two members declare two
 * different incomplete types and the second is a conflicting
 * redeclaration (C11 6.2.1p7).  Incomplete-type forward
 * declarations emit no code. */
struct codec_statistics;
struct device;
/* ---- app_codec_lc3_test.c ---- */
#include "g1_app_symbols.h"
struct device;
/* readable reconstruction; identity: FUN_0002ed68 @ 0x0002ed68
 * public-name: app_codec_lc3_test
 * durable-map: recon/catalogs/function_names_app.json
 * callees (readable <= raw @ address):
 *   debug_print                              <= FUN_00019c70 @ 0x00019c70
 *   enqueue_dmic                             <= FUN_0002ec5c @ 0x0002ec5c
 *   app_codec_lc3_test                       <= FUN_0002ed68 @ 0x0002ed68
 *   sendAudioStram2Cache                     <= FUN_0002f6b0 @ 0x0002f6b0
 *   is_battery_critical                      <= FUN_00032ee4 @ 0x00032ee4
 *   get_synced_clock_time                    <= FUN_0004a4d0 @ 0x0004a4d0
 *   qspi_nor_write                           <= FUN_00060f20 @ 0x00060f20
 *   lc3_frame_samples                        <= FUN_00068e40 @ 0x00068e40
 *   lc3_encoder_size                         <= FUN_00068ecc @ 0x00068ecc
 *   lc3_setup_encoder                        <= FUN_00068f94 @ 0x00068f94
 *   lc3_encode                               <= FUN_00069238 @ 0x00069238
 *   malloc                                   <= FUN_00076d6c @ 0x00076d6c
 *   free                                     <= FUN_00076d7c @ 0x00076d7c
 *   z_device_is_ready                        <= FUN_0008638c @ 0x0008638c
 * address symbols (name @ address):
 *   rodata_87bf0                             @ 0x00087bf0
 *   rodata_87bf8                             @ 0x00087bf8
 *   rodata_9e9ea                             @ 0x0009e9ea
 *   rodata_9ebc6                             @ 0x0009ebc6
 *   rodata_a3f7f                             @ 0x000a3f7f   [INLINED -- G6 literal batch]
 *   rodata_a3fbe                             @ 0x000a3fbe   [INLINED -- G6 literal batch]
 *   rodata_a3fdf                             @ 0x000a3fdf   [INLINED -- G6 literal batch]
 *   rodata_a41c2                             @ 0x000a41c2   [INLINED -- G6 literal batch]
 *   g_log_level                              @ 0x2000230c
 *   g_audio_flash_write_offset               @ 0x20002404
 *   g_log_use_alt_sink                       @ 0x20007554
 *   g_pending_event_word                     @ 0x20007b78
 */
/* Reconstructed FUN_0002ed68 @ 0x2ed68  (parity: 300/300 trials, PROVEN) */
#include <stdint.h>
#include "../../../headers/g1_log.h"
#include "g1_audio.h"
typedef unsigned int uint;
typedef unsigned undefined4;
extern int enqueue_dmic(unsigned int);
extern void sendAudioStram2Cache(int a);
extern void get_synced_clock_time(long long*);
extern int qspi_nor_write(int, unsigned int, unsigned char*, unsigned int);
extern int lc3_frame_samples(int a, int b);
extern unsigned lc3_encoder_size(int a, int b);
extern unsigned lc3_setup_encoder(int a, int b, int c, int d);
extern int lc3_encode(unsigned a, int b, int c, int d, int e, int f, unsigned g, int h);
extern int malloc(unsigned a);
extern void free(int a);
extern _Bool z_device_is_ready(const struct device *);

void app_codec_lc3_test(int param_1, int param_2)
{
    volatile int *v = (volatile int *)((unsigned long)&g_log_level) /*=0x2000230c*/;
    volatile int *dbg = (volatile int *)((unsigned long)&g_log_use_alt_sink) /*=0x20007554*/;
    volatile int *S = (volatile int *)((unsigned long)&rodata_87bf0) /*=0x87bf0*/;
    volatile uint *puVar2v = (volatile uint *)((unsigned long)&g_audio_flash_write_offset) /*=0x20002404*/;
    int *piVar1;
    uint *puVar2;
    unsigned uVar3;
    uint uVar4;
    int iVar5, iVar6, iVar7, iVar8, iVar9, iVar10, iVar11;
    struct codec_statistics { unsigned first, second; } local_stats;

    uVar3 = lc3_encoder_size(10000, 16000);
    uVar4 = lc3_frame_samples(10000, 16000);
    iVar5 = malloc(uVar3);
    iVar11 = (uVar4 & 0x7fff) * 2;
    iVar6 = malloc(iVar11);
    iVar10 = (param_2 / iVar11 & 0xffffU) * 0x14;
    iVar7 = malloc(iVar10);
    if (iVar5 == 0) {
        if (0 < *v) {
            if (*dbg == 0) log_message(((unsigned long)"%s(): malloc error\r\n\n") /*=0xa3f7f*/, ((unsigned long)"app_codec_lc3_test") /*=0xa41c2*/);
            else debug_print(((unsigned long)"%s(): malloc error\r\n\n") /*=0xa3f7f*/, ((unsigned long)"app_codec_lc3_test") /*=0xa41c2*/);
        }
LAB_0002edf8:
        iVar5 = iVar6;
        if (iVar6 != 0) goto LAB_0002ede2;
    } else {
        if (iVar6 != 0) {
            if (iVar7 != 0) {
                iVar8 = is_battery_critical();
                piVar1 = (int *)S;
                if ((iVar8 == 1) && (iVar8 = z_device_is_ready(((unsigned long)&rodata_87bf0) /*=0x87bf0*/), iVar8 == 0)) {
                    if (0 < *v) {
                        iVar9 = *piVar1;
                        iVar10 = *dbg;
                        uVar3 = ((unsigned long)&rodata_9e9ea) /*=0x9e9ea*/;
LAB_0002ee5a:
                        if (iVar10 == 0) log_message(uVar3, ((unsigned long)"app_codec_lc3_test") /*=0xa41c2*/, iVar9);
                        else debug_print(uVar3, ((unsigned long)"app_codec_lc3_test") /*=0xa41c2*/, iVar9);
                    }
                } else {
                    uVar3 = lc3_setup_encoder(10000, 16000, 0, iVar5);
                    iVar8 = iVar7;
                    do {
                        if (iVar8 == iVar10 + iVar7) {
                            iVar11 = is_battery_critical();
                            puVar2 = (uint *)puVar2v;
                            if (iVar11 != 1) {
                                if (*(volatile int *)((unsigned long)&g_pending_event_word) /*=0x20007b78*/ == 0) {
                                    enqueue_dmic(iVar7);
                                } else {
                                    local_stats.first = 0;
                                    local_stats.second = 0;
                                    get_synced_clock_time(&local_stats);
                                    if (2 < *v) {
                                        if (*dbg == 0) {
                                            log_message(((unsigned long)"%s(): send audio stream data to storage thread,timestemp = %lld\n") /*=0xa3fdf*/, ((unsigned long)"app_codec_lc3_test") /*=0xa41c2*/,
                                                        local_stats.first,
                                                        local_stats.second);
                                        }
                                        else debug_print(((unsigned long)"%s(): send audio stream data to storage thread,timestemp = %lld\n") /*=0xa3fdf*/, ((unsigned long)"app_codec_lc3_test") /*=0xa41c2*/,
                                                         local_stats.first,
                                                         local_stats.second);
                                    }
                                    sendAudioStram2Cache(iVar7);
                                }
                                goto LAB_0002eeb6;
                            }
                            if (0x40ffff < *puVar2v) goto LAB_0002eeb6;
                            typedef int (*codec_write_fn)(int, uint, int, int);
                            codec_write_fn write_frame =
                                *(volatile codec_write_fn *)(
                                    *(volatile uint32_t *)((unsigned long)&rodata_87bf8) /*=0x87bf8*/ + 4);
                            iVar9 = write_frame(((unsigned long)&rodata_87bf0) /*=0x87bf0*/, *puVar2v,
                                               iVar7, iVar10);
                            if (iVar9 != 0) {
                                if (*v < 1) goto LAB_0002eeb6;
                                iVar10 = *dbg;
                                uVar3 = ((unsigned long)&rodata_9ebc6) /*=0x9ebc6*/;
                                goto LAB_0002ee5a;
                            }
                            if (0 < *v) {
                                if (*dbg == 0) log_message(((unsigned long)"%s(): Flash write to addr 0x%x\n\n") /*=0xa3fbe*/, ((unsigned long)"app_codec_lc3_test") /*=0xa41c2*/, *puVar2);
                                else debug_print(((unsigned long)"%s(): Flash write to addr 0x%x\n\n") /*=0xa3fbe*/, ((unsigned long)"app_codec_lc3_test") /*=0xa41c2*/,
                                                 *puVar2);
                            }
                            *puVar2 = *puVar2 + iVar10;
                            goto LAB_0002eeb6;
                        }
                        iVar9 = lc3_encode(uVar3, 0, param_1, 1, 0x14, iVar8, uVar3, param_1);
                        iVar8 = iVar8 + 0x14;
                        param_1 = param_1 + iVar11;
                    } while (iVar9 == 0);
                    if (0 < *v) {
                        iVar10 = *dbg;
                        uVar3 = 0xa3f95;
                        goto LAB_0002ee5a;
                    }
                }
LAB_0002eeb6:
                free(iVar5);
                free(iVar6);
                goto LAB_0002edce;
            }
            if (*v < 1) {
                free(iVar5);
                iVar7 = iVar6;
                goto LAB_0002edce;
            }
LAB_0002ee16:
            if (*dbg == 0) log_message(((unsigned long)"%s(): malloc error\r\n\n") /*=0xa3f7f*/, ((unsigned long)"app_codec_lc3_test") /*=0xa41c2*/);
            else debug_print(((unsigned long)"%s(): malloc error\r\n\n") /*=0xa3f7f*/, ((unsigned long)"app_codec_lc3_test") /*=0xa41c2*/);
            free(iVar5);
            goto LAB_0002edf8;
        }
        if (0 < *v) goto LAB_0002ee16;
LAB_0002ede2:
        free(iVar5);
    }
    if (iVar7 == 0) return;
LAB_0002edce:
    free(iVar7);
    return;
}

/* ---- erase_audio_buffer.c ---- */
/* readable reconstruction; identity: FUN_0002f008 @ 0x0002f008
 * public-name: erase_audio_buffer
 * durable-map: recon/catalogs/function_names_app.json
 * callees (readable <= raw @ address):
 *   debug_print                              <= FUN_00019c70 @ 0x00019c70
 * address symbols (name @ address):
 *   rodata_10000                             @ 0x00010000
 *   rodata_87bf0                             @ 0x00087bf0
 *   g_log_level                              @ 0x2000230c
 *   g_audio_flash_write_offset               @ 0x20002404
 *   g_log_use_alt_sink                       @ 0x20007554
 */
/* Reconstructed erase_audio_buffer @ 0x2f008  (parity: 300/300 trials, PROVEN) */

typedef int (*fn3)(int,int,int);
int erase_audio_buffer(void){
  int obj = ((unsigned long)&rodata_87bf0) /*=0x87bf0*/;
  fn3 f = *(volatile fn3 *)((*(volatile int *)(obj+8)) + 8);
  int iVar1 = f(obj, 0x400000, ((unsigned long)&rodata_10000) /*=0x10000*/);
  if(iVar1==0){
    int iVar2 = *(volatile int *)((unsigned long)&g_log_level) /*=0x2000230c*/;
    *(volatile int *)((unsigned long)&g_audio_flash_write_offset) /*=0x20002404*/ = 0x400000;
    if(2 < iVar2){ if(*(volatile int *)((unsigned long)&g_log_use_alt_sink) /*=0x20007554*/==0) log_message(((unsigned long)"%s(): Flash erase ok \n\n"),((unsigned long)"erase_audio_buffer")); else debug_print(((unsigned long)"%s(): Flash erase ok \n\n"),((unsigned long)"erase_audio_buffer")); }
  } else if(0 < *(volatile int *)((unsigned long)&g_log_level) /*=0x2000230c*/){
    if(*(volatile int *)((unsigned long)&g_log_use_alt_sink) /*=0x20007554*/==0) log_message(((unsigned long)"%s(): Flash erase failed! %d\n\n"),((unsigned long)"erase_audio_buffer"),iVar1); else debug_print(((unsigned long)"%s(): Flash erase failed! %d\n\n"),((unsigned long)"erase_audio_buffer"),iVar1);
  }
  return iVar1;
}

/* ================================================================ */
/* member unit: qspi_nor_write.c */
/* ================================================================ */
#include "g1_app_symbols.h"
struct k_sem;
/* readable reconstruction; identity: FUN_00060f20 @ 0x00060f20
 * public-name: qspi_nor_write
 * durable-map: recon/catalogs/function_names_app.json
 * callees (readable <= raw @ address):
 *   qspi_get_zephyr_ret_code                 <= FUN_00060990 @ 0x00060990
 *   qspi_nor_lock_if_magic                   <= FUN_000609f4 @ 0x000609f4
 *   qspi_nor_acquire                         <= FUN_00060a10 @ 0x00060a10
 *   qspi_nor_suspend_bus                     <= FUN_00060a5c @ 0x00060a5c
 *   qspi_nor_write                           <= FUN_00060f20 @ 0x00060f20
 *   k_sem_give                               <= FUN_00072880 @ 0x00072880
 *   qspi_log_forward                         <= FUN_000838d6 @ 0x000838d6
 *   audio_stream_stop_and_wait               <= FUN_000838fa @ 0x000838fa
 *   audio_i2s_stop_and_reset_channels        <= FUN_00083906 @ 0x00083906
 *   audio_i2s_start_channels                 <= FUN_0008392e @ 0x0008392e
 *   qspi_nor_write_protection_set            <= FUN_00083954 @ 0x00083954
 *   nrfx_qspi_write                          <= FUN_00085200 @ 0x00085200
 *   nrfx_qspi_read                           <= FUN_00085206 @ 0x00085206
 *   memcpy                                   <= FUN_00086c04 @ 0x00086c04
 * address symbols (name @ address):
 *   rodata_88270                             @ 0x00088270
 *   rodata_f5cd8                             @ 0x000f5cd8
 *   g_sram_base_word                         @ 0x20000000
 */
/* Reconstructed FUN_00060f20 @ 0x60f20  (parity: 300/300 trials, PROVEN) */
#include <stdint.h>
#include "g1_audio.h"
extern int qspi_get_zephyr_ret_code(int);
extern int qspi_nor_acquire(int,...);
extern void qspi_nor_suspend_bus(unsigned char*);
extern void k_sem_give(struct k_sem *);
extern int qspi_log_forward(int,...);
extern int audio_stream_stop_and_wait(int,...);
extern int audio_i2s_stop_and_reset_channels(int,...);
extern int qspi_nor_write_protection_set(int,...);
extern int nrfx_qspi_write(int,...);
extern int nrfx_qspi_read(int,...);
extern void memcpy(int, int, int);

int qspi_nor_write(int param_1, unsigned param_2, unsigned char *param_3, unsigned param_4)
{
    int iVar1, iVar2;
    unsigned uVar3;
    unsigned local_48, local_44, uStack_40, local_3c;
    unsigned char auStack_38[20];

    if (param_3 == 0 || param_4 == 0 || (4 < param_4 && (param_4 & 3) != 0) || (param_2 & 3) != 0)
        return -0x16;
    if ((int)param_2 < 0 || *(unsigned*)(*(int*)(param_1+4)+0x2c) < param_2 + param_4) {
        local_44 = ((unsigned long)&rodata_f5cd8) /*=0xf5cd8*/;
        local_48 = 4;
        uStack_40 = param_2;
        local_3c = param_4;
        qspi_log_forward(((unsigned long)&rodata_88270) /*=0x88270*/, 0x2040, &local_48);
        return -0x16;
    }
    iVar1 = qspi_nor_acquire(param_1);
    if (iVar1 != 0) goto LAB_00061054;
    audio_stream_stop_and_wait(*(unsigned*)(param_1+0x10));
    iVar2 = qspi_nor_write_protection_set(param_1, 0);
    audio_i2s_stop_and_reset_channels(param_1);
    iVar1 = 0x0bad0000;
    if (iVar2 == 0) {
        if (param_4 < 4) {
            iVar2 = nrfx_qspi_read((int)auStack_38, 4, param_2);
            qspi_nor_lock_if_magic(*(unsigned*)(param_1+0x10), iVar2);
            if (iVar2 == 0x0bad0000) {
                memcpy((int)auStack_38, param_3, param_4);
                param_4 = 4;
                param_3 = auStack_38;
LAB_00060fd6:
                iVar2 = nrfx_qspi_write((int)param_3, param_4, param_2);
                qspi_nor_lock_if_magic(*(unsigned*)(param_1+0x10), iVar2);
            }
        } else {
            if (((unsigned)param_3 & 0xe0000000) == ((unsigned long)&g_sram_base_word) /*=0x20000000*/ && ((unsigned)param_3 & 3) == 0)
                goto LAB_00060fd6;
            do {
                uVar3 = param_4;
                if (0xf < param_4) uVar3 = 0x10;
                memcpy((int)auStack_38, param_3, uVar3);
                iVar2 = nrfx_qspi_write((int)auStack_38, uVar3, param_2);
                qspi_nor_lock_if_magic(*(unsigned*)(param_1+0x10), iVar2);
                if (iVar2 != iVar1) break;
                param_4 -= uVar3;
                param_3 += uVar3;
                param_2 += uVar3;
            } while (param_4 != 0);
        }
    }
    audio_i2s_start_channels(param_1);
    iVar1 = qspi_nor_write_protection_set(param_1, 1);
    k_sem_give(*(unsigned*)(param_1+0x10));
    if (iVar2 == 0) iVar2 = iVar1;
    iVar1 = qspi_get_zephyr_ret_code(iVar2);
LAB_00061054:
    qspi_nor_suspend_bus(param_1);
    return iVar1;
}

