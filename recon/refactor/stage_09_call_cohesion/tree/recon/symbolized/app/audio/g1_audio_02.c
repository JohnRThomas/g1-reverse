/*
 * Cohesive translation unit for the `audio' module.
 *
 * GENERATED by recon/refactor/transforms/t04_cohesive_tu.py.  Do not
 * edit: a stage tree is regenerated, never hand-patched
 * (recon/refactor/README.md C4).
 *
 * The 2 functions below were 2 separate translation units until this
 * stage.  Each one's text is reproduced VERBATIM and in the order the
 * generated source list gave it, and they were CONSECUTIVE in that list.
 * They were proven able to share a translation unit: no symbol is
 * declared here with two types, no identifier has internal linkage in one
 * member and is named by another, and no local typedef, macro, struct tag
 * or enum constant of one member is visible to a member that names it.
 *
 * members, in link order:
 *   enqueue_uid.c
 *   dequeue_uid.c
 */

/* File-scope forward declarations for every struct/union tag this
 * unit names.  Without them a tag whose only appearance in a member
 * is inside a parameter list has PARAMETER-LIST scope, so two
 * textually IDENTICAL declarations in two members declare two
 * different incomplete types and the second is a conflicting
 * redeclaration (C11 6.2.1p7).  Incomplete-type forward
 * declarations emit no code. */
struct k_msgq;
struct uid_record;
/* ---- enqueue_uid.c ---- */
#include "g1_app_symbols.h"
#include <zephyr/sys_clock.h>
#include "../../../headers/g1_log.h"
/* readable reconstruction; identity: FUN_00018e48 @ 0x00018e48
 * public-name: enqueue_uid
 * durable-map: recon/catalogs/function_names_app.json
 * callees (readable <= raw @ address):
 *   debug_print                              <= FUN_00019c70 @ 0x00019c70
 *   k_msgq_put                               <= FUN_000720d0 @ 0x000720d0
 *   k_msgq_get                               <= FUN_00072240 @ 0x00072240
 * address symbols (name @ address):
 *   rodata_9aa2f                             @ 0x0009aa2f   [INLINED -- G6 literal batch]
 *   rodata_9aa4b                             @ 0x0009aa4b   [INLINED -- G6 literal batch]
 *   rodata_9aa64                             @ 0x0009aa64   [INLINED -- G6 literal batch]
 *   rodata_9b176                             @ 0x0009b176   [INLINED -- G6 literal batch]
 *   g_log_level                              @ 0x2000230c
 *   g_uid_pipe                               @ 0x20006a38
 *   g_log_use_alt_sink                       @ 0x20007554
 */
/* Reconstructed enqueue_uid @ 0x18e48  (parity: 300/300 trials, PROVEN) */

extern int k_msgq_get(struct k_msgq *, void *, k_timeout_t);
extern int k_msgq_put(struct k_msgq *, const void *, k_timeout_t);
int enqueue_uid(unsigned *param_1, unsigned param_2, unsigned param_3){
    unsigned local[3];
    local[0]=0; local[1]=0; local[2]=param_3;
    volatile int *g = (volatile int*)((unsigned long)&g_uid_pipe) /*=0x20006a38*/;
    if (g[0x10/4] == 0) return 1;
    int iVar2;
    if (g[0x24/4] == 10){
        k_msgq_get(((unsigned long)&g_uid_pipe) /*=0x20006a38*/, local, (k_timeout_t){ .ticks = 0LL });
        if (*(volatile int *)((unsigned long)&g_log_use_alt_sink) /*=0x20007554*/ == 0) log_message(((unsigned long)"enqueue uid drop package! \n") /*=0x9aa2f*/);
        else debug_print(((unsigned long)"enqueue uid drop package! \n") /*=0x9aa2f*/);
    }
    local[0] = param_1[0];
    local[1] = param_1[1];
    if (*(volatile int *)((unsigned long)&g_log_level) /*=0x2000230c*/ > 0){
        if (*(volatile int *)((unsigned long)&g_log_use_alt_sink) /*=0x20007554*/ == 0) log_message(((unsigned long)"%s(): local_data uid %d\n") /*=0x9aa4b*/,((unsigned long)"enqueue_uid") /*=0x9b176*/,local[0]);
        else debug_print(((unsigned long)"%s(): local_data uid %d\n") /*=0x9aa4b*/,((unsigned long)"enqueue_uid") /*=0x9b176*/,local[0]);
    }
    iVar2 = k_msgq_put(((unsigned long)&g_uid_pipe) /*=0x20006a38*/, local, (k_timeout_t){ .ticks = 0LL });
    if (iVar2 != 0 && *(volatile int *)((unsigned long)&g_log_level) /*=0x2000230c*/ > 0){
        if (*(volatile int *)((unsigned long)&g_log_use_alt_sink) /*=0x20007554*/ == 0) log_message(((unsigned long)"%s(): en uid F\n") /*=0x9aa64*/,((unsigned long)"enqueue_uid") /*=0x9b176*/);
        else debug_print(((unsigned long)"%s(): en uid F\n") /*=0x9aa64*/,((unsigned long)"enqueue_uid") /*=0x9b176*/);
    }
    return iVar2;
}

/* ---- dequeue_uid.c ---- */
#include "../../../headers/g1_dedupe.h"
/* readable reconstruction; identity: FUN_00018ff8 @ 0x00018ff8
 * public-name: dequeue_uid
 * durable-map: recon/catalogs/function_names_app.json
 * callees (readable <= raw @ address):
 *   debug_print                              <= FUN_00019c70 @ 0x00019c70
 *   k_msgq_get                               <= FUN_00072240 @ 0x00072240
 * address symbols (name @ address):
 *   rodata_9aafd                             @ 0x0009aafd   [INLINED -- G6 literal batch]
 *   rodata_9b16a                             @ 0x0009b16a   [INLINED -- G6 literal batch]
 *   g_log_level                              @ 0x2000230c
 *   g_uid_pipe                               @ 0x20006a38
 *   g_log_use_alt_sink                       @ 0x20007554
 */
/* Reconstructed dequeue_uid @ 0x18ff8  (parity: 300/300 trials, PROVEN) */


int dequeue_uid(unsigned int *param_1, unsigned int param_2, unsigned int param_3)
{
  int iVar1;
  struct uid_record {
    unsigned int first;
    unsigned int second;
  } record;

  record.first = 0;
  record.second = 0;
  (void)param_2;
  (void)param_3;
  if (*(volatile int *)(((unsigned long)&g_uid_pipe) /*=0x20006a38*/ + 0x10) == 0) {
    iVar1 = 1;
  } else {
    iVar1 = k_msgq_get(((unsigned long)&g_uid_pipe) /*=0x20006a38*/, &record, (k_timeout_t){ .ticks = 0LL });
    if (iVar1 == 0) {
      *param_1 = record.first;
      param_1[1] = record.second;
    } else if (0 < *(volatile int *)((unsigned long)&g_log_level) /*=0x2000230c*/) {
      G1_LOG_ROUTE(*(volatile int *)((unsigned long)&g_log_use_alt_sink) /*=0x20007554*/ == 0, ((unsigned long)"%s(): D uid F\n") /*=0x9aafd*/, ((unsigned long)"dequeue_uid") /*=0x9b16a*/);
    }
  }
  return iVar1;
}

