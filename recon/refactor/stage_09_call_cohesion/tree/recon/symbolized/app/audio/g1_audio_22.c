/*
 * Cohesive translation unit for the `audio' module.
 *
 * GENERATED by recon/refactor/transforms/t04_cohesive_tu.py.  Do not
 * edit: a stage tree is regenerated, never hand-patched
 * (recon/refactor/README.md C4).
 *
 * The 9 functions below were 9 separate translation units until this
 * stage.  Each one's text is reproduced VERBATIM and in the order the
 * generated source list gave it, and they were CONSECUTIVE in that list.
 * They were proven able to share a translation unit: no symbol is
 * declared here with two types, no identifier has internal linkage in one
 * member and is named by another, and no local typedef, macro, struct tag
 * or enum constant of one member is visible to a member that names it.
 *
 * members, in link order:
 *   audio_codec_get_reg14_bit2.c
 *   atomic_assign_bit.c
 *   atomic_get_word.c
 *   atomic_counter_add_and_signal.c
 *   log_forward_zero_arg.c
 *   g1_nrfx_clock_stop_hfaudio.c
 *   qspi_log_forward.c
 *   qspi_pinctrl_apply_state.c
 *   audio_stream_stop_and_wait.c
 */
/* ---- audio_codec_get_reg14_bit2.c ---- */
#include "g1_app_symbols.h"
#include "g1_audio.h"
#include <stdint.h>
/* readable reconstruction; identity: FUN_0007fe72 @ 0x0007fe72
 * public-name: audio_codec_get_reg14_bit2
 * durable-map: recon/catalogs/function_names_app.json
 * callees (readable <= raw @ address):
 *   audio_codec_reg_op_dispatch              <= FUN_0007f97c @ 0x0007f97c
 *   audio_codec_select_page                  <= FUN_0007fb20 @ 0x0007fb20
 *   audio_codec_get_reg14_bit2               <= FUN_0007fe72 @ 0x0007fe72
 */
/* Reconstructed FUN_0007fe72 @ 0x7fe72  (parity: 300/300 trials, PROVEN) */

extern int audio_codec_reg_op_dispatch(unsigned int, unsigned int, void*, unsigned int);
extern int audio_codec_select_page(int, int, ...);

int audio_codec_get_reg14_bit2(int param_1, unsigned char *param_2, int param_3, int param_4)
{
  int iVar1, iVar2;
  /* 0x7fe72 `push {r0,r1,r2,...}` puts param_2 (r1) in the sp+4 slot that
   * 0x7fe86 `add r2,sp,#4` then hands to the register read as its buffer. */
  unsigned int dummy = (unsigned int)(unsigned long)param_2;
  iVar1 = audio_codec_select_page(param_1, 1, param_3, param_4, param_1);
  if (iVar1 == 0) {
    iVar1 = audio_codec_reg_op_dispatch(param_1, 0x14, &dummy, 1);
    /* 0x7fe8e ldrb.w r3,[sp,#4] ; 0x7fe94 ubfx r3,r3,#2,#1 ; 0x7fe9c strb r3,[r7]
     * -- bit 2 (MASTER_ON) of the BYTE the read stored in the stack buffer, not
     * of the out-pointer's own value.  Reading the pointer made lsm6dso_init_chip
     * see a non-zero master flag and issue a spurious sh_master_set(0). */
    *param_2 = (unsigned char)((dummy >> 2) & 1);
    iVar2 = audio_codec_select_page(param_1, 0);
    iVar1 = iVar1 + iVar2;
  }
  return iVar1;
}

/* ---- atomic_assign_bit.c ---- */
/* readable reconstruction; identity: FUN_000811a4 @ 0x000811a4
 * public-name: atomic_assign_bit
 * durable-map: recon/catalogs/function_names_app.json
 * callees (readable <= raw @ address):
 *   atomic_and_1                             <= FUN_00081180 @ 0x00081180
 *   atomic_assign_bit                        <= FUN_000811a4 @ 0x000811a4
 */
/* Reconstructed FUN_000811a4 @ 0x811a4  (parity: 300/300 trials, PROVEN) */

extern long atomic_and_1(volatile long*, long);
void atomic_assign_bit(unsigned int *param_1, unsigned int param_2, int param_3)
{
    unsigned int uVar1 = 1u << (param_2 & 0xff);
    if (param_3 == 0) {
        atomic_and_1(param_1, ~uVar1);
        return;
    }
    (void)__atomic_fetch_or(param_1, uVar1, __ATOMIC_SEQ_CST);
}

/* ---- atomic_get_word.c ---- */
/* readable reconstruction; identity: FUN_000816a2 @ 0x000816a2
 * public-name: atomic_get_word
 * durable-map: recon/catalogs/function_names_app.json
 * callees (readable <= raw @ address):
 *   atomic_get_word                          <= FUN_000816a2 @ 0x000816a2
 */
/* Reconstructed FUN_000816a2 @ 0x816a2  (parity: 300/300 trials, PROVEN) */

unsigned long atomic_get_word(const unsigned long*param_1) {
    return *param_1;
}

/* ---- atomic_counter_add_and_signal.c ---- */
/* readable reconstruction; identity: FUN_0008174c @ 0x0008174c
 * public-name: atomic_counter_add_and_signal
 * durable-map: recon/catalogs/function_names_app.json
 * callees (readable <= raw @ address):
 *   atomic_counter_add_and_signal            <= FUN_0008174c @ 0x0008174c
 */
/* Reconstructed FUN_0008174c @ 0x8174c  (parity: 300/300 trials, PROVEN) */

void atomic_counter_add_and_signal(int param_1, int param_2)
{
  unsigned int uVar1;
  __atomic_fetch_add((unsigned int *)(param_1 + 0x2c),
                     (unsigned int)param_2, __ATOMIC_ACQ_REL);
  uVar1 = __atomic_fetch_or((unsigned int *)(param_1 + 0x10), 1,
                            __ATOMIC_ACQ_REL);
  if ((uVar1 & 1) == 0) {
    void (*fn)(void) = *(void (**)(void))(*(volatile int *)(param_1+4) + 0x1c);
    if (fn != 0) {
      fn();
    }
  }
}

/* ---- log_forward_zero_arg.c ---- */
/* readable reconstruction; identity: FUN_000837a2 @ 0x000837a2
 * public-name: log_forward_zero_arg
 * durable-map: recon/catalogs/function_names_app.json
 * callees (readable <= raw @ address):
 *   z_log_msg_runtime_create                 <= FUN_0004d944 @ 0x0004d944
 *   log_forward_zero_arg                     <= FUN_000837a2 @ 0x000837a2
 */
/* Reconstructed FUN_000837a2 @ 0x837a2  (parity: 300/300 trials, PROVEN) */

void log_forward_zero_arg(unsigned int a, unsigned int b, unsigned int c, unsigned int unused)
{
    (void)unused;
    z_log_msg_runtime_create(a, b, c, 0);
}

/* ---- g1_nrfx_clock_stop_hfaudio.c ---- */
/* readable reconstruction; identity: FUN_00083874 @ 0x00083874
 * public-name: g1_nrfx_clock_stop_hfaudio
 * durable-map: recon/catalogs/function_names_app.json
 * callees (readable <= raw @ address):
 *   nrfx_clock_stop                          <= FUN_00065324 @ 0x00065324
 *   g1_nrfx_clock_stop_hfaudio               <= FUN_00083874 @ 0x00083874
 */
/* Reconstructed FUN_00083874 @ 0x83874; HFAUDIO stop tail veneer. */
extern void nrfx_clock_stop(int domain);
static void g1_nrfx_clock_stop_hfaudio(void) { nrfx_clock_stop(3); }

/* ---- qspi_log_forward.c ---- */
/* readable reconstruction; identity: FUN_000838d6 @ 0x000838d6
 * public-name: qspi_log_forward
 * durable-map: recon/catalogs/function_names_app.json
 * callees (readable <= raw @ address):
 *   z_log_msg_runtime_create                 <= FUN_0004d944 @ 0x0004d944
 *   qspi_log_forward                         <= FUN_000838d6 @ 0x000838d6
 */
/* Reconstructed FUN_000838d6 @ 0x838d6  (parity: 300/300 trials, PROVEN) */

void qspi_log_forward(unsigned int a, unsigned int b, unsigned int c, unsigned int unused)
{
    (void)unused;
    z_log_msg_runtime_create(a, b, c, 0);
}

/* ---- qspi_pinctrl_apply_state.c ---- */
/* readable reconstruction; identity: FUN_000838dc @ 0x000838dc
 * public-name: qspi_pinctrl_apply_state
 * durable-map: recon/catalogs/function_names_app.json
 * callees (readable <= raw @ address):
 *   qspi_pinctrl_apply_state                 <= FUN_000838dc @ 0x000838dc
 *   pinctrl_lookup_state                     <= FUN_00083eb8 @ 0x00083eb8
 *   dppi_apply_channel_config_table          <= FUN_00083ede @ 0x00083ede
 */
/* Reconstructed FUN_000838dc @ 0x838dc  (parity: 300/300 trials, PROVEN) */

extern int dppi_apply_channel_config_table(const unsigned long*, unsigned int, unsigned int);

void qspi_pinctrl_apply_state(unsigned int *param_1, unsigned int *param_2, unsigned int param_3, unsigned int param_4)
{
  int iVar1;
  unsigned int *local_c;

  local_c = param_2;
  iVar1 = pinctrl_lookup_state(param_1,param_2,&local_c,param_4,param_1);
  if (-1 < iVar1) {
    dppi_apply_channel_config_table(*local_c,*(unsigned char *)(local_c + 1),*param_1);
  }
  return;
}

/* ---- audio_stream_stop_and_wait.c ---- */
/* readable reconstruction; identity: FUN_000838fa @ 0x000838fa
 * public-name: audio_stream_stop_and_wait
 * durable-map: recon/catalogs/function_names_app.json
 * callees (readable <= raw @ address):
 *   z_impl_k_sem_take                        <= FUN_00072908 @ 0x00072908
 *   audio_stream_stop_and_wait               <= FUN_000838fa @ 0x000838fa
 */
/* Reconstructed FUN_000838fa @ 0x838fa  (parity: 300/300 trials, PROVEN) */

extern void z_impl_k_sem_take(unsigned int,unsigned int,unsigned int,unsigned int);
void audio_stream_stop_and_wait(unsigned int param_1,unsigned int param_2)
{
  z_impl_k_sem_take(param_1,param_2,0xffffffff,0xffffffff);
  return;
}

