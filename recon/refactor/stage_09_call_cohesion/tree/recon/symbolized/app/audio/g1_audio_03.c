/*
 * Cohesive translation unit for the `audio' module.
 *
 * GENERATED by recon/refactor/transforms/t04_cohesive_tu.py.  Do not
 * edit: a stage tree is regenerated, never hand-patched
 * (recon/refactor/README.md C4).
 *
 * The 2 functions below were 2 separate translation units until this
 * stage.  Each one's text is reproduced VERBATIM and in the order the
 * generated source list gave it, and they were CONSECUTIVE in that list.
 * They were proven able to share a translation unit: no symbol is
 * declared here with two types, no identifier has internal linkage in one
 * member and is named by another, and no local typedef, macro, struct tag
 * or enum constant of one member is visible to a member that names it.
 *
 * members, in link order:
 *   audio_fw_load_get_wrapper.c
 *   send_dmic_msg.c
 */

/* File-scope forward declarations for every struct/union tag this
 * unit names.  Without them a tag whose only appearance in a member
 * is inside a parameter list has PARAMETER-LIST scope, so two
 * textually IDENTICAL declarations in two members declare two
 * different incomplete types and the second is a conflicting
 * redeclaration (C11 6.2.1p7).  Incomplete-type forward
 * declarations emit no code. */
struct dmic_message;
/* ---- audio_fw_load_get_wrapper.c ---- */
#include "g1_app_symbols.h"
/* readable reconstruction; identity: FUN_00019b54 @ 0x00019b54
 * public-name: audio_fw_load_get_wrapper
 * durable-map: recon/catalogs/function_names_app.json
 * callees (readable <= raw @ address):
 *   audio_fw_load_get_wrapper                <= FUN_00019b54 @ 0x00019b54
 *   master_process_audio_fw_load_req         <= FUN_0002af4c @ 0x0002af4c
 * address symbols (name @ address):
 *   rodata_9b2ba                             @ 0x0009b2ba   [INLINED -- G6 literal batch]
 *   rodata_9b2f5                             @ 0x0009b2f5   [INLINED -- G6 literal batch]
 *   g_log_level                              @ 0x2000230c
 */
/* Reconstructed FUN_00019b54 @ 0x19b54  (parity: 300/300 trials, PROVEN) */
#include <stdint.h>
#include "../../../headers/g1_log.h"
typedef unsigned int uint;
extern int master_process_audio_fw_load_req(char *, unsigned char *, unsigned char *, unsigned int);
uint32_t audio_fw_load_get_wrapper(int param_1,uint8_t* param_2,uint32_t param_3){
  if(*(volatile int *)((unsigned long)&g_log_level) /*=0x2000230c*/==5){
    volatile uint8_t* pbVar3=*(volatile uint8_t* volatile*)(param_1+0x10);
    log_message(((unsigned long)"spim tx(len=%d): %02x,%02x,%02x,%02x, %02x,%02x,%02x,%02x\n") /*=0x9b2ba*/,*(volatile uint32_t *)(param_1+0x14),pbVar3[0],pbVar3[1],pbVar3[2],pbVar3[3],pbVar3[0],pbVar3[1],pbVar3[2],pbVar3[3]);
  }
  uint32_t uVar2=master_process_audio_fw_load_req(param_1-0x77c,*(volatile uint32_t *)(param_1+0x10),param_2,param_3);
  if(*(volatile int *)((unsigned long)&g_log_level) /*=0x2000230c*/==5){
    log_message(((unsigned long)"spim ret(len=%d): %02x,%02x,%02x,%02x, %02x,%02x,%02x,%02x\n") /*=0x9b2f5*/,param_3,param_2[0],param_2[1],param_2[2],param_2[3],param_2[0],param_2[1],param_2[2],param_2[3]);
  }
  return uVar2;
}

/* ---- send_dmic_msg.c ---- */
/* readable reconstruction; identity: FUN_00019ed4 @ 0x00019ed4
 * public-name: send_dmic_msg
 * durable-map: recon/catalogs/function_names_app.json
 * callees (readable <= raw @ address):
 *   get_device_info                          <= FUN_000167a8 @ 0x000167a8
 *   debug_print                              <= FUN_00019c70 @ 0x00019c70
 *   get_dmic_msgq_count                      <= FUN_0002ecf4 @ 0x0002ecf4
 *   dequeue_dmic                             <= FUN_0002ed00 @ 0x0002ed00
 *   set_shutdown_flag                        <= FUN_0007cbfe @ 0x0007cbfe
 *   memset_bytes                             <= FUN_00086c78 @ 0x00086c78
 * address symbols (name @ address):
 *   rodata_9b45e                             @ 0x0009b45e   [INLINED -- G6 literal batch]
 *   rodata_9b482                             @ 0x0009b482   [INLINED -- G6 literal batch]
 *   rodata_9e0a4                             @ 0x0009e0a4   [INLINED -- G6 literal batch]
 *   g_log_level                              @ 0x2000230c
 *   g_log_use_alt_sink                       @ 0x20007554
 *   g_dmic_send_fail_cnt                     @ 0x20007558
 *   g_dmic_send_pos_cnt                      @ 0x2000755c
 *   g_dmic_send_hundreds_cnt                 @ 0x20007560
 *   g_dmic_msg_seq                           @ 0x20010321
 */
/* Reconstructed send_dmic_msg @ 0x19ed4. */

#include "../../../headers/g1_dedupe.h"
#include "g1_audio.h"

struct dmic_message {
    uint32_t header;
    uint8_t tail[199];
};

typedef int (*dmic_send_fn)(const void *message, unsigned int length);

extern unsigned int get_dmic_msgq_count(void);
extern int dequeue_dmic(void *payload);
extern void set_shutdown_flag(void *state, int enabled);
extern void memset_bytes(void*, int, int);
extern unsigned long long thunk_FUN_00074f68(void);

int send_dmic_msg(uint8_t *transport)
{
    volatile uint8_t *sequence = (volatile uint8_t *)((unsigned long)&g_dmic_msg_seq) /*=0x20010321*/;
    volatile int *failure_count = (volatile int *)((unsigned long)&g_dmic_send_fail_cnt) /*=0x20007558*/;
    struct dmic_message message;
    uint8_t old_sequence;
    int result;

    message.header = 0;
    memset_bytes(message.tail, 0, sizeof(message.tail));
    ((uint8_t *)&message.header)[0] = 0xf1;

    do {
        ((uint8_t *)&message.header)[1] = *sequence;
        if (get_dmic_msgq_count() == 0) {
            return 0;
        }

        result = dequeue_dmic((uint8_t *)&message + 2);
        if (result != 0) {
            return result;
        }

        result = (*(dmic_send_fn *)(transport + 0x0c))(&message, 202);
        if (result < 0 && ++*failure_count > 9) {
            set_shutdown_flag(get_device_info(), 1);
            if (*(volatile int *)((unsigned long)&g_log_level) /*=0x2000230c*/ > 0) {
                G1_LOG_ROUTE(*(volatile int *)((unsigned long)&g_log_use_alt_sink) /*=0x20007554*/ == 0, ((unsigned long)"%s(): BLE send failed for %d times\n") /*=0x9b45e*/, ((unsigned long)"send_dmic_msg") /*=0x9e0a4*/,
                                *failure_count);
            }
            *failure_count = 0;
            return result;
        }

        if (*(volatile int *)((unsigned long)&g_dmic_send_pos_cnt) /*=0x2000755c*/ + 1 < 100) {
            ++*(volatile int *)((unsigned long)&g_dmic_send_pos_cnt) /*=0x2000755c*/;
        } else {
            unsigned long long timestamp;
            unsigned long long scaled_timestamp;
            int report_count;

            *(volatile int *)((unsigned long)&g_dmic_send_pos_cnt) /*=0x2000755c*/ = 0;
            timestamp = thunk_FUN_00074f68();
            report_count = *(volatile int *)((unsigned long)&g_dmic_send_hundreds_cnt) /*=0x20007560*/;
            *(volatile int *)((unsigned long)&g_dmic_send_hundreds_cnt) /*=0x20007560*/ = report_count + 1;
            if (*(volatile int *)((unsigned long)&g_log_level) /*=0x2000230c*/ > 0) {
                scaled_timestamp = (timestamp * 1000ULL + 0x7fffULL) >> 15;
                G1_LOG_ROUTE(*(volatile int *)((unsigned long)&g_log_use_alt_sink) /*=0x20007554*/ == 0, ((unsigned long)"%s(): dmic_send_count %d send_fail_count %d time %lld\n") /*=0x9b482*/, ((unsigned long)"send_dmic_msg") /*=0x9e0a4*/,
                                (report_count + 1) * 100, *failure_count,
                                (uint32_t)scaled_timestamp,
                                (uint32_t)(scaled_timestamp >> 32));
            }
        }

        old_sequence = *sequence;
        *sequence = old_sequence + 1;
    } while (((old_sequence + 1) & 3) != 0);

    return 0;
}

