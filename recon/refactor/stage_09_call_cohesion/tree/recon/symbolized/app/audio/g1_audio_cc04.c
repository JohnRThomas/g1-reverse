/*
 * Call-cohesive translation unit for the `audio' module.
 *
 * GENERATED by recon/refactor/transforms/t09_call_cohesion.py.  Do
 * not edit: a stage tree is regenerated, never hand-patched
 * (recon/refactor/README.md C4).
 *
 * The 2 translation units below were grouped because they CALL ONE
 * ANOTHER, not because they were adjacent in the generated source
 * list.  Each member's text is reproduced VERBATIM.  Every member was
 * checked pairwise against every other member already in this unit by
 * stage 04's seven refusal rules, unchanged: no symbol is declared
 * here with two types, no identifier has internal linkage in one
 * member and is named by another, and no local typedef, macro, struct
 * tag or enum constant of one member is visible to a member that
 * names it.
 *
 * members, in generated-source-list order:
 *   g1_audio_16.c
 *   g1_audio_17.c
 *
 * call edges inside this unit (caller -> callee): 1
 *   g1_audio_17.c -> g1_audio_16.c
 */

/* File-scope forward declarations for every struct/union tag this
 * unit names.  Without them a tag whose only appearance in a member
 * is inside a parameter list has PARAMETER-LIST scope, so two
 * textually IDENTICAL declarations in two members declare two
 * different incomplete types and the second is a conflicting
 * redeclaration (C11 6.2.1p7).  Incomplete-type forward
 * declarations emit no code. */
struct event_record;
struct k_sem;
/* ================================================================ */
/* member unit: g1_audio_16.c */
/* ================================================================ */
/*
 * Cohesive translation unit for the `audio' module.
 *
 * GENERATED by recon/refactor/transforms/t04_cohesive_tu.py.  Do not
 * edit: a stage tree is regenerated, never hand-patched
 * (recon/refactor/README.md C4).
 *
 * The 6 functions below were 6 separate translation units until this
 * stage.  Each one's text is reproduced VERBATIM and in the order the
 * generated source list gave it, and they were CONSECUTIVE in that list.
 * They were proven able to share a translation unit: no symbol is
 * declared here with two types, no identifier has internal linkage in one
 * member and is named by another, and no local typedef, macro, struct tag
 * or enum constant of one member is visible to a member that names it.
 *
 * members, in link order:
 *   pdm_release_pin.c
 *   post_uid_event_mode2.c
 *   audio_fw_load_trigger_passthrough.c
 *   invoke_optional_op_offset12.c
 *   opt_node_header_len.c
 *   opt_node_value_len.c
 */

/* File-scope forward declarations for every struct/union tag this
 * unit names.  Without them a tag whose only appearance in a member
 * is inside a parameter list has PARAMETER-LIST scope, so two
 * textually IDENTICAL declarations in two members declare two
 * different incomplete types and the second is a conflicting
 * redeclaration (C11 6.2.1p7).  Incomplete-type forward
 * declarations emit no code. */
struct event_record;
struct k_sem;
/* ---- pdm_release_pin.c ---- */
#include "g1_app_symbols.h"
/* readable reconstruction; identity: FUN_00066130 @ 0x00066130
 * public-name: pdm_release_pin
 * durable-map: recon/catalogs/function_names_app.json
 * callees (readable <= raw @ address):
 *   nrf_gpio_pin_port_decode_65ff4           <= FUN_00065ff4 @ 0x00065ff4
 *   pdm_release_pin                          <= FUN_00066130 @ 0x00066130
 */
/* Reconstructed FUN_00066130 @ 0x66130  (parity: 300/300 trials, PROVEN) */

#include <stdint.h>
extern int nrf_gpio_pin_port_decode_65ff4(int *p);

static void pdm_release_pin(int param_1, unsigned int param_2, unsigned int param_3)
{
  int local_c = param_1;
  unsigned int uStack_8 = param_3;
  (void)uStack_8;
  int iVar1 = nrf_gpio_pin_port_decode_65ff4(&local_c);
  iVar1 = iVar1 + local_c * 4;
  volatile uint32_t *p = (volatile uint32_t *)(iVar1 + 0x200);
  *p = (0xfffcf0f0u & *p) | 2;
}

/* ---- post_uid_event_mode2.c ---- */
#include "g1_audio.h"
struct k_sem;
/* readable reconstruction; identity: FUN_0007c0e2 @ 0x0007c0e2
 * public-name: post_uid_event_mode2
 * durable-map: recon/catalogs/function_names_app.json
 * callees (readable <= raw @ address):
 *   ancs_get_conn_ctx                        <= FUN_000181fc @ 0x000181fc
 *   enqueue_uid                              <= FUN_00018e48 @ 0x00018e48
 *   k_sem_give                               <= FUN_00072880 @ 0x00072880
 *   post_uid_event_mode2                     <= FUN_0007c0e2 @ 0x0007c0e2
 */
/* Reconstructed FUN_0007c0e2 @ 0x7c0e2  (parity: 300/300 trials, PROVEN) */

extern int enqueue_uid(void *p);
extern void k_sem_give(struct k_sem *);

void post_uid_event_mode2(unsigned int param_1, unsigned int param_2, unsigned int param_3)
{
  struct event_record {
    unsigned int value;
    unsigned int mode;
    unsigned int context;
  } event = { param_1, (param_2 & 0xffffff00u) | 2u, param_3 };
  int iVar1 = ancs_get_conn_ctx();
  int iVar2 = enqueue_uid(&event);
  if (iVar2 == 0) {
    k_sem_give((unsigned int)iVar1 + 0x200);
  }
}

/* ---- audio_fw_load_trigger_passthrough.c ---- */
/* readable reconstruction; identity: FUN_0007c1fe @ 0x0007c1fe
 * public-name: audio_fw_load_trigger_passthrough
 * durable-map: recon/catalogs/function_names_app.json
 * callees (readable <= raw @ address):
 *   audio_fw_load_get_wrapper                <= FUN_00019b54 @ 0x00019b54
 *   audio_fw_load_trigger_passthrough        <= FUN_0007c1fe @ 0x0007c1fe
 */
/* Reconstructed FUN_0007c1fe @ 0x7c1fe  (parity: 300/300 trials, PROVEN) */

extern unsigned long audio_fw_load_get_wrapper(int, unsigned char*, unsigned long);
unsigned int audio_fw_load_trigger_passthrough(unsigned int param_1,unsigned int param_2,unsigned int param_3)
{
  audio_fw_load_get_wrapper(param_1, param_2, param_3);
  return param_3;
}

/* ---- invoke_optional_op_offset12.c ---- */
/* readable reconstruction; identity: FUN_0007c3da @ 0x0007c3da
 * public-name: invoke_optional_op_offset12
 * durable-map: recon/catalogs/function_names_app.json
 * callees (readable <= raw @ address):
 *   invoke_optional_op_offset12              <= FUN_0007c3da @ 0x0007c3da
 */
/* Full reconstruction FUN_0007c3da @ 0x7c3da (exact extent 16 bytes).
 *
 * P4 iteration 40.  The shipped body is a pure tail dispatch
 *     0007c3da  cbz  r0, #0x7c3e2
 *     0007c3dc  ldr  r3, [r0, #0xc]
 *     0007c3de  cbz  r3, #0x7c3e6
 *     0007c3e0  bx   r3
 * so EVERY argument register the caller set is forwarded untouched.  The only
 * caller, st25dv_build_and_write_ndef_records (0x250f8), passes two: the record
 * and the out node that FUN_00025020 / FUN_00025058 bind.  The previous body
 * declared a single parameter and happened to keep r1 alive; that is a property
 * of this codegen, not of the source, so the second argument is now explicit.
 */
uint32_t invoke_optional_op_offset12(uint8_t *object, void *out_node)
{
    if (object == 0) return 7;
    uint32_t (*callback)(uint8_t *, void *) =
        *(uint32_t (**)(uint8_t *, void *))(object + 12);
    return callback != 0 ? callback(object, out_node) : 15;
}

/* ---- opt_node_header_len.c ---- */
/* readable reconstruction; identity: FUN_0007c3ea @ 0x0007c3ea
 * public-name: opt_node_header_len
 * durable-map: recon/catalogs/function_names_app.json
 * callees (readable <= raw @ address):
 *   opt_node_header_len                      <= FUN_0007c3ea @ 0x0007c3ea
 */
/* Reconstructed FUN_0007c3ea @ 0x7c3ea  (parity: 300/300 trials, PROVEN) */

unsigned char * opt_node_header_len(unsigned char *param_1)
{
  int iVar1;

  if (param_1 != (unsigned char *)0x0) {
    if ((*param_1 & 0x10) == 0) {
      iVar1 = 6;
    }
    else {
      iVar1 = 3;
    }
    if ((int)((unsigned int)*param_1 << 0x1c) < 0) {
      iVar1 = iVar1 + 1;
    }
    param_1 = (unsigned char *)((unsigned int)param_1[1] + (unsigned int)param_1[2] + iVar1);
  }
  return param_1;
}

/* ---- opt_node_value_len.c ---- */
/* readable reconstruction; identity: FUN_0007c408 @ 0x0007c408
 * public-name: opt_node_value_len
 * durable-map: recon/catalogs/function_names_app.json
 * callees (readable <= raw @ address):
 *   opt_node_value_len                       <= FUN_0007c408 @ 0x0007c408
 */
/* Reconstructed FUN_0007c408 @ 0x7c408  (parity: 300/300 trials, PROVEN)
 *
 * P4 iteration 40 -- DROPPED ARGUMENT.  The indirect `value_len` op is invoked
 * by the shipped function with the DESCRIPTOR in r0, not the outer node:
 *     0007c408  mov  r3, r0
 *     0007c40a  cbz  r0, #0x7c41a
 *     0007c40c  ldr  r0, [r0, #0x14]     ; <<< r0 = the descriptor
 *     0007c40e  cbz  r0, #0x7c416
 *     0007c410  ldr  r2, [r0, #4]
 *     0007c412  cbz  r2, #0x7c416
 *     0007c414  bx   r2                  ; tail call, r0 = the descriptor
 *     0007c416  ldr  r0, [r3, #0x10]
 * The previous body wrote `fn()` with NO argument.  Measured in the shipped-in
 * build /private/tmp/g1-i39c-app/zephyr/zephyr.elf, that compiled to
 *     78a1e  ldr r3,[r0,#20] ; 78a22 ldr r3,[r3,#4] ; 78a26 bx r3
 * i.e. r0 still held the OUTER node.  Harmless while every op pointer was an
 * unrelocated original-image address, fatal as soon as FUN_0007c38a /
 * FUN_0007c39c became real code: they read `*r0` expecting the record type
 * byte 7 / 8 and would have seen the option-node header instead, answering a
 * payload length of 0.  `cfg_verify` cannot see this -- the target is an
 * order-keyed oracle whose arguments are not compared.
 */

typedef unsigned int (*fnptr_t)(int *);

unsigned int opt_node_value_len(int param_1)
{
    if (param_1 == 0) return 0;
    int *p14 = *(int **)(param_1 + 0x14);
    if (p14 != 0) {
        fnptr_t fn = *(fnptr_t *)((char *)p14 + 4);
        if (fn != 0) {
            return fn(p14);
        }
    }
    return *(unsigned int *)(param_1 + 0x10);
}

/* ================================================================ */
/* member unit: g1_audio_17.c */
/* ================================================================ */
/*
 * Cohesive translation unit for the `audio' module.
 *
 * GENERATED by recon/refactor/transforms/t04_cohesive_tu.py.  Do not
 * edit: a stage tree is regenerated, never hand-patched
 * (recon/refactor/README.md C4).
 *
 * The 4 functions below were 4 separate translation units until this
 * stage.  Each one's text is reproduced VERBATIM and in the order the
 * generated source list gave it, and they were CONSECUTIVE in that list.
 * They were proven able to share a translation unit: no symbol is
 * declared here with two types, no identifier has internal linkage in one
 * member and is named by another, and no local typedef, macro, struct tag
 * or enum constant of one member is visible to a member that names it.
 *
 * members, in link order:
 *   opt_node_total_len.c
 *   opt_field1_set.c
 *   opt_field2_set.c
 *   opt_field3_set.c
 */
/* ---- opt_node_total_len.c ---- */
#include "g1_app_symbols.h"
#include "g1_audio.h"
#include <stdint.h>
/* readable reconstruction; identity: FUN_0007c41c @ 0x0007c41c
 * public-name: opt_node_total_len
 * durable-map: recon/catalogs/function_names_app.json
 * callees (readable <= raw @ address):
 *   opt_node_header_len                      <= FUN_0007c3ea @ 0x0007c3ea
 *   opt_node_value_len                       <= FUN_0007c408 @ 0x0007c408
 *   opt_node_total_len                       <= FUN_0007c41c @ 0x0007c41c
 */
/* Reconstructed FUN_0007c41c @ 0x7c41c  (parity: 300/300 trials, PROVEN) */

/* P4 iteration 40 -- DROPPED ARGUMENT.  Shipped 0007c41e `mov r5,r0` then
 * 0007c420 `bl #0x7c3ea` with r0 STILL the node; the header-length op is a
 * one-argument function (see opt_node_header_len, which dereferences r0). */
extern unsigned char * opt_node_header_len(unsigned char *);

int opt_node_total_len(unsigned int param_1)
{
    int iVar1 = opt_node_header_len(param_1);
    int iVar2 = opt_node_value_len(param_1);
    return iVar2 + iVar1;
}

/* ---- opt_field1_set.c ---- */
/* readable reconstruction; identity: FUN_0007c430 @ 0x0007c430
 * public-name: opt_field1_set
 * durable-map: recon/catalogs/function_names_app.json
 * callees (readable <= raw @ address):
 *   opt_field1_set                           <= FUN_0007c430 @ 0x0007c430
 */
/* Reconstructed FUN_0007c430 @ 0x7c430  (parity: 300/300 trials, PROVEN) */

unsigned int opt_field1_set(unsigned char *param_1, unsigned int param_2, int *param_3)
{
  if (param_1 != 0 && param_3 != 0 &&
      (*param_3 != 0 || ((char)((unsigned char*)param_3)[4] == 0))) {
    *param_1 = *param_1 | (param_2 & 7);
    param_1[1] = ((unsigned char*)param_3)[4];
    *(int *)(param_1 + 4) = *param_3;
    return 0;
  }
  return 7;
}

/* ---- opt_field2_set.c ---- */
/* readable reconstruction; identity: FUN_0007c456 @ 0x0007c456
 * public-name: opt_field2_set
 * durable-map: recon/catalogs/function_names_app.json
 * callees (readable <= raw @ address):
 *   opt_field2_set                           <= FUN_0007c456 @ 0x0007c456
 */
/* Reconstructed FUN_0007c456 @ 0x7c456  (parity: 300/300 trials, PROVEN) */

int opt_field2_set(unsigned char *param_1, int *param_2)
{
    if (param_1 == 0 || param_2 == 0) return 7;
    if (!(param_2[0] != 0 || param_2[1] == 0)) return 7;
    unsigned char b = *(volatile unsigned char *)param_1;
    b = b & 0xef;
    *(volatile unsigned char *)param_1 = b;
    unsigned int p1 = *(volatile unsigned int *)((char*)param_2+4);
    unsigned int flag = (p1 > 0xff) ? 0 : 1;
    b = (b & 0xef) | (flag << 4);
    *(volatile unsigned char *)param_1 = b;
    *(volatile unsigned int *)((char*)param_1+0xc) = *(volatile unsigned int *)param_2;
    *(volatile unsigned int *)((char*)param_1+0x10) = *(volatile unsigned int *)((char*)param_2+4);
    return 0;
}

/* ---- opt_field3_set.c ---- */
/* readable reconstruction; identity: FUN_0007c48a @ 0x0007c48a
 * public-name: opt_field3_set
 * durable-map: recon/catalogs/function_names_app.json
 * callees (readable <= raw @ address):
 *   opt_field3_set                           <= FUN_0007c48a @ 0x0007c48a
 */
/* Reconstructed FUN_0007c48a @ 0x7c48a  (parity: 300/300 trials, PROVEN) */

unsigned int opt_field3_set(uint8_t *param_1, int *param_2)
{
    uint8_t bVar1;
    if (param_1 != (uint8_t*)0 && param_2 != (int*)0) {
        if (*param_2 == 0) {
            if ((char)*((uint8_t*)param_2 + 4) != 0) {
                return 7;
            }
            bVar1 = *param_1 & 0xf7;
        } else {
            bVar1 = *param_1 | 8;
        }
        *param_1 = bVar1;
        *(int*)(param_1 + 8) = *param_2;
        param_1[2] = *((uint8_t*)param_2 + 4);
        return 0;
    }
    return 7;
}

