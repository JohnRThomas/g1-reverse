/*
 * Call-cohesive translation unit for the `audio' module.
 *
 * GENERATED by recon/refactor/transforms/t09_call_cohesion.py.  Do
 * not edit: a stage tree is regenerated, never hand-patched
 * (recon/refactor/README.md C4).
 *
 * The 4 translation units below were grouped because they CALL ONE
 * ANOTHER, not because they were adjacent in the generated source
 * list.  Each member's text is reproduced VERBATIM.  Every member was
 * checked pairwise against every other member already in this unit by
 * stage 04's seven refusal rules, unchanged: no symbol is declared
 * here with two types, no identifier has internal linkage in one
 * member and is named by another, and no local typedef, macro, struct
 * tag or enum constant of one member is visible to a member that
 * names it.
 *
 * members, in generated-source-list order:
 *   qspi_nor_pm_action.c
 *   g1_audio_20.c
 *   audio_codec_read_trim_word.c
 *   delay_scaled_busy_wait.c
 *
 * call edges inside this unit (caller -> callee): 3
 *   audio_codec_read_trim_word.c -> g1_audio_20.c
 *   qspi_nor_pm_action.c -> delay_scaled_busy_wait.c
 *   qspi_nor_pm_action.c -> g1_audio_20.c
 */

/* File-scope forward declarations for every struct/union tag this
 * unit names.  Without them a tag whose only appearance in a member
 * is inside a parameter list has PARAMETER-LIST scope, so two
 * textually IDENTICAL declarations in two members declare two
 * different incomplete types and the second is a conflicting
 * redeclaration (C11 6.2.1p7).  Incomplete-type forward
 * declarations emit no code. */
struct g1_opt_view;
/* ================================================================ */
/* member unit: qspi_nor_pm_action.c */
/* ================================================================ */
#include "g1_app_symbols.h"
/* readable reconstruction; identity: FUN_00060b48 @ 0x00060b48
 * public-name: qspi_nor_pm_action
 * durable-map: recon/catalogs/function_names_app.json
 * callees (readable <= raw @ address):
 *   qspi_nor_acquire                         <= FUN_00060a10 @ 0x00060a10
 *   qspi_nor_suspend_bus                     <= FUN_00060a5c @ 0x00060a5c
 *   qspi_nor_send_cinstr                     <= FUN_00060ab0 @ 0x00060ab0
 *   qspi_nor_pm_action                       <= FUN_00060b48 @ 0x00060b48
 *   nrfx_qspi_init                           <= FUN_00066994 @ 0x00066994
 *   nrfx_qspi_mem_busy_check                 <= FUN_00066ae0 @ 0x00066ae0
 *   nrfx_qspi_uninit                         <= FUN_00066b24 @ 0x00066b24
 *   audio_hw_lock_is_busy                    <= FUN_0007ef2e @ 0x0007ef2e
 *   qspi_pinctrl_apply_state                 <= FUN_000838dc @ 0x000838dc
 *   audio_apply_config_cmd_0xab              <= FUN_0008397e @ 0x0008397e
 *   delay_scaled_busy_wait                   <= FUN_00086384 @ 0x00086384
 * address symbols (name @ address):
 *   rodata_838cb                             @ 0x000838cb
 */
/* Reconstructed FUN_00060b48 @ 0x60b48  (parity: 300/300 trials, PROVEN) */
#include <stdint.h>
#include "g1_audio.h"
typedef unsigned int uint;
extern int qspi_nor_acquire(int);
extern void qspi_nor_suspend_bus(unsigned char*);
extern int qspi_nor_send_cinstr(int,void*,int,int,int);
#define g1_recon_nrfx_qspi_init nrfx_qspi_init
extern int g1_recon_nrfx_qspi_init(int,int,int);
#define g1_recon_nrfx_qspi_mem_busy_check nrfx_qspi_mem_busy_check
extern int audio_hw_lock_is_busy(unsigned long);
extern int qspi_pinctrl_apply_state(int,int);

uint qspi_nor_pm_action(int param_1, int param_2, unsigned param_3, unsigned param_4){
    int iVar5 = *(int*)(param_1+0x10);
    int iVar4 = *(int*)(param_1+4);
    int iVar3 = param_1;
    volatile int local[3];
    int iVar1 = audio_hw_lock_is_busy(param_1);
    if (iVar1 == 0){
        uint uVar2;
        if (param_2 != 0){
            if (param_2 != 1) return 0xffffff7a;
            uVar2 = qspi_pinctrl_apply_state(*(int*)(iVar4+0x34), 0);
            if ((int)uVar2 < 0) return uVar2;
            iVar3 = g1_recon_nrfx_qspi_init(iVar4, ((unsigned long)&rodata_838cb) /*=0x838cb*/, iVar5);
            if (iVar3 != 0x0bad0000) return 0xfffffffb;
            uVar2 = audio_apply_config_cmd_0xab(param_1);
            if ((int)uVar2 < 0) return uVar2;
            qspi_nor_suspend_bus(param_1);
            return 0;
        }
        uVar2 = qspi_nor_acquire(param_1);
        if ((int)uVar2 < 0) return uVar2;
        uVar2 = *(uint8_t*)(iVar5+0x60);
        if (uVar2==0){
            iVar1 = g1_recon_nrfx_qspi_mem_busy_check();
            if (iVar1 == 0x0bad0000){
                local[0]=0xb9; local[1]=uVar2; local[2]=uVar2;
                uVar2 = qspi_nor_send_cinstr(param_1, (void*)local, 0, 0xb9, iVar3);
                if ((int)uVar2 < 0) return uVar2;
                delay_scaled_busy_wait(10);
                nrfx_qspi_uninit();
                uVar2 = qspi_pinctrl_apply_state(*(int*)(iVar4+0x34), 1);
                return uVar2 & ((int)uVar2 >> 0x1f);
            }
        }
    }
    return 0xfffffff0;
}

/* ================================================================ */
/* member unit: g1_audio_20.c */
/* ================================================================ */
/*
 * Cohesive translation unit for the `audio' module.
 *
 * GENERATED by recon/refactor/transforms/t04_cohesive_tu.py.  Do not
 * edit: a stage tree is regenerated, never hand-patched
 * (recon/refactor/README.md C4).
 *
 * The 12 functions below were 12 separate translation units until this
 * stage.  Each one's text is reproduced VERBATIM and in the order the
 * generated source list gave it, and they were CONSECUTIVE in that list.
 * They were proven able to share a translation unit: no symbol is
 * declared here with two types, no identifier has internal linkage in one
 * member and is named by another, and no local typedef, macro, struct tag
 * or enum constant of one member is visible to a member that names it.
 *
 * members, in link order:
 *   opt_list_encode.c
 *   opt_list_append_node.c
 *   atomic_or_bit1.c
 *   device_api_call_slot0.c
 *   buffer_append_sum_checksum.c
 *   audio_hw_lock_get_status_byte.c
 *   audio_hw_lock_is_busy.c
 *   audio_hw_lock_acquire.c
 *   audio_hw_lock_release.c
 *   audio_hw_lock_get_aux_flag.c
 *   audio_codec_reg_op_dispatch.c
 *   audio_codec_bus_write.c
 */

/* File-scope forward declarations for every struct/union tag this
 * unit names.  Without them a tag whose only appearance in a member
 * is inside a parameter list has PARAMETER-LIST scope, so two
 * textually IDENTICAL declarations in two members declare two
 * different incomplete types and the second is a conflicting
 * redeclaration (C11 6.2.1p7).  Incomplete-type forward
 * declarations emit no code. */
struct g1_opt_view;
/* ---- opt_list_encode.c ---- */
#include "g1_app_symbols.h"
/* readable reconstruction; identity: FUN_0007c77e @ 0x0007c77e
 * public-name: opt_list_encode
 * durable-map: recon/catalogs/function_names_app.json
 * callees (readable <= raw @ address):
 *   opt_node_serialize                       <= FUN_0007c6a0 @ 0x0007c6a0
 *   opt_list_total_len                       <= FUN_0007c754 @ 0x0007c754
 *   opt_list_encode                          <= FUN_0007c77e @ 0x0007c77e
 */
/* Reconstructed FUN_0007c77e @ 0x7c77e  (parity: 300/300 trials, PROVEN)
 *
 * P4 iteration 40 -- STACK-OBJECT LAYOUT.  The shipped body pushes r0..r3 as a
 * spill area and hands out TWO two-word objects from it: sp+0/sp+4 to
 * opt_list_total_len (which writes {total, count}) and sp+8/sp+0xc to
 * opt_node_serialize (which writes the byte count back into sp+0xc and which
 * the caller then reads with `0007c7d0 ldr r3,[sp,#0xc]`).
 *
 * The previous body modelled the second object as TWO SEPARATE LOCALS.
 * Measured in /private/tmp/g1-i40c-app/zephyr/zephyr.elf, GCC therefore kept
 * the length in a register and emitted
 *     78f94 add r1, sp, #4 ; 78f96 str r3,[sp,#4] ; 78f98 bl opt_node_serialize
 * -- the LENGTH WORD OF THE VIEW IS NEVER WRITTEN.  opt_node_serialize then
 * compared its own total against a stale frame word, took its
 * `remaining < total` exit and returned 1 without serializing anything, and
 * the caller wrote the total back into the view; st25dv_build_and_write_ndef_
 * records duly pushed 28 bytes of STALE STACK to the ST25DV mailbox
 * (`000670210020B7F1...` against the oracle's
 * `0006910606574C434341502001091E030A510703574C4353544149056401`).  The same
 * codegen also dropped the written-length read-back: `78faa mov r8, r0` set the
 * running offset to the callee's zero return instead of to sp+0xc.
 */

struct g1_opt_view { int data; int length; };

extern int opt_node_serialize(int, int *);
extern int opt_list_total_len(int *, int *);

int opt_list_encode(int *param_1, int *param_2, int param_3, unsigned param_4){
    struct g1_opt_view total;
    struct g1_opt_view view;
    int status, node, written, remaining;

    if ((param_2 == 0) || (*param_2 == 0)) return 7;
    /* the pushed argument words the two objects start life as */
    total.data = (int)param_1;
    total.length = (int)param_2;
    view.data = param_3;
    view.length = (int)param_4;

    status = opt_list_total_len(param_1, &total);
    if ((status != 0) || ((unsigned)param_2[1] < (unsigned)total.data)) {
        param_2[1] = total.data;
        return 1;
    }
    remaining = param_2[1];
    written = 0;
    if (param_1 != 0) {
        for (node = *param_1; node != 0; node = *(int*)(node + 0x18)) {
            view.data = *param_2 + written;
            view.length = remaining;
            status = opt_node_serialize(node, &view);
            if (status != 0) {
                param_2[1] = total.data;
                return status;
            }
            written += view.length;
            remaining -= view.length;
        }
    }
    param_2[1] = written;
    return 0;
}

/* ---- opt_list_append_node.c ---- */
#include "g1_audio.h"
/* readable reconstruction; identity: FUN_0007c7de @ 0x0007c7de
 * public-name: opt_list_append_node
 * durable-map: recon/catalogs/function_names_app.json
 * callees (readable <= raw @ address):
 *   opt_node_total_len                       <= FUN_0007c41c @ 0x0007c41c
 *   opt_list_append_node                     <= FUN_0007c7de @ 0x0007c7de
 */
/* Reconstructed FUN_0007c7de @ 0x7c7de  (parity: 300/300 trials, PROVEN) */


unsigned int opt_list_append_node(unsigned int *param_1, unsigned char *param_2)
{
    unsigned char bVar1;
    unsigned char *pbVar2;
    unsigned char *pbVar5;
    int iVar3;
    unsigned int uVar4;

    if (param_1 == 0 || param_2 == 0) {
        uVar4 = 7;
    } else {
        bVar1 = *param_2;
        *param_2 = (unsigned char)((bVar1 & 0x7f) | 0x40);
        *(volatile unsigned int *)(param_2 + 0x18) = 0;
        pbVar2 = *(unsigned char **)param_1;
        if (pbVar2 == 0) {
            *param_2 = (unsigned char)((bVar1 & 0x7f) | 0xc0);
            *(unsigned char **)param_1 = param_2;
        } else {
            do {
                pbVar5 = pbVar2;
                pbVar2 = *(unsigned char **)(pbVar5 + 0x18);
            } while (*(unsigned char **)(pbVar5 + 0x18) != 0);
            *(unsigned char **)(pbVar5 + 0x18) = param_2;
            *pbVar5 = (unsigned char)(*pbVar5 & 0xbf);
        }
        iVar3 = opt_node_total_len(param_2);
        uVar4 = 0;
        param_1[1] = param_1[1] + iVar3;
        param_1[2] = param_1[2] + 1;
    }
    return uVar4;
}

/* ---- atomic_or_bit1.c ---- */
/* readable reconstruction; identity: FUN_0007cb54 @ 0x0007cb54
 * public-name: atomic_or_bit1
 * durable-map: recon/catalogs/function_names_app.json
 * callees (readable <= raw @ address):
 *   atomic_or_bit1                           <= FUN_0007cb54 @ 0x0007cb54
 */
/* Reconstructed FUN_0007cb54 @ 0x7cb54 */
#include <stdint.h>

void atomic_or_bit1(volatile uint32_t *flags)
{
    __atomic_fetch_or(flags, 2u, __ATOMIC_RELAXED);
}

/* ---- device_api_call_slot0.c ---- */
/* readable reconstruction; identity: FUN_0007d120 @ 0x0007d120
 * public-name: device_api_call_slot0
 * durable-map: recon/catalogs/function_names_app.json
 * callees (readable <= raw @ address):
 *   device_api_call_slot0                    <= FUN_0007d120 @ 0x0007d120
 */
/* Reconstructed FUN_0007d120 @ 0x7d120 */
typedef uint32_t (*dispatch_t)(uint32_t,uint32_t,uint32_t,uint32_t);
int device_api_call_slot0(void*object, unsigned long b, void*c, unsigned long d) {
  dispatch_t fn=**(dispatch_t volatile **)(object+8); return fn((uint32_t)(uintptr_t)object,b,c,d);
}

/* ---- buffer_append_sum_checksum.c ---- */
/* readable reconstruction; identity: FUN_0007d16a @ 0x0007d16a
 * public-name: buffer_append_sum_checksum
 * durable-map: recon/catalogs/function_names_app.json
 * callees (readable <= raw @ address):
 *   buffer_append_sum_checksum               <= FUN_0007d16a @ 0x0007d16a
 */
/* Reconstructed FUN_0007d16a @ 0x7d16a  (parity: 300/300 trials, PROVEN) */

int buffer_append_sum_checksum(int *param_1, unsigned char *param_2)
{
    if (param_1 == 0 || param_2 == 0) {
        return -1;
    }
    char cVar2 = 0;
    unsigned char bVar1 = *param_2;
    int iVar4;
    for (iVar4 = 0; iVar4 < (int)(unsigned int)bVar1; iVar4++) {
        cVar2 = cVar2 + *(char*)(*param_1 + iVar4);
    }
    *(char*)(*param_1 + (unsigned int)bVar1) = cVar2;
    *param_2 = bVar1 + 1;
    return 0;
}

/* ---- audio_hw_lock_get_status_byte.c ---- */
/* readable reconstruction; identity: FUN_0007ef1c @ 0x0007ef1c
 * public-name: audio_hw_lock_get_status_byte
 * durable-map: recon/catalogs/function_names_app.json
 * callees (readable <= raw @ address):
 *   audio_hw_lock_get_status_byte            <= FUN_0007ef1c @ 0x0007ef1c
 */
/* Reconstructed FUN_0007ef1c @ 0x7ef1c  (parity: 300/300 trials, PROVEN) */

unsigned int audio_hw_lock_get_status_byte(int param_1, unsigned char *param_2)
{
    int p = *(int*)(param_1 + 0x14);
    if (p != 0) {
        *param_2 = *(unsigned char*)(p + 8);
        return 0;
    }
    return 0xffffffa8;
}

/* ---- audio_hw_lock_is_busy.c ---- */
/* readable reconstruction; identity: FUN_0007ef2e @ 0x0007ef2e
 * public-name: audio_hw_lock_is_busy
 * durable-map: recon/catalogs/function_names_app.json
 * callees (readable <= raw @ address):
 *   audio_hw_lock_is_busy                    <= FUN_0007ef2e @ 0x0007ef2e
 */
/* Reconstructed FUN_0007ef2e @ 0x7ef2e  (parity: 300/300 trials, PROVEN) */

int audio_hw_lock_is_busy(unsigned long param_1) {
  unsigned int v = *(unsigned int*)(param_1 + 0x14);
  if (v != 0) {
    v = *(volatile unsigned int *)(v + 4) & 1;
  }
  return v;
}

/* ---- audio_hw_lock_acquire.c ---- */
/* readable reconstruction; identity: FUN_0007ef3e @ 0x0007ef3e
 * public-name: audio_hw_lock_acquire
 * durable-map: recon/catalogs/function_names_app.json
 * callees (readable <= raw @ address):
 *   audio_hw_lock_acquire                    <= FUN_0007ef3e @ 0x0007ef3e
 */
/* Reconstructed FUN_0007ef3e @ 0x7ef3e */

void audio_hw_lock_acquire(void *object)
{
    uint8_t *base = object;
    uintptr_t member = *(uintptr_t *)(base + 0x14);
    if (member) {
        volatile uint32_t *flags = (volatile uint32_t *)(member + 4);
        (void)__atomic_fetch_or((uint32_t *)flags, 1u, __ATOMIC_ACQ_REL);
    }
}

/* ---- audio_hw_lock_release.c ---- */
/* readable reconstruction; identity: FUN_0007ef56 @ 0x0007ef56
 * public-name: audio_hw_lock_release
 * durable-map: recon/catalogs/function_names_app.json
 */
/* audio_hw_lock_release @ 0x0007ef56; raw FUN_0007ef56 */

void audio_hw_lock_release(uint8_t *device)
{
    uint8_t *state = *(uint8_t **)(device + 0x14);

    if (state != 0) {
        __atomic_fetch_and((uint32_t *)(state + 4), ~1u, __ATOMIC_SEQ_CST);
    }
}

/* ---- audio_hw_lock_get_aux_flag.c ---- */
/* readable reconstruction; identity: FUN_0007ef6e @ 0x0007ef6e
 * public-name: audio_hw_lock_get_aux_flag
 * durable-map: recon/catalogs/function_names_app.json
 * callees (readable <= raw @ address):
 *   audio_hw_lock_get_aux_flag               <= FUN_0007ef6e @ 0x0007ef6e
 */
/* Reconstructed FUN_0007ef6e @ 0x7ef6e  (parity: 300/300 trials, PROVEN) */

unsigned int audio_hw_lock_get_aux_flag(unsigned char *param_1) {
  unsigned int v = *(unsigned int*)(param_1 + 0x14);
  if (v != 0) {
    unsigned int w = __atomic_load_n((unsigned int *)(v + 4), __ATOMIC_ACQUIRE);
    v = (w >> 6) & 1;
  }
  return v;
}

/* ---- audio_codec_reg_op_dispatch.c ---- */
/* readable reconstruction; identity: FUN_0007f97c @ 0x0007f97c
 * public-name: audio_codec_reg_op_dispatch
 * durable-map: recon/catalogs/function_names_app.json
 * callees (readable <= raw @ address):
 *   audio_codec_reg_op_dispatch              <= FUN_0007f97c @ 0x0007f97c
 */
/* FUN_0007f97c @ 0x7f97c: indirect tail-dispatch through the object's callback slot. */
typedef int32_t (*callback_t)(uint32_t, uint32_t, uint32_t, uint32_t);

int audio_codec_reg_op_dispatch(unsigned int object, unsigned int arg1, void*arg2, unsigned int arg3) {
    callback_t callback = *(callback_t *)(object + 4);
    return callback(*(uint32_t *)(object + 12), arg1, arg2, arg3);
}

/* ---- audio_codec_bus_write.c ---- */
/* readable reconstruction; identity: FUN_0007f98a @ 0x0007f98a
 * public-name: audio_codec_bus_write
 * durable-map: recon/catalogs/function_names_app.json
 * callees (readable <= raw @ address):
 *   audio_codec_bus_write                    <= FUN_0007f98a @ 0x0007f98a
 */
/* Full reconstruction FUN_0007f98a @ 0x7f98a (exact extent 14 bytes). */
void audio_codec_bus_write(uint32_t *object, uint32_t r1, uint32_t r2, uint32_t r3)
{
    void (*callback)(uint32_t, uint32_t, uint32_t, uint32_t) =
        (void (*)(uint32_t, uint32_t, uint32_t, uint32_t))(uintptr_t)object[0];
    callback(object[3], r1, r2, r3);
}

/* ================================================================ */
/* member unit: audio_codec_read_trim_word.c */
/* ================================================================ */
#include "g1_app_symbols.h"
/* readable reconstruction; identity: FUN_0007fc04 @ 0x0007fc04
 * public-name: audio_codec_read_trim_word
 * durable-map: recon/catalogs/function_names_app.json
 * callees (readable <= raw @ address):
 *   audio_codec_reg_op_dispatch              <= FUN_0007f97c @ 0x0007f97c
 *   audio_codec_select_page                  <= FUN_0007fb20 @ 0x0007fb20
 *   audio_codec_read_trim_word               <= FUN_0007fc04 @ 0x0007fc04
 */
/* Reconstructed FUN_0007fc04 @ 0x7fc04  (parity: 300/300 trials, PROVEN) */

extern int audio_codec_select_page(unsigned int a, unsigned int b);
extern int audio_codec_reg_op_dispatch(unsigned int, unsigned int, void*, unsigned int);

int audio_codec_read_trim_word(unsigned int param_1, unsigned int param_2)
{
    int iVar1, iVar2, iVar3;
    iVar1 = audio_codec_select_page(param_1, 2);
    iVar2 = audio_codec_reg_op_dispatch(param_1, 0x46, param_2, 2);
    iVar3 = audio_codec_select_page(param_1, 0);
    return iVar3 + iVar1 + iVar2;
}

/* ================================================================ */
/* member unit: delay_scaled_busy_wait.c */
/* ================================================================ */
#include "g1_app_symbols.h"
/* readable reconstruction; identity: FUN_00086384 @ 0x00086384
 * public-name: delay_scaled_busy_wait
 * durable-map: recon/catalogs/function_names_app.json
 * callees (readable <= raw @ address):
 *   delay_busy_wait_usec                     <= FUN_0004c254 @ 0x0004c254
 *   delay_scaled_busy_wait                   <= FUN_00086384 @ 0x00086384
 */
/* Reconstructed FUN_00086384 @ 0x86384  (parity: 300/300 trials, PROVEN) */

extern void delay_busy_wait_usec(int a);

void delay_scaled_busy_wait(int param_1)
{
  if (param_1 == 0) return;
  delay_busy_wait_usec(param_1);
}

