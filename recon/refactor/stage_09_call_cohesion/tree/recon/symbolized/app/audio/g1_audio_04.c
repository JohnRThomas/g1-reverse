/*
 * Cohesive translation unit for the `audio' module.
 *
 * GENERATED by recon/refactor/transforms/t04_cohesive_tu.py.  Do not
 * edit: a stage tree is regenerated, never hand-patched
 * (recon/refactor/README.md C4).
 *
 * The 2 functions below were 2 separate translation units until this
 * stage.  Each one's text is reproduced VERBATIM and in the order the
 * generated source list gave it, and they were CONSECUTIVE in that list.
 * They were proven able to share a translation unit: no symbol is
 * declared here with two types, no identifier has internal linkage in one
 * member and is named by another, and no local typedef, macro, struct tag
 * or enum constant of one member is visible to a member that names it.
 *
 * members, in link order:
 *   enqueue_file.c
 *   dequeue_file.c
 */

/* File-scope forward declarations for every struct/union tag this
 * unit names.  Without them a tag whose only appearance in a member
 * is inside a parameter list has PARAMETER-LIST scope, so two
 * textually IDENTICAL declarations in two members declare two
 * different incomplete types and the second is a conflicting
 * redeclaration (C11 6.2.1p7).  Incomplete-type forward
 * declarations emit no code. */
struct k_msgq;
/* ---- enqueue_file.c ---- */
#include "g1_app_symbols.h"
#include <zephyr/sys_clock.h>
#include "../../../headers/g1_log.h"
#include "../../../headers/g1_dedupe.h"
/* readable reconstruction; identity: FUN_00023514 @ 0x00023514
 * public-name: enqueue_file
 * durable-map: recon/catalogs/function_names_app.json
 * callees (readable <= raw @ address):
 *   debug_print                              <= FUN_00019c70 @ 0x00019c70
 *   k_msgq_put                               <= FUN_000720d0 @ 0x000720d0
 *   k_msgq_get                               <= FUN_00072240 @ 0x00072240
 *   safe_memcpy_checked                      <= FUN_00086c1e @ 0x00086c1e
 * address symbols (name @ address):
 *   rodata_9e824                             @ 0x0009e824   [INLINED -- G6 literal batch]
 *   rodata_9e840                             @ 0x0009e840   [INLINED -- G6 literal batch]
 *   rodata_9e8f6                             @ 0x0009e8f6   [INLINED -- G6 literal batch]
 *   g_log_level                              @ 0x2000230c
 *   g_log_use_alt_sink                       @ 0x20007554
 *   g_file_msg_pipe                          @ 0x200079a0
 */
/* Reconstructed enqueue_file @ 0x23514  (parity: 300/300 trials, PROVEN) */

extern int k_msgq_get(struct k_msgq *, void *, k_timeout_t);
extern void safe_memcpy_checked(void*, unsigned int, unsigned int, int);
extern int k_msgq_put(struct k_msgq *, const void *, k_timeout_t);

int enqueue_file(unsigned int param_1, unsigned int param_2)
{
    int iVar1;
    unsigned char buf[201];

    if (*(volatile int *)(((unsigned long)&g_file_msg_pipe) /*=0x200079a0*/ + 0x24) == 0x1e) {
        k_msgq_get(((unsigned long)&g_file_msg_pipe) /*=0x200079a0*/, buf, (k_timeout_t){ .ticks = 0LL });
        if (0 < *(volatile int *)((unsigned long)&g_log_level) /*=0x2000230c*/) {
            G1_LOG_ROUTE(*(volatile unsigned int *)((unsigned long)&g_log_use_alt_sink) /*=0x20007554*/ == 0, ((unsigned long)"%s(): enqueue_file is full\n") /*=0x9e824*/, ((unsigned long)"enqueue_file") /*=0x9e8f6*/);
        }
    }
    safe_memcpy_checked(buf, param_1, param_2, 0xc9);
    buf[200] = (unsigned char)param_2;
    iVar1 = k_msgq_put(((unsigned long)&g_file_msg_pipe) /*=0x200079a0*/, buf, (k_timeout_t){ .ticks = 0LL });
    if ((iVar1 != 0) && (0 < *(volatile int *)((unsigned long)&g_log_level) /*=0x2000230c*/)) {
        G1_LOG_ROUTE(*(volatile unsigned int *)((unsigned long)&g_log_use_alt_sink) /*=0x20007554*/ == 0, ((unsigned long)"%s(): enqueue_file failed\r\n\n") /*=0x9e840*/, ((unsigned long)"enqueue_file") /*=0x9e8f6*/);
    }
    return iVar1;
}

/* ---- dequeue_file.c ---- */
/* readable reconstruction; identity: FUN_000235a4 @ 0x000235a4
 * public-name: dequeue_file
 * durable-map: recon/catalogs/function_names_app.json
 * callees (readable <= raw @ address):
 *   dequeue_file                             <= FUN_000235a4 @ 0x000235a4
 *   k_msgq_get                               <= FUN_00072240 @ 0x00072240
 *   memcpy                                   <= FUN_00086c04 @ 0x00086c04
 * address symbols (name @ address):
 *   rodata_9e85d                             @ 0x0009e85d   [INLINED -- G6 literal batch]
 *   g_file_msg_pipe                          @ 0x200079a0
 */
/* Reconstructed FUN_000235a4 @ 0x235a4  (parity: 300/300 trials, PROVEN) */

extern void memcpy(int, int, int);

int dequeue_file(unsigned int param_1)
{
    /* The controller response is 201 bytes; retain three spare bytes. */
    unsigned char buf[204];
    int iVar1 = k_msgq_get(((unsigned long)&g_file_msg_pipe) /*=0x200079a0*/, buf, (k_timeout_t){ .ticks = 0LL });
    if (iVar1 == 0) {
        memcpy(param_1, buf, 0xc9);
    } else {
        log_message(((unsigned long)"dequeue_file failed\r\n") /*=0x9e85d*/);
    }
    return iVar1;
}

