/*
 * Cohesive translation unit for the `audio' module.
 *
 * GENERATED by recon/refactor/transforms/t04_cohesive_tu.py.  Do not
 * edit: a stage tree is regenerated, never hand-patched
 * (recon/refactor/README.md C4).
 *
 * The 3 functions below were 3 separate translation units until this
 * stage.  Each one's text is reproduced VERBATIM and in the order the
 * generated source list gave it, and they were CONSECUTIVE in that list.
 * They were proven able to share a translation unit: no symbol is
 * declared here with two types, no identifier has internal linkage in one
 * member and is named by another, and no local typedef, macro, struct tag
 * or enum constant of one member is visible to a member that names it.
 *
 * members, in link order:
 *   chan_connect_disconnect_dispatch.c
 *   dppi_apply_channel_config_table.c
 *   transport_notify_callback.c
 */
/* ---- chan_connect_disconnect_dispatch.c ---- */
#include "g1_app_symbols.h"
#include <stdint.h>
/* readable reconstruction; identity: FUN_00083cfc @ 0x00083cfc
 * public-name: chan_connect_disconnect_dispatch
 * durable-map: recon/catalogs/function_names_app.json
 * callees (readable <= raw @ address):
 *   nrfx_twim_enable                         <= FUN_00067884 @ 0x00067884
 *   nrfx_twim_disable                        <= FUN_000678d0 @ 0x000678d0
 *   pinctrl_configure_state                  <= FUN_00083cde @ 0x00083cde
 *   chan_connect_disconnect_dispatch         <= FUN_00083cfc @ 0x00083cfc
 */
/* Reconstructed FUN_00083cfc @ 0x83cfc  (parity: 300/300 trials, PROVEN) */

extern void nrfx_twim_enable(int a);
extern void nrfx_twim_disable(int a);
extern int pinctrl_configure_state(unsigned int a, int b, unsigned int c, unsigned int d);

int chan_connect_disconnect_dispatch(int param_1, int param_2, unsigned int param_3, unsigned int param_4)
{
    int iVar1;
    int iVar2;

    iVar2 = *(int *)(param_1 + 4);
    if (param_2 != 0) {
        if (param_2 == 1) {
            iVar1 = pinctrl_configure_state(*(unsigned int *)(iVar2 + 0x20), 0,
                                 param_3, param_4);
            if (-1 < iVar1) {
                nrfx_twim_enable(iVar2);
            }
        } else {
            iVar1 = -0x86;
        }
        return iVar1;
    }
    nrfx_twim_disable(iVar2);
    iVar2 = pinctrl_configure_state(*(unsigned int *)(iVar2 + 0x20), 1, param_3, param_4);
    return iVar2;
}

/* ---- dppi_apply_channel_config_table.c ---- */
/* readable reconstruction; identity: FUN_00083ede @ 0x00083ede
 * public-name: dppi_apply_channel_config_table
 * durable-map: recon/catalogs/function_names_app.json
 * callees (readable <= raw @ address):
 *   nrf_gpio_pin_port_decode                 <= FUN_00061f64 @ 0x00061f64
 *   dppi_apply_channel_config_table          <= FUN_00083ede @ 0x00083ede
 */
/* Reconstructed FUN_00083ede @ 0x83ede. */

extern uintptr_t nrf_gpio_pin_port_decode(uint32_t *channel_index);

static void write_channel_mask(uint32_t *channel_index, unsigned offset)
{
    uintptr_t channel_state = nrf_gpio_pin_port_decode(channel_index);
    *(volatile uint32_t *)(channel_state + offset) =
        1u << (channel_index[0] & 0xffu);
}

int dppi_apply_channel_config_table(const uint32_t *records, unsigned record_count,
                 uintptr_t device)
{
    uint32_t channel_index[2];

    for (unsigned index = 0; index < record_count; ++index) {
        uint32_t encoded = records[index];
        uint32_t channel = encoded & 0x7fu;
        unsigned kind = encoded >> 16;
        unsigned submode = (encoded >> 9) & 0x0fu;
        unsigned option_bit = 0;
        unsigned enabled_bit = 0;
        int mask_offset = -1;

        if (channel == 0x7fu) {
            channel = UINT32_MAX;
        }
        channel_index[0] = channel;

        switch (kind) {
        case 0x00:
            *(volatile uint32_t *)(device + 0x50c) = channel;
            mask_offset = 8;
            option_bit = 1;
            enabled_bit = 1;
            break;
        case 0x01:
            *(volatile uint32_t *)(device + 0x514) = channel;
            break;
        case 0x02:
            *(volatile uint32_t *)(device + 0x508) = channel;
            mask_offset = 8;
            option_bit = 1;
            enabled_bit = 1;
            break;
        case 0x03:
            *(volatile uint32_t *)(device + 0x510) = channel;
            break;
        case 0x0b:
            *(volatile uint32_t *)(device + 0x508) = channel;
            if (submode == 0) {
                submode = 6;
            }
            break;
        case 0x0c:
            *(volatile uint32_t *)(device + 0x50c) = channel;
            if (submode == 0) {
                submode = 6;
            }
            break;
        case 0x14:
            *(volatile uint32_t *)(device + 0x540) = channel;
            mask_offset = 12;
            option_bit = 1;
            enabled_bit = 1;
            break;
        case 0x15:
            *(volatile uint32_t *)(device + 0x544) = channel;
            break;
        case 0x16:
            *(volatile uint32_t *)(device + 0x560) = channel;
            mask_offset = (encoded & 0x4000u) ? 8 : 12;
            option_bit = 1;
            enabled_bit = 1;
            break;
        case 0x17:
            *(volatile uint32_t *)(device + 0x564) = channel;
            mask_offset = (encoded & 0x4000u) ? 8 : 12;
            option_bit = 1;
            enabled_bit = 1;
            break;
        case 0x18:
            *(volatile uint32_t *)(device + 0x568) = channel;
            mask_offset = (encoded & 0x4000u) ? 8 : 12;
            option_bit = 1;
            enabled_bit = 1;
            break;
        case 0x19:
            *(volatile uint32_t *)(device + 0x56c) = channel;
            mask_offset = (encoded & 0x4000u) ? 8 : 12;
            option_bit = 1;
            enabled_bit = 1;
            break;
        case 0x1d:
            *(volatile uint32_t *)(device + 0x524) = channel;
            enabled_bit = 1;
            break;
        case 0x1e:
            *(volatile uint32_t *)(device + 0x528) = channel;
            mask_offset = 8;
            option_bit = 1;
            enabled_bit = 1;
            break;
        case 0x1f:
            *(volatile uint32_t *)(device + 0x530) = channel;
            enabled_bit = 1;
            break;
        case 0x20:
            *(volatile uint32_t *)(device + 0x534) = channel;
            enabled_bit = 1;
            break;
        case 0x21:
            *(volatile uint32_t *)(device + 0x538) = channel;
            enabled_bit = 1;
            break;
        case 0x22:
            *(volatile uint32_t *)(device + 0x53c) = channel;
            enabled_bit = 1;
            break;
        default:
            return -0x86;
        }

        if (channel == UINT32_MAX) {
            continue;
        }
        if (mask_offset >= 0) {
            write_channel_mask(channel_index, (unsigned)mask_offset);
        }

        encoded = records[index];
        if ((encoded & 0x2000u) != 0) {
            option_bit = 0;
            enabled_bit = 1;
        }
        channel_index[0] = channel;
        uintptr_t channel_state = nrf_gpio_pin_port_decode(channel_index) +
                                  channel_index[0] * sizeof(uint32_t);
        volatile uint32_t *configuration =
            (volatile uint32_t *)(channel_state + 0x200);
        uint32_t preserved = *configuration & 0xfffcf0f0u;
        *configuration = preserved | (submode << 8) |
                         (((encoded >> 7) & 3u) << 2) |
                         option_bit | (enabled_bit << 1);
    }
    return 0;
}

/* ---- transport_notify_callback.c ---- */
/* readable reconstruction; identity: FUN_00084840 @ 0x00084840
 * public-name: transport_notify_callback
 * durable-map: recon/catalogs/function_names_app.json
 * callees (readable <= raw @ address):
 *   transport_notify_callback                <= FUN_00084840 @ 0x00084840
 */
/* Optional transport callback FUN_00084840 @ 0x84840 (14-byte extent). */
typedef int (*callback_t)(uint8_t *object, uint32_t event, uint32_t context);
int transport_notify_callback(uint8_t *object, uint32_t event)
{
    uint8_t *transport = *(uint8_t **)(*(uint8_t **)(object + 0x10) + 0x0c);
    callback_t callback = *(callback_t *)transport;
    if (callback != 0)
        return callback(object, event, *(uint32_t *)(transport + 4));
    return (int)(uintptr_t)object;
}

