/*
 * Call-cohesive translation unit for the `audio' module.
 *
 * GENERATED by recon/refactor/transforms/t09_call_cohesion.py.  Do
 * not edit: a stage tree is regenerated, never hand-patched
 * (recon/refactor/README.md C4).
 *
 * The 4 translation units below were grouped because they CALL ONE
 * ANOTHER, not because they were adjacent in the generated source
 * list.  Each member's text is reproduced VERBATIM.  Every member was
 * checked pairwise against every other member already in this unit by
 * stage 04's seven refusal rules, unchanged: no symbol is declared
 * here with two types, no identifier has internal linkage in one
 * member and is named by another, and no local typedef, macro, struct
 * tag or enum constant of one member is visible to a member that
 * names it.
 *
 * members, in generated-source-list order:
 *   g1_audio_05.c
 *   g1_audio_06.c
 *   g1_audio_18.c
 *   g1_audio_19.c
 *
 * call edges inside this unit (caller -> callee): 3
 *   g1_audio_05.c -> g1_audio_18.c
 *   g1_audio_06.c -> g1_audio_05.c
 *   g1_audio_19.c -> g1_audio_18.c
 */

/* File-scope forward declarations for every struct/union tag this
 * unit names.  Without them a tag whose only appearance in a member
 * is inside a parameter list has PARAMETER-LIST scope, so two
 * textually IDENTICAL declarations in two members declare two
 * different incomplete types and the second is a conflicting
 * redeclaration (C11 6.2.1p7).  Incomplete-type forward
 * declarations emit no code. */
struct buffer_view;
struct encoded_record;
struct g1_opt_view;
struct k_msgq;
struct record_builder;
/* ================================================================ */
/* member unit: g1_audio_05.c */
/* ================================================================ */
/*
 * Cohesive translation unit for the `audio' module.
 *
 * GENERATED by recon/refactor/transforms/t04_cohesive_tu.py.  Do not
 * edit: a stage tree is regenerated, never hand-patched
 * (recon/refactor/README.md C4).
 *
 * The 2 functions below were 2 separate translation units until this
 * stage.  Each one's text is reproduced VERBATIM and in the order the
 * generated source list gave it, and they were CONSECUTIVE in that list.
 * They were proven able to share a translation unit: no symbol is
 * declared here with two types, no identifier has internal linkage in one
 * member and is named by another, and no local typedef, macro, struct tag
 * or enum constant of one member is visible to a member that names it.
 *
 * members, in link order:
 *   st25dv_build_and_write_ndef_records.c
 *   get_last_standby_event_id.c
 */

/* File-scope forward declarations for every struct/union tag this
 * unit names.  Without them a tag whose only appearance in a member
 * is inside a parameter list has PARAMETER-LIST scope, so two
 * textually IDENTICAL declarations in two members declare two
 * different incomplete types and the second is a conflicting
 * redeclaration (C11 6.2.1p7).  Incomplete-type forward
 * declarations emit no code. */
struct buffer_view;
struct encoded_record;
struct record_builder;
/* ---- st25dv_build_and_write_ndef_records.c ---- */
#include "g1_app_symbols.h"
/* readable reconstruction; identity: FUN_000250f8 @ 0x000250f8
 * public-name: st25dv_build_and_write_ndef_records
 * durable-map: recon/catalogs/function_names_app.json
 * callees (readable <= raw @ address):
 *   st25dv_mailbox_write_with_retry          <= FUN_00024fe8 @ 0x00024fe8
 *   event_record_init                        <= FUN_00025090 @ 0x00025090
 *   fill_record_type8                        <= FUN_000250c4 @ 0x000250c4
 *   st25dv_build_and_write_ndef_records      <= FUN_000250f8 @ 0x000250f8
 *   invoke_optional_op_offset12              <= FUN_0007c3da @ 0x0007c3da
 *   opt_record_decode                        <= FUN_0007c4f4 @ 0x0007c4f4
 *   opt_list_encode                          <= FUN_0007c77e @ 0x0007c77e
 *   opt_list_append_node                     <= FUN_0007c7de @ 0x0007c7de
 * address symbols (name @ address):
 *   g_ndef_build_status_flag                 @ 0x20018c6a
 */
/* Reconstructed FUN_000250f8 @ 0x250f8 */
#include <stdint.h>

extern int st25dv_mailbox_write_with_retry(void *, unsigned int);
extern unsigned int event_record_init(unsigned char *, unsigned int *);
extern unsigned int fill_record_type8(unsigned char *, unsigned int *);
extern unsigned long invoke_optional_op_offset12(unsigned char*, void*);
extern unsigned opt_record_decode(int *, unsigned char *);
extern int opt_list_encode(int *, int *, int, unsigned);
extern unsigned int opt_list_append_node(unsigned int *, unsigned char *);

struct encoded_record {
    uint32_t words[7];
};

struct buffer_view {
    void *data;
    uint32_t length;
};

struct record_builder {
    void *data;
    uint32_t length;
    uint32_t state;
};

int st25dv_build_and_write_ndef_records(const unsigned char *primary,
                 const unsigned char *secondary,
                 const unsigned char *suffix)
{
    unsigned char primary_spec[10];
    unsigned char secondary_spec[9];
    unsigned char output[32];
    unsigned char primary_work[32];
    unsigned char secondary_work[32];
    struct encoded_record primary_record;
    struct encoded_record suffix_record;
    struct encoded_record secondary_record;
    struct encoded_record records[4];
    struct record_builder builder;
    struct buffer_view output_view;
    unsigned int status;
    int record_count;

    primary_spec[0] = 0x20;
    primary_spec[1] = primary[0];
    primary_spec[2] = primary[1];
    primary_spec[3] = primary[2];
    primary_spec[4] = primary[3];
    primary_spec[5] = primary[9];
    primary_spec[6] = primary[4];
    primary_spec[7] = primary[6];
    primary_spec[8] = primary[7];
    primary_spec[9] = primary[8];

    status = (unsigned int)event_record_init(primary_work, primary_spec);
    status |= (unsigned int)invoke_optional_op_offset12(primary_work, &primary_record);
    records[0] = primary_record;
    status &= 0xffff;

    if (secondary[0] == 0) {
        record_count = 1;
    } else {
        secondary_spec[0] = secondary[1];
        secondary_spec[1] = secondary[2];
        secondary_spec[2] = secondary[3];
        secondary_spec[3] = secondary[4];
        secondary_spec[4] = secondary[5];
        secondary_spec[5] = secondary[6];
        secondary_spec[6] = secondary[7];
        secondary_spec[8] = secondary[8];
        record_count = 2;
        unsigned int secondary_status;
        secondary_status = (unsigned int)fill_record_type8(secondary_work, secondary_spec);
        secondary_status |= (unsigned int)invoke_optional_op_offset12(secondary_work, &secondary_record);
        status = (status | secondary_status) & 0xffff;
        records[1] = secondary_record;
    }

    if (suffix[0] != 0) {
        struct buffer_view suffix_view;
        ((uint32_t *)output)[0] = 0x57020651;
        ((uint32_t *)output)[1] = 0x4f46434c;
        output[8] = 0x44;
        output[9] = suffix[1];
        output[10] = suffix[2];
        suffix_view.data = output;
        suffix_view.length = 11;
        status = (unsigned int)opt_record_decode(&suffix_view, &suffix_record);
        if (record_count == 1)
            records[1] = suffix_record;
        else
            records[2] = suffix_record;
        ++record_count;
    }

    builder.data = 0;
    builder.length = 0;
    builder.state = 0;
    *(volatile unsigned char *)((unsigned long)&g_ndef_build_status_flag) /*=0x20018c6a*/ = 0;
    for (int index = 0; index != record_count; ++index) {
        status = (status |
                  (unsigned int)opt_list_append_node(&builder, &records[index])) & 0xffff;
    }

    output_view.data = output;
    output_view.length = 0x20;
    status = ((status |
               ((unsigned int)opt_list_encode(&builder, &output_view,
                                            (void *)((unsigned long)&g_ndef_build_status_flag) /*=0x20018c6a*/, 0x20) & 0xffff)) |
              ((unsigned int)st25dv_mailbox_write_with_retry(output_view.data,
                                          output_view.length) & 0xffff));
    return status == 0 ? 0 : -1;
}

/* ---- get_last_standby_event_id.c ---- */
/* readable reconstruction; identity: FUN_000269fc @ 0x000269fc
 * public-name: get_last_standby_event_id
 * durable-map: recon/catalogs/function_names_app.json
 * callees (readable <= raw @ address):
 *   get_last_standby_event_id                <= FUN_000269fc @ 0x000269fc
 * address symbols (name @ address):
 *   g_last_standby_event_id                  @ 0x2000302d
 */
/* Reconstructed FUN_000269fc @ 0x269fc  (parity: 300/300 trials, PROVEN) */

unsigned char get_last_standby_event_id(void) {
    return *(volatile unsigned char *)((unsigned long)&g_last_standby_event_id) /*=0x2000302d*/;
}

/* ================================================================ */
/* member unit: g1_audio_06.c */
/* ================================================================ */
/*
 * Cohesive translation unit for the `audio' module.
 *
 * GENERATED by recon/refactor/transforms/t04_cohesive_tu.py.  Do not
 * edit: a stage tree is regenerated, never hand-patched
 * (recon/refactor/README.md C4).
 *
 * The 3 functions below were 3 separate translation units until this
 * stage.  Each one's text is reproduced VERBATIM and in the order the
 * generated source list gave it, and they were CONSECUTIVE in that list.
 * They were proven able to share a translation unit: no symbol is
 * declared here with two types, no identifier has internal linkage in one
 * member and is named by another, and no local typedef, macro, struct tag
 * or enum constant of one member is visible to a member that names it.
 *
 * members, in link order:
 *   master_process_audio_fw_load_req.c
 *   init_dmic_msgq.c
 *   clean_dmic_msgq.c
 */

/* File-scope forward declarations for every struct/union tag this
 * unit names.  Without them a tag whose only appearance in a member
 * is inside a parameter list has PARAMETER-LIST scope, so two
 * textually IDENTICAL declarations in two members declare two
 * different incomplete types and the second is a conflicting
 * redeclaration (C11 6.2.1p7).  Incomplete-type forward
 * declarations emit no code. */
struct k_msgq;
/* ---- master_process_audio_fw_load_req.c ---- */
#include "g1_app_symbols.h"
#include "../../../headers/g1_log.h"
#include "../../../headers/g1_dedupe.h"
#include "g1_audio.h"
/* readable reconstruction; identity: FUN_0002af4c @ 0x0002af4c
 * public-name: master_process_audio_fw_load_req
 * durable-map: recon/catalogs/function_names_app.json
 * callees (readable <= raw @ address):
 *   get_device_info                          <= FUN_000167a8 @ 0x000167a8
 *   ancs_set_notification_enabled            <= FUN_00019ac0 @ 0x00019ac0
 *   debug_print                              <= FUN_00019c70 @ 0x00019c70
 *   get_device_serial_buf                    <= FUN_000232b0 @ 0x000232b0
 *   get_product_code_buf                     <= FUN_000232b8 @ 0x000232b8
 *   get_last_standby_event_id                <= FUN_000269fc @ 0x000269fc
 *   imu_set_enabled                          <= FUN_0002bd4c @ 0x0002bd4c
 *   get_low_battery_flag_if_master           <= FUN_0002efa8 @ 0x0002efa8
 *   get_notification_counts_cmd_response     <= FUN_00033a5c @ 0x00033a5c
 *   post_notification_cmd_response           <= FUN_000340c4 @ 0x000340c4
 *   debug_print_hex_dump                     <= FUN_0004a424 @ 0x0004a424
 *   rate_limited_elapsed_seconds_tick        <= FUN_0004a46c @ 0x0004a46c
 *   get_boot_seconds                         <= FUN_0004a51c @ 0x0004a51c
 *   uint32_to_little_endian                  <= FUN_0004a568 @ 0x0004a568
 *   post_uid_event_mode2                     <= FUN_0007c0e2 @ 0x0007c0e2
 *   is_system_idle_ready                     <= FUN_0007ce00 @ 0x0007ce00
 *   device_info_set_mode                     <= FUN_0007d2f8 @ 0x0007d2f8
 *   md5_compute_digest                       <= FUN_0007d968 @ 0x0007d968
 *   memcpy                                   <= FUN_00086c04 @ 0x00086c04
 *   memset_bytes                             <= FUN_00086c78 @ 0x00086c78
 * address symbols (name @ address):
 *   rodata_9b708                             @ 0x0009b708
 *   rodata_9b74b                             @ 0x0009b74b   [INLINED -- refactor stage 01]
 *   rodata_a1ca4                             @ 0x000a1ca4   [INLINED -- refactor stage 01]
 *   rodata_a1ce0                             @ 0x000a1ce0
 *   rodata_a1cfc                             @ 0x000a1cfc
 *   rodata_a1d06                             @ 0x000a1d06   [INLINED -- refactor stage 01]
 *   rodata_a1d31                             @ 0x000a1d31   [INLINED -- refactor stage 01]
 *   rodata_a1d59                             @ 0x000a1d59   [INLINED -- refactor stage 01]
 *   rodata_a1dbe                             @ 0x000a1dbe   [INLINED -- refactor stage 01]
 *   rodata_a1df5                             @ 0x000a1df5
 *   rodata_a1e3a                             @ 0x000a1e3a
 *   rodata_a1e66                             @ 0x000a1e66
 *   rodata_a1ead                             @ 0x000a1ead   [INLINED -- refactor stage 01]
 *   rodata_a1edb                             @ 0x000a1edb   [INLINED -- refactor stage 01]
 *   rodata_a1f1a                             @ 0x000a1f1a
 *   rodata_a1f24                             @ 0x000a1f24
 *   rodata_a1f35                             @ 0x000a1f35   [INLINED -- refactor stage 01]
 *   rodata_a1f49                             @ 0x000a1f49
 *   rodata_a1f4e                             @ 0x000a1f4e   [INLINED -- refactor stage 01]
 *   rodata_a1f7d                             @ 0x000a1f7d   [INLINED -- refactor stage 01]
 *   rodata_a1fc7                             @ 0x000a1fc7   [INLINED -- refactor stage 01]
 *   rodata_a1ff2                             @ 0x000a1ff2   [INLINED -- refactor stage 01]
 *   rodata_a201b                             @ 0x000a201b   [INLINED -- refactor stage 01]
 *   rodata_a2041                             @ 0x000a2041   [INLINED -- refactor stage 01]
 *   rodata_a2061                             @ 0x000a2061   [INLINED -- refactor stage 01]
 *   rodata_a20c2                             @ 0x000a20c2   [INLINED -- refactor stage 01]
 *   rodata_a20e9                             @ 0x000a20e9   [INLINED -- refactor stage 01]
 *   rodata_a211e                             @ 0x000a211e   [INLINED -- refactor stage 01]
 *   rodata_a2184                             @ 0x000a2184   [INLINED -- refactor stage 01]
 *   rodata_a21c4                             @ 0x000a21c4   [INLINED -- refactor stage 01]
 *   rodata_a21f9                             @ 0x000a21f9
 *   rodata_a2227                             @ 0x000a2227   [INLINED -- refactor stage 01]
 *   rodata_a22b8                             @ 0x000a22b8   [INLINED -- refactor stage 01]
 *   rodata_a2334                             @ 0x000a2334
 *   rodata_a2364                             @ 0x000a2364   [INLINED -- refactor stage 01]
 *   rodata_a2383                             @ 0x000a2383   [INLINED -- refactor stage 01]
 *   rodata_a23a0                             @ 0x000a23a0   [INLINED -- refactor stage 01]
 *   rodata_a23cd                             @ 0x000a23cd
 *   rodata_a23d0                             @ 0x000a23d0
 *   rodata_a23e8                             @ 0x000a23e8
 *   rodata_a23ff                             @ 0x000a23ff
 *   rodata_a2416                             @ 0x000a2416   [INLINED -- refactor stage 01]
 *   rodata_a243a                             @ 0x000a243a   [INLINED -- refactor stage 01]
 *   rodata_a245b                             @ 0x000a245b   [INLINED -- refactor stage 01]
 *   rodata_a7cd6                             @ 0x000a7cd6
 *   rodata_a7cf4                             @ 0x000a7cf4
 *   rodata_a829f                             @ 0x000a829f
 *   rodata_f680e                             @ 0x000f680e
 *   g_log_level                              @ 0x2000230c
 *   g_log_use_alt_sink                       @ 0x20007554
 */
/* Reconstructed master_process_audio_fw_load_req @ 0x2af4c  (parity: 750/750 trials, PROVEN) */
typedef unsigned char byte;
typedef unsigned char undefined1;
typedef unsigned short undefined2;
typedef unsigned int undefined4;
typedef unsigned int uint;
typedef void code;

extern int ancs_set_notification_enabled(uint);
extern unsigned int get_product_code_buf(void);
extern unsigned char get_last_standby_event_id(void);
extern int imu_set_enabled(int, char*, uint);
extern int get_low_battery_flag_if_master(void);
extern int post_notification_cmd_response(char*, byte*, char*, byte*, byte*, byte*, undefined4);
extern void debug_print_hex_dump(int, int, int);
extern void rate_limited_elapsed_seconds_tick(int*, int, int);
extern int get_boot_seconds(void);
extern int uint32_to_little_endian(byte*, int);
extern int post_uid_event_mode2(uint);
extern int is_system_idle_ready(void);
extern int device_info_set_mode(int);
extern int md5_compute_digest(byte*, int, byte*);
extern void memcpy(int, int, int);
extern int memset_bytes(void*, int, int);
extern unsigned long process_sync_buffer(unsigned int, ...);
extern int update_persist_task_status(char*, int, int);
extern int get_notification_counts_cmd_response(char*, byte*);

#define DAT_0002b208 ((volatile int*)((unsigned long)&g_log_use_alt_sink) /*=0x20007554*/)
#define DAT_0002b20c ((const char*)((unsigned long)"master_process_audio_fw_load_req") /*=0xa243a*/)
#define DAT_0002b210 ((const char*)((unsigned long)"%s(): recev: pack_index:%d, start_addr:0x%x, rx_buf_len:%d\n") /*=0xa1ca4*/)
#define DAT_0002b214 ((const char*)((unsigned long)"read_fw_pack_from_nor_flash_by_qspi") /*=0xa2416*/)
#define DAT_0002b218 ((const char*)((unsigned long)&rodata_a1ce0) /*=0xa1ce0*/)
#define DAT_0002b21c ((unsigned long)&rodata_a1cfc) /*=0xa1cfc*/
#define DAT_0002b220 ((int*)((unsigned long)&g_log_level) /*=0x2000230c*/)
#define DAT_0002b224 ((const char*)((unsigned long)&rodata_a23ff) /*=0xa23ff*/)
#define DAT_0002b228 ((const char*)((unsigned long)"%s(): BLE_REQ_PUT_BRIGHTNESS new level:%d\n") /*=0xa1d06*/)
#define DAT_0002b22c ((const char*)((unsigned long)"%s(): BLE_REQ_PUT_BRIGHTNESS ignore:%d\n") /*=0xa1d31*/)
#define DAT_0002b230 ((const char*)((unsigned long)"%s(): BLE_REQ_PUT_ANTI_SHAKE_ENABLE: new state: %d\n") /*=0xa1d59*/)
#define DAT_0002b234 ((const char*)0x000a1d8d)
#define DAT_0002b238 ((const char*)((unsigned long)"%s(): BLE_REQ_PUT_DISPLAY_MODE: %d, flag_show_tip: %d\n") /*=0xa1dbe*/)
#define DAT_0002b4d4 ((volatile int*)((unsigned long)&g_log_use_alt_sink) /*=0x20007554*/)
#define DAT_0002b4d8 ((const char*)((unsigned long)&rodata_a23ff) /*=0xa23ff*/)
#define DAT_0002b4dc ((const char*)((unsigned long)&rodata_a1df5) /*=0xa1df5*/)
#define DAT_0002b4e0 ((const char*)((unsigned long)&rodata_a1e66) /*=0xa1e66*/)
#define DAT_0002b4e4 ((const char*)((unsigned long)&rodata_a1e3a) /*=0xa1e3a*/)
#define DAT_0002b4e8 ((const char*)((unsigned long)"%s(): BLE_REQ_PUT_DISPLAY_MODE error mode:%d\n") /*=0xa1ead*/)
#define DAT_0002b4ec ((int*)((unsigned long)&g_log_level) /*=0x2000230c*/)
#define DAT_0002b4f0 ((const char*)((unsigned long)"%s(): BLE_REQ_PUT_INTERNAL_DEBUG:op_code=0x%02x,op_val=0x%02x\n") /*=0xa1edb*/)
#define DAT_0002b4f4 ((unsigned long)&rodata_a1f1a) /*=0xa1f1a*/
#define DAT_0002b4f8 ((unsigned long)&rodata_a1f49) /*=0xa1f49*/
#define DAT_0002b4fc ((const char*)((unsigned long)&rodata_a1f24) /*=0xa1f24*/)
#define DAT_0002b500 ((const char*)((unsigned long)"%s(): screen_id=%d\n") /*=0xa1f35*/)
#define DAT_0002b504 ((const char*)((unsigned long)"%s(): playload: %02x,%02x,%02x,%02x,%02x,%02x\n") /*=0xa1f4e*/)
#define DAT_0002b508 ((const char*)((unsigned long)"%s(): update->BLE_REQ_PUT_COUNTDOWN_TIMER: %d(%02d:%02d:%02d), enable:%d\n") /*=0xa1f7d*/)
#define DAT_0002b50c ((const char*)((unsigned long)"%s(): recv#BLE_REQ_PUT_TELEPROMPTER_INFO:\n") /*=0xa1fc7*/)
#define DAT_0002b510 ((const char*)((unsigned long)"%s(): recv#BLE_REQ_PUT_NAVIGATION_INFO:\n") /*=0xa1ff2*/)
#define DAT_0002b7a8 ((int*)((unsigned long)&g_log_level) /*=0x2000230c*/)
#define DAT_0002b7ac ((volatile int*)((unsigned long)&g_log_use_alt_sink) /*=0x20007554*/)
#define DAT_0002b7b0 ((const char*)((unsigned long)&rodata_a23ff) /*=0xa23ff*/)
#define DAT_0002b7b4 ((const char*)((unsigned long)"%s(): recv#BLE_REQ_PUT_SCHEDULE_TASK\n") /*=0xa201b*/)
#define DAT_0002b7b8 ((const char*)((unsigned long)"%s(): recv#SCHEDULE_TASK: save\n") /*=0xa2041*/)
#define DAT_0002b7bc ((const char*)((unsigned long)"%s(): BLE_REQ_PUT_WAKEUP_ANGLE new level:%d offset %d\n") /*=0xa2061*/)
#define DAT_0002b7c0 ((const char*)0x000a2098)
#define DAT_0002b7c4 ((const char*)((unsigned long)"%s(): BLE_REQ_PUT_NOTIFY_EN enable:%d\n") /*=0xa20c2*/)
#define DAT_0002b7c8 ((const char*)((unsigned long)"%s(): recv#BLE_REQ_PUT_GLASSES_SETTING,type is 0x%x\n") /*=0xa20e9*/)
#define DAT_0002b7cc ((const char*)((unsigned long)"%s(): ble recv raster_config_info:enable is %d, raster_height_gear is %d, canvas_distance_gear is %d\n") /*=0xa211e*/)
#define DAT_0002b7d0 ((const char*)((unsigned long)&rodata_a23e8) /*=0xa23e8*/)
#define DAT_0002b7d4 ((const char*)((unsigned long)"%s(): BLE_REQ_GET_DISPLAY_MODE:0x%02x, 0x%02x, 0x%02x, 0x%02x,\n") /*=0xa2184*/)
#define DAT_0002b7d8 ((const char*)((unsigned long)"%s(): BLE_REQ_GET_ANTI_SHAKE_ENABLE:0x%02x, 0x%02x,\n") /*=0xa21c4*/)
#define DAT_0002b7dc ((const char*)((unsigned long)&rodata_a21f9) /*=0xa21f9*/)
#define DAT_0002baa0 ((unsigned long)&rodata_a23cd) /*=0xa23cd*/
#define DAT_0002baa4 ((int*)((unsigned long)&g_log_level) /*=0x2000230c*/)
#define DAT_0002baa8 ((const char*)((unsigned long)&rodata_a23e8) /*=0xa23e8*/)
#define DAT_0002baac ((const char*)((unsigned long)"%s(): BLE_REQ_GET_DEVICE_INFO:0x%02x,0x%02x,0x%02x,0x%02x, 0x%02x,0x%02x,0x%02x,0x%02x, 0x%02x,0x%02x,0x%02x,0x%02x,0x%02x,0x%02x,0x%02x,0x%02x\n") /*=0xa2227*/)
#define DAT_0002bab0 ((const char*)((unsigned long)"%s(): BLE_REQ_GET_M_N_S_MAC:master[0x%02x,0x%02x,0x%02x,0x%02x,0x%02x,0x%02x], [0x%02x,0x%02x,0x%02x,0x%02x,0x%02x,0x%02x]\n") /*=0xa22b8*/)
#define DAT_0002bab4 ((volatile int*)((unsigned long)&g_log_use_alt_sink) /*=0x20007554*/)
#define DAT_0002bab8 ((const char*)((unsigned long)&rodata_a2334) /*=0xa2334*/)
#define DAT_0002babc ((const char*)((unsigned long)&rodata_9b708) /*=0x9b708*/)
#define DAT_0002bac0 ((const char*)0x0009b729)
#define DAT_0002bac4 ((const char*)((unsigned long)"%s(): BLE_REQ_GET_ESB_CHANNEL: %d\n") /*=0x9b74b*/)
#define DAT_0002bc0c ((int*)((unsigned long)&g_log_level) /*=0x2000230c*/)
#define DAT_0002bc10 ((volatile int*)((unsigned long)&g_log_use_alt_sink) /*=0x20007554*/)
#define DAT_0002bc14 ((const char*)((unsigned long)&rodata_a23d0) /*=0xa23d0*/)
#define DAT_0002bc18 ((const char*)((unsigned long)"%s(): receive dfu_soc=0x%02x\n\n") /*=0xa2364*/)
#define DAT_0002bc1c ((const char*)((unsigned long)"%s(): master enter dfu mode\n") /*=0xa2383*/)
#define DAT_0002bc20 ((const char*)((unsigned long)"process_recv_ble_req") /*=0xa245b*/)
#define DAT_0002bc24 ((const char*)((unsigned long)"%s(): tx error req_type head->req_type %d.\n\n") /*=0xa23a0*/)
#define DAT_0002bc28 ((unsigned long)&rodata_f680e) /*=0xf680e*/
#define DAT_00033aa8 ((int*)((unsigned long)&g_log_level) /*=0x2000230c*/)
#define DAT_00033aac ((volatile int*)((unsigned long)&g_log_use_alt_sink) /*=0x20007554*/)
#define DAT_00033ab0 ((const char*)((unsigned long)&rodata_a829f) /*=0xa829f*/)
#define DAT_00033ab4 ((const char*)((unsigned long)&rodata_a7cd6) /*=0xa7cd6*/)
#define DAT_00033ab8 ((const char*)((unsigned long)&rodata_a7cf4) /*=0xa7cf4*/)

int master_process_audio_fw_load_req(char *param_1, byte *param_2, byte *param_3, undefined4 param_4)
{
  byte bVar1;
  undefined2 uVar2;
  byte bVar3;
  int *piVar4;
  uint *puVar5;
  int *piVar6;
  int *piVar7;
  int *piVar8;
  int *piVar9;
  undefined1 uVar10;
  int iVar11;
  undefined4 uVar12;
  int iVar13;
  char *pcVar14;
  byte *pbVar15;
  undefined4 *puVar16;
  undefined4 *puVar17;
  undefined4 *puVar18;
  char *pcVar19;
  uint uVar20;
  byte bVar21;
  code *pcVar22;
  byte *pbVar23;
  int iVar24;
  uint uVar25;
  int iVar26;
  uint uVar27;
  undefined4 uVar28;
  undefined1 local_124;
  undefined4 local_123;
  undefined4 local_11f;
  undefined2 local_11b;
  char local_119;
  undefined1 auStack_118 [244];

  piVar9 = DAT_00033aa8;
  piVar8 = DAT_0002bc0c;
  piVar7 = DAT_0002baa4;
  piVar6 = DAT_0002b7a8;
  puVar5 = (uint*)DAT_0002b4ec;
  piVar4 = DAT_0002b220;
  pbVar23 = param_2 + 4;
  if (param_2[1] == 3) {
    uVar28 = *(undefined4 *)(param_2 + 8);
    iVar24 = *(int *)(param_2 + 0xc);
    if (2 < *DAT_0002b220) {
      G1_LOG_ROUTE(*DAT_0002b208 == 0, DAT_0002b210,DAT_0002b20c,*(undefined4 *)(param_2 + 4),uVar28,iVar24);
    }
    if (iVar24 - 0x13U < 0x800d) {
      iVar11 = get_device_info();
      if (*(int *)(iVar11 + 0x1030) != 0) {
        iVar11 = get_device_info();
        iVar26 = iVar24 + -0x12;
        pcVar22 = *(code **)(iVar11 + 0x1030);
        uVar12 = get_device_info();
        iVar13 = (*(int(*)(int,undefined4,byte*,int))pcVar22)(uVar12,uVar28,param_3 + 0x12,iVar26);
        iVar11 = iVar26;
        if ((iVar13 != 0) && (iVar11 = iVar13, 0 < *piVar4)) {
          G1_LOG_ROUTE(*DAT_0002b208 == 0, DAT_0002b218,DAT_0002b214,iVar13);
        }
        if (iVar26 == iVar11) {
          *param_3 = 0x6f;
          param_3[1] = 0x6b;
          md5_compute_digest(param_3 + 0x12,iVar26,param_3 + 2);
          debug_print_hex_dump(DAT_0002b21c,param_3 + 2,0x10);
          return iVar24;
        }
      }
    }
    *param_3 = 0x6e;
    param_3[1] = 0x6f;
    return 0;
  }
  uVar20 = (uint)*param_2;
  if (0x26 < (uVar20 - 1 & 0xff)) {
    if (0x1c < (uVar20 - 0x29 & 0xff)) {
      if (9 < uVar20 - 0x47) {
        if (0 < *DAT_0002bc0c) {
          G1_LOG_ROUTE(*DAT_0002bc10 == 0, DAT_0002bc24,DAT_0002bc20);
        }
        uVar2 = *(undefined2 *)(DAT_0002bc28 + 1);
        *(undefined4 *)param_3 = *(undefined4*)DAT_0002bc28;
        *(undefined2 *)(param_3 + 4) = uVar2;
        return 6;
      }
      switch(uVar20) {
      case 0x4a:
        uVar20 = (uint)param_2[4];
        if (2 < *DAT_0002bc0c) {
          G1_LOG_ROUTE(*DAT_0002bc10 == 0, DAT_0002bc18,DAT_0002bc14,uVar20);
        }
        if ((int)(uVar20 << 0x1e) < 0) {
          param_1[0xc9] = -0x7d;
          param_1[0xca] = '\x01';
          memset_bytes((char*)&local_123 + 3,0,0xf8);
          local_124 = 2;
          local_123 = *(undefined4 *)(param_1 + 0xc9);
          local_11f = *(undefined4 *)(param_1 + 0xcd);
          local_11b = *(undefined2 *)(param_1 + 0xd1);
          local_119 = param_1[0xd3];
          memset_bytes(auStack_118,0,0x15);
          (*(void(**)(void*,int))(param_1 + 0x774))(&local_124,0xfc);
        }
        if ((int)(uVar20 << 0x1f) < 0) {
          if (2 < *piVar8) {
            G1_LOG_ROUTE(*DAT_0002bc10 == 0, DAT_0002bc1c,DAT_0002bc14);
          }
          (*(void(**)(void*))(param_1 + 0x102c))(param_1 + 0x68);
        }
        break;
      case 0x4b:
        iVar24 = post_notification_cmd_response(param_1,param_2,param_1 + 0xd4,param_2,pbVar23,param_3,param_4);
        return iVar24;
      case 0x4c:
        uVar20 = *(uint *)(param_2 + 4);
        post_uid_event_mode2(uVar20 << 0x18 | (uVar20 >> 8 & 0xff) << 0x10 | (uVar20 >> 0x10 & 0xff) << 8 |
                     uVar20 >> 0x18);
        break;
      case 0x4d:
        iVar24 = get_device_info();
        param_1 = (char *)(iVar24 + 0x9ac);
        goto LAB_0002b188;
      case 0x4e:
        *(undefined1 *)(*(int *)(param_1 + 0x100c) + 0x196) = 0;
        if (*(char *)(*(int *)(param_1 + 0x100c) + 7) == '\0') {
          *(undefined1 *)(*(int *)(param_1 + 0x100c) + 7) = 10;
        }
        *param_3 = 0xc9;
        if (**(int **)(param_1 + 0x1054) == 0x10) {
          return 1;
        }
        uVar28 = 0x10;
        goto LAB_0002b404;
      case 0x4f:
        iVar24 = get_device_info();
        *(byte *)(iVar24 + 0x108f) = param_2[4];
        bVar21 = *param_2;
        iVar24 = get_device_info();
        *(uint *)(iVar24 + 0x104c) = (uint)bVar21;
        iVar24 = get_device_info();
        process_sync_buffer((void*)(iVar24 + 0x80));
        *param_3 = 0xc9;
        param_3[1] = param_2[4];
        return 2;
      default:
        goto switchD_0002b03a_caseD_3;
      }
      goto LAB_0002b1ac;
    }
    switch(uVar20 - 0x29) {
    case 0:
      *param_3 = param_1[0xed5];
      param_3[1] = param_1[0xf98];
      if (*piVar6 < 3) {
        return 2;
      }
      iVar24 = *DAT_0002b7ac;
      uVar28 = (undefined4)DAT_0002b7d0;
      uVar12 = (undefined4)DAT_0002b7dc;
      break;
    case 1:
      bVar21 = param_1[0xf60];
      *param_3 = bVar21;
      if (*piVar6 < 3) {
        return 1;
      }
      if (*DAT_0002b7ac != 0) {
        debug_print(DAT_0002b7d8,DAT_0002b7d0);
        return 1;
      }
      log_message(DAT_0002b7d8,DAT_0002b7d0,(uint)bVar21,(uint)param_3[1]);
      return 1;
    case 2:
      *param_3 = param_1[0xfea];
      uVar28 = get_last_standby_event_id();
      piVar4 = DAT_0002b7a8;
      param_3[1] = (byte)uVar28;
      if (*piVar4 < 3) {
        return 2;
      }
      if (*DAT_0002b7ac != 0) {
        debug_print(DAT_0002b7d4,DAT_0002b7d0,(uint)*param_3,uVar28,(uint)param_3[2],(uint)param_3[3]);
        return 2;
      }
      log_message(DAT_0002b7d4,DAT_0002b7d0,(uint)*param_3,uVar28,(uint)param_3[2],(uint)param_3[3]);
      return 2;
    case 3:
      uVar20 = (uint)(byte)param_1[0xfc0];
      uVar25 = (uint)(byte)param_1[0xfc1];
      if (uVar20 == 0x5d) {
        if (param_1[0xfc2] == '\0') {
          if (uVar25 == 0x5d) {
            uVar20 = 0x5e;
            uVar25 = uVar20;
            goto LAB_0002b7fe;
          }
          uVar20 = 0x5e;
          uVar27 = uVar25 - 0x5e & 0xff;
        }
        else {
          if (uVar25 == 0x5d) {
            uVar20 = 0x5f;
            goto LAB_0002b8ee;
          }
          uVar20 = 0x5f;
          uVar27 = uVar25 - 0x5e & 0xff;
        }
      }
      else if (uVar20 == 0x5e) {
        if (param_1[0xfc2] == '\0') {
          if (uVar25 == 0x5d) {
            uVar20 = 0x60;
            uVar25 = 0x5e;
            goto LAB_0002b7fe;
          }
          uVar20 = 0x60;
          uVar27 = uVar25 - 0x5e & 0xff;
        }
        else {
          if (uVar25 == 0x5d) {
            uVar20 = 0x61;
            uVar25 = 0x5e;
            goto LAB_0002b7fe;
          }
          uVar20 = 0x61;
          uVar27 = uVar25 - 0x5e & 0xff;
        }
      }
      else if (uVar20 == 0x5f) {
        if (uVar25 == 0x5d) {
          uVar20 = 0x62;
          goto LAB_0002b8ee;
        }
        uVar20 = 0x62;
        uVar27 = uVar25 - 0x5e & 0xff;
      }
      else if (uVar20 == 0x60) {
        if (uVar25 == 0x5d) {
          uVar20 = 99;
          goto LAB_0002b8ee;
        }
        uVar20 = 99;
        uVar27 = uVar25 - 0x5e & 0xff;
      }
      else if (uVar20 < 0x61) {
        if (uVar25 == 0x5d) goto LAB_0002b8ee;
        uVar27 = uVar25 - 0x5e & 0xff;
      }
      else {
        if (uVar25 == 0x5d) {
          uVar20 = 100;
LAB_0002b8ee:
          uVar25 = 0x5e;
          goto LAB_0002b7fe;
        }
        uVar27 = uVar25 - 0x5e & 0xff;
        uVar20 = 100;
        uVar25 = 100;
      }
      if (uVar27 < 3) {
        uVar25 = (int)*(char *)(DAT_0002baa0 + uVar27);
      }
LAB_0002b7fe:
      *param_3 = (byte)uVar20;
      param_3[1] = (byte)uVar25;
      bVar21 = param_1[0xfc4];
      param_3[2] = bVar21;
      bVar1 = param_1[0xfc5];
      param_3[3] = bVar1;
      bVar3 = param_1[0xfc6];
      param_3[4] = bVar3;
      pbVar23 = param_3 + 5;
      pcVar14 = param_1 + 0xfcc;
      do {
        pcVar19 = pcVar14 + 4;
        pbVar15 = pbVar23 + 4;
        *(undefined4 *)pbVar23 = *(undefined4 *)pcVar14;
        pbVar23 = pbVar15;
        pcVar14 = pcVar19;
      } while (pcVar19 != param_1 + 0xfd8);
      *(undefined2 *)pbVar15 = *(undefined2 *)pcVar19;
      if (2 < *DAT_0002baa4) {
        G1_LOG_ROUTE(*DAT_0002bab4 == 0, DAT_0002baac,DAT_0002baa8,uVar20,uVar25,(uint)bVar21,(uint)bVar1,(uint)bVar3,
                      (uint)param_3[5],(uint)param_3[6],(uint)param_3[7],(uint)param_3[8],
                      (uint)param_3[9],(uint)param_3[10],(uint)param_3[0xb],(uint)param_3[0xc],
                      (uint)param_3[0xd],(uint)param_3[0xe],(uint)param_3[0xf]);
      }
      return 0x13;
    case 4:
      *(undefined4 *)param_3 = *(undefined4 *)(param_1 + 0xfda);
      *(undefined2 *)(param_3 + 4) = *(undefined2 *)(param_1 + 0xfde);
      *(undefined4 *)(param_3 + 6) = *(undefined4 *)(param_1 + 0xfe0);
      *(undefined2 *)(param_3 + 10) = *(undefined2 *)(param_1 + 0xfe4);
      if (2 < *DAT_0002baa4) {
        G1_LOG_ROUTE(*DAT_0002bab4 == 0, DAT_0002bab0,DAT_0002baa8,(uint)*param_3,(uint)param_3[1],(uint)param_3[2],
                      (uint)param_3[3],(uint)param_3[4],(uint)param_3[5],(uint)param_3[6],
                      (uint)param_3[7],(uint)param_3[8],(uint)param_3[9],(uint)param_3[10],
                      (uint)param_3[0xb]);
      }
      return 0xc;
    default:
      goto switchD_0002b03a_caseD_3;
    case 9:
      *param_3 = param_1[0xef4];
      param_3[1] = param_1[0xef5];
      if (*piVar7 < 3) {
        return 2;
      }
      iVar24 = *DAT_0002bab4;
      uVar28 = (undefined4)DAT_0002baa8;
      uVar12 = (undefined4)DAT_0002bab8;
      break;
    case 10:
      puVar16 = (undefined4 *)get_product_code_buf();
      puVar18 = puVar16;
      pbVar23 = param_3;
      do {
        puVar17 = puVar18 + 1;
        *(undefined4 *)pbVar23 = *puVar18;
        puVar18 = puVar17;
        pbVar23 = pbVar23 + 4;
      } while (puVar17 != puVar16 + 4);
      if (*DAT_0002baa4 < 3) {
        return 0x10;
      }
      iVar24 = *DAT_0002bab4;
      uVar28 = (undefined4)DAT_0002bac0;
      goto LAB_0002b9d8;
    case 0xb:
      puVar16 = (undefined4 *)get_device_serial_buf();
      puVar18 = puVar16;
      pbVar23 = param_3;
      do {
        puVar17 = puVar18 + 1;
        *(undefined4 *)pbVar23 = *puVar18;
        puVar18 = puVar17;
        pbVar23 = pbVar23 + 4;
      } while (puVar17 != puVar16 + 4);
      if (*DAT_0002baa4 < 3) {
        return 0x10;
      }
      iVar24 = *DAT_0002bab4;
      uVar28 = (undefined4)DAT_0002babc;
LAB_0002b9d8:
      G1_LOG_ROUTE(iVar24 == 0, (const char*)uVar28,DAT_0002baa8,param_3);
      return 0x10;
    case 0xc:
      *param_3 = param_1[2];
      if (*piVar7 < 3) {
        return 1;
      }
      if (*DAT_0002bab4 != 0) {
        debug_print(DAT_0002bac4,DAT_0002baa8);
        return 1;
      }
      log_message(DAT_0002bac4,DAT_0002baa8);
      return 1;
    case 0xd:
      return get_notification_counts_cmd_response(param_1, param_3);
    case 0xe:
      uVar28 = get_boot_seconds();
      uint32_to_little_endian(param_3,uVar28);
      if (param_1[0xae3] == '\0') {
        iVar24 = *(int *)(param_1 + 0x9b4);
        if (iVar24 != 0) {
          iVar24 = 1;
        }
        bVar21 = (byte)iVar24;
      }
      else {
        bVar21 = 0;
      }
      goto LAB_0002b31a;
    }
    G1_LOG_ROUTE(iVar24 == 0, (const char*)uVar28,(const char*)uVar12,uVar20);
    return 2;
  }
  switch(uVar20 - 1) {
  case 0:
    uVar20 = (uint)param_2[4];
    if (((byte)param_1[0xed5] == uVar20) && (param_1[0xf98] == param_2[5])) {
      if (2 < *DAT_0002b220) {
        G1_LOG_ROUTE(*DAT_0002b208 == 0, DAT_0002b22c,DAT_0002b224);
      }
    }
    else {
      if (2 < *DAT_0002b220) {
        G1_LOG_ROUTE(*DAT_0002b208 == 0, DAT_0002b228,DAT_0002b224,uVar20);
      }
      (*(void(**)(void*,uint))(param_1 + 0xb8c))(param_1 + 0xb6c,uVar20);
      param_1[0xf98] = param_2[5];
      *(uint *)(param_1 + 0x104c) = (uint)*param_2;
      process_sync_buffer(param_1 + 0x80);
    }
    *param_3 = param_2[4];
    param_3[1] = param_2[5];
    param_3[2] = 0xc9;
    return 3;
  case 1:
    bVar21 = param_2[4];
    uVar20 = (uint)(byte)param_1[0xf60];
    if (uVar20 != bVar21) {
      if (2 < *DAT_0002b220) {
        G1_LOG_ROUTE(*DAT_0002b208 == 0, DAT_0002b230,DAT_0002b224,(uint)bVar21);
      }
      param_1[0xf60] = bVar21;
      goto LAB_0002b17c;
    }
    if (2 < *DAT_0002b220) {
      iVar24 = *DAT_0002b208;
      uVar28 = (undefined4)DAT_0002b234;
      uVar12 = (undefined4)DAT_0002b224;
LAB_0002b1a0:
      G1_LOG_ROUTE(iVar24 == 0, (const char*)uVar28,(const char*)uVar12,uVar20);
    }
    goto LAB_0002b1ac;
  case 2:
    bVar21 = param_2[4];
    uVar20 = (uint)bVar21;
    uVar25 = (uint)param_2[5];
    if (2 < *DAT_0002b220) {
      G1_LOG_ROUTE(*DAT_0002b208 == 0, DAT_0002b238,DAT_0002b224,uVar20,uVar25);
    }
    if (2 < uVar20 - 10) {
      if (2 < *piVar4) {
        G1_LOG_ROUTE(*DAT_0002b4d4 == 0, DAT_0002b4e8,DAT_0002b4d8,uVar20);
      }
      bVar21 = 0xca;
      goto LAB_0002b2d8;
    }
    if (uVar20 != (byte)param_1[0xfea]) {
      if (*param_1 == '\x01') {
        if ((byte)param_1[0xfea] == 0xc) {
          if ((uVar20 != 0xc) && (uVar10 = 1, uVar25 != 1)) goto LAB_0002b1f2;
        }
        else if (uVar20 == 0xc) {
          uVar10 = 0;
LAB_0002b1f2:
          device_info_set_mode(uVar10);
        }
      }
      param_1[0xfea] = bVar21;
      *(uint *)(param_1 + 0x104c) = (uint)*param_2;
      process_sync_buffer(param_1 + 0x80);
      if (param_1[0xb0c] == '\0') {
        iVar24 = *piVar4;
        if (uVar20 == 0xb) {
          if (2 < iVar24) {
            G1_LOG_ROUTE(*DAT_0002b4d4 == 0, DAT_0002b4dc,DAT_0002b4d8);
          }
          pcVar14 = param_1 + 0xaf4;
          param_1[0xfe9] = '\x03';
LAB_0002b282:
          process_sync_buffer(pcVar14);
          return 0;
        }
      }
      else {
        iVar24 = *piVar4;
        if (uVar20 == 0xc) {
          if (2 < iVar24) {
            G1_LOG_ROUTE(*DAT_0002b4d4 == 0, DAT_0002b4e0,DAT_0002b4d8);
          }
          goto LAB_0002b1ac;
        }
      }
      if (2 < iVar24) {
        iVar24 = *DAT_0002b4d4;
        uVar28 = (undefined4)DAT_0002b4e4;
        uVar12 = (undefined4)DAT_0002b4d8;
        goto LAB_0002b1a0;
      }
    }
    goto LAB_0002b1ac;
  default:
    goto switchD_0002b03a_caseD_3;
  case 4:
    uVar25 = (uint)param_2[4];
    bVar21 = param_2[5];
    uVar20 = (uint)bVar21;
    if (2 < (int)*DAT_0002b4ec) {
      G1_LOG_ROUTE(*DAT_0002b4d4 == 0, DAT_0002b4f0,DAT_0002b4d8,uVar25,uVar20);
    }
    uVar28 = (undefined4)DAT_0002b4fc;
    if (uVar25 == 1) {
      if (uVar20 != 0) {
        uVar20 = 1;
      }
      imu_set_enabled(DAT_0002b4f4,param_1,uVar20);
    }
    else if (uVar25 == 2) {
      *puVar5 = uVar20;
      log_message((const char*)uVar28,(const char*)uVar20);
    }
    else if ((uVar25 == 3) && (uVar25 = *puVar5, param_1[0xd5] = bVar21, 2 < (int)uVar25)) {
      G1_LOG_ROUTE(*DAT_0002b4d4 == 0, DAT_0002b500,DAT_0002b4d8,uVar20);
    }
    bVar21 = *(byte *)(DAT_0002b4f8 + 1);
    *(undefined4 *)param_3 = *(undefined4*)DAT_0002b4f8;
LAB_0002b31a:
    param_3[4] = bVar21;
    return 5;
  case 6:
    bVar21 = param_2[8];
    if (2 < (int)*DAT_0002b4ec) {
      G1_LOG_ROUTE(*DAT_0002b4d4 == 0, DAT_0002b504,DAT_0002b4d8,(uint)param_2[4],(uint)param_2[5],(uint)param_2[6],
                    (uint)param_2[7],(uint)bVar21,(uint)param_2[9]);
    }
    uVar20 = *(uint *)(param_2 + 4);
    *(byte *)(*(int *)(param_1 + 0xff0) + 5) = bVar21;
    **(uint **)(param_1 + 0xff0) = uVar20;
    *(undefined1 *)(*(int *)(param_1 + 0xff0) + 6) = 1;
    if (2 < (int)*puVar5) {
      G1_LOG_ROUTE(*DAT_0002b4d4 == 0, DAT_0002b508,DAT_0002b4d8,**(undefined4 **)(param_1 + 0xff0),uVar20 / 0xe10,
                    (uVar20 % 0xe10) / 0x3c,(uVar20 % 0xe10) % 0x3c,(uint)bVar21);
    }
    *(uint *)(param_1 + 0x104c) = (uint)*param_2;
    process_sync_buffer(param_1 + 0x80);
    *param_3 = 0xc9;
    if (*(char *)(*(int *)(param_1 + 0xff0) + 5) == '\0') {
      return 1;
    }
    uVar28 = 2;
    goto LAB_0002b404;
  case 7:
    if (2 < *DAT_0002b7a8) {
      G1_LOG_ROUTE(*DAT_0002b7ac == 0, DAT_0002b7b4,DAT_0002b7b0);
    }
    memcpy(*(undefined4 *)(param_1 + 0xff4),pbVar23,0x16a);
    **(undefined4 **)(param_1 + 0xfec) = *(undefined4 *)(*(int *)(param_1 + 0xff4) + 0x164);
    rate_limited_elapsed_seconds_tick(*(undefined4 *)(param_1 + 0xfec),0,1);
    if (2 < *piVar6) {
      G1_LOG_ROUTE(*DAT_0002b7ac == 0, DAT_0002b7b8,DAT_0002b7b0);
    }
LAB_0002b17c:
    *(uint *)(param_1 + 0x104c) = (uint)*param_2;
    param_1 = param_1 + 0x80;
LAB_0002b188:
    process_sync_buffer(param_1);
    goto LAB_0002b1ac;
  case 8:
    if (2 < (int)*DAT_0002b4ec) {
      G1_LOG_ROUTE(*DAT_0002b4d4 == 0, DAT_0002b50c,DAT_0002b4d8);
    }
    memcpy(*(undefined4 *)(param_1 + 0xffc),pbVar23,0x217);
    if ((param_2[5] == 0) &&
       (memset_bytes(*(void**)(param_1 + 0xffc),0,0x217), param_2[5] == 0)) {
      return 0;
    }
    uVar28 = 9;
    goto LAB_0002b446;
  case 9:
    if ((int)*DAT_0002b4ec < 3) {
      return 0;
    }
    if (*DAT_0002b4d4 != 0) {
      debug_print(DAT_0002b510,DAT_0002b4d8);
      return 0;
    }
    log_message(DAT_0002b510,DAT_0002b4d8);
    return 0;
  case 10:
    bVar21 = param_2[4];
    uVar27 = (uint)bVar21;
    uVar20 = (uint)(byte)param_1[0xef4];
    bVar1 = param_2[5];
    uVar25 = (uint)bVar1;
    if ((uVar20 != uVar27) || ((byte)param_1[0xef5] != uVar25)) {
      if (2 < *DAT_0002b7a8) {
        G1_LOG_ROUTE(*DAT_0002b7ac == 0, DAT_0002b7bc,DAT_0002b7b0,uVar27,uVar25);
      }
      param_1[0xef4] = bVar21;
      param_1[0xef5] = bVar1;
      goto LAB_0002b17c;
    }
    if (2 < *DAT_0002b7a8) {
      iVar24 = *DAT_0002b7ac;
      uVar28 = (undefined4)DAT_0002b7c0;
      uVar12 = (undefined4)DAT_0002b7b0;
      goto LAB_0002b1a0;
    }
    goto LAB_0002b1ac;
  case 0xc:
    iVar24 = get_low_battery_flag_if_master();
    if (iVar24 != 0) {
      return 0;
    }
    *(undefined1 *)(*(int *)(param_1 + 0x1004) + 0x195) = 0;
    iVar24 = *(int *)(param_1 + 0x1004);
    goto LAB_0002b4a0;
  case 0xe:
    iVar24 = get_low_battery_flag_if_master();
    if (iVar24 != 0) {
      return 0;
    }
    *(undefined1 *)(*(int *)(param_1 + 0x1008) + 0x195) = 0;
    iVar24 = *(int *)(param_1 + 0x1008);
LAB_0002b4a0:
    if (*(char *)(iVar24 + 6) == '\0') {
      *(undefined1 *)(iVar24 + 6) = 10;
    }
    *param_3 = 0xc9;
    if (**(int **)(param_1 + 0x1054) == 0xb) {
      return 1;
    }
    uVar28 = 0xb;
LAB_0002b404:
    update_persist_task_status(param_1,uVar28,2);
    return 1;
  case 0x10:
    *(undefined4 *)(param_1 + 0x104c) = 7;
    pcVar14 = param_1 + 0x80;
    goto LAB_0002b282;
  case 0x13:
    bVar21 = param_2[4];
    if (0 < *DAT_0002b7a8) {
      G1_LOG_ROUTE(*DAT_0002b7ac == 0, DAT_0002b7c4,DAT_0002b7b0,(uint)bVar21);
    }
    ancs_set_notification_enabled((uint)bVar21);
    goto LAB_0002b1ac;
  case 0x25:
    if (2 < *DAT_0002b7a8) {
      G1_LOG_ROUTE(*DAT_0002b7ac == 0, DAT_0002b7c8,DAT_0002b7b0,(uint)param_2[8]);
    }
    if (param_2[8] != 2) {
      return 0;
    }
    if (1 < *piVar6) {
      G1_LOG_ROUTE(*DAT_0002b7ac == 0, DAT_0002b7cc,DAT_0002b7b0,(uint)param_2[9],(uint)param_2[10],(uint)param_2[0xb]);
    }
    if (param_2[9] != 1) {
      **(undefined1 **)(param_1 + 0x1018) = 0;
      return 0;
    }
    **(undefined1 **)(param_1 + 0x1018) = 1;
    param_1[0xec0] = param_2[10];
    param_1[0xec1] = param_2[0xb];
    iVar24 = is_system_idle_ready();
    if (iVar24 == 0) {
      return 0;
    }
    uVar28 = 0xf;
LAB_0002b446:
    update_persist_task_status(param_1,uVar28,2);
switchD_0002b03a_caseD_3:
    return 0;
  }
LAB_0002b1ac:
  bVar21 = 0xc9;
LAB_0002b2d8:
  *param_3 = bVar21;
  return 1;
}

/* ---- init_dmic_msgq.c ---- */
struct k_msgq;
#include <stddef.h>
/* readable reconstruction; identity: FUN_0002ebd8 @ 0x0002ebd8
 * public-name: init_dmic_msgq
 * durable-map: recon/catalogs/function_names_app.json
 * callees (readable <= raw @ address):
 *   debug_print                              <= FUN_00019c70 @ 0x00019c70
 *   z_impl_k_msgq_alloc_init                 <= FUN_00086448 @ 0x00086448
 * address symbols (name @ address):
 *   rodata_a3ee4                             @ 0x000a3ee4   [INLINED -- G6 literal batch]
 *   rodata_a41ff                             @ 0x000a41ff   [INLINED -- G6 literal batch]
 *   g_log_level                              @ 0x2000230c
 *   g_log_use_alt_sink                       @ 0x20007554
 *   g_dmic_msgq                              @ 0x20007b7c
 */
/* Reconstructed init_dmic_msgq @ 0x2ebd8  (parity: 300/300 trials, PROVEN) */

extern int z_impl_k_msgq_alloc_init(struct k_msgq *, size_t,  uint32_t);
int init_dmic_msgq(void){
    int iVar1 = z_impl_k_msgq_alloc_init(((unsigned long)&g_dmic_msgq) /*=0x20007b7c*/,200,8);
    if(iVar1!=0 && *(volatile int *)((unsigned long)&g_log_level) /*=0x2000230c*/>0){
        G1_LOG_ROUTE(*(volatile unsigned int *)((unsigned long)&g_log_use_alt_sink) /*=0x20007554*/==0, ((unsigned long)"%s(): dmic init failed\n") /*=0xa3ee4*/,((unsigned long)"init_dmic_msgq") /*=0xa41ff*/);
    }
    return iVar1;
}

/* ---- clean_dmic_msgq.c ---- */
/* readable reconstruction; identity: FUN_0002ec1c @ 0x0002ec1c
 * public-name: clean_dmic_msgq
 * durable-map: recon/catalogs/function_names_app.json
 * callees (readable <= raw @ address):
 *   debug_print                              <= FUN_00019c70 @ 0x00019c70
 *   k_msgq_cleanup                           <= FUN_00086480 @ 0x00086480
 * address symbols (name @ address):
 *   rodata_a3efc                             @ 0x000a3efc   [INLINED -- G6 literal batch]
 *   rodata_a41ef                             @ 0x000a41ef   [INLINED -- G6 literal batch]
 *   g_log_level                              @ 0x2000230c
 *   g_log_use_alt_sink                       @ 0x20007554
 *   g_dmic_msgq                              @ 0x20007b7c
 */
/* Reconstructed clean_dmic_msgq @ 0x2ec1c  (parity: 300/300 trials, PROVEN) */

extern int k_msgq_cleanup(struct k_msgq *);
int clean_dmic_msgq(void){
    int iVar1 = k_msgq_cleanup(((unsigned long)&g_dmic_msgq) /*=0x20007b7c*/);
    if(iVar1!=0 && *(volatile int *)((unsigned long)&g_log_level) /*=0x2000230c*/ > 0){
        G1_LOG_ROUTE(*(volatile unsigned int *)((unsigned long)&g_log_use_alt_sink) /*=0x20007554*/==0, ((unsigned long)"%s(): dmic cleanup failed\n") /*=0xa3efc*/,((unsigned long)"clean_dmic_msgq") /*=0xa41ef*/);
    }
    return iVar1;
}

/* ================================================================ */
/* member unit: g1_audio_18.c */
/* ================================================================ */
/*
 * Cohesive translation unit for the `audio' module.
 *
 * GENERATED by recon/refactor/transforms/t04_cohesive_tu.py.  Do not
 * edit: a stage tree is regenerated, never hand-patched
 * (recon/refactor/README.md C4).
 *
 * The 5 functions below were 5 separate translation units until this
 * stage.  Each one's text is reproduced VERBATIM and in the order the
 * generated source list gave it, and they were CONSECUTIVE in that list.
 * They were proven able to share a translation unit: no symbol is
 * declared here with two types, no identifier has internal linkage in one
 * member and is named by another, and no local typedef, macro, struct tag
 * or enum constant of one member is visible to a member that names it.
 *
 * members, in link order:
 *   opt_record_init.c
 *   opt_record_decode.c
 *   opt_node_serialize_7c5ba.c
 *   opt_record_bind_value.c
 *   serialization_copy_fields_0c_10.c
 */
/* ---- opt_record_init.c ---- */
#include "g1_app_symbols.h"
#include "g1_audio.h"
/* readable reconstruction; identity: FUN_0007c4b6 @ 0x0007c4b6
 * public-name: opt_record_init
 * durable-map: recon/catalogs/function_names_app.json
 * callees (readable <= raw @ address):
 *   opt_field1_set                           <= FUN_0007c430 @ 0x0007c430
 *   opt_field2_set                           <= FUN_0007c456 @ 0x0007c456
 *   opt_field3_set                           <= FUN_0007c48a @ 0x0007c48a
 *   opt_record_init                          <= FUN_0007c4b6 @ 0x0007c4b6
 */
/* Reconstructed FUN_0007c4b6 @ 0x7c4b6  (parity: 300/300 trials, PROVEN) */
extern unsigned int opt_field1_set(unsigned char*, unsigned int, int*);
extern unsigned int opt_field3_set(unsigned char*, int*);
extern int opt_field2_set(unsigned char*, int*);

unsigned int opt_record_init(unsigned char *param_1)
{
    unsigned int uVar1;
    struct {
        unsigned int value;
        unsigned char flag;
    } header = {0};
    unsigned int state[2] = {0, 0};
    if (param_1 == 0) {
        uVar1 = 7;
    } else {
        *param_1 = 0xc0;
        opt_field1_set(param_1, 0, &header);
        opt_field3_set(param_1, &header);
        opt_field2_set(param_1, state);
        uVar1 = 0;
        *(unsigned int*)(param_1 + 0x14) = 0;
        *(unsigned int*)(param_1 + 0x18) = 0;
    }
    return uVar1;
}

/* ---- opt_record_decode.c ---- */
/* readable reconstruction; identity: FUN_0007c4f4 @ 0x0007c4f4
 * public-name: opt_record_decode
 * durable-map: recon/catalogs/function_names_app.json
 * callees (readable <= raw @ address):
 *   opt_record_init                          <= FUN_0007c4b6 @ 0x0007c4b6
 *   opt_record_decode                        <= FUN_0007c4f4 @ 0x0007c4f4
 */
/* Reconstructed FUN_0007c4f4 @ 0x7c4f4  (parity: 300/300 trials, PROVEN) */
extern unsigned int opt_record_init(unsigned char *);
unsigned opt_record_decode(int *param_1, unsigned char *param_2){
  unsigned char bVar1;
  unsigned uVar3, uVar4, uVar5, uVar6, uVar7;
  volatile unsigned char *pb = param_2;
  if (param_1 == 0 || *param_1 == 0 || param_2 == 0) return 7;
  if (opt_record_init(param_2) != 0) return 0xc;
  if (param_1[1] == 0) return 0xb;
  bVar1 = *(unsigned char*)*param_1;
  pb[0] = bVar1;
  if ((unsigned)param_1[1] < 2) return 0xb;
  uVar3 = *(unsigned char*)(*param_1 + 1);
  pb[1] = *(unsigned char*)(*param_1 + 1);
  if ((bVar1 & 0x10) == 0){
    if ((unsigned)param_1[1] < 6) return 0xb;
    uVar6 = 6;
    uVar4 = *(unsigned*)(*param_1 + 2);
    uVar4 = uVar4<<0x18 | ((uVar4>>8)&0xff)<<0x10 | ((uVar4>>0x10)&0xff)<<8 | uVar4>>0x18;
  } else {
    if ((unsigned)param_1[1] < 3) return 0xb;
    uVar6 = 3;
    uVar4 = *(unsigned char*)(*param_1 + 2);
  }
  uVar5 = bVar1 & 8;
  *(volatile unsigned int *)(param_2 + 0x10) = uVar4;
  if ((bVar1 & 8) == 0){
    pb[2] = (unsigned char)uVar5;
    if (uVar3 == 0){
      *(volatile unsigned int *)(param_2 + 4) = 0;
      uVar5 = 0;
      goto LAB_c552;
    }
   LAB_c58a:
    uVar7 = uVar3 + uVar6;
    if ((unsigned)param_1[1] < uVar7) return 0xb;
    uVar3 = *param_1 + uVar6;
  } else {
    uVar7 = uVar6 + 1;
    if ((unsigned)param_1[1] < uVar7) return 0xb;
    uVar5 = *(unsigned char*)(*param_1 + uVar6);
    pb[2] = *(unsigned char*)(*param_1 + uVar6);
    uVar6 = uVar7;
    if (uVar3 != 0) goto LAB_c58a;
  }
  *(volatile unsigned int *)(param_2 + 4) = uVar3;
  uVar6 = uVar7;
  if (uVar5 != 0){
    uVar6 = uVar5 + uVar7;
    if ((unsigned)param_1[1] < uVar6) return 0xb;
    uVar5 = *param_1 + uVar7;
  }
 LAB_c552:
  *(volatile unsigned int *)(param_2 + 8) = uVar5;
  if (uVar4 != 0){
    if ((unsigned)param_1[1] < uVar4 + uVar6) return 0xb;
    uVar4 = *param_1 + uVar6;
  }
  *(volatile unsigned int *)(param_2 + 0xc) = uVar4;
  *(volatile unsigned int *)(param_2 + 0x18) = 0;
  return 0;
}

/* ---- opt_node_serialize_7c5ba.c ---- */
/* readable reconstruction; identity: FUN_0007c5ba @ 0x0007c5ba
 * public-name: opt_node_serialize_7c5ba
 * durable-map: recon/catalogs/function_names_app.json
 * callees (readable <= raw @ address):
 *   opt_node_value_len                       <= FUN_0007c408 @ 0x0007c408
 *   opt_node_serialize_7c5ba                 <= FUN_0007c5ba @ 0x0007c5ba
 */
/* Reconstructed FUN_0007c5ba @ 0x7c5ba  (parity: 300/300 trials, PROVEN) */

/* P4 iteration 40 -- DROPPED ARGUMENT.  Shipped 0007c5e0 `bl #0x7c408` is
 * reached with r0 never rewritten since entry, so the value-length helper
 * receives the node.  With no argument the candidate handed it whatever r0
 * happened to hold. */
unsigned opt_node_serialize_7c5ba(unsigned char* param_1, int* param_2){
  unsigned uVar3; int iVar4,iVar5;
  if(param_1==0) return 7;
  if(param_2==0) return 7;
  if(*param_2==0) return 7;
  if((unsigned)param_2[1] < 7){ param_2[1]=7; return 1; }
  *(unsigned char*)(*param_2) = *param_1;
  *(unsigned char*)(*param_2 + 1) = param_1[1];
  uVar3 = opt_node_value_len(param_1);
  if(uVar3 <= 0xff){
    *(unsigned char*)(*param_2 + 2) = (unsigned char)uVar3;
    iVar5 = 3;
  } else {
    *(unsigned char*)(*param_2+2)=(unsigned char)(uVar3>>0x18);
    *(unsigned char*)(*param_2+3)=(unsigned char)(uVar3>>0x10);
    *(unsigned char*)(*param_2+4)=(unsigned char)(uVar3>>8);
    *(unsigned char*)(*param_2+5)=(unsigned char)uVar3;
    iVar5=6;
  }
  iVar4 = (int)((unsigned)*param_1 << 0x1c);
  if(iVar4 < 0){
    *(unsigned char*)(*param_2 + iVar5) = param_1[2];
    iVar5 = iVar5+1;
  }
  param_2[1] = iVar5;
  return 0;
}

/* ---- opt_record_bind_value.c ---- */
/* readable reconstruction; identity: FUN_0007c61e @ 0x0007c61e
 * public-name: opt_record_bind_value
 * durable-map: recon/catalogs/function_names_app.json
 * callees (readable <= raw @ address):
 *   opt_node_value_len                       <= FUN_0007c408 @ 0x0007c408
 *   opt_record_bind_value                    <= FUN_0007c61e @ 0x0007c61e
 */
/* Reconstructed FUN_0007c61e @ 0x7c61e  (parity: 300/300 trials, PROVEN) */

unsigned int opt_record_bind_value(unsigned char *param_1, unsigned char *param_2)
{
    unsigned int uVar1;
    unsigned int uVar2;

    if (param_1 == 0 || param_2 == 0 || (unsigned char)(*param_2 - 1) > 0x15 ||
        *(unsigned int*)(param_2 + 4) == 0 || *(unsigned int*)(param_2 + 8) == 0 ||
        *(unsigned int*)(param_2 + 0xc) == 0) {
        uVar2 = 7;
    } else {
        *(unsigned char **)(param_1 + 0x14) = param_2;
        uVar1 = opt_node_value_len(param_1);
        uVar2 = 0;
        *param_1 = (*param_1 & 0xef) | ((uVar1 < 0x100) << 4);
    }
    return uVar2;
}

/* ---- serialization_copy_fields_0c_10.c ---- */
/* readable reconstruction; identity: FUN_0007c65c @ 0x0007c65c
 * public-name: serialization_copy_fields_0c_10
 * durable-map: recon/catalogs/function_names_app.json
 * callees (readable <= raw @ address):
 *   serialization_copy_fields_0c_10          <= FUN_0007c65c @ 0x0007c65c
 */
/* Reconstructed FUN_0007c65c @ 0x7c65c  (parity: 300/300 trials, PROVEN) */

unsigned int serialization_copy_fields_0c_10(int param_1, unsigned int *param_2)
{
    if (param_1 != 0 && param_2 != 0) {
        *param_2 = *(unsigned int *)(param_1 + 0xc);
        param_2[1] = *(unsigned int *)(param_1 + 0x10);
        return 0;
    }
    return 7;
}

/* ================================================================ */
/* member unit: g1_audio_19.c */
/* ================================================================ */
/*
 * Cohesive translation unit for the `audio' module.
 *
 * GENERATED by recon/refactor/transforms/t04_cohesive_tu.py.  Do not
 * edit: a stage tree is regenerated, never hand-patched
 * (recon/refactor/README.md C4).
 *
 * The 3 functions below were 3 separate translation units until this
 * stage.  Each one's text is reproduced VERBATIM and in the order the
 * generated source list gave it, and they were CONSECUTIVE in that list.
 * They were proven able to share a translation unit: no symbol is
 * declared here with two types, no identifier has internal linkage in one
 * member and is named by another, and no local typedef, macro, struct tag
 * or enum constant of one member is visible to a member that names it.
 *
 * members, in link order:
 *   serialization_read_or_copy.c
 *   opt_node_serialize.c
 *   opt_list_total_len.c
 */

/* File-scope forward declarations for every struct/union tag this
 * unit names.  Without them a tag whose only appearance in a member
 * is inside a parameter list has PARAMETER-LIST scope, so two
 * textually IDENTICAL declarations in two members declare two
 * different incomplete types and the second is a conflicting
 * redeclaration (C11 6.2.1p7).  Incomplete-type forward
 * declarations emit no code. */
struct g1_opt_view;
/* ---- serialization_read_or_copy.c ---- */
#include "g1_app_symbols.h"
/* readable reconstruction; identity: FUN_0007c670 @ 0x0007c670
 * public-name: serialization_read_or_copy
 * durable-map: recon/catalogs/function_names_app.json
 * callees (readable <= raw @ address):
 *   serialization_copy_fields_0c_10          <= FUN_0007c65c @ 0x0007c65c
 *   serialization_read_or_copy               <= FUN_0007c670 @ 0x0007c670
 */
/* Reconstructed FUN_0007c670 @ 0x7c670  (parity: 300/300 trials, PROVEN)
 *
 * P4 iteration 40 -- TWO DROPPED ARGUMENTS.  The shipped tail passes THREE
 * live registers to the indirect `+8` iterator op:
 *     0007c672  mov  r3, r2              ; r2 itself is never rewritten
 *     0007c674  mov  r4, r1              ; r1 itself is never rewritten
 *     0007c67c  strd r5, r5, [r1]
 *     0007c680  ldr  r5, [r0, #0x14]
 *     0007c684  ldr  r6, [r5, #8]
 *     0007c688  mov  r0, r5
 *     0007c68a  blx  r6                  ; r0=descriptor r1=out view r2=flag
 * The previous body wrote `fp(iVar1)`.  Measured in the shipped-in build
 * /private/tmp/g1-i39c-app/zephyr/zephyr.elf that compiled to
 *     78c4c  ldr r1,[r3,#8] ; 78c5c mov r0,r3 ; 78c5e ldr r2,[r3,#8] ; blx r2
 * so BOTH r1 and r2 arrived holding the op pointer itself.  FUN_00024a40 /
 * FUN_00024ad8 write their two-word result through r1, so the callee would
 * have stored into a flash code address, and their rewind flag (r2) would have
 * been permanently non-zero, pinning the payload cursor at 0.  `cfg_verify` is
 * blind to it for the same reason as FUN_0007c408: dropped register arguments
 * to an order-keyed oracle.
 */

extern unsigned int serialization_copy_fields_0c_10(int, unsigned int*);

static int serialization_read_or_copy(int param_1, int *param_2, int param_3)
{
    if (param_1 != 0) {
        if (param_2 == (int*)0) {
            param_1 = 0;
        } else {
            param_2[0] = 0;
            param_2[1] = 0;
            int iVar1 = *(volatile int *)((char*)param_1 + 0x14);
            if ((iVar1 == 0) || (*(volatile int *)((char*)iVar1 + 8) == 0)) {
                if (param_3 != 0) {
                    serialization_copy_fields_0c_10(param_1, param_2);
                }
            } else {
                void (*fp)(int, int *, int) =
                    (void(*)(int, int *, int))*(volatile unsigned int *)((char*)iVar1 + 8);
                fp(iVar1, param_2, param_3);
            }
            param_1 = *param_2;
        }
    }
    return param_1;
}

/* ---- opt_node_serialize.c ---- */
/* readable reconstruction; identity: FUN_0007c6a0 @ 0x0007c6a0
 * public-name: opt_node_serialize
 * durable-map: recon/catalogs/function_names_app.json
 * callees (readable <= raw @ address):
 *   opt_node_value_len                       <= FUN_0007c408 @ 0x0007c408
 *   opt_node_total_len                       <= FUN_0007c41c @ 0x0007c41c
 *   opt_node_serialize_7c5ba                 <= FUN_0007c5ba @ 0x0007c5ba
 *   serialization_read_or_copy               <= FUN_0007c670 @ 0x0007c670
 *   opt_node_serialize                       <= FUN_0007c6a0 @ 0x0007c6a0
 *   memcpy                                   <= FUN_00086c04 @ 0x00086c04
 */
/* Reconstructed FUN_0007c6a0 @ 0x7c6a0  (parity: 300/300 trials, PROVEN)
 *
 * P4 iteration 40 -- DROPPED ARGUMENTS + STACK-OBJECT LAYOUT.  Three defects,
 * all in the class AGENTS.md lists as invisible to the harness:
 *
 *  (a) memcpy is a THREE-argument function and every copy here is the NDEF
 *      serializer writing the record type name, the record id and each payload
 *      fragment into the output buffer:
 *        0007c6e4 ldrb r2,[r5,#1] ; 0007c6ea ldr r0,[r4] ; 0007c6ec ldr r1,[r5,#4]
 *        0007c6ee add  r0,r6      ; 0007c6f0 bl #0x86c04
 *        0007c6f8 ldrb r2,[r5,#2] ; ...       0007c702 bl #0x86c04
 *        0007c738 ldr  r2,[sp,#0xc]; ...      0007c744 bl #0x86c04
 *      The previous body passed only (dst, src).
 *  (b) 0007c6ba `bl #0x7c41c` runs with r0 still the node; the total-length
 *      helper takes one argument and the previous body passed 0.
 *  (c) the two-word view handed to opt_node_serialize_7c5ba lived in TWO
 *      SEPARATE locals, so GCC was free to keep the length in a register.  It
 *      is one object; a struct makes that explicit.
 */
#include <stdint.h>
#include "g1_audio.h"
extern unsigned opt_node_serialize_7c5ba(unsigned char*, int*);
static int serialization_read_or_copy(int, int *, int);
extern void memcpy(int, int, int);

/* The shipped code passes sp+0/sp+4 and sp+8/sp+0xc as ONE two-word object
 * each (the callee writes the second word back). */
struct g1_opt_view { int data; int length; };

int opt_node_serialize(int param_1, int *param_2){
    if (param_1==0 || param_2==0 || *param_2==0) return 7;
    unsigned uVar6 = param_2[1];
    unsigned uVar1 = opt_node_total_len(param_1);
    if (uVar6 < uVar1){
        int iv = opt_node_total_len(param_1);
        param_2[1] = iv;
        return 1;
    }
    struct g1_opt_view local;
    volatile struct g1_opt_view fragment;
    local.data = *param_2;
    local.length = param_2[1];
    int iVar3 = opt_node_serialize_7c5ba(param_1, &local);
    int iVar2 = local.length;
    if (iVar3 != 0) return iVar3;
    if (*(char*)(param_1+1) != 0){
        memcpy(*param_2 + iVar2, *(int*)(param_1+4),
                     *(unsigned char*)(param_1+1));
        iVar2 = iVar2 + *(unsigned char*)(param_1+1);
    }
    if (*(char*)(param_1+2) != 0){
        memcpy(*param_2 + iVar2, *(int*)(param_1+8),
                     *(unsigned char*)(param_1+2));
        iVar2 = iVar2 + *(unsigned char*)(param_1+2);
    }
    int iVar7 = *param_2;
    int iVar3b = param_2[1];
    uVar1 = opt_node_value_len(param_1);
    if ((unsigned)(iVar3b - iVar2) < uVar1){
        return 1;
    }
    int acc = 0;
    int uVar5 = 1;
    while (1){
        int iVar4 = serialization_read_or_copy(param_1, (void *)&fragment, uVar5);
        if (iVar4 == 0) break;
        if (fragment.length != 0){
            memcpy(iVar2 + acc + iVar7, fragment.data,
                         (unsigned)fragment.length);
        }
        uVar5 = 0;
        acc = acc + fragment.length;
    }
    param_2[1] = iVar2 + acc;
    return 0;
}

/* ---- opt_list_total_len.c ---- */
/* readable reconstruction; identity: FUN_0007c754 @ 0x0007c754
 * public-name: opt_list_total_len
 * durable-map: recon/catalogs/function_names_app.json
 * callees (readable <= raw @ address):
 *   opt_node_total_len                       <= FUN_0007c41c @ 0x0007c41c
 *   opt_list_total_len                       <= FUN_0007c754 @ 0x0007c754
 */
/* Reconstructed FUN_0007c754 @ 0x7c754  (parity: 300/300 trials, PROVEN) */

int opt_list_total_len(int *param_1, int *param_2)
{
    if (param_1 == 0 || param_2 == 0) {
        return 7;
    }
    int iVar4 = 0, iVar5 = 0, iVar3;
    for (iVar3 = *param_1; iVar3 != 0; iVar3 = *(int*)(iVar3 + 0x18)) {
        int iVar1 = opt_node_total_len(iVar3);
        iVar4 = iVar4 + 1;
        iVar5 = iVar5 + iVar1;
    }
    param_2[0] = iVar5;
    param_2[1] = iVar4;
    return 0;
}

