/*
 * Cohesive translation unit for the `audio' module.
 *
 * GENERATED by recon/refactor/transforms/t04_cohesive_tu.py.  Do not
 * edit: a stage tree is regenerated, never hand-patched
 * (recon/refactor/README.md C4).
 *
 * The 5 functions below were 5 separate translation units until this
 * stage.  Each one's text is reproduced VERBATIM and in the order the
 * generated source list gave it, and they were CONSECUTIVE in that list.
 * They were proven able to share a translation unit: no symbol is
 * declared here with two types, no identifier has internal linkage in one
 * member and is named by another, and no local typedef, macro, struct tag
 * or enum constant of one member is visible to a member that names it.
 *
 * members, in link order:
 *   uarte_nrfx_tx_complete.c
 *   pinctrl_apply_state.c
 *   flowctl_release_credit_and_kick.c
 *   flowctl_schedule_next_send.c
 *   pmic_write_reg7_enable.c
 */

/* File-scope forward declarations for every struct/union tag this
 * unit names.  Without them a tag whose only appearance in a member
 * is inside a parameter list has PARAMETER-LIST scope, so two
 * textually IDENTICAL declarations in two members declare two
 * different incomplete types and the second is a conflicting
 * redeclaration (C11 6.2.1p7).  Incomplete-type forward
 * declarations emit no code. */
struct k_timer;
/* ---- uarte_nrfx_tx_complete.c ---- */
#include "g1_app_symbols.h"
/* readable reconstruction; identity: FUN_00084ade @ 0x00084ade
 * public-name: uarte_nrfx_tx_complete
 * durable-map: recon/catalogs/function_names_app.json
 * callees (readable <= raw @ address):
 *   audio_dma_start_transfer                 <= FUN_0008496c @ 0x0008496c
 *   is_tx_ready                              <= FUN_00084abe @ 0x00084abe
 *   uarte_nrfx_tx_complete                   <= FUN_00084ade @ 0x00084ade
 */
/* Reconstructed FUN_00084ade @ 0x84ade  (parity: 300/300 trials, PROVEN) */

extern long long is_tx_ready(unsigned int);
extern void audio_dma_start_transfer(unsigned int, unsigned int, unsigned int);

void uarte_nrfx_tx_complete(unsigned int param_1)
{
  long long uVar2;
  int iVar1;
  int field;
  uVar2 = is_tx_ready(*(unsigned int *)(param_1 + 4));
  iVar1 = (int)(uVar2 >> 32);
  field = *(int *)(iVar1 + 0xc);
  if ((int)uVar2 == 0) {
    *(unsigned char *)(field + 0xcd) = 1;
    return;
  }
  *(unsigned char *)(field + 0xcd) = 0;
  *(unsigned int *)(field + 0xbc) = 0xffffffff;
  audio_dma_start_transfer(param_1, *(unsigned int *)(field + 0x10), *(unsigned int *)(field + 0x14));
}

/* ---- pinctrl_apply_state.c ---- */
#include "g1_audio.h"
/* readable reconstruction; identity: FUN_00084b14 @ 0x00084b14
 * public-name: pinctrl_apply_state
 * durable-map: recon/catalogs/function_names_app.json
 * callees (readable <= raw @ address):
 *   pinctrl_lookup_state                     <= FUN_00083eb8 @ 0x00083eb8
 *   dppi_apply_channel_config_table          <= FUN_00083ede @ 0x00083ede
 *   pinctrl_apply_state                      <= FUN_00084b14 @ 0x00084b14
 */
/* Reconstructed FUN_00084b14 @ 0x84b14  (parity: 300/300 trials, PROVEN) */

extern int dppi_apply_channel_config_table(const unsigned long*, unsigned int, unsigned int);

void pinctrl_apply_state(unsigned int *param_1, unsigned int *param_2, unsigned int param_3, unsigned int param_4)
{
  int iVar1;
  unsigned int *local_c;

  local_c = param_2;
  iVar1 = pinctrl_lookup_state(param_1,param_2,&local_c,param_4,param_1);
  if (-1 < iVar1) {
    dppi_apply_channel_config_table(*local_c,*(unsigned char *)(local_c + 1),*param_1);
  }
  return;
}

/* ---- flowctl_release_credit_and_kick.c ---- */
/* readable reconstruction; identity: FUN_00084b32 @ 0x00084b32
 * public-name: flowctl_release_credit_and_kick
 * durable-map: recon/catalogs/function_names_app.json
 * callees (readable <= raw @ address):
 *   uarte_blocking_transfer                  <= FUN_00084a54 @ 0x00084a54
 *   flowctl_release_credit_and_kick          <= FUN_00084b32 @ 0x00084b32
 */
/* Reconstructed FUN_00084b32 @ 0x84b32  (parity: 300/300 trials, PROVEN) */
#include <stdint.h>
extern int uarte_blocking_transfer(int,int,int);
void flowctl_release_credit_and_kick(int param_1, uint32_t param_2){
  int iVar5 = *(volatile int *)(param_1+0x10);
  int iVar4 = *(volatile int *)(iVar5+0xc);
  *(volatile uint32_t *)(iVar4+0xc0) = *(volatile uint32_t *)(iVar4+0xc0) & ~param_2;
  int r5 = *(volatile int *)(iVar5+0xc);
  if(*(volatile int *)(r5+0xc0) == 0){
    if(param_2 == 2){
      int r = uarte_blocking_transfer(*(volatile int *)(param_1+4), r5+0xc4, 5);
      *(volatile uint8_t *)(r5+0xc9) = (uint8_t)r;
    }
    int base = *(volatile int *)(*(volatile int *)(param_1+4));
    *(volatile uint32_t *)(base+0x500) = 0;
  }
}

/* ---- flowctl_schedule_next_send.c ---- */
/* readable reconstruction; identity: FUN_00084b86 @ 0x00084b86
 * public-name: flowctl_schedule_next_send
 * durable-map: recon/catalogs/function_names_app.json
 * callees (readable <= raw @ address):
 *   post_event_tag2_from_node                <= FUN_0008484e @ 0x0008484e
 *   flowctl_schedule_next_send               <= FUN_00084b86 @ 0x00084b86
 *   z_impl_k_timer_stop                      <= FUN_0008673e @ 0x0008673e
 */
/* Reconstructed FUN_00084b86 @ 0x84b86  (parity: 300/300 trials, PROVEN) */

extern void post_event_tag2_from_node(int a,int b,int c,int d,unsigned e);
extern void z_impl_k_timer_stop(struct k_timer *);
void flowctl_schedule_next_send(int param_1, unsigned p2, unsigned p3, unsigned param_4){
    int piVar6 = *(volatile int *)(param_1 + 0x34);
    if (*(volatile signed char *)(*(volatile int *)(piVar6+0xc) + 0xce) != 0) return;
    int iVar7 = *(volatile int *)(piVar6+0);
    *(volatile int *)(*(volatile int *)(*(volatile int *)(iVar7+4)) + 0x308) = 0x10;
    int node = *(volatile int *)(piVar6+0xc);
    int iVar3v = *(volatile int *)(node + 0xb8);
    int bVar8 = (*(volatile int *)(node + 0x6c) != iVar3v);
    if (bVar8){
        *(volatile int *)(node + 0x6c) = iVar3v;
        node = *(volatile int *)(piVar6+0xc);
        iVar3v = *(volatile int *)(node + 0x74);
        *(volatile int *)(node + 0x7c) = iVar3v;
    }
    int iv3 = *(volatile int *)(piVar6+0xc);
    int iVar5 = *(volatile int *)(iv3 + 0x6c) - *(volatile int *)(iv3 + 0x70);
    int iVar4 = 0;
    if (iVar5 < 0){
        *(volatile int *)(iv3 + 0xb8) = *(volatile int *)(iv3 + 0x70);
        iv3 = *(volatile int *)(piVar6+0xc);
        unsigned uVar1 = *(volatile unsigned int *)(iv3 + 0x5c);
        unsigned uVar2 = *(volatile unsigned int *)(iv3 + 0x60);
        if (uVar2 <= uVar1) goto LAB;
        iVar4 = iVar5;
        iVar5 = (int)(uVar1 - uVar2);
        if (iVar5 <= 0) goto LAB;
        bVar8 = 1;
    } else {
        unsigned uVar1 = *(volatile unsigned int *)(iv3 + 0x5c);
        unsigned uVar2 = *(volatile unsigned int *)(iv3 + 0x60);
        if ((unsigned)((unsigned)iVar5 + uVar2) > uVar1){
            iVar4 = iVar5;
            iVar5 = (int)(uVar1 - uVar2);
            if (iVar5 <= 0) goto LAB;
            bVar8 = 1;
        } else {
            if (iVar5 == 0) goto LAB;
            iVar4 = *(volatile int *)(iv3 + 0x7c);
            bVar8 = 0;
            if (*(volatile int *)(iv3 + 0x78) <= iVar4){
                *(volatile int *)(iv3 + 0x7c) = iVar4 - *(volatile int *)(iv3 + 0x78);
                goto LAB;
            }
        }
    }
    post_event_tag2_from_node(iVar7, iVar5, iVar4, iv3, param_4);
    { int n = *(volatile int *)(piVar6+0xc);
      *(volatile int *)(n + 0x60) = *(volatile int *)(n + 0x60) + iVar5; }
    { int n = *(volatile int *)(piVar6+0xc);
      *(volatile int *)(n + 0x70) = *(volatile int *)(n + 0x70) + iVar5; }
    if (bVar8){
        int n = *(volatile int *)(piVar6+0xc);
        z_impl_k_timer_stop(n + 0x80);
    }
LAB:
    *(volatile int *)(*(volatile int *)(*(volatile int *)(iVar7+4)) + 0x304) = 0x10;
    return;
}

/* ---- pmic_write_reg7_enable.c ---- */
/* readable reconstruction; identity: FUN_00084cb0 @ 0x00084cb0
 * public-name: pmic_write_reg7_enable
 * durable-map: recon/catalogs/function_names_app.json
 * callees (readable <= raw @ address):
 *   dev_write_reg3                           <= FUN_00083dc8 @ 0x00083dc8
 *   pmic_write_reg7_enable                   <= FUN_00084cb0 @ 0x00084cb0
 */
/* Reconstructed FUN_00084cb0 @ 0x84cb0  (parity: 300/300 trials, PROVEN) */

extern int dev_write_reg3(unsigned int, unsigned int, unsigned int, unsigned int);

static unsigned int pmic_write_reg7_enable(int param_1)
{
  if (**(volatile char **)(param_1 + 0x10) != 0) {
    return dev_write_reg3(**(volatile unsigned int **)(param_1 + 4), 7, 0, 1);
  }
  return 0xffffffea;
}

