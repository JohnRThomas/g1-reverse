/*
 * Call-cohesive translation unit for the `storage' module.
 *
 * GENERATED by recon/refactor/transforms/t09_call_cohesion.py.  Do
 * not edit: a stage tree is regenerated, never hand-patched
 * (recon/refactor/README.md C4).
 *
 * The 3 translation units below were grouped because they CALL ONE
 * ANOTHER, not because they were adjacent in the generated source
 * list.  Each member's text is reproduced VERBATIM.  Every member was
 * checked pairwise against every other member already in this unit by
 * stage 04's seven refusal rules, unchanged: no symbol is declared
 * here with two types, no identifier has internal linkage in one
 * member and is named by another, and no local typedef, macro, struct
 * tag or enum constant of one member is visible to a member that
 * names it.
 *
 * members, in generated-source-list order:
 *   g1_storage_01.c
 *   g1_storage_10.c
 *   g1_storage_11.c
 *
 * call edges inside this unit (caller -> callee): 2
 *   g1_storage_01.c -> g1_storage_10.c
 *   g1_storage_11.c -> g1_storage_10.c
 */

/* File-scope forward declarations for every struct/union tag this
 * unit names.  Without them a tag whose only appearance in a member
 * is inside a parameter list has PARAMETER-LIST scope, so two
 * textually IDENTICAL declarations in two members declare two
 * different incomplete types and the second is a conflicting
 * redeclaration (C11 6.2.1p7).  Incomplete-type forward
 * declarations emit no code. */
struct device;
struct device_raw;
struct flash_driver_api_raw;
struct flash_pages_info_raw;
struct flash_pages_layout_raw;
/* ================================================================ */
/* member unit: g1_storage_01.c */
/* ================================================================ */
/*
 * Cohesive translation unit for the `storage' module.
 *
 * GENERATED by recon/refactor/transforms/t04_cohesive_tu.py.  Do not
 * edit: a stage tree is regenerated, never hand-patched
 * (recon/refactor/README.md C4).
 *
 * The 3 functions below were 3 separate translation units until this
 * stage.  Each one's text is reproduced VERBATIM and in the order the
 * generated source list gave it, and they were CONSECUTIVE in that list.
 * They were proven able to share a translation unit: no symbol is
 * declared here with two types, no identifier has internal linkage in one
 * member and is named by another, and no local typedef, macro, struct tag
 * or enum constant of one member is visible to a member that names it.
 *
 * members, in link order:
 *   sett_init.c
 *   flash_write_paged.c
 *   calc_flash_crc.c
 */

/* File-scope forward declarations for every struct/union tag this
 * unit names.  Without them a tag whose only appearance in a member
 * is inside a parameter list has PARAMETER-LIST scope, so two
 * textually IDENTICAL declarations in two members declare two
 * different incomplete types and the second is a conflicting
 * redeclaration (C11 6.2.1p7).  Incomplete-type forward
 * declarations emit no code. */
struct device;
/* ---- sett_init.c ---- */
#include "g1_app_symbols.h"
#include "../../../headers/g1_log.h"
#include "../../../headers/g1_dedupe.h"
/* readable reconstruction; identity: FUN_00022518 @ 0x00022518
 * public-name: sett_init
 * durable-map: recon/catalogs/function_names_app.json
 * callees (readable <= raw @ address):
 *   debug_print                              <= FUN_00019c70 @ 0x00019c70
 *   settings_register                        <= FUN_0004e494 @ 0x0004e494
 *   settings_subsys_init                     <= FUN_0004e744 @ 0x0004e744
 *   log_message                              <= FUN_0007dda4 @ 0x0007dda4
 * address symbols (name @ address):
 *   rodata_22121                             @ 0x00022121
 *   ADDR_local_store_write_THUMB             @ 0x00022169
 *   rodata_7c26b                             @ 0x0007c26b
 *   rodata_9e266                             @ 0x0009e266
 *   rodata_9e2cb                             @ 0x0009e2cb   [INLINED -- refactor stage 01]
 *   rodata_9e549                             @ 0x0009e549   [INLINED -- refactor stage 01]
 *   g_log_level                              @ 0x2000230c
 *   g_t_init                                 @ 0x20002368
 *   g_log_use_alt_sink                       @ 0x20007554
 */
/* Reconstructed sett_init @ 0x22518  (parity: 300/300 trials, PROVEN) */

extern int settings_subsys_init(void);
extern int settings_register(unsigned int);

void sett_init(int *param_1)
{
    int iVar2;
    volatile int *piVar1;
    unsigned int format_string;
    int iVar3;

    iVar2 = settings_subsys_init();
    piVar1 = (volatile int*)((unsigned long)&g_log_level) /*=0x2000230c*/;
    if (iVar2 == 0) {
        iVar2 = settings_register(((unsigned long)&g_t_init) /*=0x20002368*/);
        if (iVar2 == 0) {
            if (1 < *piVar1) {
                G1_LOG_ROUTE(*(volatile unsigned int *)((unsigned long)&g_log_use_alt_sink) /*=0x20007554*/ == 0, ((unsigned long)"%s(): init ok\n") /*=0x9e2cb*/, ((unsigned long)"sett_init") /*=0x9e549*/);
            }
            iVar2 = 1;
            goto LAB;
        }
        if (*piVar1 < 2) goto LAB;
        iVar3 = *(volatile int *)((unsigned long)&g_log_use_alt_sink) /*=0x20007554*/;
        format_string = 0x9e2a0;
    } else {
        if (*piVar1 < 2) goto LAB;
        iVar3 = *(volatile int *)((unsigned long)&g_log_use_alt_sink) /*=0x20007554*/;
        format_string = ((unsigned long)&rodata_9e266) /*=0x9e266*/;
    }
    G1_LOG_ROUTE(iVar3 == 0, format_string, ((unsigned long)"sett_init") /*=0x9e549*/, iVar2);
LAB:
    param_1[0] = iVar2;
    param_1[1] = ADDR_local_store_write_THUMB /*=0x22169*/;
    param_1[2] = ((unsigned long)&rodata_7c26b) /*=0x7c26b*/;
    param_1[3] = ((unsigned long)&rodata_22121) /*=0x22121*/;
}

/* ---- flash_write_paged.c ---- */
/* readable reconstruction; identity: FUN_000227d0 @ 0x000227d0
 * public-name: flash_write_paged
 * durable-map: recon/catalogs/function_names_app.json
 * callees (readable <= raw @ address):
 *   debug_print                              <= FUN_00019c70 @ 0x00019c70
 *   flash_settings_write_and_verify          <= FUN_00022658 @ 0x00022658
 *   flash_write_paged                        <= FUN_000227d0 @ 0x000227d0
 * address symbols (name @ address):
 *   rodata_9e3db                             @ 0x0009e3db   [INLINED -- G6 literal batch]
 *   g_log_use_alt_sink                       @ 0x20007554
 */
/* Reconstructed FUN_000227d0 @ 0x227d0. */
#include <stdint.h>

extern int flash_settings_write_and_verify(const void *source, void *destination, int count);

int flash_write_paged(const uint8_t *source, uint8_t *destination,
                 uint32_t byte_count)
{
    uint32_t blocks = ((byte_count >> 12) + 1) & 0xff;
    int final_block = (int)blocks - 1;
    int final_count = (int16_t)(byte_count - ((uint32_t)final_block << 12));
    unsigned int block = 0;
    int total = 0;

    if (*(volatile int *)((unsigned long)&g_log_use_alt_sink) /*=0x20007554*/ == 0)
        log_message(((unsigned long)"size is %d\n") /*=0x9e3db*/, byte_count);
    else
        debug_print(((unsigned long)"size is %d\n") /*=0x9e3db*/, byte_count);

    while ((uint8_t)block < blocks) {
        int count = final_block <= (int)block ? final_count : 0x1000;
        total += flash_settings_write_and_verify(source + block * 0x1000,
                             destination + block * 0x1000, count);
        ++block;
    }
    return total;
}

/* ---- calc_flash_crc.c ---- */
/* readable reconstruction; identity: FUN_00022974 @ 0x00022974
 * public-name: calc_flash_crc
 * durable-map: recon/catalogs/function_names_app.json
 * callees (readable <= raw @ address):
 *   get_device_info                          <= FUN_000167a8 @ 0x000167a8
 *   debug_print                              <= FUN_00019c70 @ 0x00019c70
 *   calc_flash_crc                           <= FUN_00022974 @ 0x00022974
 *   watchdog_feed_retry                      <= FUN_0002ae84 @ 0x0002ae84
 *   g1_recon_crc16_ansi_seeded               <= FUN_0007da4a @ 0x0007da4a
 *   z_device_is_ready                        <= FUN_0008638c @ 0x0008638c
 *   memset_bytes                             <= FUN_00086c78 @ 0x00086c78
 * address symbols (name @ address):
 *   rodata_87bf0                             @ 0x00087bf0
 *   rodata_9e484                             @ 0x0009e484   [INLINED -- G6 literal batch]
 *   rodata_9e4a3                             @ 0x0009e4a3   [INLINED -- G6 literal batch]
 *   rodata_9e4c7                             @ 0x0009e4c7   [INLINED -- G6 literal batch]
 *   rodata_9e4e3                             @ 0x0009e4e3   [INLINED -- G6 literal batch]
 *   rodata_9e4f0                             @ 0x0009e4f0   [INLINED -- G6 literal batch]
 *   rodata_9e4f9                             @ 0x0009e4f9   [INLINED -- G6 literal batch]
 *   rodata_a40ec                             @ 0x000a40ec
 *   g_log_level                              @ 0x2000230c
 *   g_flash_crc_active_flag                  @ 0x2000302c
 *   g_log_use_alt_sink                       @ 0x20007554
 *   g_flash_crc_skip_watchdog_flag           @ 0x20018d90
 */
/* Reconstructed FUN_00022974 @ 0x22974. */
#include "g1_storage.h"

typedef int (*flash_read_fn)(int context, int address, void *destination,
                             int count);

extern void watchdog_feed_retry(void);
extern unsigned int g1_recon_crc16_ansi_seeded(unsigned int crc,
        const unsigned char *data, int count);
extern _Bool z_device_is_ready(const struct device *);
extern void memset_bytes(void*, int, int);

uint32_t calc_flash_crc(uint16_t *crc, int start_address,
                      uint32_t byte_count)
{
    volatile int *const log_level = (volatile int *)((unsigned long)&g_log_level) /*=0x2000230c*/;
    volatile int *const alternate_log = (volatile int *)((unsigned long)&g_log_use_alt_sink) /*=0x20007554*/;
    uint8_t buffer[1028];
    uint32_t block_count;
    int cursor;
    int end_address;

    if (*log_level >= 3) {
        if (*alternate_log == 0)
            log_message(((unsigned long)"%s(): join in calc_flash_crc\n\n") /*=0x9e484*/, ((unsigned long)"calc_flash_crc") /*=0x9e4f9*/);
        else
            debug_print(((unsigned long)"%s(): join in calc_flash_crc\n\n") /*=0x9e484*/, ((unsigned long)"calc_flash_crc") /*=0x9e4f9*/);
    }

    if (crc == 0 || byte_count == 0) {
        if (*log_level >= 3) {
            if (*alternate_log == 0)
                log_message(((unsigned long)"%s(): calc_flash_crc para is NULL\n\n") /*=0x9e4a3*/, ((unsigned long)"calc_flash_crc") /*=0x9e4f9*/);
            else
                debug_print(((unsigned long)"%s(): calc_flash_crc para is NULL\n\n") /*=0x9e4a3*/, ((unsigned long)"calc_flash_crc") /*=0x9e4f9*/);
        }
        return UINT32_MAX;
    }

    block_count = (byte_count >> 10) & 0xffffu;
    if ((byte_count & 0x3ffu) != 0)
        block_count = (block_count + 1) & 0xffffu;

    *(uint32_t *)buffer = 0xff;
    memset_bytes(buffer + 4, 0, 0x3fc);
    if (z_device_is_ready((const void *)((unsigned long)&rodata_87bf0) /*=0x87bf0*/) == 0) {
        log_message(((unsigned long)&rodata_a40ec) /*=0xa40ec*/, *(volatile uint32_t *)((unsigned long)&rodata_87bf0) /*=0x87bf0*/);
        return UINT32_MAX;
    }

    cursor = start_address;
    end_address = start_address + (int)(block_count * 0x400);
    while (cursor != end_address) {
        int chunk_size = (int)(byte_count + (uint32_t)start_address) - cursor;
        int context;
        int status;
        flash_read_fn read;
        unsigned int dump_index;
        int level;

        if (chunk_size >= 0x400)
            chunk_size = 0x400;

        context = get_device_info();
        read = *(flash_read_fn *)(context + 0x1030);
        context = get_device_info();
        status = read(context, cursor, buffer, chunk_size);
        if (status != 0) {
            log_message(((unsigned long)"Flash read 0x%x failed: %d\n") /*=0x9e4c7*/, cursor, status);
            return UINT32_MAX;
        }

        dump_index = 0;
        for (;;) {
            level = *log_level;
            if (chunk_size <= (int)(uint8_t)dump_index)
                break;
            if (level > 2) {
                if (*alternate_log == 0)
                    log_message(((unsigned long)"%s(): 0x%x \n") /*=0x9e4e3*/, ((unsigned long)"calc_flash_crc") /*=0x9e4f9*/,
                                buffer[(uint8_t)dump_index]);
                else
                    debug_print(((unsigned long)"%s(): 0x%x \n") /*=0x9e4e3*/, ((unsigned long)"calc_flash_crc") /*=0x9e4f9*/,
                                buffer[(uint8_t)dump_index]);
            }
            ++dump_index;
        }

        if (level > 2) {
            if (*alternate_log == 0)
                log_message(((unsigned long)"%s(): \n\n") /*=0x9e4f0*/, ((unsigned long)"calc_flash_crc") /*=0x9e4f9*/);
            else
                debug_print(((unsigned long)"%s(): \n\n") /*=0x9e4f0*/, ((unsigned long)"calc_flash_crc") /*=0x9e4f9*/);
        }
        *crc = g1_recon_crc16_ansi_seeded(*crc, buffer, chunk_size);
        cursor += 0x400;
    }

    if (*(volatile uint8_t *)((unsigned long)&g_flash_crc_active_flag) /*=0x2000302c*/ != 0 &&
        *(volatile uint8_t *)((unsigned long)&g_flash_crc_skip_watchdog_flag) /*=0x20018d90*/ == 0)
        watchdog_feed_retry();
    return 0;
}

/* ================================================================ */
/* member unit: g1_storage_10.c */
/* ================================================================ */
/*
 * Cohesive translation unit for the `storage' module.
 *
 * GENERATED by recon/refactor/transforms/t04_cohesive_tu.py.  Do not
 * edit: a stage tree is regenerated, never hand-patched
 * (recon/refactor/README.md C4).
 *
 * The 12 functions below were 12 separate translation units until this
 * stage.  Each one's text is reproduced VERBATIM and in the order the
 * generated source list gave it, and they were CONSECUTIVE in that list.
 * They were proven able to share a translation unit: no symbol is
 * declared here with two types, no identifier has internal linkage in one
 * member and is named by another, and no local typedef, macro, struct tag
 * or enum constant of one member is visible to a member that names it.
 *
 * members, in link order:
 *   attr_configure_mode3_readback.c
 *   ptr_load_u32.c
 *   g1_recon_crc16_ansi_seeded.c
 *   build_status_byte_packet.c
 *   nullsub_3.c
 *   storage_ctx_get_field0c.c
 *   settings_read_6byte_id28.c
 *   const_return_one.c
 *   bt_addr_le_copy_828da.c
 *   cf_read.c
 *   log_msg_create_3arg.c
 *   set_change_aware_no_store.c
 */
/* ---- attr_configure_mode3_readback.c ---- */
#include "g1_app_symbols.h"
#include "g1_storage.h"
#include <stdint.h>
/* readable reconstruction; identity: FUN_0007d05e @ 0x0007d05e
 * public-name: attr_configure_mode3_readback
 * durable-map: recon/catalogs/function_names_app.json
 * callees (readable <= raw @ address):
 *   attr_store_set                           <= FUN_00030178 @ 0x00030178
 *   attr_store_get                           <= FUN_000302f8 @ 0x000302f8
 *   wait_attr_0x4714_clear                   <= FUN_0007cfac @ 0x0007cfac
 *   attr_configure_mode3_readback            <= FUN_0007d05e @ 0x0007d05e
 */
/* Reconstructed FUN_0007d05e @ 0x7d05e  (parity: 300/300 trials, PROVEN) */

extern int attr_store_set(unsigned int a, ...);
extern int attr_store_get(unsigned int a, unsigned int b);

int attr_configure_mode3_readback(unsigned int param_1)
{
  int iVar1;

  iVar1 = attr_store_set(0x4704);
  if ((((iVar1 == 0) && (iVar1 = attr_store_set(0x4710,3), iVar1 == 0)) &&
      (iVar1 = attr_store_set(0x4714,1), iVar1 == 0)) && (iVar1 = wait_attr_0x4714_clear(), iVar1 == 0)) {
    iVar1 = attr_store_get(0x470c,param_1);
    if (iVar1 != 0) {
      iVar1 = 1;
    }
    iVar1 = -iVar1;
  } else {
    iVar1 = -1;
  }
  return iVar1;
}

/* ---- ptr_load_u32.c ---- */
/* readable reconstruction; identity: FUN_0007d1c8 @ 0x0007d1c8
 * public-name: ptr_load_u32
 * durable-map: recon/catalogs/function_names_app.json
 * callees (readable <= raw @ address):
 *   ptr_load_u32                             <= FUN_0007d1c8 @ 0x0007d1c8
 */
/* Reconstructed FUN_0007d1c8 @ 0x7d1c8  (parity: 300/300 trials, PROVEN) */

unsigned int ptr_load_u32(unsigned int *param_1){
  return *param_1;
}

/* ---- g1_recon_crc16_ansi_seeded.c ---- */
/* readable reconstruction; identity: FUN_0007da4a @ 0x0007da4a
 * public-name: g1_recon_crc16_ansi_seeded
 * durable-map: recon/catalogs/function_names_app.json
 * callees (readable <= raw @ address):
 *   g1_recon_crc16_configurable              <= FUN_0007d9c0 @ 0x0007d9c0
 *   g1_recon_crc16_ansi_seeded               <= FUN_0007da4a @ 0x0007da4a
 */
/* Reconstructed FUN_0007da4a @ 0x7da4a  (parity: 300/300 trials, PROVEN) */

extern unsigned int g1_recon_crc16_configurable(unsigned int seed, unsigned int polynomial,
        unsigned int xor_out, int reflect_input, char reflect_output,
        const unsigned char *src, int len);

unsigned int g1_recon_crc16_ansi_seeded(unsigned int seed, const unsigned char *src, int len)
{
  unsigned int uVar1;
  if (src == 0 || len < 1) {
    uVar1 = 0;
  } else {
    uVar1 = g1_recon_crc16_configurable(seed, 0x8005, 0xffff, 1, 1, src, len);
  }
  return uVar1;
}

/* ---- build_status_byte_packet.c ---- */
/* readable reconstruction; identity: FUN_0007ef04 @ 0x0007ef04
 * public-name: build_status_byte_packet
 * durable-map: recon/catalogs/function_names_app.json
 * callees (readable <= raw @ address):
 *   build_status_byte_packet                 <= FUN_0007ef04 @ 0x0007ef04
 */
/* Reconstructed FUN_0007ef04 @ 0x7ef04  (parity: 300/300 trials, PROVEN) */

int build_status_byte_packet(int param_1, unsigned char *param_2, int param_3, unsigned char param_4) {
    int bVar1 = (param_1 == 1);
    if (bVar1) param_4 = 3;
    if (bVar1) param_2[1] = (unsigned char)param_1;
    if (bVar1) {
        param_2[4] = (unsigned char)param_1;
        param_2[0] = param_4;
        param_1 = 0;
    }
    if (bVar1) {
        param_2[2] = param_4;
    } else {
        param_1 = 1;
    }
    if (bVar1) param_2[3] = param_4;
    return param_1;
}

/* ---- nullsub_3.c ---- */
/* readable reconstruction; identity: FUN_0007ef7e @ 0x0007ef7e
 * public-name: nullsub_3
 * durable-map: recon/catalogs/function_names_app.json
 */
/* Reconstructed nullsub_3 @ 0x7ef7e  (parity: 300/300 trials, PROVEN) */

void nullsub_3(void){}

/* ---- storage_ctx_get_field0c.c ---- */
/* readable reconstruction; identity: FUN_0007f00e @ 0x0007f00e
 * public-name: storage_ctx_get_field0c
 * durable-map: recon/catalogs/function_names_app.json
 * callees (readable <= raw @ address):
 *   storage_ctx_get_field0c                  <= FUN_0007f00e @ 0x0007f00e
 */
/* Reconstructed FUN_0007f00e @ 0x7f00e  (parity: 300/300 trials, PROVEN) */

unsigned int storage_ctx_get_field0c(char *param_1){
  return *(unsigned int *)(param_1 + 0xc);
}

/* ---- settings_read_6byte_id28.c ---- */
/* readable reconstruction; identity: FUN_0007fae4 @ 0x0007fae4
 * public-name: settings_read_6byte_id28
 * durable-map: recon/catalogs/function_names_app.json
 * callees (readable <= raw @ address):
 *   audio_codec_reg_op_dispatch              <= FUN_0007f97c @ 0x0007f97c
 *   settings_read_6byte_id28                 <= FUN_0007fae4 @ 0x0007fae4
 */
/* Reconstructed FUN_0007fae4 @ 0x7fae4  (parity: 300/300 trials, PROVEN) */

extern int audio_codec_reg_op_dispatch(unsigned int, unsigned int, void*, unsigned int);
static void settings_read_6byte_id28(unsigned int param_1, unsigned short *param_2)
{
  unsigned int local_10 = param_1;
  unsigned int local_c = (unsigned int)param_2;
  audio_codec_reg_op_dispatch(param_1, 0x28, &local_10, 6);
  *(volatile unsigned short *)&param_2[0] = (unsigned short)(local_10 & 0xffff);
  *(volatile unsigned short *)&param_2[1] = (unsigned short)((local_10 >> 16) & 0xffff);
  *(volatile unsigned short *)&param_2[2] = (unsigned short)(local_c & 0xffff);
}

/* ---- const_return_one.c ---- */
/* readable reconstruction; identity: FUN_0008256e @ 0x0008256e
 * public-name: const_return_one
 * durable-map: recon/catalogs/function_names_app.json
 * callees (readable <= raw @ address):
 *   const_return_one                         <= FUN_0008256e @ 0x0008256e
 */
/* Reconstructed FUN_0008256e @ 0x8256e  (parity: 300/300 trials, PROVEN) */

unsigned int const_return_one(void)
{
    return 1;
}

/* ---- bt_addr_le_copy_828da.c ---- */
/* readable reconstruction; identity: FUN_000828da @ 0x000828da
 * public-name: bt_addr_le_copy_828da
 * durable-map: recon/catalogs/function_names_app.json
 * callees (readable <= raw @ address):
 *   bt_addr_le_copy_828da                    <= FUN_000828da @ 0x000828da
 */
/* Reconstructed FUN_000828da @ 0x828da  (parity: 300/300 trials, PROVEN) */

void bt_addr_le_copy_828da(uint32_t *param_1, uint32_t *param_2)
{
  *param_1 = *param_2;
  *(uint16_t*)((char*)param_1 + 4) = *(uint16_t*)((char*)param_2 + 4);
  *(uint8_t*)((char*)param_1 + 6) = *(uint8_t*)((char*)param_2 + 6);
  return;
}

/* ---- cf_read.c ---- */
/* readable reconstruction; identity: FUN_000829c0 @ 0x000829c0
 * public-name: cf_read
 * durable-map: recon/catalogs/function_names_app.json
 * callees (readable <= raw @ address):
 *   find_cf_cfg                              <= FUN_00059c04 @ 0x00059c04
 *   bt_gatt_attr_read                        <= FUN_00082932 @ 0x00082932
 *   cf_read                                  <= FUN_000829c0 @ 0x000829c0
 */
/* Reconstructed FUN_000829c0 @ 0x829c0  (parity: 300/300 trials, PROVEN) */

extern void bt_gatt_attr_read(unsigned int a, unsigned int b, unsigned short c, void *d, int e);

static void cf_read(unsigned int param_1, unsigned int param_2, unsigned int param_3, unsigned int param_4, unsigned short param_5)
{
    unsigned char local_14[8];
    local_14[0] = 0;
    int iVar1 = find_cf_cfg(param_1);
    if (iVar1 != 0) {
        local_14[0] = *(volatile unsigned char *)((char*)iVar1 + 8);
    }
    bt_gatt_attr_read(param_3, param_4, param_5, local_14, 1);
}

/* ---- log_msg_create_3arg.c ---- */
/* readable reconstruction; identity: FUN_00082a42 @ 0x00082a42
 * public-name: log_msg_create_3arg
 * durable-map: recon/catalogs/function_names_app.json
 * callees (readable <= raw @ address):
 *   z_log_msg_runtime_create                 <= FUN_0004d944 @ 0x0004d944
 *   log_msg_create_3arg                      <= FUN_00082a42 @ 0x00082a42
 */
/* Reconstructed FUN_00082a42 @ 0x82a42  (parity: 300/300 trials, PROVEN) */

void log_msg_create_3arg(unsigned int a, unsigned int b, unsigned int c, unsigned int unused)
{
    (void)unused;
    z_log_msg_runtime_create(a, b, c, 0);
}

/* ---- set_change_aware_no_store.c ---- */
/* readable reconstruction; identity: FUN_00082b98 @ 0x00082b98
 * public-name: set_change_aware_no_store
 * durable-map: recon/catalogs/function_names_app.json
 * callees (readable <= raw @ address):
 *   atomic_or_0                              <= FUN_000826e0 @ 0x000826e0
 *   atomic_and_4                             <= FUN_000826f6 @ 0x000826f6
 *   set_change_aware_no_store                <= FUN_00082b98 @ 0x00082b98
 */
/* Reconstructed FUN_00082b98 @ 0x82b98  (parity: 300/300 trials, PROVEN) */

extern unsigned long long atomic_or_0(int,unsigned int);
extern unsigned int atomic_and_4(int,unsigned int,unsigned int,unsigned int,unsigned int);
unsigned int set_change_aware_no_store(int param_1,int param_2,unsigned int param_3,unsigned int param_4)
{
  unsigned int uVar1;
  unsigned long long uVar2;
  if (param_2 == 0) {
    uVar1 = atomic_and_4(param_1 + 0xc,0xfffffffeU,param_3,param_4,param_4);
    uVar1 = uVar1 & 1;
  } else {
    uVar2 = atomic_or_0(param_1 + 0xc,1);
    uVar1 = ~(unsigned int)uVar2 & (unsigned int)(uVar2 >> 0x20);
  }
  return uVar1;
}

/* ================================================================ */
/* member unit: g1_storage_11.c */
/* ================================================================ */
/*
 * Cohesive translation unit for the `storage' module.
 *
 * GENERATED by recon/refactor/transforms/t04_cohesive_tu.py.  Do not
 * edit: a stage tree is regenerated, never hand-patched
 * (recon/refactor/README.md C4).
 *
 * The 2 functions below were 2 separate translation units until this
 * stage.  Each one's text is reproduced VERBATIM and in the order the
 * generated source list gave it, and they were CONSECUTIVE in that list.
 * They were proven able to share a translation unit: no symbol is
 * declared here with two types, no identifier has internal linkage in one
 * member and is named by another, and no local typedef, macro, struct tag
 * or enum constant of one member is visible to a member that names it.
 *
 * members, in link order:
 *   sc_restore_rsp.c
 *   flash_get_page_info.c
 */

/* File-scope forward declarations for every struct/union tag this
 * unit names.  Without them a tag whose only appearance in a member
 * is inside a parameter list has PARAMETER-LIST scope, so two
 * textually IDENTICAL declarations in two members declare two
 * different incomplete types and the second is a conflicting
 * redeclaration (C11 6.2.1p7).  Incomplete-type forward
 * declarations emit no code. */
struct device_raw;
struct flash_driver_api_raw;
struct flash_pages_info_raw;
struct flash_pages_layout_raw;
/* ---- sc_restore_rsp.c ---- */
#include "g1_app_symbols.h"
#include "g1_storage.h"
/* readable reconstruction; identity: FUN_00082bd4 @ 0x00082bd4
 * public-name: sc_restore_rsp
 * durable-map: recon/catalogs/function_names_app.json
 * callees (readable <= raw @ address):
 *   find_sc_cfg_59bcc                        <= FUN_00059bcc @ 0x00059bcc
 *   find_cf_cfg                              <= FUN_00059c04 @ 0x00059c04
 *   log_gatt_sc_store_failure                <= FUN_0005a0e8 @ 0x0005a0e8
 *   const_return_one                         <= FUN_0008256e @ 0x0008256e
 *   set_change_aware                         <= FUN_00082bb8 @ 0x00082bb8
 *   sc_restore_rsp                           <= FUN_00082bd4 @ 0x00082bd4
 */
/* Reconstructed FUN_00082bd4 @ 0x82bd4  (parity: 300/300 trials, PROVEN) */

extern unsigned int const_return_one(void);
extern void set_change_aware(void *a, int b);
extern void *find_sc_cfg_59bcc(unsigned char a, int b);

void sc_restore_rsp(int param_1, unsigned int param_2, int param_3, unsigned int param_4)
{
    int iVar1;
    unsigned char *puVar2;

    iVar1 = const_return_one();
    if (iVar1 != 0) {
        void *r = find_cf_cfg(param_1);
        if (r != 0) {
            if ((int)((unsigned int)(*(volatile unsigned char *)((int)r + 8)) << 0x1f) < 0) {
                set_change_aware(r, 1);
            }
        }
    }
    if (param_3 == 0) {
        puVar2 = find_sc_cfg_59bcc(*(volatile unsigned char *)(param_1 + 8), param_1 + 0x90);
        if (puVar2 != 0) {
            *(volatile int *)(puVar2 + 8) = param_3;
            log_gatt_sc_store_failure(puVar2);
            return;
        }
    }
}

/* ---- flash_get_page_info.c ---- */
/* readable reconstruction; identity: FUN_00083a2c @ 0x00083a2c
 * public-name: flash_get_page_info
 * durable-map: recon/catalogs/function_names_app.json
 */
/* Reconstructed Zephyr flash_get_page_info helper @ 0x00083a2c.
 * Raw/address back-map: FUN_00083a2c / 0x00083a2c.
 */
#include <stdint.h>

struct device_raw {
    const char *name;
    const void *config;
    const void *api;
};

struct flash_pages_layout_raw {
    uint32_t pages_count;
    uint32_t pages_size;
};

struct flash_pages_info_raw {
    uint32_t start_offset;
    uint32_t size;
    uint32_t index;
};

struct flash_driver_api_raw {
    uint8_t reserved[0x10];
    void (*page_layout)(const struct device_raw *,
                        const struct flash_pages_layout_raw **, uint32_t *);
};

int flash_get_page_info(const struct device_raw *device, uint32_t offset,
                        uint32_t index, struct flash_pages_info_raw *info)
{
    const struct flash_driver_api_raw *api =
        (const struct flash_driver_api_raw *)device->api;
    const struct flash_pages_layout_raw *layout;
    uint32_t layout_count;

    info->start_offset = 0;
    info->index = 0;
    api->page_layout(device, &layout, &layout_count);

    while (layout_count-- != 0u) {
        info->size = layout->pages_size;
        uint32_t jump = offset == 0u
            ? index - info->index
            : (offset - info->start_offset) / info->size;
        if (jump > layout->pages_count) {
            jump = layout->pages_count;
        }
        info->start_offset += jump * info->size;
        info->index += jump;
        if (jump < layout->pages_count) {
            return 0;
        }
        layout++;
    }
    return -22;
}

