/*
 * Call-cohesive translation unit for the `storage' module.
 *
 * GENERATED by recon/refactor/transforms/t09_call_cohesion.py.  Do
 * not edit: a stage tree is regenerated, never hand-patched
 * (recon/refactor/README.md C4).
 *
 * The 2 translation units below were grouped because they CALL ONE
 * ANOTHER, not because they were adjacent in the generated source
 * list.  Each member's text is reproduced VERBATIM.  Every member was
 * checked pairwise against every other member already in this unit by
 * stage 04's seven refusal rules, unchanged: no symbol is declared
 * here with two types, no identifier has internal linkage in one
 * member and is named by another, and no local typedef, macro, struct
 * tag or enum constant of one member is visible to a member that
 * names it.
 *
 * members, in generated-source-list order:
 *   g1_storage_08.c
 *   g1_storage_12.c
 *
 * call edges inside this unit (caller -> callee): 1
 *   g1_storage_08.c -> g1_storage_12.c
 */

/* File-scope forward declarations for every struct/union tag this
 * unit names.  Without them a tag whose only appearance in a member
 * is inside a parameter list has PARAMETER-LIST scope, so two
 * textually IDENTICAL declarations in two members declare two
 * different incomplete types and the second is a conflicting
 * redeclaration (C11 6.2.1p7).  Incomplete-type forward
 * declarations emit no code. */
struct flash_address_log_record_raw;
/* ================================================================ */
/* member unit: g1_storage_08.c */
/* ================================================================ */
/*
 * Cohesive translation unit for the `storage' module.
 *
 * GENERATED by recon/refactor/transforms/t04_cohesive_tu.py.  Do not
 * edit: a stage tree is regenerated, never hand-patched
 * (recon/refactor/README.md C4).
 *
 * The 6 functions below were 6 separate translation units until this
 * stage.  Each one's text is reproduced VERBATIM and in the order the
 * generated source list gave it, and they were CONSECUTIVE in that list.
 * They were proven able to share a translation unit: no symbol is
 * declared here with two types, no identifier has internal linkage in one
 * member and is named by another, and no local typedef, macro, struct tag
 * or enum constant of one member is visible to a member that names it.
 *
 * members, in link order:
 *   sc_restore.c
 *   qspi_nor_lock_if_magic.c
 *   storage_read_with_word_cache.c
 *   flash_nrf_read_invalid_address.c
 *   flash_read_boot_swap_ate.c
 *   resolve_dual_slot_state_code.c
 */

/* File-scope forward declarations for every struct/union tag this
 * unit names.  Without them a tag whose only appearance in a member
 * is inside a parameter list has PARAMETER-LIST scope, so two
 * textually IDENTICAL declarations in two members declare two
 * different incomplete types and the second is a conflicting
 * redeclaration (C11 6.2.1p7).  Incomplete-type forward
 * declarations emit no code. */
struct flash_address_log_record_raw;
/* ---- sc_restore.c ---- */
#include "g1_app_symbols.h"
/* readable reconstruction; identity: FUN_0005b554 @ 0x0005b554
 * public-name: sc_restore
 * durable-map: recon/catalogs/function_names_app.json
 * callees (readable <= raw @ address):
 *   bt_conn_index                            <= FUN_000569a0 @ 0x000569a0
 *   find_sc_cfg_59bcc                        <= FUN_00059bcc @ 0x00059bcc
 *   bt_gatt_indicate                         <= FUN_0005b378 @ 0x0005b378
 *   sc_restore                               <= FUN_0005b554 @ 0x0005b554
 *   bt_conn_get_security                     <= FUN_000814e2 @ 0x000814e2
 *   bt_conn_is_peer_addr_le                  <= FUN_000814e6 @ 0x000814e6
 *   gatt_ccc_changed                         <= FUN_000825c0 @ 0x000825c0
 *   log_msg_create_3arg                      <= FUN_00082a42 @ 0x00082a42
 *   bt_gatt_check_perm                       <= FUN_00082cba @ 0x00082cba
 * address symbols (name @ address):
 *   ADDR_gatt_ccc_write_THUMB                @ 0x0005a465
 *   ADDR_sc_restore_rsp_THUMB                @ 0x00082bd5
 *   rodata_88128                             @ 0x00088128
 *   rodata_8b3dc                             @ 0x0008b3dc
 *   g_bt_gatt_sc_ccc                         @ 0x20002a20
 *   sc_range                                 @ 0x2000ff14
 */
/* Reconstructed FUN_0005b554 @ 0x5b554  (parity: 300/300 trials, PROVEN) */
#include <stdint.h>
extern int bt_conn_index(int,...);
extern int find_sc_cfg_59bcc(int,...);
extern int bt_gatt_indicate(int,...);
extern int bt_conn_get_security(int,...);
extern int bt_conn_is_peer_addr_le(int, int, void*);
extern void gatt_ccc_changed(unsigned int, int);
extern int log_msg_create_3arg(int,...);
extern int bt_gatt_check_perm(unsigned long, void*, unsigned long);
unsigned int sc_restore(int param_1, int param_2, int *param_3)
{
  int dummy[16];
  int iVar8 = *param_3;
  if (*(int*)(param_1+8) == ADDR_gatt_ccc_write_THUMB /*=0x5a465*/) {
    unsigned char *puVar9 = *(unsigned char**)(param_1+0xc);
    if ((*(short*)(puVar9+8) != 0) &&
        (bt_conn_is_peer_addr_le(iVar8, *puVar9, (int)(puVar9+1)) != 0)) {
      int local_48 = bt_gatt_check_perm(iVar8, param_1, 0x12a);
      if (local_48 != 0) {
        if (local_48 == 3) {
          log_msg_create_3arg(((unsigned long)&rodata_88128) /*=0x88128*/, 0x1880, dummy);
          return 1;
        }
        unsigned int uVar10 = (local_48 == 5) ? 3 : 2;
        unsigned int uVar5 = (unsigned int)bt_conn_get_security(iVar8);
        if (uVar5 < uVar10) {
          if (uVar10 <= *(unsigned char*)((int)param_3+4)) return 1;
          *(char*)((int)param_3+4) = (char)uVar10;
          return 1;
        }
      }
      gatt_ccc_changed(param_1, (int)puVar9);
      if (puVar9 == (unsigned char*)((unsigned long)&g_bt_gatt_sc_ccc) /*=0x20002a20*/) {
        int iVar4 = find_sc_cfg_59bcc(*(unsigned char*)(iVar8+8), iVar8+0x90);
        if ((iVar4 != 0) && ((*(short*)(iVar4+8) != 0) || (*(short*)(iVar4+10) != 0))) {
          int iVar6 = bt_conn_index(iVar8);
          unsigned short uVar1 = *(unsigned short*)(iVar4+10);
          *(volatile unsigned short *)(((unsigned long)&sc_range) /*=0x2000ff14*/ + iVar6*4) = *(unsigned short*)(iVar4+8);
          *(volatile unsigned short *)(((unsigned long)&sc_range) /*=0x2000ff14*/ + iVar6*4 + 2) = uVar1;
          int iVar7 = iVar6*0x18 + 0x2000aebc;
          *(volatile int *)(iVar7+0x10) = ((unsigned long)&sc_range) /*=0x2000ff14*/ + (short)iVar6*4;
          *(volatile int *)(iVar7+4) = ((unsigned long)&rodata_8b3dc) /*=0x8b3dc*/;
          *(volatile int *)(iVar7+8) = ADDR_sc_restore_rsp_THUMB /*=0x82bd5*/;
          *(volatile unsigned short *)(iVar7+0x14) = 4;
          int r = bt_gatt_indicate(iVar8, 0x2000aebc + (short)iVar6*0x18);
          if (r != 0) {
            log_msg_create_3arg(((unsigned long)&rodata_88128) /*=0x88128*/, 0x1040, dummy);
          }
        }
      }
    }
  }
  return 1;
}

/* ---- qspi_nor_lock_if_magic.c ---- */
/* readable reconstruction; identity: FUN_000609f4 @ 0x000609f4
 * public-name: qspi_nor_lock_if_magic
 * durable-map: recon/catalogs/function_names_app.json
 * callees (readable <= raw @ address):
 *   qspi_nor_lock_if_magic                   <= FUN_000609f4 @ 0x000609f4
 *   z_impl_k_sem_take                        <= FUN_00072908 @ 0x00072908
 */
/* Reconstructed FUN_000609f4 @ 0x609f4  (parity: 300/300 trials, PROVEN) */

extern void z_impl_k_sem_take(unsigned int, unsigned int, unsigned int, unsigned int);

void qspi_nor_lock_if_magic(unsigned int param_1, unsigned int param_2)
{
    if (param_2 == 0x0bad0000UL) {
        z_impl_k_sem_take(param_1 + 0x30, param_2, 0xffffffffUL, 0xffffffffUL);
        return;
    }
    return;
}

/* ---- storage_read_with_word_cache.c ---- */
/* readable reconstruction; identity: FUN_00061070 @ 0x00061070
 * public-name: storage_read_with_word_cache
 * durable-map: recon/catalogs/function_names_app.json
 * callees (readable <= raw @ address):
 *   qspi_get_zephyr_ret_code                 <= FUN_00060990 @ 0x00060990
 *   qspi_nor_lock_if_magic                   <= FUN_000609f4 @ 0x000609f4
 *   qspi_nor_acquire                         <= FUN_00060a10 @ 0x00060a10
 *   qspi_nor_suspend_bus                     <= FUN_00060a5c @ 0x00060a5c
 *   storage_read_with_word_cache             <= FUN_00061070 @ 0x00061070
 *   qspi_log_forward                         <= FUN_000838d6 @ 0x000838d6
 *   audio_i2s_stop_and_reset_channels        <= FUN_00083906 @ 0x00083906
 *   audio_i2s_start_channels                 <= FUN_0008392e @ 0x0008392e
 *   nrfx_qspi_read                           <= FUN_00085206 @ 0x00085206
 *   memcpy                                   <= FUN_00086c04 @ 0x00086c04
 *   memmove                                  <= FUN_00086c44 @ 0x00086c44
 * address symbols (name @ address):
 *   rodata_88270                             @ 0x00088270
 */
/* Reconstructed FUN_00061070 @ 0x61070  (parity: 300/300 trials, PROVEN) */
extern int  qspi_get_zephyr_ret_code(int);
extern void qspi_nor_lock_if_magic(unsigned int, unsigned int);
extern int qspi_nor_acquire(unsigned long);
extern void qspi_nor_suspend_bus(unsigned char*);
extern void audio_i2s_stop_and_reset_channels(int);
extern void audio_i2s_start_channels(void*);
extern void qspi_log_forward(int,int,void*);
extern int  nrfx_qspi_read(int,int,int);
extern int  memcpy(int,int,int);
extern int  memmove(int,int,int);
#define VI(a) (*(volatile int *)(a))

int storage_read_with_word_cache(int param_1,int param_2,unsigned int param_3,unsigned int param_4){
  int iVar1; unsigned int uVar2,uVar3,uVar4,uVar5,uVar6,uVar7,uVar8,t3;
  int L34,L38;
  unsigned char st[16];
  if (param_3==0) return -0x16;
  if (param_4==0) return 0;
  if ((param_2<0) || ((unsigned int)VI(VI(param_1+4)+0x2c) < (unsigned int)(param_2+param_4))) {
    qspi_log_forward(((unsigned long)&rodata_88270) /*=0x88270*/,0x2040,st);
    return -0x16;
  }
  iVar1 = qspi_nor_acquire(param_1);
  if (iVar1 != 0) goto LAB_611cc;
  audio_i2s_stop_and_reset_channels(param_1);
  uVar6 = (unsigned int)(-param_2) & 3u;
  if (param_4 <= uVar6) uVar6 = param_4;
  t3 = ((int)param_3 < 1) ? (unsigned int)(-(int)((unsigned int)(-(int)param_3)&3u))
                          : (param_3 & 3u);
  uVar4 = (unsigned int)(-(int)t3) & 3u;
  if (param_4 <= uVar4) uVar4 = param_4;
  uVar2 = param_4 - uVar6;
  uVar5 = (param_4 - uVar4) & 0xfffffffcu;
  uVar7 = uVar2 & 0xfffffffcu;
  uVar3 = ((int)uVar5 < (int)uVar7) ? uVar5 : uVar7;
  uVar8 = ((int)uVar5 < (int)uVar7) ? (uVar2 - uVar5) : (uVar2 & 3u);
  if (uVar3 == 0) goto LAB_61156;
  L34 = (int)(param_3 + uVar4); L38 = (int)uVar4;
  iVar1 = nrfx_qspi_read(L34, (int)uVar3, param_2 + (int)uVar6);
  qspi_nor_lock_if_magic(VI(param_1+0x10), iVar1);
  if (iVar1 == 0x0bad0000) {
    if (uVar6 != (unsigned int)L38) memmove((int)(param_3+uVar6), L34, (int)uVar3);
    goto LAB_61156;
  }
  goto LAB_611be;
LAB_61156:
  if (uVar6 != 0) {
    L34 = 4 - (int)uVar6;
    iVar1 = nrfx_qspi_read((int)st, 4, param_2 - L34);
    qspi_nor_lock_if_magic(VI(param_1+0x10), iVar1);
    if (iVar1 != 0x0bad0000) goto LAB_611be;
    memcpy((int)param_3, (int)st + L34, (int)uVar6);
  }
  iVar1 = 0x0bad0000;
  if (uVar8 != 0) {
    iVar1 = nrfx_qspi_read((int)st, 8, param_2 + (int)uVar6 + (int)uVar3);
    qspi_nor_lock_if_magic(VI(param_1+0x10), iVar1);
    if (iVar1 == 0x0bad0000) memcpy((int)(uVar3+uVar6+param_3), (int)st, (int)uVar8);
  }
LAB_611be:
  audio_i2s_start_channels(param_1);
  iVar1 = qspi_get_zephyr_ret_code(iVar1);
LAB_611cc:
  qspi_nor_suspend_bus(param_1);
  return iVar1;
}

/* ---- flash_nrf_read_invalid_address.c ---- */
/* readable reconstruction; identity: tail_61200 @ 0x00061200
 * public-name: flash_nrf_read_invalid_address
 * durable-map: recon/catalogs/function_names_app.json
 * callees (readable <= raw @ address):
 *   z_log_msg_runtime_create                 <= FUN_0004d944 @ 0x0004d944
 * address symbols (name @ address):
 *   rodata_881b0                             @ 0x000881b0
 *   rodata_f5d81                             @ 0x000f5d81
 */
/* Compiler-outlined cold error path of Zephyr flash_nrf_read @ 0x00061200.
 * Raw/address back-map: tail_61200 / 0x00061200.
 */
#include <stddef.h>
#include "g1_storage.h"

struct flash_address_log_record_raw {
    uint32_t count;
    uint32_t format;
    int32_t address;
    size_t length;
};


#define log_output_record               z_log_msg_runtime_create /* 0x0004d944 */
int flash_nrf_read_invalid_address(int32_t address, size_t length)
{
    const struct flash_address_log_record_raw diagnostic = {
        4,
        ((unsigned long)&rodata_f5d81) /*=0xf5d81*/,
        address,
        length,
    };

    log_output_record(((unsigned long)&rodata_881b0) /*=0x881b0*/, 0x2040, &diagnostic, 0);
    return -22;
}

/* ---- flash_read_boot_swap_ate.c ---- */
/* readable reconstruction; identity: FUN_0006403c @ 0x0006403c
 * public-name: flash_read_boot_swap_ate
 * durable-map: recon/catalogs/function_names_app.json
 * callees (readable <= raw @ address):
 *   flash_read_boot_swap_ate                 <= FUN_0006403c @ 0x0006403c
 *   flash_area_read                          <= FUN_0007ef80 @ 0x0007ef80
 *   flash_calc_prev_ate_offset               <= FUN_00084d64 @ 0x00084d64
 *   flash_region_is_erased                   <= FUN_00084d8c @ 0x00084d8c
 *   flash_write_byte_and_verify              <= FUN_00084db2 @ 0x00084db2
 *   flash_verify_write_at_current_offset     <= FUN_00084e66 @ 0x00084e66
 *   memcmp                                   <= FUN_00086be4 @ 0x00086be4
 * address symbols (name @ address):
 *   rodata_9907c                             @ 0x0009907c
 */
/* Reconstructed FUN_0006403c @ 0x6403c  (parity: 300/300 trials, PROVEN) */

extern int flash_area_read(unsigned int, int, unsigned int, unsigned int);
extern int memcmp(const void *, const void *, size_t);
extern int flash_calc_prev_ate_offset(int);
extern int flash_write_byte_and_verify(int, void*, int);
extern uint32_t flash_verify_write_at_current_offset(int, void*);

unsigned int flash_read_boot_swap_ate(int param_1, unsigned char*param_2) {
  int iVar1;
  uint32_t uVar2;
  uint8_t uVar3;
  volatile uint8_t local_21;
  uint8_t auStack_20[20];
  iVar1 = flash_area_read(param_1, *(int*)(param_1+8) - 0x10,
                       auStack_20, 0x10);
  if (iVar1 >= 0){
    iVar1 = flash_region_is_erased(param_1, auStack_20, 0x10);
    if (iVar1 == 0){
      iVar1 = memcmp(auStack_20, ((unsigned long)&rodata_9907c) /*=0x9907c*/, 0x10);
      uVar3 = (iVar1 == 0) ? 1 : 2;
    } else {
      uVar3 = 3;
    }
    *param_2 = uVar3;
    uVar2 = flash_calc_prev_ate_offset(param_1);
    iVar1 = flash_area_read(param_1, (int)uVar2, (void*)&local_21, 1);
    if (iVar1 >= 0){
      param_2[1] = local_21 & 0xf;
      param_2[4] = local_21 >> 4;
      iVar1 = flash_region_is_erased(param_1, (void*)&local_21, 1);
      if (iVar1 != 0 || param_2[1] > 4){
        param_2[1] = 1;
        param_2[4] = 0;
      }
      iVar1 = flash_write_byte_and_verify(param_1, param_2 + 2, ((*(int*)(param_1+8) - 0x18) & 0xfffffff8) - 8);
      if (iVar1 == 0){
        uVar2 = flash_verify_write_at_current_offset(param_1, param_2 + 3);
        return uVar2;
      }
    }
  }
  return 1;
}

/* ---- resolve_dual_slot_state_code.c ---- */
/* readable reconstruction; identity: FUN_00064134 @ 0x00064134
 * public-name: resolve_dual_slot_state_code
 * durable-map: recon/catalogs/function_names_app.json
 * callees (readable <= raw @ address):
 *   resolve_dual_slot_state_code             <= FUN_00064134 @ 0x00064134
 *   build_status_byte_packet                 <= FUN_0007ef04 @ 0x0007ef04
 *   nvs_ate_id_matches                       <= FUN_00084d70 @ 0x00084d70
 *   flash_area_write_and_close               <= FUN_00084e72 @ 0x00084e72
 * address symbols (name @ address):
 *   rodata_8bb90                             @ 0x0008bb90
 *   rodata_f694f                             @ 0x000f694f
 */
/* Reconstructed FUN_00064134 @ 0x64134  (parity: 300/300 trials, PROVEN) */

typedef unsigned int uint;
extern int build_status_byte_packet(uint, void*);
extern int nvs_ate_id_matches(uint8_t, uint);
extern int flash_area_write_and_close(uint32_t, void*);

uint resolve_dual_slot_state_code(uint param_1, uint32_t param_2, uint param_3, uint32_t param_4){
  int iVar1, iVar2;
  uint8_t *puVar3;
  uint uVar4, uVar5;
  volatile uint8_t S[16];
  *(volatile uint32_t *)(S+0) = param_1;
  *(volatile uint32_t *)(S+4) = param_2;
  *(volatile uint32_t *)(S+8) = param_3;
  *(volatile uint32_t *)(S+12) = param_4;
  iVar1 = build_status_byte_packet(param_1, (void*)S);
  if (iVar1 == 1){
    iVar1 = flash_area_write_and_close(*(uint32_t*)(((unsigned long)&rodata_8bb90) /*=0x8bb90*/ + param_1*8), (void*)S);
  }
  if (iVar1 == 0){
    iVar1 = flash_area_write_and_close(*(uint32_t*)(((unsigned long)&rodata_8bb90) /*=0x8bb90*/ + param_1*8 + 4), (void*)(S+8));
    if (iVar1 == 1){ S[8]=3; S[0xb]=3; }
    else if (iVar1 != 0) return 0xff;
    int cnt = 0;
    uVar4 = S[0];
    uVar5 = S[8];
    puVar3 = (uint8_t*)((unsigned long)&rodata_f694f) /*=0xf694f*/;
    do {
      iVar2 = nvs_ate_id_matches(puVar3[0], uVar4);
      if (iVar2 != 0 && (iVar2 = nvs_ate_id_matches(puVar3[1], uVar5), iVar2 != 0)
          && (puVar3[2] == 4 || S[3] == puVar3[2])
          && (puVar3[3] == 4 || S[0xb] == puVar3[3])
          && (puVar3[4] == 4 || S[2] == puVar3[4])){
        if ((uint8_t)(puVar3[5] - 2) < 3) return puVar3[5];
        return 0xff;
      }
      cnt = cnt + 1;
      puVar3 = puVar3 + 6;
    } while (cnt != 3);
    return 1;
  }
  return 0xff;
}

/* ================================================================ */
/* member unit: g1_storage_12.c */
/* ================================================================ */
/*
 * Cohesive translation unit for the `storage' module.
 *
 * GENERATED by recon/refactor/transforms/t04_cohesive_tu.py.  Do not
 * edit: a stage tree is regenerated, never hand-patched
 * (recon/refactor/README.md C4).
 *
 * The 2 functions below were 2 separate translation units until this
 * stage.  Each one's text is reproduced VERBATIM and in the order the
 * generated source list gave it, and they were CONSECUTIVE in that list.
 * They were proven able to share a translation unit: no symbol is
 * declared here with two types, no identifier has internal linkage in one
 * member and is named by another, and no local typedef, macro, struct tag
 * or enum constant of one member is visible to a member that names it.
 *
 * members, in link order:
 *   layout_select_region.c
 *   flash_calc_prev_ate_offset.c
 */
/* ---- layout_select_region.c ---- */
#include "g1_app_symbols.h"
#include <stdint.h>
/* readable reconstruction; identity: FUN_00084774 @ 0x00084774
 * public-name: layout_select_region
 * durable-map: recon/catalogs/function_names_app.json
 * callees (readable <= raw @ address):
 *   flash_page_index_lookup                  <= FUN_00084602 @ 0x00084602
 *   layout_select_region                     <= FUN_00084774 @ 0x00084774
 */
/* Reconstructed FUN_00084774 @ 0x84774  (parity: 300/300 trials, PROVEN) */

extern unsigned int flash_page_index_lookup(int*, int, unsigned int, unsigned short*);

/* ARGUMENT-PASSTHROUGH DEFECT, fixed in P4 iteration 15.
 * The original (0x84774) is a TAIL CALL that forwards ALL FOUR arguments to
 * 0x84602 (`flash_page_index_lookup`): it pushes {r4,r5,r6} and uses only
 * those as scratch, so r1 (min), r2 (max) and r3 (index out-pointer) reach
 * the callee untouched:
 *     84774  push {r4,r5,r6}
 *     84776  ldrh r4,[r0,#8] ; ldrh r5,[r0,#10] ; subs r5,r5,r4
 *     8477c  ldrd r4,r6,[r0] ; mla r4,r6,r5,r4 ; cmp r1,r4 ; ble 8479c
 *     84788  ldrh r4,[r0,#20]; ldrh r5,[r0,#22]; subs r5,r5,r4
 *     8478e  ldrd r4,r6,[r0,#12]; mla r4,r6,r5,r4; cmp r1,r4; bgt 847a2
 *     8479a  adds r0,#12
 *     8479c  pop {r4,r5,r6} ; b.w 0x84602
 * The previous two-parameter declaration let GCC use r2/r3 as scratch
 * (`subs r2,r2,r3` at our 0x77b82/0x77b94), so `max` arrived at
 * flash_page_index_lookup as (max_idx - min_idx) = 9 instead of 4400000 and
 * the lookup returned -EINVAL.  MEASURED in iteration 15 (g1-i15c): that
 * -EINVAL made npm1300_charger_init (panel_temp_calibration_init, 0x62644)
 * return -22, and main then skipped jdb_panel_init / pt_nfc_eeprom_link_start
 * / notification_system_init -- the E4 blocker.  This is the SIXTH member of
 * the dropped-argument class the differential harness is structurally blind
 * to (callees are order-keyed oracles; their argument registers are never
 * compared). */
int layout_select_region(int *param_1, int param_2, int param_3,
                        unsigned short *param_4)
{
  int diff1 = *(unsigned short *)((char *)param_1 + 10) - *(unsigned short *)((char *)param_1 + 8);
  int formula1 = param_1[1] * diff1 + param_1[0];
  if (formula1 < param_2) {
    int diff2 = *(unsigned short *)((char *)param_1 + 0x16) - *(unsigned short *)((char *)param_1 + 0x14);
    int formula2 = param_1[4] * diff2 + param_1[3];
    if (formula2 < param_2) {
      return 0xffffffea;
    }
    param_1 = param_1 + 3;
  }
  return flash_page_index_lookup(param_1, param_2, param_3, param_4);
}

/* ---- flash_calc_prev_ate_offset.c ---- */
/* readable reconstruction; identity: FUN_00084d64 @ 0x00084d64
 * public-name: flash_calc_prev_ate_offset
 * durable-map: recon/catalogs/function_names_app.json
 * callees (readable <= raw @ address):
 *   flash_calc_prev_ate_offset               <= FUN_00084d64 @ 0x00084d64
 */
/* Reconstructed FUN_00084d64 @ 0x84d64  (parity: 300/300 trials, PROVEN) */

int flash_calc_prev_ate_offset(int param_1)
{
  return (*(volatile uint32_t *)(param_1 + 8) - 0x18U & 0xfffffff8) - 0x10;
}

