/*
 * Cohesive translation unit for the `unsorted' module.
 *
 * GENERATED by recon/refactor/transforms/t04_cohesive_tu.py.  Do not
 * edit: a stage tree is regenerated, never hand-patched
 * (recon/refactor/README.md C4).
 *
 * The 6 functions below were 6 separate translation units until this
 * stage.  Each one's text is reproduced VERBATIM and in the order the
 * generated source list gave it, and they were CONSECUTIVE in that list.
 * They were proven able to share a translation unit: no symbol is
 * declared here with two types, no identifier has internal linkage in one
 * member and is named by another, and no local typedef, macro, struct tag
 * or enum constant of one member is visible to a member that names it.
 *
 * members, in link order:
 *   set_misc_286c_value.c
 *   entropy_get_entropy_isr_call.c
 *   bt_id_save.c
 *   reschedule_on_sys_work_q.c
 *   bt_uuid_expand_to_128.c
 *   set_random_address.c
 */
/* ---- set_misc_286c_value.c ---- */
#include "g1_app_symbols.h"
/* readable reconstruction; identity: FUN_00051038 @ 0x00051038
 * public-name: set_misc_286c_value
 * durable-map: recon/catalogs/function_names_app.json
 * callees (readable <= raw @ address):
 *   set_misc_286c_value                      <= FUN_00051038 @ 0x00051038
 * address symbols (name @ address):
 *   g_misc_286c_val                          @ 0x2000286c
 */
/* Reconstructed FUN_00051038 @ 0x51038  (parity: 300/300 trials, PROVEN) */

#include <stdint.h>
#include "../../../headers/g1_log.h"
#include "../../../headers/g1_dedupe.h"
#include <stddef.h>
static void set_misc_286c_value(uint32_t param_1) {
    *(volatile uint32_t *)((unsigned long)&g_misc_286c_val) /*=0x2000286c*/ = param_1;
}

/* ---- entropy_get_entropy_isr_call.c ---- */
/* readable reconstruction; identity: FUN_00052bf8 @ 0x00052bf8
 * public-name: entropy_get_entropy_isr_call
 * durable-map: recon/catalogs/function_names_app.json
 * callees (readable <= raw @ address):
 *   entropy_get_entropy_isr_call             <= FUN_00052bf8 @ 0x00052bf8
 *   assert_post_action                       <= FUN_0007e2ec @ 0x0007e2ec
 *   printk                                   <= FUN_0007e2fa @ 0x0007e2fa
 * address symbols (name @ address):
 *   entropy_dev                              @ 0x00087b90
 *   rodata_99cbd                             @ 0x00099cbd   [INLINED -- G6 literal batch]
 *   rodata_f2a45                             @ 0x000f2a45   [INLINED -- G6 literal batch]
 *   rodata_f2a79                             @ 0x000f2a79   [INLINED -- G6 literal batch]
 *   rodata_f2a99                             @ 0x000f2a99   [INLINED -- G6 literal batch]
 */
/* Reconstructed FUN_00052bf8 @ 0x52bf8  (parity: 300/300 trials, PROVEN) */

extern int assert_post_action(int, int);

void entropy_get_entropy_isr_call(unsigned int param_1, unsigned int param_2)
{
    volatile unsigned int *pp = (volatile unsigned int*)(((unsigned long)&entropy_dev) /*=0x87b90*/ + 8);
    unsigned int A = *pp;
    unsigned int r4 = *(volatile unsigned int *)A;
    unsigned int arg1, arg2;
    if (r4 == 0) {
        printk(((unsigned long)"ASSERTION FAIL [%s] @ %s:%d\n") /*=0x99cbd*/, ((unsigned long)"api->get_entropy != ((void *)0)") /*=0xf2a79*/, ((unsigned long)"WEST_TOPDIR/zephyr/include/zephyr/drivers/entropy.h") /*=0xf2a45*/, 0x4d);
        G1_ASSERT_FAIL((((unsigned long)"\tCallback pointer should not be NULL\n") /*=0xf2a99*/, 0, 0, 0), (((unsigned long)"WEST_TOPDIR/zephyr/include/zephyr/drivers/entropy.h") /*=0xf2a45*/, 0x4d));
        arg1 = 0x4d;
        arg2 = ((unsigned long)"WEST_TOPDIR/zephyr/include/zephyr/drivers/entropy.h") /*=0xf2a45*/;
    } else {
        arg1 = param_1;
        arg2 = param_2;
    }
    {
        void (*fp)(unsigned int, unsigned int, unsigned int) = (void (*)(unsigned int,unsigned int,unsigned int))r4;
        fp(((unsigned long)&entropy_dev) /*=0x87b90*/, arg1, arg2);
    }
}

/* ---- bt_id_save.c ---- */
/* readable reconstruction; identity: FUN_00052f68 @ 0x00052f68
 * public-name: bt_id_save
 * durable-map: recon/catalogs/function_names_app.json
 * callees (readable <= raw @ address):
 *   z_log_msg_runtime_create                 <= FUN_0004d944 @ 0x0004d944
 *   bt_settings_store                        <= FUN_00052f18 @ 0x00052f18
 *   bt_id_save                               <= FUN_00052f68 @ 0x00052f68
 * address symbols (name @ address):
 *   rodata_88178                             @ 0x00088178
 *   rodata_9a1dd                             @ 0x0009a1dd
 *   rodata_f2c71                             @ 0x000f2c71
 *   g_ble_dev_state                          @ 0x20002000
 */
/* Reconstructed FUN_00052f68 @ 0x52f68  (parity: 300/300 trials, PROVEN) */

extern int bt_settings_store(int,int);
extern void z_log_msg_runtime_create(unsigned int, unsigned int, unsigned int, unsigned int);

void bt_id_save(void)
{
    unsigned char b = *(volatile unsigned char *)(((unsigned long)&g_ble_dev_state) /*=0x20002000*/ + 7);
    int local_18 = (int)(unsigned)b * 7;
    local_18 = bt_settings_store(((unsigned long)&rodata_9a1dd) /*=0x9a1dd*/, 0);
    if (local_18 != 0) {
        struct { int f0; int f4; int f8; } s;
        s.f0 = 3;
        s.f4 = ((unsigned long)&rodata_f2c71) /*=0xf2c71*/;
        s.f8 = local_18;
        z_log_msg_runtime_create(((unsigned long)&rodata_88178) /*=0x88178*/, 0x1840, &s, 0);
    }
}

/* ---- reschedule_on_sys_work_q.c ---- */
/* readable reconstruction; identity: FUN_000531d8 @ 0x000531d8
 * public-name: reschedule_on_sys_work_q
 * durable-map: recon/catalogs/function_names_app.json
 * callees (readable <= raw @ address):
 *   reschedule_on_sys_work_q                 <= FUN_000531d8 @ 0x000531d8
 *   k_work_reschedule_for_queue              <= FUN_00073424 @ 0x00073424
 * address symbols (name @ address):
 *   g_sys_work_q                             @ 0x20005d38
 */
/* Reconstructed FUN_000531d8 @ 0x531d8  (parity: 300/300 trials, PROVEN) */

extern unsigned int k_work_reschedule_for_queue(unsigned int a, void *b);
unsigned int reschedule_on_sys_work_q(void *param_1)
{
    return k_work_reschedule_for_queue(((unsigned long)&g_sys_work_q) /*=0x20005d38*/, param_1);
}

/* ---- bt_uuid_expand_to_128.c ---- */
/* readable reconstruction; identity: FUN_000531e4 @ 0x000531e4
 * public-name: bt_uuid_expand_to_128
 * durable-map: recon/catalogs/function_names_app.json
 * callees (readable <= raw @ address):
 *   bt_uuid_expand_to_128                    <= FUN_000531e4 @ 0x000531e4
 * address symbols (name @ address):
 *   rodata_f2cc8                             @ 0x000f2cc8
 */
/* Reconstructed FUN_000531e4 @ 0x531e4  (parity: 300/300 trials, PROVEN) */
static void bt_uuid_expand_to_128(char *param_1,char *param_2){
  char cVar1=*(volatile char *)param_1;
  if(cVar1==1){
    volatile uint32_t* s=(volatile uint32_t*)((unsigned long)&rodata_f2cc8) /*=0xf2cc8*/;
    volatile uint32_t* d=(volatile uint32_t*)param_2;
    volatile uint32_t* end=(volatile uint32_t*)(((unsigned long)&rodata_f2cc8) /*=0xf2cc8*/+0x10);
    do{ *d=*s; d++; s++; }while(s!=end);
    *(volatile uint8_t *)d=*(volatile uint8_t *)s;
    uint32_t uVar7=*(volatile uint32_t *)(param_1+4);
    *(volatile uint8_t *)(param_2+0xd)=(uint8_t)uVar7;
    *(volatile uint8_t *)(param_2+0xf)=(uint8_t)(uVar7>>0x10);
    *(volatile uint8_t *)(param_2+0xe)=(uint8_t)(uVar7>>8);
    *(volatile uint8_t *)(param_2+0x10)=(uint8_t)(uVar7>>0x18);
  } else if(cVar1==2){
    volatile uint32_t* s=(volatile uint32_t*)param_1;
    volatile uint32_t* d=(volatile uint32_t*)param_2;
    volatile uint32_t* end=(volatile uint32_t*)(param_1+0x10);
    do{ *d=*s; d++; s++; }while(s!=end);
    *(volatile uint8_t *)d=*(volatile uint8_t *)s;
  } else if(cVar1==0){
    volatile uint32_t* s=(volatile uint32_t*)((unsigned long)&rodata_f2cc8) /*=0xf2cc8*/;
    volatile uint32_t* d=(volatile uint32_t*)param_2;
    volatile uint32_t* end=(volatile uint32_t*)(((unsigned long)&rodata_f2cc8) /*=0xf2cc8*/+0x10);
    do{ *d=*s; d++; s++; }while(s!=end);
    *(volatile uint8_t *)d=*(volatile uint8_t *)s;
    uint16_t uVar2=*(volatile uint16_t *)(param_1+2);
    *(volatile uint8_t *)(param_2+0xd)=(uint8_t)uVar2;
    *(volatile uint8_t *)(param_2+0xe)=(uint8_t)(uVar2>>8);
  }
}

/* ---- set_random_address.c ---- */
/* readable reconstruction; identity: FUN_00054d88 @ 0x00054d88
 * public-name: set_random_address
 * durable-map: recon/catalogs/function_names_app.json
 * callees (readable <= raw @ address):
 *   bt_hci_cmd_create                        <= FUN_00053cd4 @ 0x00053cd4
 *   bt_hci_cmd_send_sync                     <= FUN_00053d70 @ 0x00053d70
 *   bt_addr_copy                             <= FUN_00080fba @ 0x00080fba
 *   net_buf_simple_add_mem                   <= FUN_00083740 @ 0x00083740
 *   memcmp                                   <= FUN_00086be4 @ 0x00086be4
 * address symbols (name @ address):
 *   g_20002069                               @ 0x20002069
 */
/* Reconstructed tail_54d88 @ 0x54d88
 * CFG_VERIFY_CALL_ARITIES=3,2,3,3,2
 * Readable identity: set_random_address.
 * Raw/address backmap: set_random_address <= tail_54d88 @ 0x00054d88.
 */
extern int memcmp(const void *, const void *, size_t); /* memcmp */
extern uint8_t *bt_hci_cmd_create(uint32_t, uint32_t); /* bt_hci_cmd_create */
extern void *net_buf_simple_add_mem(void *, const void *, uint32_t); /* memcpy */
extern int bt_hci_cmd_send_sync(uint32_t, void *, void *); /* bt_hci_cmd_send_sync */
extern uint8_t *bt_addr_copy(void *, const void *); /* bt_addr_copy */

int set_random_address(const void *address)
{
    uint8_t *packet;
    int error;
    if (memcmp(address, (const void *)((unsigned long)&g_20002069) /*=0x20002069*/, 6U) == 0) return 0;
    packet = bt_hci_cmd_create(0x2005U, 6U);
    if (packet == 0) return -105;
    net_buf_simple_add_mem(packet + 12, address, 6U);
    error = bt_hci_cmd_send_sync(0x2005U, packet, 0);
    if (error != 0) return error;
    packet = bt_addr_copy((void *)((unsigned long)&g_20002069) /*=0x20002069*/, address);
    packet[-1] = 1U;
    return 0;
}

