/*
 * Cohesive translation unit for the `unsorted' module.
 *
 * GENERATED by recon/refactor/transforms/t04_cohesive_tu.py.  Do not
 * edit: a stage tree is regenerated, never hand-patched
 * (recon/refactor/README.md C4).
 *
 * The 7 functions below were 7 separate translation units until this
 * stage.  Each one's text is reproduced VERBATIM and in the order the
 * generated source list gave it, and they were CONSECUTIVE in that list.
 * They were proven able to share a translation unit: no symbol is
 * declared here with two types, no identifier has internal linkage in one
 * member and is named by another, and no local typedef, macro, struct tag
 * or enum constant of one member is visible to a member that names it.
 *
 * members, in link order:
 *   gpio_arm_pin_interrupt.c
 *   rtc_timer_cc_reg_get.c
 *   rtc_read_extended_cycle_count.c
 *   rtc_timer_channel_alloc.c
 *   nrf_rtc_timer_chan_free.c
 *   dppi_channel_disable_and_free.c
 *   cbor_min_encoded_size.c
 */
/* ---- gpio_arm_pin_interrupt.c ---- */
#include "g1_app_symbols.h"
/* readable reconstruction; identity: FUN_00063524 @ 0x00063524
 * public-name: gpio_arm_pin_interrupt
 * durable-map: recon/catalogs/function_names_app.json
 * callees (readable <= raw @ address):
 *   gpio_arm_pin_interrupt                   <= FUN_00063524 @ 0x00063524
 * address symbols (name @ address):
 *   rodata_10000                             @ 0x00010000
 *   g_gpio_pin_latch_mask                    @ 0x2000b2d0
 *   g_gpio_pin_enabled_mask                  @ 0x2000b2d8
 *   REG_50015304                             @ 0x50015304
 */
/* Full reconstruction of FUN_00063524 @ 0x63524 (60 bytes). */
#include <stdint.h>
#include "../../../headers/g1_nrf_regs.h"
#include "../../../headers/g1_dedupe.h"

uint32_t gpio_arm_pin_interrupt(uint32_t line, uint32_t enable)
{
    uint32_t shift = line & 0xffu;

    if (enable != 0) {
        uint32_t bit = shift < 32u ? UINT32_C(1) << shift : 0;
        __atomic_fetch_or((uint32_t *)((unsigned long)&g_gpio_pin_enabled_mask) /*=0x2000b2d8*/, bit, __ATOMIC_ACQ_REL);

        uint32_t event = shift < 16u ? UINT32_C(0x10000) << shift : 0;
        *(volatile uint32_t *)REG_50015304 /*=0x50015304*/ = event;

        uint32_t pending = *(volatile uint32_t *)((unsigned long)&g_gpio_pin_latch_mask) /*=0x2000b2d0*/;
        if (shift < 32u && ((pending >> shift) & 1u) != 0)
            *(volatile uint32_t *)0xe000e200u = UINT32_C(0x200000);
    }

    /* The leaf preserves its incoming r0 on every path. */
    return line;
}

/* ---- rtc_timer_cc_reg_get.c ---- */
#include "../../../headers/g1_log.h"
/* readable reconstruction; identity: FUN_000635a4 @ 0x000635a4
 * public-name: rtc_timer_cc_reg_get
 * durable-map: recon/catalogs/function_names_app.json
 * callees (readable <= raw @ address):
 *   rtc_timer_cc_reg_get                     <= FUN_000635a4 @ 0x000635a4
 *   assert_post_action                       <= FUN_0007e2ec @ 0x0007e2ec
 *   printk                                   <= FUN_0007e2fa @ 0x0007e2fa
 * address symbols (name @ address):
 *   rodata_99cbd                             @ 0x00099cbd   [INLINED -- G6 literal batch]
 *   rodata_f6659                             @ 0x000f6659
 *   rodata_f668a                             @ 0x000f668a   [INLINED -- G6 literal batch]
 */
/* Reconstructed FUN_000635a4 @ 0x635a4  (parity: 300/300 trials, PROVEN) */

extern void assert_post_action(const char *, unsigned int);

static unsigned int rtc_timer_cc_reg_get(unsigned int param_1, unsigned int param_2, unsigned int param_3, unsigned int param_4)
{
  unsigned int uVar1;
  if (param_1 > 1) {
    G1_ASSERT_FAIL((((unsigned long)"ASSERTION FAIL [%s] @ %s:%d\n") /*=0x99cbd*/, ((unsigned long)"chan >= 0 && chan < (1 + 1)") /*=0xf668a*/, ((unsigned long)&rodata_f6659) /*=0xf6659*/, 0x8d, param_4), (((unsigned long)&rodata_f6659) /*=0xf6659*/, 0x8d));
  }
  uVar1 = (G1_NRF_RTC1_S_BASE + 0x44);
  if (param_1 == 0) {
    uVar1 = 0;
  }
  return uVar1;
}

/* ---- rtc_read_extended_cycle_count.c ---- */
/* readable reconstruction; identity: FUN_00063610 @ 0x00063610
 * public-name: rtc_read_extended_cycle_count
 * durable-map: recon/catalogs/function_names_app.json
 * callees (readable <= raw @ address):
 *   rtc_read_extended_cycle_count            <= FUN_00063610 @ 0x00063610
 * address symbols (name @ address):
 *   g_rtc_cycle_range_minmax                 @ 0x200066b8
 *   g_uptime_ref_tick_hi                     @ 0x200066bc
 *   g_uptime_tick_overflow_state             @ 0x2000b2dc
 *   REG_50015504                             @ 0x50015504
 */
/* Reconstructed FUN_00063610 @ 0x63610  (parity: 300/300 trials, PROVEN) */

unsigned long long rtc_read_extended_cycle_count(void)
{
  unsigned int counterVal = *(volatile unsigned int *)((unsigned long)&g_uptime_tick_overflow_state) /*=0x2000b2dc*/;
  unsigned int uVar1 = counterVal >> 8;
  unsigned int shifted = counterVal << 24;
  __atomic_thread_fence(__ATOMIC_SEQ_CST);
  unsigned int uVar3 = *(volatile unsigned int *)REG_50015504 /*=0x50015504*/;
  unsigned int uVar2 = uVar3 + shifted;
  unsigned int carry1 = (uVar2 < uVar3) ? 1 : 0;
  uVar1 = uVar1 + carry1;
  if (uVar3 < 0x100000) {
    unsigned int lo = *(volatile unsigned int *)((unsigned long)&g_rtc_cycle_range_minmax) /*=0x200066b8*/;
    unsigned int hi = *(volatile unsigned int *)((unsigned long)&g_uptime_ref_tick_hi) /*=0x200066bc*/;
    unsigned long long a = ((unsigned long long)uVar1 << 32) | uVar2;
    unsigned long long b = ((unsigned long long)hi << 32) | lo;
    if (a < b) {
      unsigned int old = uVar2;
      uVar2 = uVar2 + 0x1000000;
      unsigned int carry2 = (uVar2 < old) ? 1 : 0;
      uVar1 = uVar1 + carry2;
    }
  }
  return ((unsigned long long)uVar1 << 32) | uVar2;
}

/* ---- rtc_timer_channel_alloc.c ---- */
/* readable reconstruction; identity: FUN_0006385c @ 0x0006385c
 * public-name: rtc_timer_channel_alloc
 * durable-map: recon/catalogs/function_names_app.json
 * callees (readable <= raw @ address):
 *   rtc_timer_channel_alloc                  <= FUN_0006385c @ 0x0006385c
 * address symbols (name @ address):
 *   nrf_rtc_timer_free_channels              @ 0x2000b2d4
 */
/* Reconstructed FUN_0006385c @ 0x6385c  (parity: 300/300 trials, PROVEN) */

static unsigned int rtc_timer_channel_alloc(void)
{
  volatile unsigned int *addr = (volatile unsigned int *)((unsigned long)&nrf_rtc_timer_free_channels) /*=0x2000b2d4*/;
  unsigned int val, idx, old;
  while (1) {
    val = *addr;
    if (val == 0) return 0xfffffff4;
    idx = 31 - __builtin_clz(val);
    old = __atomic_fetch_and(addr, ~(1u << (idx & 0xff)),
                             __ATOMIC_ACQ_REL);
    if ((int)((old >> (idx & 0xff)) << 0x1f) < 0) break;
  }
  return idx;
}

/* ---- nrf_rtc_timer_chan_free.c ---- */
/* readable reconstruction; identity: FUN_00063898 @ 0x00063898
 * public-name: nrf_rtc_timer_chan_free
 * durable-map: recon/catalogs/function_names_app.json
 * callees (readable <= raw @ address):
 *   nrf_rtc_timer_chan_free                  <= FUN_00063898 @ 0x00063898
 *   assert_post_action                       <= FUN_0007e2ec @ 0x0007e2ec
 *   printk                                   <= FUN_0007e2fa @ 0x0007e2fa
 * address symbols (name @ address):
 *   rodata_99cbd                             @ 0x00099cbd   [INLINED -- G6 literal batch]
 *   rodata_f6659                             @ 0x000f6659
 *   rodata_f66a6                             @ 0x000f66a6   [INLINED -- G6 literal batch]
 *   nrf_rtc_timer_free_channels              @ 0x2000b2d4
 */
/* Reconstructed FUN_00063898 @ 0x63898  (parity: 300/300 trials, PROVEN) */


static void nrf_rtc_timer_chan_free(int param_1, unsigned int param_2, unsigned int param_3, unsigned int param_4)
{
    if (param_1 != 1) {
        G1_ASSERT_FAIL((((unsigned long)"ASSERTION FAIL [%s] @ %s:%d\n") /*=0x99cbd*/, ((unsigned long)"chan > 0 && chan < (1 + 1)") /*=0xf66a6*/, ((unsigned long)&rodata_f6659) /*=0xf6659*/, 0x257UL), (((unsigned long)&rodata_f6659) /*=0xf6659*/, 0x257UL));
    }
    (void)__atomic_fetch_or((unsigned int *)((unsigned long)&nrf_rtc_timer_free_channels) /*=0x2000b2d4*/, 2,
                            __ATOMIC_ACQ_REL);
}

/* ---- dppi_channel_disable_and_free.c ---- */
/* readable reconstruction; identity: FUN_00065418 @ 0x00065418
 * public-name: dppi_channel_disable_and_free
 * durable-map: recon/catalogs/function_names_app.json
 * callees (readable <= raw @ address):
 *   nrfx_flag32_free                         <= FUN_00064ef8 @ 0x00064ef8
 *   dppi_channel_disable_and_free            <= FUN_00065418 @ 0x00065418
 * address symbols (name @ address):
 *   g_flag32_channel_alloc_mask              @ 0x20002bbc
 *   REG_50017508                             @ 0x50017508
 */
/* Reconstructed FUN_00065418 @ 0x65418  (parity: 300/300 trials, PROVEN) */

extern void nrfx_flag32_free(unsigned int a, unsigned int b);

static void dppi_channel_disable_and_free(unsigned int param_1)
{
    *(volatile unsigned int *)REG_50017508 /*=0x50017508*/ = 1u << (param_1 & 0xff);
    nrfx_flag32_free(((unsigned long)&g_flag32_channel_alloc_mask) /*=0x20002bbc*/, param_1);
}

/* ---- cbor_min_encoded_size.c ---- */
/* readable reconstruction; identity: FUN_0007158c @ 0x0007158c
 * public-name: cbor_min_encoded_size
 * durable-map: recon/catalogs/function_names_app.json
 * callees (readable <= raw @ address):
 *   cbor_min_encoded_size                    <= FUN_0007158c @ 0x0007158c
 */
/* Reconstructed FUN_0007158c @ 0x7158c  (parity: 300/300 trials, PROVEN) */

typedef unsigned int uint;

uint cbor_min_encoded_size(char *param_1, uint param_2)
{
    uint uVar1;
    signed char sVar2;
    do {
        uVar1 = param_2;
        if (uVar1 == 0) {
            return 0;
        }
        param_2 = uVar1 - 1;
    } while (*(volatile char *)(param_1 + (uVar1 - 1)) == 0);
    if (uVar1 > 2) {
        if (uVar1 - 2 < 7) {
            sVar2 = *(volatile signed char *)(0x000f7c37UL + (uVar1 - 2));
        } else {
            sVar2 = 0;
        }
        uVar1 = 1 << sVar2;
    }
    return uVar1;
}

