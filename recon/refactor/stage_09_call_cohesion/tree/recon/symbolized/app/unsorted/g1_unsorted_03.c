/*
 * Cohesive translation unit for the `unsorted' module.
 *
 * GENERATED by recon/refactor/transforms/t04_cohesive_tu.py.  Do not
 * edit: a stage tree is regenerated, never hand-patched
 * (recon/refactor/README.md C4).
 *
 * The 12 functions below were 12 separate translation units until this
 * stage.  Each one's text is reproduced VERBATIM and in the order the
 * generated source list gave it, and they were CONSECUTIVE in that list.
 * They were proven able to share a translation unit: no symbol is
 * declared here with two types, no identifier has internal linkage in one
 * member and is named by another, and no local typedef, macro, struct tag
 * or enum constant of one member is visible to a member that names it.
 *
 * members, in link order:
 *   wlccap_record_next_fragment.c
 *   wlcstai_record_next_fragment.c
 *   packet_transport_write_frame.c
 *   wlccap_record_encode.c
 *   wlcstai_record_encode.c
 *   transport_state_update.c
 *   transport_parameters_read.c
 *   transport_parameters_write.c
 *   register_ipc_service_recv_callback.c
 *   set_imu_thread_delay.c
 *   imu_fusion_resume.c
 *   imu_fusion_suspend.c
 */
/* ---- wlccap_record_next_fragment.c ---- */
#include "g1_app_symbols.h"
#include <stdint.h>
#include "g1_unsorted.h"
#include "../../../headers/g1_log.h"
#include "../../../headers/g1_dedupe.h"
/* readable reconstruction; identity: FUN_00024a40 @ 0x00024a40
 * public-name: wlccap_record_next_fragment
 * durable-map: recon/catalogs/function_names_app.json
 * callees (readable <= raw @ address):
 *   wlccap_record_next_fragment              <= FUN_00024a40 @ 0x00024a40
 * address symbols (name @ address):
 *   g_wlc_fragment_staging_byte              @ 0x20018c67
 *   g_wlccap_fragment_cursor                 @ 0x20007a0c
 */
/* Reconstructed FUN_00024a40 @ 0x24a40  (exact extent 142 bytes; the halfword
 * at 0x24ace is alignment and 0x24ad0/0x24ad4 are its literal pool)
 *
 * P4 iteration 40.  Catalog-missing.  Installed as the literal 0x00024a41 at
 * offset +8 of the type-7 (WLCCAP) NDEF record by event_record_init
 * (0x25090).  Its only invoker is serialization_read_or_copy (0x7c670):
 *     0007c67c  strd r5, r5, [r1]     ; zero the 2-word out view
 *     0007c680  ldr  r5, [r0, #0x14]  ; the record
 *     0007c684  ldr  r6, [r5, #8]
 *     0007c688  mov  r0, r5
 *     0007c68a  blx  r6               ; r0 = record, r1 = out view, r2 = flag
 * so all THREE registers are live arguments: the record, a two-word
 * {pointer,length} out view, and a "restart the walk" flag.
 *
 * The function is the WLCCAP payload ITERATOR.  A file-scope cursor at
 * 0x20007a0c selects which of the six payload fragments to hand back; the
 * caller loops until the accumulated length reaches the value_len op's answer
 * (6, FUN_0007c38a).  Every fragment is one byte, so out[1] is set to 1 up
 * front and only the degenerate arm clears it.
 *
 * Shipped bytes (the tbb table at 0x24a64 is `03 06 1d 27 29 2b`, i.e. the six
 * case targets 0x24a6a / 0x24a70 / 0x24a9e / 0x24ab2 / 0x24ab6 / 0x24aba):
 *     00024a40  push {r4, r5, r6, lr}
 *     00024a42  cbz  r0, #0x24a9c            ; NULL   -> return 0
 *     00024a44  ldrb r3, [r0] ; cmp r3, #7
 *     00024a48  bne  #0x24ac6                ; type   -> return 0
 *     00024a4a  cmp  r1, #0 ; beq #0x24aca   ; no out -> return 0
 *     00024a4e  ldr  r4, [pc, #0x80]         ; @0x24ad0 = 0x20007a0c
 *     00024a50  cbz  r2, #0x24a56
 *     00024a52  movs r3, #0 ; str r3, [r4]   ; flag != 0 rewinds the cursor
 *     00024a56  movs r3, #1
 *     00024a58  ldr  r2, [r4]
 *     00024a5a  str  r3, [r1, #4]            ; out[1] = 1  (before the switch)
 *     00024a5c  cmp  r2, #5 ; bhi #0x24abe
 *     00024a60  tbb  [pc, r2]
 *     ...
 *     00024a96  adds r2, #1
 *     00024a98  ldr  r0, [r1]
 *     00024a9a  str  r2, [r4]                ; cursor advances on every arm
 *     00024a9c  pop  {r4, r5, r6, pc}
 *
 * Cases 0, 3, 4 and 5 hand back interior bytes of the record (+0x10, +0x17,
 * +0x18, +0x19).  Cases 1 and 2 REPACK bit fields into the shared one-byte
 * staging cell at 0x20018c67 and hand back a pointer to that cell:
 *     case 1: (rec[0x14] & 1) | (rec[0x11] << 6) | ((rec[0x12] << 2) & 0x3c)
 *                             | ((rec[0x13] << 1) & 2)
 *     case 2: (rec[0x16] & 0x1f) | (rec[0x15] << 5)
 * both truncated to 8 bits by the `strb`.  The out-of-range arm writes the
 * whole out view to zero (a single `strd`) and still advances the cursor.
 */

unsigned int wlccap_record_next_fragment(unsigned char *param_1, unsigned int *param_2,
                          int param_3)
{
  unsigned int uVar1;
  unsigned int uVar2;

  if (param_1 == 0) {
    return 0;
  }
  if (*param_1 != 7) {
    return 0;
  }
  if (param_2 == 0) {
    return 0;
  }
  if (param_3 != 0) {
    *(volatile unsigned int *)((unsigned long)&g_wlccap_fragment_cursor) /*=0x20007a0c*/ = 0;
  }
  uVar1 = *(volatile unsigned int *)((unsigned long)&g_wlccap_fragment_cursor) /*=0x20007a0c*/;
  param_2[1] = 1;
  switch (uVar1) {
  case 0:
    param_2[0] = (unsigned int)(param_1 + 0x10);
    break;
  case 1:
    uVar2 = (param_1[0x14] & 1) | ((unsigned int)param_1[0x11] << 6) |
            (((unsigned int)param_1[0x12] << 2) & 0x3c) |
            (((unsigned int)param_1[0x13] << 1) & 2);
    *(volatile unsigned char *)((unsigned long)&g_wlc_fragment_staging_byte) /*=0x20018c67*/ = (unsigned char)uVar2;
    param_2[0] = (unsigned long)&g_wlc_fragment_staging_byte /*=0x20018c67*/;
    break;
  case 2:
    uVar2 = (param_1[0x16] & 0x1f) | ((unsigned int)param_1[0x15] << 5);
    *(volatile unsigned char *)((unsigned long)&g_wlc_fragment_staging_byte) /*=0x20018c67*/ = (unsigned char)uVar2;
    param_2[0] = (unsigned long)&g_wlc_fragment_staging_byte /*=0x20018c67*/;
    break;
  case 3:
    param_2[0] = (unsigned int)(param_1 + 0x17);
    break;
  case 4:
    param_2[0] = (unsigned int)(param_1 + 0x18);
    break;
  case 5:
    param_2[0] = (unsigned int)(param_1 + 0x19);
    break;
  default:
    param_2[0] = 0;
    param_2[1] = 0;
    break;
  }
  *(volatile unsigned int *)((unsigned long)&g_wlccap_fragment_cursor) /*=0x20007a0c*/ = uVar1 + 1;
  return param_2[0];
}

/* ---- wlcstai_record_next_fragment.c ---- */
/* readable reconstruction; identity: FUN_00024ad8 @ 0x00024ad8
 * public-name: wlcstai_record_next_fragment
 * durable-map: recon/catalogs/function_names_app.json
 * callees (readable <= raw @ address):
 *   wlcstai_record_next_fragment             <= FUN_00024ad8 @ 0x00024ad8
 * address symbols (name @ address):
 *   g_wlcstai_fragment_cursor                @ 0x20007a08
 */
/* Reconstructed FUN_00024ad8 @ 0x24ad8  (exact extent 186 bytes; the halfword
 * at 0x24b92 is alignment and 0x24b94 is its literal pool)
 *
 * P4 iteration 40.  Catalog-missing sibling of FUN_00024a40: the +8 iterator
 * op of the type-8 (WLCSTAI) NDEF record, installed as the literal 0x00024ad9
 * by fill_record_type8 (0x250c4).  Same invoker and same three arguments
 * (record, two-word out view, rewind flag); its cursor is a DIFFERENT cell,
 * 0x20007a08.
 *
 * The difference from the WLCCAP iterator is that WLCSTAI's payload is
 * OPTIONAL-FIELD driven: record[0x10] is a presence bitmap and only the bytes
 * whose bit is set are emitted.  The shipped code expresses that as a nine-way
 * tbb whose arms FALL THROUGH into each other, so entering at cursor k tests
 * bits k-1, k, k+1 ... until one is set:
 *     00024af4  cmp  r2, #8 ; bhi #0x24b82
 *     00024af8  tbb  [pc, r2]            ; table 05 0a 11 18 1f 26 2d 34 3b
 *                                        ; -> 0x24b06 0x24b10 0x24b1e 0x24b2c
 *                                        ;    0x24b3a 0x24b48 0x24b56 0x24b64
 *                                        ;    0x24b72
 *     00024b06  adds r0, #0x10 ; str r0, [r1]     ; cursor 0: the control byte
 *     00024b0a  str  r3, [r4]                     ; cursor <- the NEXT index
 *     00024b0c  ldr  r0, [r1]
 *     00024b0e  pop  {r4, r5, pc}
 *     00024b10  ldrb r3, [r0, #0x10] ; lsls r3, r3, #0x1f ; bpl #0x24b1e
 *     00024b16  adds r0, #0x11 ; movs r3, #2 ; str r0, [r1] ; b #0x24b0a
 *     ... (bit 1 -> +0x12/3, bit 2 -> +0x13/4, bit 3 -> +0x14/5,
 *          bit 4 -> +0x15/6, bit 5 -> +0x16/7, bit 6 -> +0x17/8)
 *     00024b72  ldrsb.w r3, [r0, #0x10] ; cmp r3, #0 ; bge #0x24b82
 *     00024b7a  adds r0, #0x18 ; movs r3, #9 ; str r0, [r1] ; b #0x24b0a
 *     00024b82  movs r3, #0 ; strd r3, r3, [r1] ; b #0x24b0c
 *
 * Note the exhausted arm at 0x24b82 branches to 0x24b0c, NOT 0x24b0a: it zeroes
 * the out view and does NOT touch the cursor.  That asymmetry against the
 * WLCCAP iterator (whose default arm still advances) is deliberate and is
 * reproduced here.
 */

unsigned int wlcstai_record_next_fragment(unsigned char *param_1, unsigned int *param_2,
                          int param_3)
{
  unsigned int uVar1;
  unsigned int uVar2;
  unsigned int uVar3;

  if (param_1 == 0) {
    return 0;
  }
  if (*param_1 != 8) {
    return 0;
  }
  if (param_2 == 0) {
    return 0;
  }
  if (param_3 != 0) {
    *(volatile unsigned int *)((unsigned long)&g_wlcstai_fragment_cursor) /*=0x20007a08*/ = 0;
  }
  uVar1 = *(volatile unsigned int *)((unsigned long)&g_wlcstai_fragment_cursor) /*=0x20007a08*/;
  param_2[1] = 1;
  if (uVar1 > 8) {
    param_2[0] = 0;
    param_2[1] = 0;
    return param_2[0];
  }
  if (uVar1 == 0) {
    param_2[0] = (unsigned int)(param_1 + 0x10);
    *(volatile unsigned int *)((unsigned long)&g_wlcstai_fragment_cursor) /*=0x20007a08*/ = 1;
    return param_2[0];
  }
  uVar3 = param_1[0x10];
  for (uVar2 = uVar1; uVar2 < 9; uVar2++) {
    if ((uVar3 >> (uVar2 - 1)) & 1) {
      param_2[0] = (unsigned int)(param_1 + 0x10 + uVar2);
      *(volatile unsigned int *)((unsigned long)&g_wlcstai_fragment_cursor) /*=0x20007a08*/ = uVar2 + 1;
      return param_2[0];
    }
  }
  param_2[0] = 0;
  param_2[1] = 0;
  return param_2[0];
}

/* ---- packet_transport_write_frame.c ---- */
/* readable reconstruction; identity: FUN_00024e60 @ 0x00024e60
 * public-name: packet_transport_write_frame
 * durable-map: recon/catalogs/function_names_app.json
 * callees (readable <= raw @ address):
 *   st25dv_read_area_size                    <= FUN_00024d50 @ 0x00024d50
 *   st25dv_mailbox_poll_message              <= FUN_00024dac @ 0x00024dac
 *   packet_transport_write_frame             <= FUN_00024e60 @ 0x00024e60
 *   ipc_ept_op_a_locked_retry                <= FUN_000256dc @ 0x000256dc
 * address symbols (name @ address):
 *   g_st25dv_mailbox_msg                     @ 0x20007a14
 *   g_st25dv_dev                             @ 0x20007a44
 */
/* Reconstructed FUN_00024e60 @ 0x00024e60, extent 0xa0.
 * Readable identity: packet_transport_write_frame.
 * Raw/address backmap: packet_transport_write_frame <= FUN_00024e60 @ 0x00024e60.
 * CFG_VERIFY_CALL_ARITIES=1,1,4,4,4
 */

extern uint32_t st25dv_read_area_size(uint32_t type);
extern int st25dv_mailbox_poll_message(uint32_t cursor);

int packet_transport_write_frame(uint32_t type, uint32_t length, const void *payload)
{
    volatile uint32_t *const state = (volatile uint32_t *)((unsigned long)&g_st25dv_mailbox_msg) /*=0x20007a14*/;
    void *transport = *(void * volatile *)((unsigned long)&g_st25dv_dev) /*=0x20007a44*/;
    uint8_t header[4];
    uint8_t delimiter = 0xfe;
    uint32_t cursor = st25dv_read_area_size(type);
    uint32_t header_length = length > 0xfeU ? 4U : 2U;

    if (length > cursor - state[3] - 1U - header_length)
        return -2;
    if (st25dv_mailbox_poll_message(cursor) != 0)
        return -1;

    header[0] = (uint8_t)type;
    if (length > 0xfeU) {
        header[1] = 0xffU;
        header[2] = (uint8_t)(length >> 8);
        header[3] = (uint8_t)length;
    } else {
        header[1] = (uint8_t)length;
    }

    cursor = state[3];
    if (ipc_ept_op_a_locked_retry(transport, cursor, header, header_length) != 0)
        return -1;
    cursor += header_length;
    if (ipc_ept_op_a_locked_retry(transport, cursor, payload, length) != 0)
        return -1;
    return ipc_ept_op_a_locked_retry(transport, cursor + length, &delimiter, 1U) != 0 ? -1 : 0;
}

/* ---- wlccap_record_encode.c ---- */
/* readable reconstruction; identity: FUN_00025020 @ 0x00025020
 * public-name: wlccap_record_encode
 * durable-map: recon/catalogs/function_names_app.json
 * callees (readable <= raw @ address):
 *   opt_field1_set                           <= FUN_0007c430 @ 0x0007c430
 *   opt_record_bind_value                    <= FUN_0007c61e @ 0x0007c61e
 *   opt_record_init                          <= FUN_0007c4b6 @ 0x0007c4b6
 *   wlccap_record_encode                     <= FUN_00025020 @ 0x00025020
 * address symbols (name @ address):
 *   g_wlccap_record_type                     @ 0x200023c4
 */
/* Reconstructed FUN_00025020 @ 0x25020  (exact extent 50 bytes)
 *
 * P4 iteration 40.  Catalog-missing.  Installed as the literal 0x00025021 at
 * offset +12 of the type-7 (WLCCAP) NDEF record by event_record_init
 * (0x25090), and reached only through invoke_optional_op_offset12 (0x7c3da),
 * which does `ldr r3,[r0,#0xc]; bx r3` — so r0 is the record and r1 is the
 * caller's out node, both passed straight through.
 *
 * Shipped bytes:
 *     00025020  push  {r3, r4, r5, lr}
 *     00025022  mov   r4, r1
 *     00025024  mov   r5, r0
 *     00025026  cbz   r0, #0x25030
 *     00025028  ldrb  r3, [r0]
 *     0002502a  cmp   r3, #7
 *     0002502c  bne   #0x25030
 *     0002502e  cbnz  r1, #0x25034
 *     00025030  movs  r0, #7                 ; EINVAL
 *     00025032  pop   {r3, r4, r5, pc}
 *     00025034  mov   r0, r1
 *     00025036  bl    #0x7c4b6               ; opt_record_init(node)
 *     0002503a  movs  r1, #1
 *     0002503c  mov   r0, r4
 *     0002503e  ldr   r2, [pc, #0x14]        ; @0x25054 = 0x200023c4
 *     00025040  bl    #0x7c430               ; opt_field1_set(node, 1, type)
 *     00025044  mov   r1, r5
 *     00025046  mov   r0, r4
 *     00025048  bl    #0x7c61e               ; opt_record_bind_value(node, rec)
 *     0002504c  cmp   r0, #0
 *     0002504e  beq   #0x25032               ; success -> return 0
 *     00025050  b     #0x25030               ; failure -> return 7
 *
 * 0x200023c4 is the shipped `.data` descriptor { 0x0009f1e4, 6 } and
 * 0x0009f1e4 is the ASCII "WLCCAP" — the NFC Forum Wireless Charging
 * Capability record type name.  Type field 1 is the NDEF TNF "well known"
 * class that opt_field1_set ORs into the node header.
 */

extern unsigned int opt_field1_set(unsigned char *param_1, unsigned int param_2,
                                 int *param_3);

unsigned int wlccap_record_encode(unsigned char *param_1, unsigned char *param_2)
{
  if (param_1 == 0 || *param_1 != 7 || param_2 == 0) {
    return 7;
  }
  opt_record_init(param_2);
  opt_field1_set(param_2, 1, (int *)((unsigned long)&g_wlccap_record_type) /*=0x200023c4*/);
  return (opt_record_bind_value(param_2, param_1) == 0) ? 0 : 7;
}

/* ---- wlcstai_record_encode.c ---- */
/* readable reconstruction; identity: FUN_00025058 @ 0x00025058
 * public-name: wlcstai_record_encode
 * durable-map: recon/catalogs/function_names_app.json
 * callees (readable <= raw @ address):
 *   opt_field1_set                           <= FUN_0007c430 @ 0x0007c430
 *   opt_record_bind_value                    <= FUN_0007c61e @ 0x0007c61e
 *   opt_record_init                          <= FUN_0007c4b6 @ 0x0007c4b6
 *   wlcstai_record_encode                    <= FUN_00025058 @ 0x00025058
 * address symbols (name @ address):
 *   g_wlcstai_record_type                    @ 0x200023bc
 */
/* Reconstructed FUN_00025058 @ 0x25058  (exact extent 50 bytes)
 *
 * P4 iteration 40.  Catalog-missing sibling of FUN_00025020: the +12 op of the
 * type-8 (WLCSTAI) NDEF record, installed as the literal 0x00025059 by
 * fill_record_type8 (0x250c4) and reached through invoke_optional_op_offset12.
 * Instruction-for-instruction identical to FUN_00025020 except for the type
 * byte (8) and the type-name descriptor:
 *     00025062  cmp  r3, #8
 *     00025076  ldr  r2, [pc, #0x14]   ; @0x2508c = 0x200023bc
 * 0x200023bc is the shipped `.data` descriptor { 0x0009f1dc, 7 } and
 * 0x0009f1dc is the ASCII "WLCSTAI" — the NFC Forum Wireless Charging
 * Status-and-Information record type name.
 */

extern unsigned int opt_field1_set(unsigned char *param_1, unsigned int param_2,
                                 int *param_3);

unsigned int wlcstai_record_encode(unsigned char *param_1, unsigned char *param_2)
{
  if (param_1 == 0 || *param_1 != 8 || param_2 == 0) {
    return 7;
  }
  opt_record_init(param_2);
  opt_field1_set(param_2, 1, (int *)((unsigned long)&g_wlcstai_record_type) /*=0x200023bc*/);
  return (opt_record_bind_value(param_2, param_1) == 0) ? 0 : 7;
}

/* ---- transport_state_update.c ---- */
/* readable reconstruction; identity: FUN_0002538c @ 0x0002538c
 * public-name: transport_state_update
 * durable-map: recon/catalogs/function_names_app.json
 * callees (readable <= raw @ address):
 *   transport_state_update                   <= FUN_0002538c @ 0x0002538c
 *   thunk_FUN_00074f68                       <= FUN_0007c398 @ 0x0007c398
 *   box_field_state_to_display_code          <= FUN_0007c842 @ 0x0007c842
 * address symbols (name @ address):
 *   g_20007a00                               @ 0x20007a00
 *   g_20018c65                               @ 0x20018c65
 */
/* Reconstructed FUN_0002538c @ 0x0002538c, extent 0x00000098.
 * Readable identity: transport_state_update.
 * Raw/address backmap: transport_state_update <= FUN_0002538c @ 0x0002538c.
 */

extern void box_field_state_to_display_code(void *context);
extern uint64_t thunk_FUN_00074f68(void);

void transport_state_update(uint8_t *context, uint8_t *state)
{
    volatile uint8_t *const active = (volatile uint8_t *)((unsigned long)&g_20018c65) /*=0x20018c65*/;
    volatile uint32_t *const timestamp = (volatile uint32_t *)((unsigned long)&g_20007a00) /*=0x20007a00*/;
    uint8_t phase;

    context[2] = 3U;
    box_field_state_to_display_code(context);
    phase = context[2];

    if (phase == 1U) {
        state[12] = 9U;
        state[3] = 0U;
        if (*(uint32_t *)(context + 8) >= 500U) {
            *active = 0U;
            /* shipped 0x000253c2 STRB falls through into 0x000253c4
             * `bl 0x7c398 ; str r0,[=0x20007a00]` -- the timestamp refresh.
             * The `else if` arm at 0x000253ba..be returns via 0x000253c0
             * WITHOUT it, which is why it is not duplicated below. */
            *timestamp = thunk_FUN_00074f68();
        } else if (*active == 0U) {
            *active = 1U;
        }
    } else if (phase == 2U) {
        uint64_t now = thunk_FUN_00074f68();
        if (now - *timestamp >= 3001U) {
            if (state[5] == 10U) {
                if (state[0] == 0U)
                    state[12] = 6U;
                state[1] = 1U;
            }
            state[3] = 1U;
            *timestamp = thunk_FUN_00074f68();
        }
    } else if (phase == 4U) {
        if (state[5] == 10U) {
            if (state[0] == 0U)
                state[12] = 6U;
            state[1] = 1U;
        }
        if (state[2] == 0U)
            state[2] = 1U;
        *timestamp = thunk_FUN_00074f68();
    } else {
        *timestamp = thunk_FUN_00074f68();
    }
}

/* ---- transport_parameters_read.c ---- */
/* readable reconstruction; identity: FUN_000258b4 @ 0x000258b4
 * public-name: transport_parameters_read
 * durable-map: recon/catalogs/function_names_app.json
 * callees (readable <= raw @ address):
 *   ipc_send_len_prefixed_packet_locked_retry <= FUN_00025788 @ 0x00025788
 *   transport_parameters_read                <= FUN_000258b4 @ 0x000258b4
 * address symbols (name @ address):
 *   rodata_9f2f8                             @ 0x0009f2f8   [INLINED -- G6 literal batch]
 *   rodata_9f32d                             @ 0x0009f32d   [INLINED -- G6 literal batch]
 *   rodata_9f361                             @ 0x0009f361   [INLINED -- G6 literal batch]
 */
/* Reconstructed FUN_000258b4 @ 0x000258b4, extent 0x000000a0.
 * Readable identity: transport_parameters_read.
 * Raw/address backmap: transport_parameters_read <= FUN_000258b4 @ 0x000258b4.
 */

extern int ipc_send_len_prefixed_packet_locked_retry(uint32_t transport, uint32_t key,
                        void *value, uint32_t length);

int transport_parameters_read(uint32_t transport, uint32_t *value, uint32_t *result_value)
{
    uint8_t status = 0U;
    uint32_t received = 0U;
    int result;

    if (transport == 0U || value == 0 || result_value == 0)
        return -1;
    result = ipc_send_len_prefixed_packet_locked_retry(transport, 0x2006U, &status, 1U);
    if (result != 0) {
        log_message(((unsigned long)"eeprom_st25dv_read ST25DV_REG_MB_CTRL_DYN is failed\n") /*=0x9f2f8*/);
        return -2;
    }
    if ((status & 5U) != 5U)
        return -3;
    result = ipc_send_len_prefixed_packet_locked_retry(transport, 0x2007U, &received, 1U);
    if (result != 0) {
        log_message(((unsigned long)"eeprom_st25dv_read ST25DV_REG_MB_LEN_DYN is failed\n") /*=0x9f32d*/);
        return -4;
    }
    *result_value = received;
    result = ipc_send_len_prefixed_packet_locked_retry(transport, 0x2008U, value, 0xffU);
    if (result != 0) {
        log_message(((unsigned long)"eeprom_st25dv_read ST25DV_REG_MAILBOX_DYN is failed\n") /*=0x9f361*/);
        return -5;
    }
    return 0;
}

/* ---- transport_parameters_write.c ---- */
/* readable reconstruction; identity: FUN_00025950 @ 0x00025950
 * public-name: transport_parameters_write
 * durable-map: recon/catalogs/function_names_app.json
 * callees (readable <= raw @ address):
 *   ipc_ept_op_a_locked_retry                <= FUN_000256dc @ 0x000256dc
 *   ipc_send_len_prefixed_packet_locked_retry <= FUN_00025788 @ 0x00025788
 *   transport_parameters_write               <= FUN_00025950 @ 0x00025950
 * address symbols (name @ address):
 *   rodata_9f2f8                             @ 0x0009f2f8   [INLINED -- G6 literal batch]
 *   rodata_9f396                             @ 0x0009f396   [INLINED -- G6 literal batch]
 */
/* Reconstructed FUN_00025950 @ 0x00025950, extent 0x0000007c.
 * Readable identity: transport_parameters_write.
 * Raw/address backmap: transport_parameters_write <= FUN_00025950 @ 0x00025950.
 */

extern int ipc_send_len_prefixed_packet_locked_retry(uint32_t transport, uint32_t key,
                        void *value, uint32_t length);

int transport_parameters_write(uint32_t transport, const void *value, uint32_t length)
{
    uint8_t status = 0U;
    int result;

    if (transport == 0U || value == 0 || length == 0U)
        return -1;
    result = ipc_send_len_prefixed_packet_locked_retry(transport, 0x2006U, &status, 1U);
    if (result != 0) {
        log_message(((unsigned long)"eeprom_st25dv_read ST25DV_REG_MB_CTRL_DYN is failed\n") /*=0x9f2f8*/);
        return -2;
    }
    if ((status & 6U) != 0U) {
        log_message(((unsigned long)"eeprom_st25dv_write_i2c_mb_mailbox_ram no write\n") /*=0x9f396*/);
        return -3;
    }
    result = ipc_ept_op_a_locked_retry(transport, 0x2008U, value, length);
    if (result != 0) {
        log_message(0x0009f3caUL);
        return -3;
    }
    status = 1U;
    result = ipc_send_len_prefixed_packet_locked_retry(transport, 0x2006U, &status, 1U);
    if (result != 0) {
        log_message(((unsigned long)"eeprom_st25dv_read ST25DV_REG_MB_CTRL_DYN is failed\n") /*=0x9f2f8*/);
        return -2;
    }
    return 0;
}

/* ---- register_ipc_service_recv_callback.c ---- */
/* readable reconstruction; identity: FUN_00025ae8 @ 0x00025ae8
 * public-name: register_ipc_service_recv_callback
 * provenance: uncatalogued by Ghidra (gap 0x25ad2..0x25b78, immediately before
 *   its sibling global_ipc_service_send @0x25b78).  Extent derived from the
 *   original image bytes: code 0x25ae8..0x25b53 (0x6c B) + literal pool
 *   0x25b54..0x25b6b.  The function names itself through its own "%s()" log
 *   argument at 0x9f6a3.
 * callees (readable <= raw @ address):
 *   log_message                              <= FUN_0007dda4 @ 0x0007dda4
 *   debug_print                              <= FUN_00019c70 @ 0x00019c70
 * address symbols (name @ address):
 *   rodata_9f512                             @ 0x0009f512   [INLINED -- G6 literal batch]
 *   rodata_9f540                             @ 0x0009f540   [INLINED -- G6 literal batch]
 *   rodata_9f6a3                             @ 0x0009f6a3   [INLINED -- G6 literal batch]
 *   g_log_level                              @ 0x2000230c
 *   g_log_use_alt_sink                       @ 0x20007554
 *   g_ipc0_endpoint                          @ 0x20007a84
 */
/* Reconstructed register_ipc_service_recv_callback @ 0x25ae8
 * (cfg_verify PASS, 300/300 trials; plus 96/96 directed-fixture cases) */

int register_ipc_service_recv_callback(unsigned int param_1)
{
    int *piVar1;
    int iVar2;
    int iVar3;

    piVar1 = *(int * volatile *)((unsigned long)&g_ipc0_endpoint) /*=0x20007a84*/;
    iVar2 = *(volatile int *)((unsigned long)&g_log_level) /*=0x2000230c*/;
    iVar3 = piVar1[1];
    if (iVar3 < 0x16) {
        piVar1[iVar3 + 2] = (int)param_1;
        piVar1[1] = iVar3 + 1;
        if (2 < iVar2) {
            G1_LOG_ROUTE(*(volatile int *)((unsigned long)&g_log_use_alt_sink) /*=0x20007554*/ == 0, ((unsigned long)"%s(): ipc_service_register(%d,%s) %d,SUCCESS\n") /*=0x9f512*/,
                            ((unsigned long)"register_ipc_service_recv_callback") /*=0x9f6a3*/,
                            *(volatile unsigned char *)param_1,
                            *(volatile int *)(param_1 + 4), iVar3 + 1);
        }
        return 0;
    }
    if (0 < iVar2) {
        G1_LOG_ROUTE(*(volatile int *)((unsigned long)&g_log_use_alt_sink) /*=0x20007554*/ == 0, ((unsigned long)"%s(): ipc_service_register(%d,%s) %d,total must < %d\n") /*=0x9f540*/,
                        ((unsigned long)"register_ipc_service_recv_callback") /*=0x9f6a3*/,
                        *(volatile unsigned char *)param_1,
                        *(volatile int *)(param_1 + 4), iVar3, 0x16);
    }
    return -1;
}

/* ---- set_imu_thread_delay.c ---- */
/* readable reconstruction; identity: set_imu_thread_delay @ 0x00025d8c
 * public-name: set_imu_thread_delay
 * durable-map: recon/catalogs/function_names_app.json
 * callees (readable <= raw @ address):
 *   log_message                              <= FUN_0007dda4 @ 0x0007dda4
 *   debug_print                              <= FUN_00019c70 @ 0x00019c70
 * address symbols (name @ address):
 *   rodata_9f721                             @ 0x0009f721   [INLINED -- G6 literal batch]
 *   rodata_9fb00                             @ 0x0009fb00   [INLINED -- G6 literal batch]
 *   g_log_level                              @ 0x2000230c
 *   g_log_use_alt_sink                       @ 0x20007554
 */
/* Reconstructed set_imu_thread_delay @ 0x25d8c (uncatalogued Ghidra gap
 * 0x25d8c..0x25ecc; code 0x25d8c..0x25db4, literal pool 0x25db4..0x25dc4).
 * (parity: cfg_verify PASS, 200/200 trials)
 * Vtable slot +0x98 written by register_imu_funsion_context (0x26250).
 * Name self-evidenced: the log tag 0x0009fb00 is "set_imu_thread_delay".
 */


#define LOG_LEVEL (*(volatile int32_t *)((unsigned long)&g_log_level) /*=0x2000230c*/)
#define LOG_SINK  (*(volatile int32_t *)((unsigned long)&g_log_use_alt_sink) /*=0x20007554*/)

/* G7-B2 defect fix, two corrections, both read off 0x25d8c..0x25db0.
 *
 * (1) RETURN TYPE.  The body used to be `int` and to `return` the result of
 *     the logging call.  The shipped function never writes r0 on the fall
 *     through path -- 0x25db0 is a bare `bx lr` with the incoming `context`
 *     pointer still in r0 -- and the two logging paths are TAIL calls
 *     (`b.w 0x19c70` / `b.w 0x7dda4`), so what they leave in r0 is the sink's
 *     scratch, not a value this function computes.  Both sinks are `void`
 *     (recon/headers/g1_log.h), so the `int` was a decompiler artefact.  As
 *     `void` the codegen is unchanged: the fall-through is still `bx lr` with
 *     r0 untouched and both logging paths are still tail calls.
 *
 * (2) ARGUMENT COUNT.  0x0009f721 is "%s(): %d(ms)\n" -- two specifiers, so
 *     three arguments.  0x25d9e..0x25da4 load exactly r0 (format), r1 (tag)
 *     and r2 (already `mov r2, r1` at 0x25d8e, the delay).  The fourth
 *     argument the body used to pass was r3, which holds the
 *     g_log_use_alt_sink value the branch at 0x25da6 had just loaded.
 */
void set_imu_thread_delay(unsigned char *context, int delay_ms)
{
    if (*(volatile int32_t *)(context + 0x18) != delay_ms) {
        *(volatile int32_t *)(context + 0x18) = delay_ms;
        if (LOG_LEVEL > 2) {
            if (LOG_SINK == 0) {
                log_message(((unsigned long)"%s(): %d(ms)\n") /*=0x9f721*/,
                            ((unsigned long)"set_imu_thread_delay") /*=0x9fb00*/,
                            (uint32_t)delay_ms);
                return;
            }
            debug_print(((unsigned long)"%s(): %d(ms)\n") /*=0x9f721*/,
                        ((unsigned long)"set_imu_thread_delay") /*=0x9fb00*/,
                        (uint32_t)delay_ms);
        }
    }
}

/* ---- imu_fusion_resume.c ---- */
/* readable reconstruction; identity: imu_fusion_resume @ 0x00025dc4
 * public-name: imu_fusion_resume
 * durable-map: recon/catalogs/function_names_app.json
 * callees (readable <= raw @ address):
 *   log_message                              <= FUN_0007dda4 @ 0x0007dda4
 *   debug_print                              <= FUN_00019c70 @ 0x00019c70
 * address symbols (name @ address):
 *   rodata_9f72f                             @ 0x0009f72f   [INLINED -- G6 literal batch]
 *   rodata_9faf9                             @ 0x0009faf9   [INLINED -- G6 literal batch]
 *   g_log_level                              @ 0x2000230c
 *   g_log_use_alt_sink                       @ 0x20007554
 */
/* Reconstructed imu_fusion_resume @ 0x25dc4 (uncatalogued Ghidra gap
 * 0x25d8c..0x25ecc; code 0x25dc4..0x25de8, literal pool 0x25de8..0x25df8).
 * (parity: cfg_verify PASS, 200/200 trials)
 * Vtable slot +0x94 written by register_imu_funsion_context (0x26250).
 * Name self-evidenced: the log tag 0x0009faf9 is "resume".
 */


#define LOG_LEVEL (*(volatile int32_t *)((unsigned long)&g_log_level) /*=0x2000230c*/)
#define LOG_SINK  (*(volatile int32_t *)((unsigned long)&g_log_use_alt_sink) /*=0x20007554*/)

int imu_fusion_resume(uint32_t p1, uint32_t p2, uint32_t p3)
{
    (void)p1; (void)p2;
    if (LOG_LEVEL > 2) {
        int32_t sink = LOG_SINK;
        G1_LOG_ROUTE(sink == 0, ((unsigned long)"%s(): enter!\n") /*=0x9f72f*/,
                        ((unsigned long)"resume") /*=0x9faf9*/, p3, (uint32_t)sink);
    }
    return 0;
}

/* ---- imu_fusion_suspend.c ---- */
/* readable reconstruction; identity: imu_fusion_suspend @ 0x00025df8
 * public-name: imu_fusion_suspend
 * durable-map: recon/catalogs/function_names_app.json
 * callees (readable <= raw @ address):
 *   log_message                              <= FUN_0007dda4 @ 0x0007dda4
 *   debug_print                              <= FUN_00019c70 @ 0x00019c70
 * address symbols (name @ address):
 *   rodata_9f72f                             @ 0x0009f72f   [INLINED -- G6 literal batch]
 *   rodata_9faf1                             @ 0x0009faf1   [INLINED -- G6 literal batch]
 *   g_log_level                              @ 0x2000230c
 *   g_log_use_alt_sink                       @ 0x20007554
 */
/* Reconstructed imu_fusion_suspend @ 0x25df8 (uncatalogued Ghidra gap
 * 0x25d8c..0x25ecc; code 0x25df8..0x25e1c, literal pool 0x25e1c..0x25e2c).
 * (parity: cfg_verify PASS, 200/200 trials)
 * Vtable slot +0x90 written by register_imu_funsion_context (0x26250).
 * Name self-evidenced: the log tag 0x0009faf1 is "suspend".
 */


#define LOG_LEVEL (*(volatile int32_t *)((unsigned long)&g_log_level) /*=0x2000230c*/)
#define LOG_SINK  (*(volatile int32_t *)((unsigned long)&g_log_use_alt_sink) /*=0x20007554*/)

int imu_fusion_suspend(uint32_t p1, uint32_t p2, uint32_t p3)
{
    (void)p1; (void)p2;
    if (LOG_LEVEL > 2) {
        int32_t sink = LOG_SINK;
        G1_LOG_ROUTE(sink == 0, ((unsigned long)"%s(): enter!\n") /*=0x9f72f*/,
                        ((unsigned long)"suspend") /*=0x9faf1*/, p3, (uint32_t)sink);
    }
    return 0;
}

