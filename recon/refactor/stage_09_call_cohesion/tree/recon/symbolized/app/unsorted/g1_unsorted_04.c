/*
 * Cohesive translation unit for the `unsorted' module.
 *
 * GENERATED by recon/refactor/transforms/t04_cohesive_tu.py.  Do not
 * edit: a stage tree is regenerated, never hand-patched
 * (recon/refactor/README.md C4).
 *
 * The 4 functions below were 4 separate translation units until this
 * stage.  Each one's text is reproduced VERBATIM and in the order the
 * generated source list gave it, and they were CONSECUTIVE in that list.
 * They were proven able to share a translation unit: no symbol is
 * declared here with two types, no identifier has internal linkage in one
 * member and is named by another, and no local typedef, macro, struct tag
 * or enum constant of one member is visible to a member that names it.
 *
 * members, in link order:
 *   update_imu_mode.c
 *   spim_select_instance_by_mode.c
 *   active_mode_shutdown.c
 *   misc_dev_api_transfer_op12.c
 */

/* File-scope forward declarations for every struct/union tag this
 * unit names.  Without them a tag whose only appearance in a member
 * is inside a parameter list has PARAMETER-LIST scope, so two
 * textually IDENTICAL declarations in two members declare two
 * different incomplete types and the second is a conflicting
 * redeclaration (C11 6.2.1p7).  Incomplete-type forward
 * declarations emit no code. */
struct g1_i2c_msg;
struct mapping;
/* ---- update_imu_mode.c ---- */
#include "g1_app_symbols.h"
/* readable reconstruction; identity: FUN_00026100 @ 0x00026100
 * public-name: update_imu_mode
 * durable-map: recon/catalogs/function_names_app.json
 * callees (readable <= raw @ address):
 *   get_device_type                          <= FUN_00016568 @ 0x00016568
 *   debug_print                              <= FUN_00019c70 @ 0x00019c70
 *   dev_api_call_slot0                       <= FUN_0007ca54 @ 0x0007ca54
 * address symbols (name @ address):
 *   rodata_87d58                             @ 0x00087d58
 *   g_log_level                              @ 0x2000230c
 *   g_log_use_alt_sink                       @ 0x20007554
 */
/* CPUAPP update_imu_mode @ 0x00026100.
 * Raw/back-map identity: FUN_00026100, exact extent 0x150 bytes. */
#include <stdint.h>
#include "../../../headers/g1_log.h"
#include "g1_unsorted.h"

extern void wait_for_event(uint32_t ticks, uint32_t unused);

#define LOG_LEVEL (*(volatile int32_t *)((unsigned long)&g_log_level) /*=0x2000230c*/)
#define LOG_ROUTE (*(volatile uint32_t *)((unsigned long)&g_log_use_alt_sink) /*=0x20007554*/)

#define IMU_LOG(format, arg0, arg1) do { \
    if (LOG_ROUTE == 0u) \
        log_message((format), ((unsigned long)"update_imu_mode") /*=0x9fb32*/, (arg0), (arg1)); \
    else \
        debug_print((format), ((unsigned long)"update_imu_mode") /*=0x9fb32*/, (arg0), (arg1)); \
} while (0)

uint32_t update_imu_mode(uint8_t *fusion, uint32_t mode,
                      uint32_t unused2, uint32_t retry_context)
{
    uint32_t attempt;
    int32_t result;
    uint32_t frequency = 0u;

    (void)unused2;
    if (get_device_type() != 1)
        return 0u;

    if (fusion[0x14] != 0u) {
        if (LOG_LEVEL > 1)
            IMU_LOG(((unsigned long)"%s(): imu_fusion: algo is existed\n\n") /*=0x9f773*/, 0u, 0u);
        return 0xffffffffu;
    }

    (void)get_device_type();
    *(volatile uint32_t *)(fusion + 0x1c) = ((unsigned long)&rodata_87d58) /*=0x87d58*/;
    if (mode == 1u)
        frequency = 0x0cu;
    else if (mode == 2u)
        frequency = 0x1au;
    else if (mode != 0u)
        frequency = *(volatile uint32_t *)(fusion + 0x20);
    *(volatile uint32_t *)(fusion + 0x20) = frequency;
    *(volatile uint32_t *)(fusion + 0x24) = 0u;

    for (attempt = 1u; attempt != 0x15u; ++attempt) {
        result = dev_api_call_slot0(*(volatile uint32_t *)(fusion + 0x1c),
                              3u, fusion + 0x20);
        if (result >= 0)
            break;
        if (LOG_LEVEL > 1)
            IMU_LOG(0x0009f9d9u, (uint32_t)result, retry_context);
        wait_for_event(0xa4u, 0u);
    }
    if (result < 0)
        return 0xfffffffdu;

    if (mode < 3u) {
        *(volatile uint32_t *)(fusion + 0x20) = 0u;
        *(volatile uint32_t *)(fusion + 0x24) = 0u;
    }
    for (attempt = 1u; attempt != 0x15u; ++attempt) {
        result = dev_api_call_slot0(*(volatile uint32_t *)(fusion + 0x1c),
                              7u, fusion + 0x20);
        if (result >= 0)
            break;
        if (LOG_LEVEL > 1)
            IMU_LOG(0x0009fa36u, attempt, 0u);
        wait_for_event(0xa4u, 0u);
    }
    if (result < 0)
        return 0xfffffffcu;

    if (LOG_LEVEL > 1)
        IMU_LOG(((unsigned long)"%s(): imu sensor update to mode %d\n") /*=0x9fa78*/, mode, 0u);
    return 0u;
}

/* ---- spim_select_instance_by_mode.c ---- */
/* readable reconstruction; identity: FUN_00026338 @ 0x00026338
 * public-name: spim_select_instance_by_mode
 * durable-map: recon/catalogs/function_names_app.json
 * callees (readable <= raw @ address):
 *   debug_print                              <= FUN_00019c70 @ 0x00019c70
 *   spim_select_instance_by_mode             <= FUN_00026338 @ 0x00026338
 *   nrfx_spim_uninit                         <= FUN_00067248 @ 0x00067248
 * address symbols (name @ address):
 *   rodata_9fb89                             @ 0x0009fb89   [INLINED -- G6 literal batch]
 *   rodata_9fb9f                             @ 0x0009fb9f   [INLINED -- G6 literal batch]
 *   rodata_9fbda                             @ 0x0009fbda   [INLINED -- G6 literal batch]
 *   rodata_9fc79                             @ 0x0009fc79   [INLINED -- G6 literal batch]
 *   g_log_level                              @ 0x2000230c
 *   g_log_use_alt_sink                       @ 0x20007554
 */
/* Full reconstruction FUN_00026338 @ 0x26338, exact extent 190 bytes.
 * CFG_VERIFY_CALL_ARITIES=1 */
extern void nrfx_spim_uninit(void*);
unsigned spim_select_instance_by_mode(uintptr_t event){
 struct mapping{uint32_t base,tag;};
 struct mapping mode3,mode4;
 mode3.base=0x5000c000u; *(uint8_t *)&mode3.tag=0;
 mode4.base=0x5000a000u; *(uint8_t *)&mode4.tag=1;
 if(*(volatile uint32_t *)(event+0x14)==0)return 0;
 uint32_t mode=*(volatile uint8_t *)(event+0x18);int level=*(volatile int *)((unsigned long)&g_log_level) /*=0x2000230c*/;
 const struct mapping *m;
 if(mode==3)m=&mode3;else if(mode==4)m=&mode4;else{
  if(level>0){int alternate=*(volatile int *)((unsigned long)&g_log_use_alt_sink) /*=0x20007554*/;if(alternate)debug_print(((unsigned long)"%s():  SPIM BUS ERR!\n") /*=0x9fb89*/,((unsigned long)"spi_master_deinit") /*=0x9fc79*/);else log_message(((unsigned long)"%s():  SPIM BUS ERR!\n") /*=0x9fb89*/,((unsigned long)"spi_master_deinit") /*=0x9fc79*/);}return 0;
 }
 *(volatile uint32_t *)(event+0xc)=m->base;*(volatile uint32_t *)(event+0x10)=m->tag;
 if(level>2){
  if(*(volatile int *)((unsigned long)&g_log_use_alt_sink) /*=0x20007554*/)debug_print(((unsigned long)"%s(): *SPIM(%d)speed=%dM, sck=%d, mosi=%d, miso=%d, ss=%d\n") /*=0x9fb9f*/,((unsigned long)"spi_master_deinit") /*=0x9fc79*/,mode,*(uint8_t*)(event+0x1d),*(uint8_t*)(event+0x19),*(uint8_t*)(event+0x1a),*(uint8_t*)(event+0x1b),*(uint8_t*)(event+0x1c));
  else log_message(((unsigned long)"%s(): *SPIM(%d)speed=%dM, sck=%d, mosi=%d, miso=%d, ss=%d\n") /*=0x9fb9f*/,((unsigned long)"spi_master_deinit") /*=0x9fc79*/,mode,*(uint8_t*)(event+0x1d),*(uint8_t*)(event+0x19),*(uint8_t*)(event+0x1a),*(uint8_t*)(event+0x1b),*(uint8_t*)(event+0x1c));
 }
 nrfx_spim_uninit((void*)(event+0xc));
 if(*(volatile int *)((unsigned long)&g_log_level) /*=0x2000230c*/>2){if(*(volatile int *)((unsigned long)&g_log_use_alt_sink) /*=0x20007554*/)debug_print(((unsigned long)"%s(): spim(bus=%d): uninit finish\n") /*=0x9fbda*/,((unsigned long)"spi_master_deinit") /*=0x9fc79*/,mode);else log_message(((unsigned long)"%s(): spim(bus=%d): uninit finish\n") /*=0x9fbda*/,((unsigned long)"spi_master_deinit") /*=0x9fc79*/,mode);}
 *(volatile uint32_t *)(event+0x14)=0;return 0;
}

/* ---- active_mode_shutdown.c ---- */
/* readable reconstruction; identity: FUN_0002bdf0 @ 0x0002bdf0
 * public-name: active_mode_shutdown
 * durable-map: recon/catalogs/function_names_app.json
 * callees (readable <= raw @ address):
 *   debug_print                              <= FUN_00019c70 @ 0x00019c70
 *   active_mode_shutdown                     <= FUN_0002bdf0 @ 0x0002bdf0
 * address symbols (name @ address):
 *   rodata_a24eb                             @ 0x000a24eb   [INLINED -- G6 literal batch]
 *   rodata_a24f9                             @ 0x000a24f9   [INLINED -- G6 literal batch]
 *   g_log_level                              @ 0x2000230c
 *   g_log_use_alt_sink                       @ 0x20007554
 */
/* Reconstructed FUN_0002bdf0 @ 0x0002bdf0, extent 0x00000060.
 * Readable identity: active_mode_shutdown.
 * Raw/address backmap: active_mode_shutdown <= FUN_0002bdf0 @ 0x0002bdf0.
 * CFG_VERIFY_CALL_ARITIES=4,1,4,1
 */


int active_mode_shutdown(uint8_t *device)
{
    volatile int *const log_level = (volatile int *)((unsigned long)&g_log_level) /*=0x2000230c*/;
    volatile int *const log_backend = (volatile int *)((unsigned long)&g_log_use_alt_sink) /*=0x20007554*/;
    uint8_t phase = device[0xfe6];

    if ((phase & 0xfbU) != 1U)
        return 0;
    device[0xfe6] = 3U;
    if (*log_level > 1) {
        if (*log_backend != 0)
            debug_print(((unsigned long)"%s(): begin.\n") /*=0xa24eb*/, ((unsigned long)"global_system_resume") /*=0xa2505*/);
        else
            log_message(((unsigned long)"%s(): begin.\n") /*=0xa24eb*/, ((unsigned long)"global_system_resume") /*=0xa2505*/);
    }
    ((void (*)(void *))(*(uint32_t *)(device + 0xb74)))(device + 0xb6c);
    if (*log_level > 1) {
        if (*log_backend != 0)
            debug_print(((unsigned long)"%s(): end.\n") /*=0xa24f9*/, ((unsigned long)"global_system_resume") /*=0xa2505*/);
        else
            log_message(((unsigned long)"%s(): end.\n") /*=0xa24f9*/, ((unsigned long)"global_system_resume") /*=0xa2505*/);
    }
    device[0xfe6] = 0U;
    return 0;
}

/* ---- misc_dev_api_transfer_op12.c ---- */
/* readable reconstruction; identity: FUN_00030c24 @ 0x00030c24
 * public-name: misc_dev_api_transfer_op12
 * durable-map: recon/catalogs/function_names_app.json
 * address symbols (name @ address):
 *   g_misc_dev_handle_2418                   @ 0x20002418
 */
/* Reconstructed misc_dev_api_transfer_op12 @ 0x30c24
 *
 * ITERATION 17 CORRECTION (collapsed stack objects).  The previous body
 * declared the six descriptor fields as SEPARATE stack scalars and passed only
 * `&local_20` to the callee.  GCC is entitled to drop stores to the other five
 * objects because taking the address of `local_20` does not make them escape,
 * and it did -- the emitted frame was
 *     push {r0,r1,r4,lr} ; str r0,[sp,#4] ; ... ; add r1,sp,#4
 * i.e. FIVE of the six shipped stores were gone and the callee read garbage.
 * The original writes a two-element descriptor array:
 *     30c2a  strd r4,r1,[sp]      ; msgs[0] = { param_1, param_2 }
 *     30c38  strb r1,[sp,#8]      ; msgs[0].flags = 0
 *     30c2e  strd r2,r3,[sp,#12]  ; msgs[1] = { param_3, param_4 }
 *     30c3e  strb r3,[sp,#20]     ; msgs[1].flags = 7
 *     30c4c  blx api->transfer(dev, msgs, 2, 0x12)
 * Expressed as a real array the emitted frame is instruction-for-instruction
 * the original's (only the 0x20002418 address materialisation differs, because
 * our build reaches that global through a linker pin rather than a literal).
 *
 * flags 0 / 7 are I2C_MSG_WRITE and I2C_MSG_READ|STOP|RESTART, so this is the
 * write-then-read half of the ops table at 0x20002408; misc_dev_api_write_op12
 * (0x30c60) is the write-only half.
 */

struct g1_i2c_msg { unsigned char *buf; unsigned int len; unsigned char flags; };
typedef int (*fnptr)(unsigned int, struct g1_i2c_msg *, int, int);

int misc_dev_api_transfer_op12(unsigned char *param_1, unsigned int param_2,
                               unsigned char *param_3, unsigned int param_4)
{
  struct g1_i2c_msg msgs[2];
  int iVar1;
  unsigned int base;
  fnptr fp;
  msgs[0].buf = param_1;
  msgs[0].len = param_2;
  msgs[0].flags = 0;
  msgs[1].buf = param_3;
  msgs[1].len = param_4;
  msgs[1].flags = 7;
  base = *(volatile unsigned int *)((unsigned long)&g_misc_dev_handle_2418) /*=0x20002418*/;
  fp = *(fnptr *)(*(unsigned int *)(base + 8) + 8);
  iVar1 = fp(base, msgs, 2, 0x12);
  if (iVar1 != 0) iVar1 = 1;
  return -iVar1;
}

