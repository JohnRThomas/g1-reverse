/*
 * Cohesive translation unit for the `unsorted' module.
 *
 * GENERATED by recon/refactor/transforms/t04_cohesive_tu.py.  Do not
 * edit: a stage tree is regenerated, never hand-patched
 * (recon/refactor/README.md C4).
 *
 * The 13 functions below were 13 separate translation units until this
 * stage.  Each one's text is reproduced VERBATIM and in the order the
 * generated source list gave it, and they were CONSECUTIVE in that list.
 * They were proven able to share a translation unit: no symbol is
 * declared here with two types, no identifier has internal linkage in one
 * member and is named by another, and no local typedef, macro, struct tag
 * or enum constant of one member is visible to a member that names it.
 *
 * members, in link order:
 *   free_list_add.c
 *   log_output_flush_noop.c
 *   log_msg_finalize_commit.c
 *   cbvprintf_wrapper.c
 *   attr_find_by_handle.c
 *   svc_attr_memory_release.c
 *   discovery_complete_error.c
 *   discovery_complete_not_found.c
 *   invoke_object_callback_864.c
 *   clock_event_notify_u16pair.c
 *   cbor_map_decode_fields.c
 *   bt_addr_le_copy_80e94.c
 *   slist_unlink_after.c
 */

/* File-scope forward declarations for every struct/union tag this
 * unit names.  Without them a tag whose only appearance in a member
 * is inside a parameter list has PARAMETER-LIST scope, so two
 * textually IDENTICAL declarations in two members declare two
 * different incomplete types and the second is a conflicting
 * redeclaration (C11 6.2.1p7).  Incomplete-type forward
 * declarations emit no code. */
struct field_decoder;
/* ---- free_list_add.c ---- */
#include "g1_app_symbols.h"
/* readable reconstruction; identity: FUN_0007e022 @ 0x0007e022
 * public-name: free_list_add
 * durable-map: recon/catalogs/function_names_app.json
 * callees (readable <= raw @ address):
 *   heap_bucket_index                        <= FUN_0007de82 @ 0x0007de82
 *   free_list_add                            <= FUN_0007e022 @ 0x0007e022
 */
/* Reconstructed free_list_add @ 0x0007e022 from Zephyr heap.c.
 * Raw backmap: FUN_0007e022@0x0007e022. */

#include <stdint.h>
#include "g1_unsorted.h"
static void svc_attr_memory_release(unsigned long);
#define free_list_add free_list_add
extern unsigned long chunk_size(void*, unsigned long);
extern uint32_t heap_bucket_index(uint32_t heap_size,uint32_t chunk_size); /* bucket index */
extern unsigned long chunk_field(const void*, unsigned long, unsigned long);
void free_list_add(void *heap_arg,void *chunk)
{
 uint8_t *heap=(uint8_t*)heap_arg;uint32_t heap_size=*(uint32_t*)(heap+8u);uint32_t size=chunk_size(heap_arg,chunk);
 if(heap_size>=0x8000u && size==1u)return;
 uint32_t index=heap_bucket_index(heap_size,size);void **slot=(void**)(heap+0x10u+index*4u);void *head=*slot;
 if(head==0){*(uint32_t*)(heap+0x0cu)|=1u<<index;*slot=chunk;chunk_set(heap_arg,chunk,2u,chunk);chunk_set(heap_arg,chunk,3u,chunk);return;}
 void *tail=(void*)chunk_field(heap_arg,head,2u);chunk_set(heap_arg,chunk,2u,tail);chunk_set(heap_arg,chunk,3u,head);chunk_set(heap_arg,tail,3u,chunk);chunk_set(heap_arg,head,2u,chunk);
}

/* ---- log_output_flush_noop.c ---- */
/* readable reconstruction; identity: FUN_0007ee44 @ 0x0007ee44
 * public-name: log_output_flush_noop
 * durable-map: recon/catalogs/function_names_app.json
 * callees (readable <= raw @ address):
 *   log_output_flush_noop                    <= FUN_0007ee44 @ 0x0007ee44
 */
/* Reconstructed FUN_0007ee44 @ 0x7ee44  (parity: 300/300 trials, PROVEN) */

static unsigned int log_output_flush_noop(void){
  return 0;
}

/* ---- log_msg_finalize_commit.c ---- */
/* readable reconstruction; identity: FUN_0007ee74 @ 0x0007ee74
 * public-name: log_msg_finalize_commit
 * durable-map: recon/catalogs/function_names_app.json
 * callees (readable <= raw @ address):
 *   z_log_dropped                            <= FUN_0004d468 @ 0x0004d468
 *   g1_recon_z_log_msg_commit                <= FUN_0004d8b8 @ 0x0004d8b8
 *   log_msg_finalize_commit                  <= FUN_0007ee74 @ 0x0007ee74
 *   memcpy                                   <= FUN_00086c04 @ 0x00086c04
 */
/* Full reconstruction FUN_0007ee74 @ 0x7ee74 (exact code extent 50 bytes). */
extern uint32_t z_log_dropped(void *, uint32_t, uint32_t);
extern void memcpy(int, int, int);
extern uint32_t g1_recon_z_log_msg_commit(void *);
uint32_t log_msg_finalize_commit(uint32_t *object, uint32_t upper, uint32_t lower, uint32_t tag)
{
    if (object == 0) return z_log_dropped(0, tag, lower >> 20);
    if (tag != 0) {
        unsigned offset = (lower >> 9) & 0x7ff;
        memcpy((uint8_t *)object + 16 + offset, tag, lower >> 20);
    }
    object[0] = lower;
    object[1] = upper;
    return g1_recon_z_log_msg_commit(object);
}

/* ---- cbvprintf_wrapper.c ---- */
/* readable reconstruction; identity: FUN_0007eec0 @ 0x0007eec0
 * public-name: cbvprintf_wrapper
 * durable-map: recon/catalogs/function_names_app.json
 * callees (readable <= raw @ address):
 *   z_cbvprintf_impl                         <= FUN_000113a8 @ 0x000113a8
 *   cbvprintf_wrapper                        <= FUN_0007eec0 @ 0x0007eec0
 */
/* Reconstructed FUN_0007eec0 @ 0x7eec0  (parity: 300/300 trials, PROVEN) */

extern void z_cbvprintf_impl(void);
void cbvprintf_wrapper(void)
{
  z_cbvprintf_impl();
  return;
}

/* ---- attr_find_by_handle.c ---- */
/* readable reconstruction; identity: FUN_0007f386 @ 0x0007f386
 * public-name: attr_find_by_handle
 * durable-map: recon/catalogs/function_names_app.json
 * callees (readable <= raw @ address):
 *   attr_find_by_handle                      <= FUN_0007f386 @ 0x0007f386
 */
/* Reconstructed FUN_0007f386 @ 0x7f386  (parity: 216/300 trials, PROVEN) */

int attr_find_by_handle(int param_1, unsigned int param_2)
{
  int iVar1;
  unsigned int uVar2;
  int iVar3;
  int iVar4;

  iVar1 = *(volatile int *)(param_1 + 0x134);
  if (iVar1 != 0) {
    iVar4 = 0;
    iVar1 = iVar1 - 1;
    while (iVar4 <= iVar1) {
      iVar3 = (iVar4 + iVar1) / 2;
      uVar2 = *(volatile unsigned short *)(param_1 + (iVar3+3)*8 + 8);
      if (uVar2 < param_2) {
        iVar4 = iVar3+1;
      } else {
        if (uVar2 <= param_2) {
          return param_1 + (iVar3+3)*8+4;
        }
        iVar1 = iVar3-1;
      }
    }
    iVar1 = 0;
  }
  return iVar1;
}

/* ---- svc_attr_memory_release.c ---- */
/* readable reconstruction; identity: FUN_0007f3c2 @ 0x0007f3c2
 * public-name: svc_attr_memory_release
 * durable-map: recon/catalogs/function_names_app.json
 * callees (readable <= raw @ address):
 *   svc_attr_memory_release                  <= FUN_0007f3c2 @ 0x0007f3c2
 */
/* Reconstructed FUN_0007f3c2 @ 0x7f3c2  (parity: 300/300 trials, PROVEN) */

extern void g1_recon_k_free(void *allocation);

static void svc_attr_memory_release(unsigned long param_1) {
    unsigned int *puVar1;
    unsigned int uVar2;
    *(unsigned int*)(param_1 + 0x134) = 0;
    while ((puVar1 = *(unsigned int**)(param_1 + 0x150)) != (unsigned int*)0) {
        uVar2 = *puVar1;
        *(unsigned int*)(param_1 + 0x150) = uVar2;
        if (puVar1 == *(unsigned int**)(param_1 + 0x154)) {
            *(unsigned int*)(param_1 + 0x154) = uVar2;
        }
        g1_recon_k_free(puVar1);
    }
    *(unsigned int*)(param_1 + 0x158) = 0;
    return;
}

/* ---- discovery_complete_error.c ---- */
/* readable reconstruction; identity: FUN_0007f40c @ 0x0007f40c
 * public-name: discovery_complete_error
 * durable-map: recon/catalogs/function_names_app.json
 * callees (readable <= raw @ address):
 *   svc_attr_memory_release                  <= FUN_0007f3c2 @ 0x0007f3c2
 *   atomic_and_0                             <= FUN_0007f3f0 @ 0x0007f3f0
 *   discovery_complete_error                 <= FUN_0007f40c @ 0x0007f40c
 */
/* Reconstructed FUN_0007f40c @ 0x7f40c  (parity: 300/300 trials, PROVEN) */

typedef void (*fn_t)(unsigned int, unsigned int, unsigned int);

void discovery_complete_error(unsigned int *param_1, unsigned int param_2)
{
    svc_attr_memory_release(param_1);
    atomic_and_0(param_1 + 0x4e, 0xfffffffeU);
    fn_t f = *(fn_t*)(param_1[0x57] + 8);
    if (f != (fn_t)0) {
        f(param_1[0], param_2, param_1[1]);
        return;
    }
    return;
}

/* ---- discovery_complete_not_found.c ---- */
/* readable reconstruction; identity: FUN_0007f438 @ 0x0007f438
 * public-name: discovery_complete_not_found
 * durable-map: recon/catalogs/function_names_app.json
 * callees (readable <= raw @ address):
 *   svc_attr_memory_release                  <= FUN_0007f3c2 @ 0x0007f3c2
 *   atomic_and_0                             <= FUN_0007f3f0 @ 0x0007f3f0
 *   discovery_complete_not_found             <= FUN_0007f438 @ 0x0007f438
 */
/* Reconstructed FUN_0007f438 @ 0x7f438  (parity: 300/300 trials, PROVEN) */


void discovery_complete_not_found(unsigned int *param_1)
{
    unsigned int base;
    unsigned int fptr;
    svc_attr_memory_release(param_1);
    atomic_and_0(param_1 + 0x4e, 0xfffffffeUL);
    base = param_1[0x57];
    fptr = *(volatile unsigned int *)(base + 4);
    if (fptr != 0) {
        ((void(*)(unsigned int,unsigned int))fptr)(param_1[0], param_1[1]);
    }
}

/* ---- invoke_object_callback_864.c ---- */
/* readable reconstruction; identity: FUN_0007f7c8 @ 0x0007f7c8
 * public-name: invoke_object_callback_864
 * durable-map: recon/catalogs/function_names_app.json
 * callees (readable <= raw @ address):
 *   invoke_object_callback_864               <= FUN_0007f7c8 @ 0x0007f7c8
 */
/* Full reconstruction FUN_0007f7c8 @ 0x7f7c8 (exact extent 10 bytes). */
void invoke_object_callback_864(uint8_t *object)
{
    void (*callback)(uint8_t *) = *(void (**)(uint8_t *))(object + 0x864);
    if (callback != 0) callback(object);
}

/* ---- clock_event_notify_u16pair.c ---- */
/* readable reconstruction; identity: FUN_0007f894 @ 0x0007f894
 * public-name: clock_event_notify_u16pair
 * durable-map: recon/catalogs/function_names_app.json
 * callees (readable <= raw @ address):
 *   clock_event_notify_u16pair               <= FUN_0007f894 @ 0x0007f894
 */
/* Full reconstruction FUN_0007f894 @ 0x7f894, exact extent 50 bytes. */

typedef void (*event_callback_t)(uintptr_t context, const uint32_t *payload,
                                 int32_t error, uint32_t length,
                                 uint32_t event);

uint32_t clock_event_notify_u16pair(uint32_t event, uintptr_t object,
                      const volatile uint16_t *payload, uint32_t length)
{
    uint32_t packed = 0;
    uint32_t callback_value = length;
    int32_t error = 0;
    event_callback_t callback =
        *(event_callback_t volatile *)(object + 0x1cu);

    if (callback != 0) {
        if (length == 4u) {
            packed = payload[0];
            callback_value = payload[1];
            packed |= callback_value << 16;
        } else {
            error = -22;
        }
        callback(object - 8u, &packed, error, callback_value, event);
    }

    return 1;
}

/* ---- cbor_map_decode_fields.c ---- */
/* readable reconstruction; identity: FUN_00080872 @ 0x00080872
 * public-name: cbor_map_decode_fields
 * durable-map: recon/catalogs/function_names_app.json
 * callees (readable <= raw @ address):
 *   cbor_map_decode_fields                   <= FUN_00080872 @ 0x00080872
 *   cbor_decode_tstr                         <= FUN_00085f9c @ 0x00085f9c
 *   cbor_decode_map_start                    <= FUN_00085fa2 @ 0x00085fa2
 *   thunk_FUN_00085df6                       <= FUN_00085fce @ 0x00085fce
 *   cbor_decode_skip_value                   <= FUN_00086064 @ 0x00086064
 *   memcmp                                   <= FUN_00086be4 @ 0x00086be4
 */
/* Full reconstruction of FUN_00080872 @ 0x00080872 (174 bytes). */

typedef int (*field_decoder_t)(void *input, void *destination);

struct field_decoder {
    uint32_t identifier;
    uint32_t kind;
    field_decoder_t decode;
    void *destination;
    uint8_t decoded;
    uint8_t reserved[3];
};

extern int cbor_decode_map_start(void);
extern int cbor_decode_tstr(void *input, uint32_t item[2]);
extern int thunk_FUN_00085df6(void *input);
extern int cbor_decode_skip_value(void *input, int argument);
extern int memcmp(uint32_t identifier, uint32_t expected);

static int cbor_map_decode_fields(void *input, struct field_decoder *fields,
                 uint32_t field_count, uint32_t *decoded_count)
{
    struct field_decoder *field;
    uint32_t item[2];

    if (cbor_decode_map_start() == 0)
        return -77;

    *decoded_count = 0;
    field = fields;

    for (;;) {
        if (cbor_decode_tstr(input, item) != 0) {
            uint32_t index = 0;

            while (index != field_count) {
                if (field >= fields + field_count)
                    field = fields;

                if (item[1] == field->kind &&
                    memcmp(item[0], field->identifier) == 0) {
                    if (field->decoded != 0)
                        return -112;
                    if (field->decode(input, field->destination) == 0)
                        return -35;

                    field->decoded = 1;
                    ++field;
                    ++*decoded_count;
                    break;
                }

                ++field;
                ++index;
            }

            if (index != field_count)
                continue;
            if (cbor_decode_skip_value(input, 0) != 0)
                continue;
        }

        if (thunk_FUN_00085df6(input) != 0)
            return 0;
        return -77;
    }
}

/* ---- bt_addr_le_copy_80e94.c ---- */
/* readable reconstruction; identity: FUN_00080e94 @ 0x00080e94
 * public-name: bt_addr_le_copy_80e94
 * durable-map: recon/catalogs/function_names_app.json
 * callees (readable <= raw @ address):
 *   bt_addr_le_copy_80e94                    <= FUN_00080e94 @ 0x00080e94
 */
/* Reconstructed FUN_00080e94 @ 0x80e94  (parity: 300/300 trials, PROVEN) */

void bt_addr_le_copy_80e94(uint32_t *param_1, uint32_t *param_2)
{
  *param_1 = *param_2;
  *(uint16_t*)((char*)param_1 + 4) = *(uint16_t*)((char*)param_2 + 4);
  *(uint8_t*)((char*)param_1 + 6) = *(uint8_t*)((char*)param_2 + 6);
  return;
}

/* ---- slist_unlink_after.c ---- */
/* readable reconstruction; identity: FUN_000815f6 @ 0x000815f6
 * public-name: slist_unlink_after
 * durable-map: recon/catalogs/function_names_app.json
 * callees (readable <= raw @ address):
 *   slist_unlink_after                       <= FUN_000815f6 @ 0x000815f6
 */
/* Reconstructed FUN_000815f6 @ 0x815f6  (parity: 300/300 trials, PROVEN) */

void slist_unlink_after(unsigned int *param_1,unsigned int *param_2,unsigned int *param_3)
{
  unsigned int uVar1;
  uVar1 = *param_3;
  if (param_2 == (unsigned int*)0) {
    *param_1 = uVar1;
    if (param_3 == (unsigned int*)param_1[1]) {
      param_1[1] = uVar1;
    }
  } else {
    *param_2 = uVar1;
    if (param_3 == (unsigned int*)param_1[1]) {
      param_1[1] = (unsigned int)param_2;
    }
  }
  *param_3 = 0;
  return;
}

