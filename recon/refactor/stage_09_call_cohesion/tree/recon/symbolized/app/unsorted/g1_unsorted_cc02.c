/*
 * Call-cohesive translation unit for the `unsorted' module.
 *
 * GENERATED by recon/refactor/transforms/t09_call_cohesion.py.  Do
 * not edit: a stage tree is regenerated, never hand-patched
 * (recon/refactor/README.md C4).
 *
 * The 2 translation units below were grouped because they CALL ONE
 * ANOTHER, not because they were adjacent in the generated source
 * list.  Each member's text is reproduced VERBATIM.  Every member was
 * checked pairwise against every other member already in this unit by
 * stage 04's seven refusal rules, unchanged: no symbol is declared
 * here with two types, no identifier has internal linkage in one
 * member and is named by another, and no local typedef, macro, struct
 * tag or enum constant of one member is visible to a member that
 * names it.
 *
 * members, in generated-source-list order:
 *   g1_unsorted_11.c
 *   g1_unsorted_15.c
 *
 * call edges inside this unit (caller -> callee): 1
 *   g1_unsorted_11.c -> g1_unsorted_15.c
 */

/* File-scope forward declarations for every struct/union tag this
 * unit names.  Without them a tag whose only appearance in a member
 * is inside a parameter list has PARAMETER-LIST scope, so two
 * textually IDENTICAL declarations in two members declare two
 * different incomplete types and the second is a conflicting
 * redeclaration (C11 6.2.1p7).  Incomplete-type forward
 * declarations emit no code. */
struct _reent;
struct k_heap;
/* ================================================================ */
/* member unit: g1_unsorted_11.c */
/* ================================================================ */
/*
 * Cohesive translation unit for the `unsorted' module.
 *
 * GENERATED by recon/refactor/transforms/t04_cohesive_tu.py.  Do not
 * edit: a stage tree is regenerated, never hand-patched
 * (recon/refactor/README.md C4).
 *
 * The 11 functions below were 11 separate translation units until this
 * stage.  Each one's text is reproduced VERBATIM and in the order the
 * generated source list gave it, and they were CONSECUTIVE in that list.
 * They were proven able to share a translation unit: no symbol is
 * declared here with two types, no identifier has internal linkage in one
 * member and is named by another, and no local typedef, macro, struct tag
 * or enum constant of one member is visible to a member that names it.
 *
 * members, in link order:
 *   rtc_get_elapsed_cycles_since_baseline.c
 *   strtol_r.c
 *   get_static_ctx_ptr.c
 *   lseek_r_capture_errno.c
 *   scanf_convert_integer_field.c
 *   local_esbs_ctrl_ipc_service_recv.c
 *   wlccap_record_value_len.c
 *   wlcstai_record_value_len.c
 *   FUN_0007c86c.c
 *   dev_api_call_slot0.c
 *   nfc_link_ops_noop.c
 */
/* ---- rtc_get_elapsed_cycles_since_baseline.c ---- */
#include "g1_app_symbols.h"
#include <stdint.h>
/* readable reconstruction; identity: FUN_00074b68 @ 0x00074b68
 * public-name: rtc_get_elapsed_cycles_since_baseline
 * durable-map: recon/catalogs/function_names_app.json
 * callees (readable <= raw @ address):
 *   rtc_read_extended_cycle_count            <= FUN_00063610 @ 0x00063610
 *   rtc_get_elapsed_cycles_since_baseline    <= FUN_00074b68 @ 0x00074b68
 * address symbols (name @ address):
 *   g_rtc_elapsed_calc_disabled_flag         @ 0x2000b494
 */
/* Reconstructed FUN_00074b68 @ 0x74b68  (parity: 300/300 trials, PROVEN) */

extern int rtc_read_extended_cycle_count(void);
int rtc_get_elapsed_cycles_since_baseline(void)
{
  if (*(volatile unsigned int *)((unsigned long)&g_rtc_elapsed_calc_disabled_flag) /*=0x2000b494*/ == 0) {
    return rtc_read_extended_cycle_count();
  }
  return 0;
}

/* ---- strtol_r.c ---- */
/* readable reconstruction; identity: FUN_00077a28 @ 0x00077a28
 * public-name: strtol_r
 * durable-map: recon/catalogs/function_names_app.json
 * callees (readable <= raw @ address):
 *   strtol_r                                 <= FUN_00077a28 @ 0x00077a28
 *   thunk_FUN_00071678                       <= FUN_000807f2 @ 0x000807f2
 * address symbols (name @ address):
 *   rodata_f8a6b                             @ 0x000f8a6b
 */
/* Reconstructed FUN_00077a28 @ 0x00077a28 (_strtol_r).
 * Exact configured newlib owner; extent 0x000000f8.
 */
extern int *thunk_FUN_00071678(void); /* __errno */

long strtol_r(int *reent, const char *text, char **end, int base)
{
    const uint8_t *classes = (const uint8_t *)((unsigned long)&rodata_f8a6b) /*=0xf8a6b*/;
    const uint8_t *scan = (const uint8_t *)text;
    uint32_t value = 0;
    int any = 0;
    int negative = 0;
    int character;
    if ((unsigned)base > 36U || base == 1) {
        *thunk_FUN_00071678() = 22;
        return 0;
    }
    do character = *scan++; while ((classes[character] & 8U) != 0U);
    if (character == '-') {
        negative = 1;
        character = *scan++;
    } else if (character == '+') {
        character = *scan++;
    }
    if ((base == 0 || base == 16) && character == '0' &&
        ((*scan & 0xdfU) == 'X')) {
        character = scan[1];
        scan += 2;
        base = 16;
    }
    if (base == 0) base = character == '0' ? 8 : 10;
    uint32_t limit = negative ? 0x80000000U : 0x7fffffffU;
    uint32_t cutoff = limit / (uint32_t)base;
    uint32_t cutlim = limit % (uint32_t)base;
    for (;;) {
        int digit;
        if (character >= '0' && character <= '9') digit = character - '0';
        else if (character >= 'A' && character <= 'Z') digit = character - 'A' + 10;
        else if (character >= 'a' && character <= 'z') digit = character - 'a' + 10;
        else break;
        if (digit >= base) break;
        if (any < 0 || value > cutoff ||
            (value == cutoff && (uint32_t)digit > cutlim)) any = -1;
        else { any = 1; value = value * (uint32_t)base + (uint32_t)digit; }
        character = *scan++;
    }
    if (any < 0) {
        value = limit;
        *reent = 34;
    } else if (negative) {
        value = 0U - value;
    }
    if (end != 0)
        *end = (char *)(any != 0 ? scan - 1 : (const uint8_t *)text);
    return (long)value;
}

/* ---- get_static_ctx_ptr.c ---- */
/* readable reconstruction; identity: FUN_00078590 @ 0x00078590
 * public-name: get_static_ctx_ptr
 * durable-map: recon/catalogs/function_names_app.json
 * callees (readable <= raw @ address):
 *   get_static_ctx_ptr                       <= FUN_00078590 @ 0x00078590
 * address symbols (name @ address):
 *   g_misc_static_ctx_ptr                    @ 0x20002e74
 */
/* Reconstructed FUN_00078590 @ 0x78590  (parity: 300/300 trials, PROVEN) */

static unsigned int get_static_ctx_ptr(void){
  return ((unsigned long)&g_misc_static_ctx_ptr) /*=0x20002e74*/;
}

/* ---- lseek_r_capture_errno.c ---- */
/* readable reconstruction; identity: FUN_00078598 @ 0x00078598
 * public-name: lseek_r_capture_errno
 * durable-map: recon/catalogs/function_names_app.json
 * callees (readable <= raw @ address):
 *   lseek                                    <= FUN_0004b17c @ 0x0004b17c
 *   lseek_r_capture_errno                    <= FUN_00078598 @ 0x00078598
 * address symbols (name @ address):
 *   g_errno                                  @ 0x2000cc24
 */
/* Reconstructed FUN_00078598 @ 0x78598  (parity: 300/300 trials, PROVEN) */

extern int lseek(unsigned int,unsigned int,unsigned int,unsigned int,unsigned int);
void lseek_r_capture_errno(int *param_1,unsigned int param_2,unsigned int param_3,unsigned int param_4)
{
  int *piVar1;
  int iVar2;
  piVar1 = (int*)((unsigned long)&g_errno) /*=0x2000cc24*/;
  *(volatile int *)((unsigned long)&g_errno) /*=0x2000cc24*/ = 0;
  iVar2 = lseek(param_2,param_3,param_4,param_4,param_4);
  if ((iVar2 == -1) && (*(volatile int *)piVar1 != 0)) {
    *param_1 = *(volatile int *)piVar1;
  }
  return;
}

/* ---- scanf_convert_integer_field.c ---- */
/* readable reconstruction; identity: FUN_0007932c @ 0x0007932c
 * public-name: scanf_convert_integer_field
 * durable-map: recon/catalogs/function_names_app.json
 * callees (readable <= raw @ address):
 *   scanf_convert_integer_field              <= FUN_0007932c @ 0x0007932c
 *   mem_find_byte                            <= FUN_00086bc8 @ 0x00086bc8
 *   fnmatch_build_class_table                <= FUN_0008789c @ 0x0008789c
 * address symbols (name @ address):
 *   rodata_885b0                             @ 0x000885b0
 */
/* Reconstructed FUN_0007932c @ 0x7932c  (parity: 300/300 trials, PROVEN) */
typedef uint32_t u32;
typedef unsigned char byte;
typedef u32 (*fn)(u32,...);
extern char* mem_find_byte(char*, unsigned int, int);
extern unsigned char* fnmatch_build_class_table(int, unsigned char*);

u32 scanf_convert_integer_field(u32 param_1, u32 *param_2, int *param_3, u32 *param_4){
    int iVar1; u32 uVar2; u32 uVar4; byte *pbVar5; u32 uVar6;
    u32 *puVar7; u32 *puVar8; u32 *puVar9; int iVar10; u32 *puVar11; int iVar12;
    u32 local_34[4];
    fn pcVar3;

    iVar12 = 0;
    local_34[0] = ((volatile u32*)((unsigned long)&rodata_885b0) /*=0x885b0*/)[0];
    local_34[1] = ((volatile u32*)((unsigned long)&rodata_885b0) /*=0x885b0*/)[1];
    local_34[2] = ((volatile u32*)((unsigned long)&rodata_885b0) /*=0x885b0*/)[2];
    pcVar3 = (fn)0x8712bUL;
    if (param_2[6] == 3) pcVar3 = (fn)0x87127UL;
    uVar6 = param_2[2];
    uVar4 = uVar6 - 1;
    if (uVar4 < 0x15d) iVar10 = 0;
    else { iVar10 = uVar6 - 0x15d; uVar6 = 0x15d; }
    if (0x15c < uVar4) param_2[2] = uVar6;
    puVar9 = param_2 + 7;
    *param_2 = *param_2 | 0xd00;
    puVar11 = puVar9;
  LAB_00079384:
    do {
        iVar1 = mem_find_byte(local_34[iVar12], *(byte*)(uintptr_t)*param_3, 2);
        puVar8 = puVar11;
        if (iVar1 != 0) {
            if (iVar12 == 1) {
                if (param_2[1] == 0) { param_2[1] = 8; *param_2 = *param_2 | 0x200; }
                *param_2 = *param_2 & 0xfffffaff;
                uVar4 = param_2[2]; param_2[2] = uVar4 - 1;
                if (uVar4 == 0) { iVar12 = 2; goto LAB_00079384; }
            } else if (iVar12 == 2) {
                if ((*param_2 & 0x600) != 0x200) break;
                *param_2 = *param_2 | 0x100;
                uVar4 = param_2[2]; param_2[1] = 0x10; param_2[2] = uVar4 - 1;
                if (uVar4 == 0) break;
            } else {
                uVar4 = param_2[2]; param_2[2] = uVar4 - 1;
                if (uVar4 == 0) { iVar12 = 1; goto LAB_00079384; }
            }
            pbVar5 = (byte*)(uintptr_t)*param_3;
            *param_3 = (int)(uintptr_t)(pbVar5 + 1);
            puVar8 = (u32*)((char*)puVar11 + 1);
            *(byte*)puVar11 = *pbVar5;
            iVar1 = param_3[1]; param_3[1] = iVar1 - 1;
            if ((iVar1 - 1 < 1) && (iVar1 = ((fn)(uintptr_t)param_2[0x60])(param_1, (u32)(uintptr_t)param_3), iVar1 != 0)) {
                iVar12 = 0; goto LAB_000794a0;
            }
        }
        iVar12 = iVar12 + 1;
        puVar11 = puVar8;
    } while (iVar12 != 3);
    if (param_2[1] == 0) param_2[1] = 10;
    iVar12 = 0;
    fnmatch_build_class_table(param_2[5], 0xf8d5aUL - param_2[1]);
    while (1) {
        puVar8 = puVar11;
        if (param_2[2] == 0) break;
        pbVar5 = (byte*)(uintptr_t)*param_3;
        uVar4 = (u32)*pbVar5;
        if (*(char*)(uintptr_t)(param_2[5] + uVar4) == '\0') break;
        if ((uVar4 == 0x30) && ((int)(*param_2 << 0x14) < 0)) {
            iVar12 = iVar12 + 1;
            if (iVar10 != 0) { iVar10 = iVar10 - 1; param_2[2] = param_2[2] + 1; }
        } else {
            *param_2 = *param_2 & 0xfffff6ff;
            puVar8 = (u32*)((char*)puVar11 + 1);
            *(byte*)puVar11 = *pbVar5;
        }
        iVar1 = param_3[1]; param_3[1] = iVar1 - 1;
        if (iVar1 - 1 < 1) {
            iVar1 = ((fn)(uintptr_t)param_2[0x60])(param_1, (u32)(uintptr_t)param_3);
            if (iVar1 != 0) break;
        } else {
            *param_3 = *param_3 + 1;
        }
        param_2[2] = param_2[2] - 1;
        puVar11 = puVar8;
    }
  LAB_000794a0:
    puVar11 = puVar8;
    if ((int)(*param_2 << 0x17) < 0) {
        if (puVar9 < puVar8) {
            puVar11 = (u32*)((char*)puVar8 - 1);
            ((fn)(uintptr_t)param_2[0x5f])(param_1, (u32)*(byte*)((char*)puVar8 - 1), (u32)(uintptr_t)param_3);
        }
        if (puVar11 == puVar9) return 1;
    }
    if ((*param_2 & 0x10) == 0) {
        *(byte*)puVar11 = 0;
        uVar2 = pcVar3(param_1, (u32)(uintptr_t)puVar9, 0, param_2[1]);
        puVar7 = (u32*)(uintptr_t)*param_4;
        uVar4 = *param_2;
        *param_4 = (u32)(uintptr_t)(puVar7 + 1);
        puVar7 = (u32*)(uintptr_t)*puVar7;
        if ((uVar4 & 0x20) == 0) {
            if ((int)(uVar4 << 0x1f) < 0) *(short*)puVar7 = (short)uVar2;
            else *puVar7 = uVar2;
        } else {
            *puVar7 = uVar2;
        }
        param_2[3] = param_2[3] + 1;
    }
    param_2[4] = (u32)((int)(uintptr_t)puVar11 + param_2[4] + (iVar12 - (int)(uintptr_t)puVar9));
    return 0;
}

/* ---- local_esbs_ctrl_ipc_service_recv.c ---- */
/* readable reconstruction; identity: FUN_0007c00c @ 0x0007c00c
 * public-name: local_esbs_ctrl_ipc_service_recv
 * durable-map: recon/catalogs/function_names_app.json
 */
/* Reconstructed local_esbs_ctrl_ipc_service_recv @ 0x7c00c
 * (uncatalogued 4-byte Ghidra gap 0x7c00c..0x7c010: "movs r0,#0; bx lr").
 *
 * Handler registered by main() for the IPC service id 5
 * ("cpunet-esbs-ctrl"); dispatched from ipc0_ept_recv as
 * handler(context, data + 1, length - 1).  The shipped body ignores every
 * argument and reports success.
 */
int local_esbs_ctrl_ipc_service_recv(void *context, const void *packet,
                                     int length)
{
    (void)context;
    (void)packet;
    (void)length;
    return 0;
}

/* ---- wlccap_record_value_len.c ---- */
/* readable reconstruction; identity: FUN_0007c38a @ 0x0007c38a
 * public-name: wlccap_record_value_len
 * durable-map: recon/catalogs/function_names_app.json
 * callees (readable <= raw @ address):
 *   wlccap_record_value_len                  <= FUN_0007c38a @ 0x0007c38a
 */
/* Reconstructed FUN_0007c38a @ 0x7c38a  (exact extent 14 bytes)
 *
 * P4 iteration 40.  Ghidra never catalogued this leaf: its only reference in
 * the whole image is the literal 0x0007c38b stored into offset +4 of the
 * type-7 (WLCCAP) NDEF record by event_record_init (0x25090), i.e. it is the
 * record's `value_len` op.  opt_node_value_len (0x7c408) reaches it with
 *     0007c40c  ldr r0, [r0, #0x14]   ; the record
 *     0007c410  ldr r2, [r0, #4]
 *     0007c414  bx  r2                ; r0 = the record
 * so the single argument is the record itself.
 *
 * Shipped bytes:
 *     0007c38a  20b1      cbz   r0, #0x7c396
 *     0007c38c  0378      ldrb  r3, [r0]
 *     0007c38e  072b      cmp   r3, #7
 *     0007c390  0cbf      ite   eq
 *     0007c392  0620      moveq r0, #6
 *     0007c394  0020      movne r0, #0
 *     0007c396  7047      bx    lr
 * The NULL path falls into the same `bx lr` with r0 still 0, so a NULL record
 * and a wrong-type record both answer 0.  6 is the fixed WLCCAP payload
 * length (control byte + 5 capability bytes; see the six-way iterator
 * FUN_00024a40 that walks exactly six fragments).
 */

unsigned int wlccap_record_value_len(unsigned char *param_1)
{
  if (param_1 == 0) {
    return 0;
  }
  return (*param_1 == 7) ? 6 : 0;
}

/* ---- wlcstai_record_value_len.c ---- */
/* readable reconstruction; identity: FUN_0007c39c @ 0x0007c39c
 * public-name: wlcstai_record_value_len
 * durable-map: recon/catalogs/function_names_app.json
 * callees (readable <= raw @ address):
 *   wlcstai_record_value_len                 <= FUN_0007c39c @ 0x0007c39c
 */
/* Reconstructed FUN_0007c39c @ 0x7c39c  (exact extent 38 bytes)
 *
 * P4 iteration 40.  Catalog-missing sibling of FUN_0007c38a: the `value_len`
 * op of the type-8 (WLCSTAI) NDEF record, installed as the literal 0x0007c39d
 * at offset +4 by fill_record_type8 (0x250c4).  Same call site
 * (opt_node_value_len, 0x7c408, `bx r2` with r0 = the record).
 *
 * Shipped bytes:
 *     0007c39c  cbz    r0, #0x7c3c0        ; NULL -> r0 is already 0
 *     0007c39e  ldrb   r3, [r0]
 *     0007c3a0  cmp    r3, #8
 *     0007c3a2  bne    #0x7c3be            ; wrong type -> 0
 *     0007c3a4  ldrb   r2, [r0, #0x10]     ; the presence bitmap
 *     0007c3a6  movs   r3, #0
 *     0007c3a8  movs   r0, #1              ; the mandatory control byte
 *     0007c3aa  lsr.w  r1, r2, r3
 *     0007c3ae  lsls   r1, r1, #0x1f       ; N = bit r3 of the bitmap
 *     0007c3b0  add.w  r3, r3, #1
 *     0007c3b4  it     mi
 *     0007c3b6  addmi  r0, #1
 *     0007c3b8  cmp    r3, #8
 *     0007c3ba  bne    #0x7c3aa
 *     0007c3bc  bx     lr
 * i.e. the WLCSTAI payload is 1 + popcount(record[0x10]) bytes, which is
 * exactly the fragment count FUN_00024ad8 emits (the control byte plus one
 * byte per set presence bit).
 */

unsigned int wlcstai_record_value_len(unsigned char *param_1)
{
  unsigned int uVar1;
  unsigned int uVar2;
  unsigned int uVar3;

  if (param_1 == 0) {
    return 0;
  }
  if (*param_1 != 8) {
    return 0;
  }
  uVar1 = param_1[0x10];
  uVar2 = 1;
  uVar3 = 0;
  do {
    if ((uVar1 >> uVar3) & 1) {
      uVar2 = uVar2 + 1;
    }
    uVar3 = uVar3 + 1;
  } while (uVar3 != 8);
  return uVar2;
}

/* ---- FUN_0007c86c.c ---- */
/* readable reconstruction; identity: FUN_0007c86c @ 0x0007c86c
 * public-name: FUN_0007c86c
 * durable-map: recon/catalogs/function_names_app.json
 * callees (readable <= raw @ address):
 *   (none)
 * address symbols (name @ address):
 *   (none)
 *
 * Ghidra function-catalog gap (iteration 10): the catalog stops
 * FUN_0007c85e (ipc_transport_ops_dispatch) at 0x0007c86c and resumes at the
 * thunk 0x0007c872, leaving these 6 bytes unowned.  Reconstructed from the
 * image:
 *   7c86c  ldr r3, [r0, #4]
 *   7c86e  ldr r0, [r3, #0xc]
 *   7c870  bx  lr
 * i.e. `return descriptor->i2c_spec->page_size`, where descriptor is the
 * ST25DV descriptor at g_st25dv_i2c_cfg (whose +4 is set to
 * &g_st25dv_i2c_dev and whose +0xc is set to 0x1000 by
 * serialization_ipc_ept_register).  It is the THIRD entry of the 3-word ops
 * vtable at rodata_88a38, reached from st25dv_read_chip_ids as
 *   (*(void (**)(void))(*(int *)(descriptor + 8) + 8))().
 * Proof: recon_kit.prove pass=True checked=300 cfg_status=PASS;
 * tools/cfg_verify.py app FUN_0007c86c -> PASS cases=0 (straight-line body,
 * no branch or switch selector exists to drive).
 */
/* Reconstructed FUN_0007c86c @ 0x7c86c */

unsigned int FUN_0007c86c(int param_1)
{
    return *(volatile unsigned int *)(*(volatile int *)(param_1 + 4) + 0xc);
}

/* ---- dev_api_call_slot0.c ---- */
/* readable reconstruction; identity: FUN_0007ca54 @ 0x0007ca54
 * public-name: dev_api_call_slot0
 * durable-map: recon/catalogs/function_names_app.json
 * callees (readable <= raw @ address):
 *   dev_api_call_slot0                       <= FUN_0007ca54 @ 0x0007ca54
 */
/* Reconstructed FUN_0007ca54 @ 0x7ca54  (parity: 300/300 trials, PROVEN) */

typedef unsigned int (*fnptr)(int, unsigned int, unsigned int, unsigned int);

unsigned int dev_api_call_slot0(int param_1, unsigned int param_2, unsigned int param_3)
{
  unsigned int uVar1;
  volatile unsigned int * volatile vtab = *(volatile unsigned int * volatile *)(param_1 + 8);
  fnptr f = (fnptr)vtab[0];

  if (f != (fnptr)0) {
    uVar1 = f(param_1,param_2,0,param_3);
    return uVar1;
  }
  return 0xffffffa8;
}

/* ---- nfc_link_ops_noop.c ---- */
/* readable reconstruction; identity: FUN_0007d0c0 @ 0x0007d0c0
 * public-name: nfc_link_ops_noop
 * durable-map: recon/catalogs/function_names_app.json
 */
/* Reconstructed nfc_link_ops_noop @ 0x7d0c0 (uncatalogued: Ghidra folded it
 * into the tail of read_rtc_counter_ms, 0x7d0aa, declared size 0x3a).
 * Iteration 17.
 *
 * The shipped bytes are exactly two: `4770  bx lr` -- a no-op leaf.  It is
 * slot 2 of the ops table the shipped `.data` places at 0x20002408, whose four
 * function pointers `pt_nfc_eeprom_link_init` (0x30b3c) requires to be
 * non-zero; that `.data` word is the table's only referrer in the image.
 *
 * PROOF: the compiled .text is `4770`, byte-identical to the shipped 0x7d0c0.
 */

void nfc_link_ops_noop(void)
{
}

/* ================================================================ */
/* member unit: g1_unsorted_15.c */
/* ================================================================ */
/*
 * Cohesive translation unit for the `unsorted' module.
 *
 * GENERATED by recon/refactor/transforms/t04_cohesive_tu.py.  Do not
 * edit: a stage tree is regenerated, never hand-patched
 * (recon/refactor/README.md C4).
 *
 * The 14 functions below were 14 separate translation units until this
 * stage.  Each one's text is reproduced VERBATIM and in the order the
 * generated source list gave it, and they were CONSECUTIVE in that list.
 * They were proven able to share a translation unit: no symbol is
 * declared here with two types, no identifier has internal linkage in one
 * member and is named by another, and no local typedef, macro, struct tag
 * or enum constant of one member is visible to a member that names it.
 *
 * members, in link order:
 *   cbor_finalize_backup_count.c
 *   thunk_FUN_00085df6.c
 *   FUN_000861aa.c
 *   thunk_FUN_00086320.c
 *   thunk_FUN_00086354.c
 *   FUN_00086380.c
 *   net_pkt_skip.c
 *   add_event.c
 *   g1_recon_k_free.c
 *   sqrtf_hw.c
 *   foreach_attr_entry_invoke_callback.c
 *   mem_find_byte.c
 *   dynbuf_push_byte_grow.c
 *   coredep_delay_cycles.c
 */

/* File-scope forward declarations for every struct/union tag this
 * unit names.  Without them a tag whose only appearance in a member
 * is inside a parameter list has PARAMETER-LIST scope, so two
 * textually IDENTICAL declarations in two members declare two
 * different incomplete types and the second is a conflicting
 * redeclaration (C11 6.2.1p7).  Incomplete-type forward
 * declarations emit no code. */
struct _reent;
struct k_heap;
/* ---- cbor_finalize_backup_count.c ---- */
#include "g1_app_symbols.h"
/* readable reconstruction; identity: FUN_00085c26 @ 0x00085c26
 * public-name: cbor_finalize_backup_count
 * durable-map: recon/catalogs/function_names_app.json
 * callees (readable <= raw @ address):
 *   cbor_decoder_at_end                      <= FUN_00085c12 @ 0x00085c12
 *   cbor_finalize_backup_count               <= FUN_00085c26 @ 0x00085c26
 */
/* Reconstructed FUN_00085c26 @ 0x85c26  (parity: 300/300 trials, PROVEN) */

extern unsigned long long cbor_decoder_at_end(int a);

static void cbor_finalize_backup_count(int param_1)
{
    int iVar1 = *(int *)(param_1 + 0x14);
    unsigned long long uVar2 = cbor_decoder_at_end(iVar1);
    if ((int)uVar2 != 0 && iVar1 != 0) {
        *(int *)(iVar1 + 0xc) = (int)(uVar2 >> 32);
    }
}

/* ---- thunk_FUN_00085df6.c ---- */
/* readable reconstruction; identity: FUN_00085fce @ 0x00085fce
 * public-name: thunk_FUN_00085df6
 * durable-map: recon/catalogs/function_names_app.json
 * callees (readable <= raw @ address):
 *   cbor_decode_leave_container              <= FUN_00085df6 @ 0x00085df6
 */
/* Tail thunk @ 0x85fce. */
extern int cbor_decode_leave_container(int,int,int,int); int thunk_FUN_00085df6(int a,int b,int c,int d){return cbor_decode_leave_container(a,b,c,d);}

/* ---- FUN_000861aa.c ---- */
/* readable reconstruction; identity: FUN_000861aa @ 0x000861aa
 * public-name: FUN_000861aa
 * durable-map: recon/catalogs/function_names_app.json
 * callees (readable <= raw @ address):
 *   buffer_pool_freelist_init                <= FUN_00085cf2 @ 0x00085cf2
 */
/* Tail thunk @ 0x861aa. */
extern int buffer_pool_freelist_init(int,int,int,int); static int thunk_FUN_00085cf2_a(int a,int b,int c,int d){return buffer_pool_freelist_init(a,b,c,d);}

/* ---- thunk_FUN_00086320.c ---- */
/* readable reconstruction; identity: FUN_00086334 @ 0x00086334
 * public-name: thunk_FUN_00086320
 * durable-map: recon/catalogs/function_names_app.json
 * callees (readable <= raw @ address):
 *   cbor_encode_uint32                       <= FUN_00086320 @ 0x00086320
 */
/* Tail thunk @ 0x86334. */
extern int cbor_encode_uint32(int,int,int,int); static int thunk_FUN_00086320(int a,int b,int c,int d){return cbor_encode_uint32(a,b,c,d);}

/* ---- thunk_FUN_00086354.c ---- */
/* readable reconstruction; identity: FUN_0008635c @ 0x0008635c
 * public-name: thunk_FUN_00086354
 * durable-map: recon/catalogs/function_names_app.json
 * callees (readable <= raw @ address):
 *   cbor_encode_break                        <= FUN_00086354 @ 0x00086354
 */
/* Tail thunk @ 0x8635c. */
extern int cbor_encode_break(int,int,int,int); static int thunk_FUN_00086354(int a,int b,int c,int d){return cbor_encode_break(a,b,c,d);}

/* ---- FUN_00086380.c ---- */
/* readable reconstruction; identity: FUN_00086380 @ 0x00086380
 * public-name: FUN_00086380
 * durable-map: recon/catalogs/function_names_app.json
 * callees (readable <= raw @ address):
 *   buffer_pool_freelist_init                <= FUN_00085cf2 @ 0x00085cf2
 */
/* Tail thunk @ 0x86380. */
extern int buffer_pool_freelist_init(int,int,int,int); static int thunk_FUN_00085cf2_b(int a,int b,int c,int d){return buffer_pool_freelist_init(a,b,c,d);}

/* ---- net_pkt_skip.c ---- */
/* readable reconstruction; identity: FUN_00086502 @ 0x00086502
 * public-name: net_pkt_skip
 * durable-map: recon/catalogs/function_names_app.json
 * callees (readable <= raw @ address):
 *   k_queue_insert_and_wake                  <= FUN_00072674 @ 0x00072674
 *   net_pkt_skip                             <= FUN_00086502 @ 0x00086502
 */
/* Reconstructed FUN_00086502 @ 0x86502  (parity: 300/300 trials, PROVEN) */

extern void k_queue_insert_and_wake(unsigned int, unsigned int, unsigned int, unsigned int, unsigned int, unsigned int, unsigned int);

void net_pkt_skip(unsigned int param_1, unsigned int param_2, unsigned int param_3)
{
    k_queue_insert_and_wake(param_1, 0, param_2, 0, 1, param_2, param_3);
}

/* ---- add_event.c ---- */
/* readable reconstruction; identity: FUN_00086778 @ 0x00086778
 * public-name: add_event
 * durable-map: recon/catalogs/function_names_app.json
 * callees (readable <= raw @ address):
 *   add_event                                <= FUN_00086778 @ 0x00086778
 */
/* CPUAPP Zephyr poll add_event @ 0x00086778.
 * Raw/address back-map: FUN_00086778 / 0x00086778.
 */
#include <stdint.h>
extern int z_sched_prio_cmp(void *, void *); /* FUN_00086622 */
#define add_event add_event

void add_event(uint32_t *events, uint32_t *event_node, uint8_t *poller)
{
    uint32_t *tail = (uint32_t *)(uintptr_t)events[1];
    if ((uint32_t *)(uintptr_t)events[0] != events && tail != 0) {
        uint8_t *pending_poller = *(uint8_t **)((uint8_t *)tail + 8);
        if (pending_poller != 0) pending_poller -= 0x60;
        if (z_sched_prio_cmp(pending_poller, poller - 0x60) <= 0) {
            uint32_t *pending = (uint32_t *)(uintptr_t)events[0];
            while (pending != 0 && pending != events) {
                uint8_t *p = *(uint8_t **)((uint8_t *)pending + 8);
                if (p != 0) p -= 0x60;
                if (z_sched_prio_cmp(poller - 0x60, p) > 0) {
                    uint32_t *next = (uint32_t *)(uintptr_t)pending[1];
                    event_node[0] = (uint32_t)(uintptr_t)pending;
                    event_node[1] = (uint32_t)(uintptr_t)next;
                    next[0] = (uint32_t)(uintptr_t)event_node;
                    pending[1] = (uint32_t)(uintptr_t)event_node;
                    return;
                }
                if (pending == (uint32_t *)(uintptr_t)events[1]) break;
                pending = (uint32_t *)(uintptr_t)pending[0];
            }
        }
    }
    tail = (uint32_t *)(uintptr_t)events[1];
    event_node[0] = (uint32_t)(uintptr_t)events;
    event_node[1] = (uint32_t)(uintptr_t)tail;
    tail[0] = (uint32_t)(uintptr_t)event_node;
    events[1] = (uint32_t)(uintptr_t)event_node;
}

/* ---- g1_recon_k_free.c ---- */
/* readable reconstruction; identity: FUN_000868b4 @ 0x000868b4
 * public-name: g1_recon_k_free
 * durable-map: recon/catalogs/function_names_app.json
 * callees (readable <= raw @ address):
 *   k_heap_free                              <= FUN_00071b2c @ 0x00071b2c
 */
/* Reconstructed g1_recon_k_free @ 0x000868b4.
 * Raw backmap: FUN_000868b4@0x000868b4. */

#define k_heap_free k_heap_free
extern void k_heap_free(struct k_heap *, void *);

void g1_recon_k_free(void *allocation)
{
    unsigned char *header;

    if (allocation == 0) {
        return;
    }
    header = (unsigned char *)allocation - 4;
    k_heap_free(*(void **)header, header);
}

/* ---- sqrtf_hw.c ---- */
/* readable reconstruction; identity: FUN_000869c6 @ 0x000869c6
 * public-name: sqrtf_hw
 * durable-map: recon/catalogs/function_names_app.json
 * callees (readable <= raw @ address):
 *   sqrtf_hw                                 <= FUN_000869c6 @ 0x000869c6
 */
/* Full reconstruction FUN_000869c6 @ 0x869c6 (exact 6-byte extent). */
/* The shipped body is exactly six bytes at 0x869c6:
 *     eeb1 0ac0    vsqrt.f32 s0, s0
 *     4770         bx lr
 * `__builtin_sqrtf` cannot express that here: with GCC's default
 * -fmath-errno the built-in is lowered to a CALL to `sqrtf`, and our `sqrtf`
 * (0x75dc8) calls `sqrtf_hw` -- so the emitted pair was an infinite mutual
 * recursion.  MEASURED in iteration 15 (build g1-i15a, 2.0 s run): each cycle
 * pushed 16 bytes at pc 0x47b68/0x47b6c (`push {r3,lr}` + `vpush {d8}`,
 * lr = 0x47b77) until SP walked below 0x20000000, after which the exception
 * return unstacked PC = 0 -> z_arm_usage_fault -> z_fatal_error ->
 * sys_arch_reboot.  The inline VSQRT below is the original instruction and
 * removes the call entirely.  `__asm__` (not bare `asm`) keeps this valid
 * under the application build's -std=c99. */
float sqrtf_hw(float value)
{
    float result;

    __asm__("vsqrt.f32 %0, %1" : "=t"(result) : "t"(value));
    return result;
}

/* ---- foreach_attr_entry_invoke_callback.c ---- */
/* readable reconstruction; identity: FUN_00086b40 @ 0x00086b40
 * public-name: foreach_attr_entry_invoke_callback
 * durable-map: recon/catalogs/function_names_app.json
 * callees (readable <= raw @ address):
 *   foreach_attr_entry_invoke_callback       <= FUN_00086b40 @ 0x00086b40
 */
/* Full ABI-faithful reconstruction FUN_00086b40 @ 0x86b40 (62-byte extent; CFG PASS). */

typedef unsigned int (*fp_t)(int,int,unsigned int,int,unsigned int);
static unsigned int foreach_attr_entry_invoke_callback(int param_1, fp_t param_2, unsigned int param_3, unsigned int param_4)
{
  int *piVar3 = (int*)(param_1+0x48);
  unsigned int uVar5=0;
  do {
    int iVar6 = piVar3[1];
    int iVar4 = piVar3[2];
    while (--iVar6 >= 0) {
      if (*(volatile unsigned short *)(iVar4+0xc) > 1) {
        int iVar2 = *(volatile short *)(iVar4+0xe) + 1;
        if (iVar2 != 0) {
          unsigned int uVar1 = param_2(param_1, iVar4, param_3, iVar2, param_4);
          uVar5 |= uVar1;
        }
      }
      iVar4 += 0x68;
    }
    piVar3 = (int*)*piVar3;
  } while (piVar3 != 0);
  return uVar5;
}

/* ---- mem_find_byte.c ---- */
/* readable reconstruction; identity: FUN_00086bc8 @ 0x00086bc8
 * public-name: mem_find_byte
 * durable-map: recon/catalogs/function_names_app.json
 * callees (readable <= raw @ address):
 *   mem_find_byte                            <= FUN_00086bc8 @ 0x00086bc8
 */
/* Reconstructed FUN_00086bc8 @ 0x86bc8  (parity: 300/300 trials, PROVEN) */

char * mem_find_byte(char *param_1, unsigned int param_2, int param_3)
{
  unsigned char *pcVar1;
  unsigned char *pcVar2;
  unsigned char b2 = (unsigned char)param_2;

  pcVar1 = (unsigned char *)param_1;
  do {
    pcVar2 = pcVar1;
    if (pcVar2 == (unsigned char*)param_1 + param_3) {
      return (char *)0x0;
    }
    pcVar1 = pcVar2 + 1;
  } while (*pcVar2 != b2);
  return (char *)pcVar2;
}

/* ---- dynbuf_push_byte_grow.c ---- */
struct _reent;
#include <stddef.h>
/* readable reconstruction; identity: FUN_0008790e @ 0x0008790e
 * public-name: dynbuf_push_byte_grow
 * durable-map: recon/catalogs/function_names_app.json
 * callees (readable <= raw @ address):
 *   _malloc_r                                <= FUN_00076e20 @ 0x00076e20
 *   memcpy                                   <= FUN_00086c04 @ 0x00086c04
 *   _realloc_r                               <= FUN_000876ec @ 0x000876ec
 *   dynbuf_push_byte_grow                    <= FUN_0008790e @ 0x0008790e
 */
/* Reconstructed FUN_0008790e @ 0x8790e  (parity: 300/300 trials, PROVEN) */
extern void *_malloc_r(struct _reent *, size_t);
extern void memcpy(int, int, int);
extern void *_realloc_r(struct _reent *, void *, size_t);
static uint32_t dynbuf_push_byte_grow(uint32_t param_1,volatile int* param_2){
  int iVar1,iVar2;
  if((int*)param_2[0xd]==(int*)(param_2+0x11)){
    iVar1=_malloc_r(param_1,0x400);
    if(iVar1!=0){
      param_2[0xd]=iVar1;
      param_2[0xe]=0x400;
      *(volatile uint8_t *)(iVar1+0x3ff)=*(volatile uint8_t *)((int)param_2+0x46);
      *(volatile uint8_t *)(iVar1+0x3fe)=*(volatile uint8_t *)((int)param_2+0x45);
      *(volatile uint8_t *)(iVar1+0x3fd)=*(volatile uint8_t *)((int)param_2+0x44);
      *param_2=iVar1+0x3fd;
      return 0;
    }
  } else {
    iVar2=param_2[0xe];
    iVar1=_realloc_r(param_1,param_2[0xd],iVar2<<1);
    if(iVar1!=0){
      memcpy(iVar1+iVar2,iVar1,iVar2);
      *param_2=iVar1+iVar2;
      param_2[0xd]=iVar1;
      param_2[0xe]=iVar2<<1;
      return 0;
    }
  }
  return 0xffffffff;
}

/* ---- coredep_delay_cycles.c ---- */
/* readable reconstruction; identity: FUN_00088840 @ 0x00088840
 * public-name: coredep_delay_cycles
 * durable-map: recon/catalogs/function_names_app.json
 * callees (readable <= raw @ address):
 *   coredep_delay_cycles                     <= FUN_00088840 @ 0x00088840
 */
/* Full reconstruction FUN_00088840 @ 0x88840 (exact 6-byte extent).
 *
 * P4 iteration 15.  Ghidra never catalogued this leaf: its only reference in
 * the whole image is the literal 0x00088841 in FUN_0004c254
 * (`delay_busy_wait_usec`), which loads it, ORs in the Thumb bit and `bx`es
 * to it.  The shipped bytes are
 *     3803    subs r0, r0, #3
 *     d8fd    bhi  .-2
 *     4770    bx   lr
 * i.e. nrfx's `nrfx_coredep_delay_us` three-cycle busy-wait kernel; the caller
 * has already converted microseconds to CPU cycles.
 *
 * Expressed as inline asm because the loop's exit condition is the unsigned
 * BHI on the SUBS flags, which C's `while (n > 3)` does not reproduce for the
 * wrap-around case, and because this must stay exactly three instructions.
 * `__asm__` (not bare `asm`) keeps it valid under the application build's
 * -std=c99.
 */

void coredep_delay_cycles(unsigned int cycles)
{
	__asm__ volatile("1:\tsubs\t%0, %0, #3\n\t"
			 "bhi\t1b"
			 : "+r"(cycles)
			 :
			 : "cc");
}

