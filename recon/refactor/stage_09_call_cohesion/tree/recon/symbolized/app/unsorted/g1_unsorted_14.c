/*
 * Cohesive translation unit for the `unsorted' module.
 *
 * GENERATED by recon/refactor/transforms/t04_cohesive_tu.py.  Do not
 * edit: a stage tree is regenerated, never hand-patched
 * (recon/refactor/README.md C4).
 *
 * The 20 functions below were 20 separate translation units until this
 * stage.  Each one's text is reproduced VERBATIM and in the order the
 * generated source list gave it, and they were CONSECUTIVE in that list.
 * They were proven able to share a translation unit: no symbol is
 * declared here with two types, no identifier has internal linkage in one
 * member and is named by another, and no local typedef, macro, struct tag
 * or enum constant of one member is visible to a member that names it.
 *
 * members, in link order:
 *   convert_to_id_on_match.c
 *   return_neg_notsup_stub.c
 *   thunk_FUN_00064134.c
 *   subtract_32.c
 *   adc_context_request_sampling.c
 *   g1_nrfx_clock_stop_hfclk192m.c
 *   g1_nrfx_clock_stop_lfclk.c
 *   entropy_bt_get_entropy.c
 *   mem_read_validated.c
 *   emit_u8_value_via_vtable.c
 *   transport_send_type2_via_ops.c
 *   timing_channel_dispatch.c
 *   driver_register_callback_locked.c
 *   channel_pull_one_byte.c
 *   driver_stop_active_timer.c
 *   hex4_to_uint.c
 *   linked_node_at_index.c
 *   cursor_advance_past_cstring.c
 *   sllist_insert_after.c
 *   growbuf_ensure_capacity.c
 */

/* File-scope forward declarations for every struct/union tag this
 * unit names.  Without them a tag whose only appearance in a member
 * is inside a parameter list has PARAMETER-LIST scope, so two
 * textually IDENTICAL declarations in two members declare two
 * different incomplete types and the second is a conflicting
 * redeclaration (C11 6.2.1p7).  Incomplete-type forward
 * declarations emit no code. */
struct k_timer;
struct linked_node_raw;
struct linked_owner_raw;
/* ---- convert_to_id_on_match.c ---- */
#include "g1_app_symbols.h"
#include <stddef.h>
/* readable reconstruction; identity: FUN_000831e2 @ 0x000831e2
 * public-name: convert_to_id_on_match
 * durable-map: recon/catalogs/function_names_app.json
 * callees (readable <= raw @ address):
 *   bt_addr_le_copy_83062                    <= FUN_00083062 @ 0x00083062
 *   convert_to_id_on_match                   <= FUN_000831e2 @ 0x000831e2
 *   memcmp                                   <= FUN_00086be4 @ 0x00086be4
 */
/* Reconstructed FUN_000831e2 @ 0x831e2  (parity: 300/300 trials, PROVEN) */

extern int memcmp(const void *, const void *, size_t);
extern void bt_addr_le_copy_83062(unsigned int *, unsigned int *);
void convert_to_id_on_match(int param_1, int *param_2)
{
  int iVar1;
  iVar1 = memcmp(param_1 + 0x90, *param_2, 7);
  if (iVar1 == 0) {
    bt_addr_le_copy_83062(param_1 + 0x90, param_2[1]);
  }
}

/* ---- return_neg_notsup_stub.c ---- */
/* readable reconstruction; identity: FUN_00083496 @ 0x00083496
 * public-name: return_neg_notsup_stub
 * durable-map: recon/catalogs/function_names_app.json
 * callees (readable <= raw @ address):
 *   return_neg_notsup_stub                   <= FUN_00083496 @ 0x00083496
 */
/* Reconstructed FUN_00083496 @ 0x83496  (parity: 300/300 trials, PROVEN) */

unsigned int return_neg_notsup_stub(void)
{
    return 0xffffff7a;
}

/* ---- thunk_FUN_00064134.c ---- */
/* readable reconstruction; identity: FUN_000836d4 @ 0x000836d4
 * public-name: thunk_FUN_00064134
 * durable-map: recon/catalogs/function_names_app.json
 * callees (readable <= raw @ address):
 *   resolve_dual_slot_state_code             <= FUN_00064134 @ 0x00064134
 */
/* Tail thunk @ 0x836d4. */
extern int resolve_dual_slot_state_code(int,int,int,int); int thunk_FUN_00064134(int a,int b,int c,int d){return resolve_dual_slot_state_code(a,b,c,d);}

/* ---- subtract_32.c ---- */
/* readable reconstruction; identity: FUN_000836d8 @ 0x000836d8
 * public-name: subtract_32
 * durable-map: recon/catalogs/function_names_app.json
 * callees (readable <= raw @ address):
 *   subtract_32                              <= FUN_000836d8 @ 0x000836d8
 */
/* Reconstructed FUN_000836d8 @ 0x836d8  (parity: 300/300 trials, PROVEN) */

static int subtract_32(int param_1)
{
    return param_1 - 0x20;
}

/* ---- adc_context_request_sampling.c ---- */
/* readable reconstruction; identity: FUN_00083778 @ 0x00083778
 * public-name: adc_context_request_sampling
 * durable-map: recon/catalogs/function_names_app.json
 * callees (readable <= raw @ address):
 *   adc_context_start_sampling               <= FUN_0005f638 @ 0x0005f638
 *   adc_context_request_sampling             <= FUN_00083778 @ 0x00083778
 */
/* Reconstructed FUN_00083778 @ 0x83778  (parity: 300/300 trials, PROVEN) */

/* Full reconstruction of the 42-byte atomic reference-count helper. */
#include <stdint.h>

extern void adc_context_start_sampling(void);
void adc_context_request_sampling(uint8_t *param_1)
{
    uint32_t old_count = __atomic_fetch_add((uint32_t *)(param_1 - 8), 1,
                                             __ATOMIC_RELAXED);
    if (old_count != 0) {
        *(int32_t *)(param_1 + 0x68) = -16;
        return;
    }
    adc_context_start_sampling();
}

/* ---- g1_nrfx_clock_stop_hfclk192m.c ---- */
#include "g1_unsorted.h"
/* readable reconstruction; identity: FUN_0008387a @ 0x0008387a
 * public-name: g1_nrfx_clock_stop_hfclk192m
 * durable-map: recon/catalogs/function_names_app.json
 * callees (readable <= raw @ address):
 *   nrfx_clock_stop                          <= FUN_00065324 @ 0x00065324
 *   g1_nrfx_clock_stop_hfclk192m             <= FUN_0008387a @ 0x0008387a
 */
/* Reconstructed FUN_0008387a @ 0x8387a; HFCLK192M stop tail veneer. */
static void g1_nrfx_clock_stop_hfclk192m(void) { nrfx_clock_stop(2); }

/* ---- g1_nrfx_clock_stop_lfclk.c ---- */
/* readable reconstruction; identity: FUN_00083880 @ 0x00083880
 * public-name: g1_nrfx_clock_stop_lfclk
 * durable-map: recon/catalogs/function_names_app.json
 * callees (readable <= raw @ address):
 *   nrfx_clock_stop                          <= FUN_00065324 @ 0x00065324
 *   g1_nrfx_clock_stop_lfclk                 <= FUN_00083880 @ 0x00083880
 */
/* Reconstructed FUN_00083880 @ 0x83880; LFCLK stop tail veneer. */
static void g1_nrfx_clock_stop_lfclk(void) { nrfx_clock_stop(0); }

/* ---- entropy_bt_get_entropy.c ---- */
/* readable reconstruction; identity: FUN_00083896 @ 0x00083896
 * public-name: entropy_bt_get_entropy
 * durable-map: recon/catalogs/function_names_app.json
 * callees (readable <= raw @ address):
 *   bt_hci_le_rand                           <= FUN_00053e74 @ 0x00053e74
 *   bt_is_ready                              <= FUN_00054c64 @ 0x00054c64
 *   entropy_bt_get_entropy                   <= FUN_00083896 @ 0x00083896
 */
/* Reconstructed FUN_00083896 @ 0x83896  (parity: 300/300 trials, PROVEN) */

extern int bt_is_ready(void);
extern unsigned int bt_hci_le_rand(unsigned int, unsigned int);

static unsigned int entropy_bt_get_entropy(unsigned int param_1, unsigned int param_2, unsigned int param_3)
{
  int iVar1;
  unsigned int uVar2;

  iVar1 = bt_is_ready();
  if (iVar1 != 0) {
    uVar2 = bt_hci_le_rand(param_2,param_3);
    return uVar2;
  }
  return 0xfffffff5;
}

/* ---- mem_read_validated.c ---- */
/* readable reconstruction; identity: FUN_000839fe @ 0x000839fe
 * public-name: mem_read_validated
 * durable-map: recon/catalogs/function_names_app.json
 * callees (readable <= raw @ address):
 *   is_regular_addr_valid                    <= FUN_000839dc @ 0x000839dc
 *   mem_read_validated                       <= FUN_000839fe @ 0x000839fe
 *   memcpy                                   <= FUN_00086c04 @ 0x00086c04
 */
/* Reconstructed FUN_000839fe @ 0x839fe  (parity: 300/300 trials, PROVEN) */
extern int is_regular_addr_valid(int a, int b);
extern int tail_61200(int a, int b);
extern void memcpy(int, int, int);
static unsigned mem_read_validated(int param_1, int param_2, int param_3, int param_4){
    int iVar1 = is_regular_addr_valid(param_2, param_4);
    if (iVar1 == 0){
        return tail_61200(param_2, param_4);
    }
    if (param_4 != 0){
        memcpy(param_3, param_2, param_4);
    }
    return 0;
}

/* ---- emit_u8_value_via_vtable.c ---- */
/* readable reconstruction; identity: FUN_000844a8 @ 0x000844a8
 * public-name: emit_u8_value_via_vtable
 * durable-map: recon/catalogs/function_names_app.json
 * callees (readable <= raw @ address):
 *   emit_u8_value_via_vtable                 <= FUN_000844a8 @ 0x000844a8
 */
/* Reconstructed FUN_000844a8 @ 0x844a8  (parity: 300/300 trials, PROVEN) */

typedef unsigned int (*fn_t)(int, void*, int, short);

static void emit_u8_value_via_vtable(int *param_1, unsigned char param_2, unsigned int param_3, unsigned int param_4)
{
    unsigned char local_29;
    unsigned char *local_28;
    unsigned int local_24;
    unsigned char local_20;
    unsigned int local_1c;
    unsigned int uStack_18;
    unsigned char local_14;

    local_28 = &local_29;
    local_24 = 1;
    local_20 = 0;
    local_14 = 7;
    local_29 = param_2;
    local_1c = param_3;
    uStack_18 = param_4;
    ((fn_t)(*(int *)(*(int *)(*param_1 + 8) + 8)))(*param_1, &local_28, 2, (short)param_1[1]);
}

/* ---- transport_send_type2_via_ops.c ---- */
/* readable reconstruction; identity: FUN_000844e0 @ 0x000844e0
 * public-name: transport_send_type2_via_ops
 * durable-map: recon/catalogs/function_names_app.json
 * callees (readable <= raw @ address):
 *   transport_send_type2_via_ops             <= FUN_000844e0 @ 0x000844e0
 */
/* Reconstructed FUN_000844e0 @ 0x844e0  (parity: 300/300 trials, PROVEN) */

typedef void (*fnptr)(int, void *, int, short);

static void transport_send_type2_via_ops(int *param_1, unsigned char param_2, unsigned int param_3, unsigned int param_4)
{
  unsigned char local_29 = param_2;
  unsigned char *local_28 = &local_29;
  unsigned int local_24 = 1;
  unsigned char local_20 = 0;
  unsigned int local_1c = param_3;
  unsigned int uStack_18 = param_4;
  unsigned char local_14 = 2;
  int base = *param_1;
  int fieldVal = *(int *)(base + 8);
  fnptr fp = *(fnptr *)(fieldVal + 8);
  (void)local_24; (void)local_20; (void)local_1c; (void)uStack_18; (void)local_14;
  fp(base, &local_28, 2, (short)param_1[1]);
}

/* ---- timing_channel_dispatch.c ---- */
/* readable reconstruction; identity: FUN_00084516 @ 0x00084516
 * public-name: timing_channel_dispatch
 * durable-map: recon/catalogs/function_names_app.json
 * callees (readable <= raw @ address):
 *   us_to_ticks_scaled                       <= FUN_00012580 @ 0x00012580
 *   us_to_ticks_scaled_v2                    <= FUN_000125c0 @ 0x000125c0
 *   timing_channel_dispatch                  <= FUN_00084516 @ 0x00084516
 */
/* Reconstructed FUN_00084516 @ 0x84516  (parity: 300/300 trials, PROVEN) */

extern void us_to_ticks_scaled(int a, int b, unsigned c, unsigned d, unsigned e);
extern void us_to_ticks_scaled_v2(unsigned long*, unsigned long, unsigned long);
static unsigned timing_channel_dispatch(int param_1, unsigned param_2, int param_3, unsigned param_4){
    int iVar2 = *(volatile int *)(param_1 + 0x10);
    unsigned uVar4;
    if (param_2 < 4){
        uVar4 = *(volatile unsigned int *)(iVar2 + 0xc);
        if (param_2 == 2){
            param_2 = (unsigned)(int)*(volatile short *)(iVar2 + 8);
        } else if (param_2 == 3){
            short *psVar3 = (short*)(iVar2 + 2);
            int it = param_3;
            do {
                psVar3 = psVar3 + 1;
                int iVar1 = it + 8;
                us_to_ticks_scaled(it, (int)*(volatile short *)psVar3, uVar4, 0, 0);
                it = iVar1;
            } while (it != param_3 + 0x18);
            return 0;
        } else {
            if (param_2 != 1) param_2 = (unsigned)(int)*(volatile short *)(iVar2 + 4);
            else param_2 = (unsigned)(int)*(volatile short *)(iVar2 + 6);
        }
        us_to_ticks_scaled(param_3, (int)param_2, uVar4, param_4, param_4);
    } else {
        if (param_2 - 4 > 3) return 0xffffff7au;
        uVar4 = *(volatile unsigned int *)(iVar2 + 0x18);
        if (param_2 == 6){
            param_2 = (unsigned)(int)*(volatile short *)(iVar2 + 0x14);
        } else if (param_2 == 7){
            short *psVar3 = (short*)(iVar2 + 0xe);
            int it = param_3;
            do {
                psVar3 = psVar3 + 1;
                int iVar1 = it + 8;
                us_to_ticks_scaled_v2(it, (int)*(volatile short *)psVar3, uVar4);
                it = iVar1;
            } while (it != param_3 + 0x18);
            return 0;
        } else {
            if (param_2 != 5) param_2 = (unsigned)(int)*(volatile short *)(iVar2 + 0x10);
            else param_2 = (unsigned)(int)*(volatile short *)(iVar2 + 0x12);
        }
        us_to_ticks_scaled_v2(param_3, (int)param_2, uVar4);
    }
    return 0;
}

/* ---- driver_register_callback_locked.c ---- */
/* readable reconstruction; identity: FUN_000848d2 @ 0x000848d2
 * public-name: driver_register_callback_locked
 * durable-map: recon/catalogs/function_names_app.json
 * callees (readable <= raw @ address):
 *   driver_register_callback_locked          <= FUN_000848d2 @ 0x000848d2
 */
/* Reconstructed FUN_000848d2 @ 0x848d2  (parity: 300/300 trials, PROVEN) */
uint32_t driver_register_callback_locked(int *param_1, uint32_t param_2, uint32_t param_3){
    int iVar4 = **(volatile int* volatile*)((char*)param_1 + 4);
    int iVar6 = *(volatile int *)((char*)param_1 + 0x10);
    uint32_t uVar3;
    int iVar5 = *(volatile int *)(iVar6 + 0xc);
    if(*(volatile int *)(iVar5 + 0x58) == 0){
        uVar3 = 0xfffffff3;
    } else if(*(volatile int *)(iVar5 + 0x64) == 0){
        *(volatile int *)(iVar5 + 0x64) = (int)param_2;
        *(volatile int *)(*(volatile int *)(iVar6+0xc) + 0x68) = (int)param_3;
        *(volatile int *)(iVar4 + 0x534) = (int)param_2;
        *(volatile int *)(iVar4 + 0x538) = (int)param_3;
        *(volatile uint32_t *)(iVar4 + 0x200) |= 0x20;
        uVar3 = 0;
    } else {
        uVar3 = 0xfffffff0;
    }
    return uVar3;
}

/* ---- channel_pull_one_byte.c ---- */
/* readable reconstruction; identity: FUN_0008493a @ 0x0008493a
 * public-name: channel_pull_one_byte
 * durable-map: recon/catalogs/function_names_app.json
 * callees (readable <= raw @ address):
 *   channel_pull_one_byte                    <= FUN_0008493a @ 0x0008493a
 */
/* Reconstructed FUN_0008493a @ 0x8493a  (parity: 300/300 trials, PROVEN) */

static int channel_pull_one_byte(int param_1, unsigned char *param_2)
{
    unsigned int *p10 = *(unsigned int* volatile*)(param_1 + 0x10);
    unsigned int *p4  = *(unsigned int* volatile*)(param_1 + 4);
    unsigned int cond = *(volatile unsigned int *)((char*)p10 + 0xc);
    unsigned int puVar2_int = *(volatile unsigned int *)p4;
    unsigned int *puVar2 = (unsigned int*)puVar2_int;
    if (cond != 0) {
        return (int)0xffffff7a;
    }
    unsigned int v44 = *(volatile unsigned int *)((char*)puVar2 + 0x110);
    if (v44 == 0) {
        return -1;
    }
    unsigned char *p18 = *(unsigned char* volatile*)((char*)p10 + 0x18);
    *param_2 = *(volatile unsigned char *)p18;
    *(volatile unsigned int *)((char*)puVar2 + 0x110) = 0;
    *(volatile unsigned int *)puVar2 = 1;
    return 0;
}

/* ---- driver_stop_active_timer.c ---- */
/* readable reconstruction; identity: FUN_00084c2c @ 0x00084c2c
 * public-name: driver_stop_active_timer
 * durable-map: recon/catalogs/function_names_app.json
 * callees (readable <= raw @ address):
 *   driver_stop_active_timer                 <= FUN_00084c2c @ 0x00084c2c
 *   z_impl_k_timer_stop                      <= FUN_0008673e @ 0x0008673e
 */
/* Reconstructed FUN_00084c2c @ 0x84c2c  (parity: 300/300 trials, PROVEN) */

extern void z_impl_k_timer_stop(struct k_timer *);
int driver_stop_active_timer(int param_1)
{
    int iVar3 = *(int*)(param_1 + 0x10);
    int iVar4 = **(int**)(param_1 + 4);
    int iVar2 = *(int*)(iVar3 + 0xc);
    if (*(int*)(iVar2 + 8) == 0) {
        return 0xfffffff2;
    }
    *(char*)(iVar2 + 0xcd) = 0;
    z_impl_k_timer_stop(*(int*)(iVar3 + 0xc) + 0x20);
    *(int*)(iVar4 + 0xc) = 1;
    return 0;
}

/* ---- hex4_to_uint.c ---- */
/* readable reconstruction; identity: FUN_00084e9a @ 0x00084e9a
 * public-name: hex4_to_uint
 * durable-map: recon/catalogs/function_names_app.json
 * callees (readable <= raw @ address):
 *   hex4_to_uint                             <= FUN_00084e9a @ 0x00084e9a
 */
/* Reconstructed FUN_00084e9a @ 0x84e9a  (parity: 300/300 trials, PROVEN) */

int hex4_to_uint(unsigned char *param_1)
{
  int iVar1 = 0;
  int iVar2 = 0;
  unsigned int uVar3;
  while (1) {
    uVar3 = param_1[iVar1];
    if (uVar3 - 0x30 < 10) {
      iVar2 = iVar2 - 0x30;
    } else if (uVar3 - 0x41 < 6) {
      iVar2 = iVar2 - 0x37;
    } else if (uVar3 - 0x61 <= 5) {
      iVar2 = iVar2 - 0x57;
    } else {
      return 0;
    }
    if (iVar1 == 3) break;
    iVar2 = (uVar3 + iVar2) * 0x10;
    iVar1 = iVar1 + 1;
  }
  return uVar3 + iVar2;
}

/* ---- linked_node_at_index.c ---- */
/* readable reconstruction; identity: FUN_00084f06 @ 0x00084f06
 * public-name: linked_node_at_index
 * durable-map: recon/catalogs/function_names_app.json
 */
/* Reconstructed linked_node_at_index @ 0x00084f06.
 * Raw/address back-map: FUN_00084f06 / 0x00084f06.
 */

struct linked_node_raw {
    struct linked_node_raw *next;
};

struct linked_owner_raw {
    uint32_t reserved[2];
    struct linked_node_raw *head;
};

struct linked_node_raw *linked_node_at_index(struct linked_owner_raw *owner,
                                             uint32_t index)
{
    struct linked_node_raw *node = owner == 0 ? 0 : owner->head;
    while (node != 0 && index != 0u) {
        node = node->next;
        index--;
    }
    return node;
}

/* ---- cursor_advance_past_cstring.c ---- */
/* readable reconstruction; identity: FUN_00084f16 @ 0x00084f16
 * public-name: cursor_advance_past_cstring
 * durable-map: recon/catalogs/function_names_app.json
 * callees (readable <= raw @ address):
 *   strlen                                   <= FUN_0000ef12 @ 0x0000ef12
 *   cursor_advance_past_cstring              <= FUN_00084f16 @ 0x00084f16
 */
/* Reconstructed FUN_00084f16 @ 0x84f16  (parity: 300/300 trials, PROVEN) */

extern int strlen(int a);
void cursor_advance_past_cstring(int *param_1) {
    if (param_1 != (int*)0 && *param_1 != 0) {
        int iVar2 = param_1[2];
        int iVar1 = strlen(*param_1 + iVar2);
        param_1[2] = iVar2 + iVar1;
    }
}

/* ---- sllist_insert_after.c ---- */
/* readable reconstruction; identity: FUN_00084f2e @ 0x00084f2e
 * public-name: sllist_insert_after
 * durable-map: recon/catalogs/function_names_app.json
 * callees (readable <= raw @ address):
 *   sllist_insert_after                      <= FUN_00084f2e @ 0x00084f2e
 */
/* Reconstructed FUN_00084f2e @ 0x84f2e  (parity: 300/300 trials, PROVEN) */

int sllist_insert_after(int *param_1, int *param_2)
{
    if (param_2 != 0) {
        if (param_1 == 0) {
            return 0;
        }
        if (param_2 != param_1) {
            if (param_1[2] == 0) {
                param_1[2] = (int)param_2;
                param_2[0] = 0;
                param_2[1] = (int)param_2;
            } else {
                int *puVar1 = *(int**)(param_1[2] + 4);
                if (puVar1 != 0) {
                    puVar1[0] = (int)param_2;
                    param_2[1] = (int)puVar1;
                    *(int**)(param_1[2] + 4) = param_2;
                }
            }
            return 1;
        }
    }
    return 0;
}

/* ---- growbuf_ensure_capacity.c ---- */
/* readable reconstruction; identity: FUN_00084f58 @ 0x00084f58
 * public-name: growbuf_ensure_capacity
 * durable-map: recon/catalogs/function_names_app.json
 * callees (readable <= raw @ address):
 *   growbuf_ensure_capacity                  <= FUN_00084f58 @ 0x00084f58
 *   memcpy                                   <= FUN_00086c04 @ 0x00086c04
 */
/* Reconstructed FUN_00084f58 @ 0x84f58  (parity: 300/300 trials, PROVEN) */

int growbuf_ensure_capacity(int *param_1,int param_2){
  int iVar1,iVar4,iVar5; unsigned uVar2,uVar3;
  if(param_1==0) return 0;
  iVar1=*param_1;
  if(iVar1==0) return 0;
  uVar2=param_1[1];
  if(uVar2!=0 && uVar2<=(unsigned)param_1[2]) return 0;
  if(param_2<0) return 0;
  iVar4=param_1[2];
  uVar3=param_2+iVar4+1;
  if(uVar2<uVar3){
    if(param_1[4]!=0) return 0;
    if(uVar3<0x40000000){ iVar5=param_2+iVar4+2; }
    else { if((int)uVar3<0) return 0; iVar5=0x7fffffff; }
    if(((void*)param_1[8])==0){
      iVar4=((int(*)(int))param_1[6])(iVar5);
      if(iVar4==0) goto LAB;
      memcpy(iVar4,*param_1,param_1[2]+1);
      ((void(*)(int))param_1[7])(*param_1);
    } else {
      iVar4=((int(*)(int,int))param_1[8])(iVar1,iVar5);
      if(iVar4==0){
      LAB:
        ((void(*)(int))param_1[7])(*param_1);
        *param_1=iVar4; param_1[1]=iVar4; return 0;
      }
    }
    *param_1=iVar4; param_1[1]=iVar5; iVar1=param_1[2];
  }
  return iVar1+iVar4;
}

