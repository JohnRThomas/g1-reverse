/*
 * Call-cohesive translation unit for the `unsorted' module.
 *
 * GENERATED by recon/refactor/transforms/t09_call_cohesion.py.  Do
 * not edit: a stage tree is regenerated, never hand-patched
 * (recon/refactor/README.md C4).
 *
 * The 2 translation units below were grouped because they CALL ONE
 * ANOTHER, not because they were adjacent in the generated source
 * list.  Each member's text is reproduced VERBATIM.  Every member was
 * checked pairwise against every other member already in this unit by
 * stage 04's seven refusal rules, unchanged: no symbol is declared
 * here with two types, no identifier has internal linkage in one
 * member and is named by another, and no local typedef, macro, struct
 * tag or enum constant of one member is visible to a member that
 * names it.
 *
 * members, in generated-source-list order:
 *   g1_unsorted_02.c
 *   g1_unsorted_05.c
 *
 * call edges inside this unit (caller -> callee): 1
 *   g1_unsorted_02.c -> g1_unsorted_05.c
 */

/* File-scope forward declarations for every struct/union tag this
 * unit names.  Without them a tag whose only appearance in a member
 * is inside a parameter list has PARAMETER-LIST scope, so two
 * textually IDENTICAL declarations in two members declare two
 * different incomplete types and the second is a conflicting
 * redeclaration (C11 6.2.1p7).  Incomplete-type forward
 * declarations emit no code. */
struct g1_i2c_msg;
struct k_sem;
/* ================================================================ */
/* member unit: g1_unsorted_02.c */
/* ================================================================ */
/*
 * Cohesive translation unit for the `unsorted' module.
 *
 * GENERATED by recon/refactor/transforms/t04_cohesive_tu.py.  Do not
 * edit: a stage tree is regenerated, never hand-patched
 * (recon/refactor/README.md C4).
 *
 * The 5 functions below were 5 separate translation units until this
 * stage.  Each one's text is reproduced VERBATIM and in the order the
 * generated source list gave it, and they were CONSECUTIVE in that list.
 * They were proven able to share a translation unit: no symbol is
 * declared here with two types, no identifier has internal linkage in one
 * member and is named by another, and no local typedef, macro, struct tag
 * or enum constant of one member is visible to a member that names it.
 *
 * members, in link order:
 *   local_esbm_ipc_service_recv.c
 *   nfc_field_event_signal_sem.c
 *   gpio_set_fixed_output_889f0.c
 *   gpio_set_pin1_dt_wrapper.c
 *   gpio_set_fixed_pin_dt.c
 */

/* File-scope forward declarations for every struct/union tag this
 * unit names.  Without them a tag whose only appearance in a member
 * is inside a parameter list has PARAMETER-LIST scope, so two
 * textually IDENTICAL declarations in two members declare two
 * different incomplete types and the second is a conflicting
 * redeclaration (C11 6.2.1p7).  Incomplete-type forward
 * declarations emit no code. */
struct k_sem;
/* ---- local_esbm_ipc_service_recv.c ---- */
#include "g1_app_symbols.h"
/* readable reconstruction; identity: FUN_00016bf0 @ 0x00016bf0
 * public-name: local_esbm_ipc_service_recv
 * durable-map: recon/catalogs/function_names_app.json
 */
/* Reconstructed local_esbm_ipc_service_recv @ 0x16bf0 (uncatalogued Ghidra gap
 * 0x16bc4..0x16eb8; code 0x16bf0..0x16e88, literal pool 0x16e88..0x16eb8).
 *
 * Handler registered by main() for the IPC service id 6
 * ("cpunet-esbm-cpu-sync"); dispatched from ipc0_ept_recv as
 * handler(context, data + 1, length - 1).  The name is self-evidenced: every
 * log line passes 0x00099b6d ("local_esbm_ipc_service_recv") as "%s()".
 */
#include <stdint.h>
#include "../../../headers/g1_log.h"
#include "g1_unsorted.h"

extern void msg_queue_init(void);
extern void msg_content_decrement_timer(void);
extern void set_message_pending_state(int);
extern void set_shutdown_flag(void *context, uint32_t flag);
extern void get_ui_mode_flag2(void);
extern int update_persist_task_status_to_idle(int);
extern unsigned int change_work_mode_to(unsigned int);
extern void SlaveDoubleClickEventInject(void);
extern void *get_message_entry(uint32_t id);
extern unsigned int pt_queue_get_free_slot(void);
extern void device_info_set_mode(uint32_t mode);
extern void reset_esb_sync_state(uint32_t reason);

#define LOG_LEVEL   (*(volatile int32_t *)((unsigned long)&g_log_level) /*=0x2000230c*/)
#define LOG_SINK    (*(volatile int32_t *)((unsigned long)&g_log_use_alt_sink) /*=0x20007554*/)
#define LOG_TAG     ((unsigned long)"local_esbm_ipc_service_recv") /*=0x99b6d*/
#define DEVICE_INFO (*(volatile uint8_t * volatile *)((unsigned long)&device_info) /*=0x200069fc*/)

static uint32_t load_u32(const void *pointer)
{
    uint32_t value;
    __builtin_memcpy(&value, pointer, sizeof(value));
    return value;
}

static void store_u32(void *pointer, uint32_t value)
{
    __builtin_memcpy(pointer, &value, sizeof(value));
}

static void store_u16(void *pointer, uint16_t value)
{
    __builtin_memcpy(pointer, &value, sizeof(value));
}

static uint16_t load_u16(const void *pointer)
{
    uint16_t value;
    __builtin_memcpy(&value, pointer, sizeof(value));
    return value;
}

int local_esbm_ipc_service_recv(uint8_t *context, const uint8_t *packet)
{
    uint32_t command = packet[0] & 0x3fu;
    uint8_t *entry;
    uint8_t *slot;
    uint8_t *screen;

    if (command != 0 && (command - 0xbu) > 1u) {
        uint8_t sequence = packet[0x15];

        if (*(volatile uint8_t *)((unsigned long)&g_2000ff4a) /*=0x2000ff4a*/ == sequence)
            return 0;
        *(volatile uint8_t *)((unsigned long)&g_2000ff4a) /*=0x2000ff4a*/ = sequence;

        context[0xfcf] = context[0x6cd];
        context[0xfd0] = context[0x6ce];
        context[0xfd1] = context[0x6cf];
        context[0xfc1] = context[0x6d0];
        store_u32(context + 0xfe0, load_u32(context + 0x6d8));
        store_u16(context + 0xfe4, load_u16(context + 0x6dc));
        __builtin_memcpy(context + 0x6cc, packet, 22);
        if ((packet[0x12] & 4u) != 0) {
            msg_queue_init();
            context[0x6de] &= (uint8_t)~4u;
        }
    }

    switch (packet[0] & 0x3fu) {
    case 4:
        if (DEVICE_INFO[0xd5] == 4) {
            msg_content_decrement_timer();
            set_message_pending_state(DEVICE_INFO[0xdd] != 0 ? 6u : 0u);
        }
        __atomic_fetch_or((volatile uint32_t *)((unsigned long)&g_20007b34) /*=0x20007b34*/, 2u,
                          __ATOMIC_SEQ_CST);
        set_shutdown_flag(context, 1);
        if (context[0xee4] == 2)
            get_ui_mode_flag2();
        update_persist_task_status_to_idle(context);
        return 0;

    case 5:
        set_shutdown_flag(context, 1);
        change_work_mode_to(7);
        return 0;

    case 7:
        set_shutdown_flag(context, 1);
        context[0xfea] = 0xc;
        goto shutdown_tail;

    case 8:
        context[0xfea] = 0xa;
    shutdown_tail:
        store_u32(context + 0x104c, 3);
        FUN_0007c010(context + 0x80);
        return 0;

    case 6:
        if (LOG_LEVEL > 2) {
            if (LOG_SINK == 0)
                log_message(((unsigned long)"%s(): received slave double click event\n") /*=0x99789*/, LOG_TAG);
            else
                debug_print(((unsigned long)"%s(): received slave double click event\n") /*=0x99789*/, LOG_TAG);
        }
        SlaveDoubleClickEventInject();
        return 0;

    case 9:
        *(volatile uint8_t *)((unsigned long)&g_notify_wakeup_msg_sync_flag) /*=0x2000ff4d*/ = 1;
        return 0;

    case 11:
        if (((DEVICE_INFO[0xe4] & 4u) |
             *(volatile uint8_t *)((unsigned long)&g_msg_queue_busy) /*=0x20018d8e*/) != 0)
            return 0;
        entry = get_message_entry(packet[0xd]);
        if (entry == 0 || entry[0xe] != 0)
            return 0;
        if (load_u32(packet + 9) == load_u32(entry + 8) &&
            load_u32(packet + 1) == load_u32(entry) &&
            entry[0xd] == 1)
            return 0;
        __builtin_memcpy(entry, packet + 1, 0xda);
        entry[0xd] = 1;
        return 0;

    case 12:
        if (((DEVICE_INFO[0xe4] & 4u) |
             *(volatile uint8_t *)((unsigned long)&g_msg_queue_busy) /*=0x20018d8e*/) != 0)
            return 0;
        slot = pt_queue_get_free_slot();
        if (slot == 0 || slot[0xe] != 0 || slot[0xd] == 3)
            return 0;
        __builtin_memcpy(slot + 0xda, packet + 1, 0xda);
        slot[0xd] = 3;
        return 0;

    case 13:
        if (LOG_LEVEL > 2) {
            if (LOG_SINK == 0)
                log_message(((unsigned long)"%s(): received SYNC_DISPLAY_FUNC_DATA\n") /*=0x997b2*/, LOG_TAG);
            else
                debug_print(((unsigned long)"%s(): received SYNC_DISPLAY_FUNC_DATA\n") /*=0x997b2*/, LOG_TAG);
        }
        if (context[0x6df] == 4) {
            if (LOG_LEVEL > 2) {
                if (LOG_SINK == 0)
                    log_message(((unsigned long)"%s(): master sync onboarding action_cmd %d\n") /*=0x997d9*/, LOG_TAG,
                                (uint32_t)context[0x6e0]);
                else
                    debug_print(((unsigned long)"%s(): master sync onboarding action_cmd %d\n") /*=0x997d9*/, LOG_TAG,
                                (uint32_t)context[0x6e0]);
            }
            screen = *(uint8_t * volatile *)(DEVICE_INFO + 0x1014);
            screen[2] = context[0x6e0];
            return 0;
        }
        if (context[0x6df] != 5)
            return 0;
        if (LOG_LEVEL > 2) {
            if (LOG_SINK == 0)
                log_message(((unsigned long)"%s(): master sync not_disturb sub_step %d\n") /*=0x99805*/, LOG_TAG, (uint32_t)context[0x6e0]);
            else
                debug_print(((unsigned long)"%s(): master sync not_disturb sub_step %d\n") /*=0x99805*/, LOG_TAG, (uint32_t)context[0x6e0]);
        }
        device_info_set_mode(context[0x6e0]);
        return 0;

    case 14:
        screen = *(uint8_t * volatile *)(DEVICE_INFO + 0x100c);
        if (screen[0] == 1)
            return 0;
        reset_esb_sync_state(0);
        screen = *(uint8_t * volatile *)(DEVICE_INFO + 0x100c);
        screen[0] = 1;
        return 0;

    case 15:
        screen = *(uint8_t * volatile *)(DEVICE_INFO + 0x100c);
        if (screen[0] != 4)
            return 0;
        screen[0] = 5;
        return 0;

    default:
        return 0;
    }
}

/* ---- nfc_field_event_signal_sem.c ---- */
struct k_sem;
/* readable reconstruction; identity: FUN_0001793c @ 0x0001793c
 * public-name: nfc_field_event_signal_sem
 * durable-map: recon/catalogs/function_names_app.json
 * callees (readable <= raw @ address):
 *   get_device_info                          <= FUN_000167a8 @ 0x000167a8
 *   gpio_pin_configure                       <= FUN_00017858 @ 0x00017858
 *   nfc_field_event_signal_sem               <= FUN_0001793c @ 0x0001793c
 *   k_sem_give                               <= FUN_00072880 @ 0x00072880
 * address symbols (name @ address):
 *   rodata_889d0                             @ 0x000889d0
 *   g_touch_key_irq_pending                  @ 0x20006a00
 *   g_pt_nfc_link_ready                      @ 0x20007bcc
 */
/* Reconstructed FUN_0001793c @ 0x1793c  (parity: 300/300 trials, PROVEN) */

extern void gpio_pin_configure(int, int);
extern void k_sem_give(struct k_sem *);

void nfc_field_event_signal_sem(int param_1, int param_2, int param_3)
{
  int iVar1;
  gpio_pin_configure(((unsigned long)&rodata_889d0) /*=0x889d0*/, 0x200000);
  if ((param_3 == 0x200) && (*(volatile int *)((unsigned long)&g_pt_nfc_link_ready) /*=0x20007bcc*/ != 0)) {
    *(volatile int *)((unsigned long)&g_touch_key_irq_pending) /*=0x20006a00*/ = 1;
    iVar1 = get_device_info();
    k_sem_give(iVar1 + 0xb0);
  }
  gpio_pin_configure(((unsigned long)&rodata_889d0) /*=0x889d0*/, 0x5c00000);
}

/* ---- gpio_set_fixed_output_889f0.c ---- */
/* readable reconstruction; identity: FUN_00017a04 @ 0x00017a04
 * public-name: gpio_set_fixed_output_889f0
 * durable-map: recon/catalogs/function_names_app.json
 * callees (readable <= raw @ address):
 *   gpio_set_fixed_output_889f0              <= FUN_00017a04 @ 0x00017a04
 *   gpio_pin_set_dt                          <= FUN_0007c084 @ 0x0007c084
 */
/* Reconstructed FUN_00017a04 @ 0x17a04 (uncatalogued exact GPIO tail entry). */

/* iteration 14: the descriptor address was a hardcoded numeric literal, so
 * the PROVIDE() rebind in g1_app_globals.ld could not apply and the wrapper
 * handed gpio_pin_set_dt a raw ORIGINAL-image flash address; the port
 * pointer inside it is garbage in our link and gpio_pin_set_checked
 * asserted.  Referencing the pinned symbol is what makes the rebind real. */


uint32_t gpio_set_fixed_output_889f0(uint32_t unused0, uint32_t unused1,
                      uint32_t arg2, uint32_t arg3)
{
    (void)unused0;
    (void)unused1;
    return gpio_pin_set_dt((unsigned long)&rodata_889f0 /*=0x889f0*/, 0U, arg2, arg3);
}

/* ---- gpio_set_pin1_dt_wrapper.c ---- */
/* readable reconstruction; identity: FUN_00017a10 @ 0x00017a10
 * public-name: gpio_set_pin1_dt_wrapper
 * durable-map: recon/catalogs/function_names_app.json
 * callees (readable <= raw @ address):
 *   gpio_set_pin1_dt_wrapper                 <= FUN_00017a10 @ 0x00017a10
 *   gpio_pin_set_dt                          <= FUN_0007c084 @ 0x0007c084
 */
/* Reconstructed FUN_00017a10 @ 0x17a10 (uncatalogued exact GPIO tail entry). */

/* iteration 14: the descriptor address was a hardcoded numeric literal, so
 * the PROVIDE() rebind in g1_app_globals.ld could not apply and the wrapper
 * handed gpio_pin_set_dt a raw ORIGINAL-image flash address; the port
 * pointer inside it is garbage in our link and gpio_pin_set_checked
 * asserted.  Referencing the pinned symbol is what makes the rebind real. */


uint32_t gpio_set_pin1_dt_wrapper(uint32_t unused0, uint32_t unused1,
                      uint32_t arg2, uint32_t arg3)
{
    (void)unused0;
    (void)unused1;
    return gpio_pin_set_dt((unsigned long)&rodata_889e8 /*=0x889e8*/, 1U, arg2, arg3);
}

/* ---- gpio_set_fixed_pin_dt.c ---- */
/* readable reconstruction; identity: FUN_00017a1c @ 0x00017a1c
 * public-name: gpio_set_fixed_pin_dt
 * durable-map: recon/catalogs/function_names_app.json
 * callees (readable <= raw @ address):
 *   gpio_set_fixed_pin_dt                    <= FUN_00017a1c @ 0x00017a1c
 *   gpio_pin_set_dt                          <= FUN_0007c084 @ 0x0007c084
 */
/* Reconstructed FUN_00017a1c @ 0x17a1c (uncatalogued exact GPIO tail entry). */

/* iteration 14: the descriptor address was a hardcoded numeric literal, so
 * the PROVIDE() rebind in g1_app_globals.ld could not apply and the wrapper
 * handed gpio_pin_set_dt a raw ORIGINAL-image flash address; the port
 * pointer inside it is garbage in our link and gpio_pin_set_checked
 * asserted.  Referencing the pinned symbol is what makes the rebind real. */


uint32_t gpio_set_fixed_pin_dt(uint32_t unused0, uint32_t unused1,
                      uint32_t arg2, uint32_t arg3)
{
    (void)unused0;
    (void)unused1;
    return gpio_pin_set_dt((unsigned long)&rodata_889e8 /*=0x889e8*/, 0U, arg2, arg3);
}

/* ================================================================ */
/* member unit: g1_unsorted_05.c */
/* ================================================================ */
/*
 * Cohesive translation unit for the `unsorted' module.
 *
 * GENERATED by recon/refactor/transforms/t04_cohesive_tu.py.  Do not
 * edit: a stage tree is regenerated, never hand-patched
 * (recon/refactor/README.md C4).
 *
 * The 19 functions below were 19 separate translation units until this
 * stage.  Each one's text is reproduced VERBATIM and in the order the
 * generated source list gave it, and they were CONSECUTIVE in that list.
 * They were proven able to share a translation unit: no symbol is
 * declared here with two types, no identifier has internal linkage in one
 * member and is named by another, and no local typedef, macro, struct tag
 * or enum constant of one member is visible to a member that names it.
 *
 * members, in link order:
 *   misc_dev_api_write_op12.c
 *   framed_serial_receive_parser.c
 *   packet_transport_send_byte.c
 *   pt_queue_get_free_slot.c
 *   panel_render_screen_dispatch.c
 *   ui_new_message_task.c
 *   handle_stocks_action.c
 *   not_disturb_disable_pending.c
 *   panel_set_brightness_level.c
 *   panel_suspend.c
 *   panel_resume.c
 *   set_g_misc_val_27c8.c
 *   extract_decimal.c
 *   cpu_idle_wfi_gate_check.c
 *   delay_busy_wait_usec.c
 *   lookup_word_table_8acb4.c
 *   g1_recon_z_log_msg_alloc.c
 *   g1_recon_z_log_msg_commit.c
 *   uuid_len_from_type.c
 */

/* File-scope forward declarations for every struct/union tag this
 * unit names.  Without them a tag whose only appearance in a member
 * is inside a parameter list has PARAMETER-LIST scope, so two
 * textually IDENTICAL declarations in two members declare two
 * different incomplete types and the second is a conflicting
 * redeclaration (C11 6.2.1p7).  Incomplete-type forward
 * declarations emit no code. */
struct g1_i2c_msg;
/* ---- misc_dev_api_write_op12.c ---- */
#include "g1_app_symbols.h"
/* readable reconstruction; identity: FUN_00030c60 @ 0x00030c60
 * public-name: misc_dev_api_write_op12
 * durable-map: recon/catalogs/function_names_app.json
 * address symbols (name @ address):
 *   g_misc_dev_handle_2418                   @ 0x20002418
 */
/* Reconstructed misc_dev_api_write_op12 @ 0x30c60 (uncatalogued: Ghidra folded
 * it into the tail of misc_dev_api_transfer_op12, 0x30c24, whose declared
 * extent runs to 0x30c90).  Code 0x30c60..0x30c8a, literal pool 0x30c8c
 * (= 0x20002418).  Iteration 17.
 *
 * Slot 1 of the ops table the shipped `.data` places at 0x20002408 -- the
 * table `pt_nfc_eeprom_link_init` (0x30b3c) requires to be all-non-zero, and
 * whose ONLY referrer in the whole image is that `.data` word.
 *
 * Single-message form of misc_dev_api_transfer_op12: one { buf, len,
 * flags = 2 } descriptor (I2C_MSG_WRITE | I2C_MSG_STOP) handed to
 * `api->transfer` (offset +8 of the device's api pointer) with num_msgs = 1
 * and addr = 0x12.
 */

struct g1_i2c_msg { unsigned char *buf; unsigned int len; unsigned char flags; };
typedef int (*fnptr)(unsigned int, struct g1_i2c_msg *, int, int);

int misc_dev_api_write_op12(unsigned char *param_1, unsigned int param_2)
{
  struct g1_i2c_msg msg;
  int iVar1;
  unsigned int base;
  fnptr fp;
  msg.buf = param_1;
  msg.len = param_2;
  msg.flags = 2;
  base = *(volatile unsigned int *)((unsigned long)&g_misc_dev_handle_2418) /*=0x20002418*/;
  fp = *(fnptr *)(*(unsigned int *)(base + 8) + 8);
  iVar1 = fp(base, &msg, 1, 0x12);
  if (iVar1 != 0) iVar1 = 1;
  return -iVar1;
}

/* ---- framed_serial_receive_parser.c ---- */
/* readable reconstruction; identity: FUN_00033554 @ 0x00033554
 * public-name: framed_serial_receive_parser
 * durable-map: recon/catalogs/function_names_app.json
 * callees (readable <= raw @ address):
 *   memcpy                                   <= FUN_00086c04 @ 0x00086c04
 * address symbols (name @ address):
 *   rodata_a7993                             @ 0x000a7993   [INLINED -- refactor stage 01]
 *   rodata_a7aab                             @ 0x000a7aab   [INLINED -- G6 literal batch]
 *   rodata_a7ac1                             @ 0x000a7ac1   [INLINED -- G6 literal batch]
 *   rodata_f5400                             @ 0x000f5400
 *   g_uart_rx_frame_len                      @ 0x2001a128
 *   g_uart_rx_frame_buf                      @ 0x2001a129
 *   g_2001a12d                               @ 0x2001a12d
 */
/* CPUAPP framed serial receive/parser @ 0x00033554.
 * Raw/back-map identity: FUN_00033554, exact extent 0x14c bytes. */
#include <stdint.h>
#include "../../../headers/g1_log.h"

extern void memcpy(int, int, int);

uint32_t framed_serial_receive_parser(uint32_t transport, uint8_t **output,
                      uint32_t *output_size)
{
    volatile uint8_t *const received_size = (volatile uint8_t *)((unsigned long)&g_uart_rx_frame_len) /*=0x2001a128*/;
    volatile uint8_t *const received = (volatile uint8_t *)((unsigned long)g_uart_rx_frame_buf) /*=0x2001a129*/;
    uint32_t offset;

    if (transport == 0u || output == 0 || output_size == 0)
        return 0xffffffffu;
    if (*received_size == 0u)
        return 0xfffffffeu;

    for (offset = 0u; offset <= 0x100u - (uint32_t)*received_size; ++offset) {
        uint32_t payload_size;
        uint32_t index;
        uint8_t checksum;

        if (received[offset] != 0x5au || received[offset + 1u] != 0xa5u ||
            received[offset + 2u] != 0x7fu)
            continue;
        payload_size = received[offset + 3u];
        if ((int32_t)(payload_size + 4u) >= (int32_t)(0x100u - offset))
            continue;

        checksum = 0u;
        for (index = 0u; index != payload_size + 4u; ++index)
            checksum = (uint8_t)(checksum + received[offset + index]);
        if (received[offset + payload_size + 4u] != checksum)
            continue;

        memcpy(*output, (const void *)(uintptr_t)
                     (((unsigned long)&g_2001a12d) /*=0x2001a12d*/ + offset), payload_size);
        *output_size = payload_size;
        log_message(((unsigned long)"use read_serial_data:") /*=0xa7aab*/);
        for (index = 0u; index != payload_size; ++index)
            log_message(((unsigned long)"%02x ") /*=0xa7993*/, (uint32_t)(*output)[index]);
        log_message(((unsigned long)&rodata_f5400) /*=0xf5400*/);
        if (offset <= 0x100u - (uint32_t)*received_size) {
            *received_size = 0u;
            return 0u;
        }
        break;
    }

    *received_size = 0u;
    log_message(((unsigned long)"Err:serial recv data does not meet the protocol\n") /*=0xa7ac1*/);
    return 0xfffffffdu;
}

/* ---- packet_transport_send_byte.c ---- */
/* readable reconstruction; identity: FUN_0003364c @ 0x0003364c
 * public-name: packet_transport_send_byte
 * durable-map: recon/catalogs/function_names_app.json
 * callees (readable <= raw @ address):
 *   packet_transport_send_byte               <= FUN_0003364c @ 0x0003364c
 *   k_sleep                                  <= FUN_00074844 @ 0x00074844
 * address symbols (name @ address):
 *   rodata_a7af2                             @ 0x000a7af2   [INLINED -- G6 literal batch]
 */
/* Reconstructed FUN_0003364c @ 0x0003364c, extent 0x00000054.
 * Readable identity: packet_transport_send_byte.
 * Raw/address backmap: packet_transport_send_byte <= FUN_0003364c @ 0x0003364c.
 * CFG_VERIFY_CALL_ARITIES=1,2,3,2
 */

extern int32_t k_sleep(k_timeout_t);

int packet_transport_send_byte(void *transport, const uint8_t *value, const void *required)
{
    uint32_t *vtable;
    int result;

    if (transport == 0 || value == 0 || required == 0)
        return -1;
    vtable = *(uint32_t **)((uint8_t *)transport + 8);
    result = ((int (*)(uint32_t))vtable[1])(10000U);
    if (result != 0) {
        log_message(((unsigned long)"Failed to initiate transmission\n") /*=0xa7af2*/);
        return -2;
    }
    k_sleep(0x4000U, 0U);
    ((void (*)(void *, uint32_t))vtable[7])(transport, *value);
    k_sleep(3277U, 0U);
    return 0;
}

/* ---- pt_queue_get_free_slot.c ---- */
/* readable reconstruction; identity: FUN_00033bc4 @ 0x00033bc4
 * public-name: pt_queue_get_free_slot
 * durable-map: recon/catalogs/function_names_app.json
 * callees (readable <= raw @ address):
 *   pt_queue_get_free_slot                   <= FUN_00033bc4 @ 0x00033bc4
 */
/* Reconstructed FUN_00033bc4 @ 0x33bc4  (parity: 300/300 trials, PROVEN) */

unsigned int pt_queue_get_free_slot(void)
{
  unsigned int uVar1;
  uVar1 = (unsigned int)*(volatile unsigned char *)(0x20008dacUL + 0x118);
  if (uVar1 != 0) {
    if (*(volatile unsigned char *)(0x20008dacUL + 0x116) == 0) {
      uVar1 = 0;
      if (*(volatile unsigned char *)(0x20008dacUL + 0x115) < 4) {
        uVar1 = 0x20008dacUL + 0x108;
        *(volatile unsigned char *)(0x20008dacUL + 0x114) = 10;
        return uVar1;
      }
    } else {
      uVar1 = 0;
    }
  }
  return uVar1;
}

/* ---- panel_render_screen_dispatch.c ---- */
/* readable reconstruction; identity: panel_render_screen_dispatch @ 0x00035774
 * public-name: panel_render_screen_dispatch
 * durable-map: recon/catalogs/function_names_app.json
 * callees (readable <= raw @ address):
 *   (indirect only -- through the screen table and the context vtable)
 * address symbols (name @ address):
 *   g_screen_render_table                    @ 0x20002430
 */
/* Reconstructed panel_render_screen_dispatch @ 0x35774 (uncatalogued: Ghidra
 * folded it into the tail of dump_whitelist_init; code 0x35774..0x357d4,
 * literal pool 0x357d8..0x357dc).  (parity: cfg_verify PASS, 203/203 trials)
 * Vtable slot +0x14 (device_ctx + 0xb80) written by quicknote_buffer_pool_init;
 * the only user is ui_refalsh_warp+0x284 (0x48de0).
 */

typedef void (*render_one_t)(uint32_t arg);
typedef void (*render_ctx_t)(uint8_t *context, uint32_t arg);
typedef void (*ctx_hook_t)(uint8_t *context);

int32_t panel_render_screen_dispatch(uint8_t *context, uint32_t screen, uint32_t arg)
{
    uint32_t *entry;
    int use_table;

    if (*(volatile uint8_t *)(context + 0x47b) == 0)
        return -1;
    *(volatile uint32_t *)(context + 0x348) = 0;
    *(volatile uint32_t *)(context + 0x34c) = 0xb0;

    use_table = 1;
    if (screen != 7) {
        ((ctx_hook_t)*(volatile uint32_t *)(context + 0x1c))(context);
        use_table = ((uint32_t)(screen - 1) <= 16u);
    }
    if (use_table) {
        entry = (uint32_t *)((unsigned long)&g_screen_render_table /*=0x20002430*/
                             + (screen - 1) * 16u);
        if (entry[1] != 0) {
            if (entry[3] != 0)
                ((render_one_t)entry[3])(arg);
        }
        ((render_ctx_t)entry[2])(context, arg);
    }
    if (*(volatile uint32_t *)(context + 0x35c) != 0)
        ((ctx_hook_t)*(volatile uint32_t *)(context + 0x18))(context);
    return 0;
}

/* ---- ui_new_message_task.c ---- */
/* readable reconstruction; identity: FUN_00036b3c @ 0x00036b3c
 * public-name: ui_new_message_task
 * durable-map: recon/catalogs/function_names_app.json
 * callees (readable <= raw @ address):
 *   get_device_info                          <= FUN_000167a8 @ 0x000167a8
 *   debug_print                              <= FUN_00019c70 @ 0x00019c70
 *   get_message_pending_state                <= FUN_00034410 @ 0x00034410
 *   notification_icon_type_from_package      <= FUN_0003483c @ 0x0003483c
 *   gui_set_active_canvas                    <= FUN_000431b4 @ 0x000431b4
 *   gui_screen_clear                         <= FUN_000431c0 @ 0x000431c0
 *   gui_canvas_flags_set_bit1                <= FUN_000432d0 @ 0x000432d0
 *   gui_canvas_flags_clear_bit1              <= FUN_000432ec @ 0x000432ec
 *   gui_bmp_bitmap_draw                      <= FUN_00043484 @ 0x00043484
 *   reflash_fb_data_to_lcd                   <= FUN_00047260 @ 0x00047260
 *   device_info_text_width_get               <= FUN_0007d3ee @ 0x0007d3ee
 *   device_info_text_height_get_clamped      <= FUN_0007d446 @ 0x0007d446
 * address symbols (name @ address):
 *   rodata_a8e61                             @ 0x000a8e61   [INLINED -- G6 literal batch]
 *   rodata_a8e84                             @ 0x000a8e84   [INLINED -- G6 literal batch]
 *   rodata_a8e98                             @ 0x000a8e98
 *   rodata_aae20                             @ 0x000aae20
 *   g_log_use_alt_sink                       @ 0x20007554
 *   g_2001b812                               @ 0x2001b812
 *   g_2001b813                               @ 0x2001b813
 */
/* CPUAPP ui_new_message_task @ 0x00036b3c.
 * Raw/back-map identity: FUN_00036b3c, exact reachable extent 0x1fc bytes. */
#include "g1_unsorted.h"

extern uint32_t get_message_pending_state(void);
extern uint32_t notification_icon_type_from_package(uint32_t index);
extern void gui_screen_clear(void);
extern unsigned int gui_set_active_canvas(unsigned int);
extern void gui_canvas_flags_set_bit1(void);
extern void gui_canvas_flags_clear_bit1(void);
extern uint32_t device_info_text_width_get(void);
extern uint32_t device_info_text_height_get_clamped(void);
extern int gui_bmp_bitmap_draw(unsigned int, int, int, int, int, int);
extern void reflash_fb_data_to_lcd(uintptr_t left, uintptr_t right, uint32_t x,
                         uint32_t y, uint32_t width, uint32_t height);

#define LOG_ROUTE (*(volatile uint32_t *)((unsigned long)&g_log_use_alt_sink) /*=0x20007554*/)
#define MESSAGE_TASK_ACTIVE (*(volatile uint8_t *)((unsigned long)&g_2001b813) /*=0x2001b813*/)
#define MESSAGE_TASK_RENDERED (*(volatile uint8_t *)((unsigned long)&g_2001b812) /*=0x2001b812*/)
#define MASK_TABLE ((const uint8_t *)((unsigned long)&rodata_aae20) /*=0xaae20*/)
#define MASK_PHASE ((const uint8_t *)((unsigned long)&rodata_a8e98) /*=0xa8e98*/)

#define TASK_LOG(format, ...) do { \
    if (LOG_ROUTE == 0u) log_message((format), ##__VA_ARGS__); \
    else debug_print((format), ##__VA_ARGS__); \
} while (0)

uint32_t ui_new_message_task(uint8_t *canvas, uint32_t unused, uint32_t phase)
{
    uintptr_t state = get_device_info();
    uint32_t mode = get_message_pending_state();
    uint8_t was_active = MESSAGE_TASK_ACTIVE;

    (void)unused;
    if (mode == 4u)
        return 0u;
    if (phase == 2u) {
        TASK_LOG(((unsigned long)"ui_new_message_come_on_task exit !") /*=0xa8e61*/);
        gui_screen_clear();
        MESSAGE_TASK_ACTIVE = 0u;
        MESSAGE_TASK_RENDERED = 0u;
        return 0u;
    }
    if (phase == 0u)
        return 0u;

    if (MESSAGE_TASK_ACTIVE == 0u) {
        MESSAGE_TASK_ACTIVE = 1u;
        gui_set_active_canvas(canvas + 0x24);
        gui_canvas_flags_set_bit1();
        gui_screen_clear();
        MESSAGE_TASK_RENDERED = was_active;
    }
    if (*(volatile uint8_t *)(state + 0xf6u) < 2u) {
        MESSAGE_TASK_RENDERED = 0u;
        gui_screen_clear();
        return 0u;
    }

    state = get_device_info();
    uint32_t message_type = notification_icon_type_from_package(
        (uint8_t)(*(volatile uint8_t *)(state + 0xddu) - 1u));
    TASK_LOG(((unsigned long)"new msgType is %d \n") /*=0xa8e84*/, message_type);
    if (MESSAGE_TASK_RENDERED != 0u)
        return 0u;

    gui_canvas_flags_clear_bit1();
    for (uint32_t frame = 0u; frame != 8u; ++frame) {
        uint32_t glyph;
        switch (message_type) {
        case 1u: glyph = 0x37u; break;
        case 2u: glyph = 0x36u; break;
        case 3u: glyph = 0x3au; break;
        case 4u: glyph = 0x39u; break;
        default: glyph = 0x38u; break;
        }
        uint32_t x = device_info_text_width_get();
        uint32_t y = device_info_text_height_get_clamped() + 0x3au;
        gui_bmp_bitmap_draw(glyph, x, y, 0u, 0u, 0u);

        for (uint32_t row = 0u; row != 199u; ++row) {
            uint8_t *pixels = *(uint8_t **)(void *)(canvas + 0x24u + row * 4u);
            const uint8_t *mask = MASK_TABLE + (row % 26u) * 0xa00u +
                                  (uint32_t)MASK_PHASE[frame] * 0x140u;
            for (uint32_t column = 0u; column != 0x140u; ++column) {
                uint8_t pixel = pixels[column];
                if (pixel != 0u)
                    pixels[column] = (uint8_t)(pixel & mask[column]);
            }
        }
        state = get_device_info();
        uintptr_t left = *(volatile uintptr_t *)(state + 0xeb4u);
        state = get_device_info();
        reflash_fb_data_to_lcd(left, *(volatile uintptr_t *)(state + 0xeb8u),
                     0u, 0u, 0x280u, 199u);
    }
    gui_canvas_flags_set_bit1();
    MESSAGE_TASK_RENDERED = 1u;
    return 0u;
}

/* ---- handle_stocks_action.c ---- */
#include "../../../headers/g1_dedupe.h"
/* readable reconstruction; identity: FUN_000371e8 @ 0x000371e8
 * public-name: handle_stocks_action
 * durable-map: recon/catalogs/function_names_app.json
 * callees (readable <= raw @ address):
 *   debug_print                              <= FUN_00019c70 @ 0x00019c70
 * address symbols (name @ address):
 *   rodata_a8ff3                             @ 0x000a8ff3   [INLINED -- G6 literal batch]
 *   rodata_a959e                             @ 0x000a959e   [INLINED -- G6 literal batch]
 *   g_log_level                              @ 0x2000230c
 *   g_dashboard_widget_state                 @ 0x20004950
 *   g_log_use_alt_sink                       @ 0x20007554
 *   g_news_widget_index_raw                  @ 0x2001b814
 */
/* Reconstructed handle_stocks_action @ 0x371e8  (parity: 300/300 trials, PROVEN) */


unsigned int handle_stocks_action(unsigned int param_1, unsigned int param_2,
                                  unsigned int param_3, unsigned int param_4)
{
    unsigned int action = param_1 & 0xffu;
    *(volatile unsigned char *)(((unsigned long)&g_dashboard_widget_state) /*=0x20004950*/+5) = (unsigned char)action;
    *(volatile unsigned char *)((unsigned long)&g_news_widget_index_raw) /*=0x2001b814*/ = (unsigned char)action;
    if (*(volatile int *)((unsigned long)&g_log_level) /*=0x2000230c*/ > 2) {
        G1_LOG_ROUTE(*(volatile unsigned int *)((unsigned long)&g_log_use_alt_sink) /*=0x20007554*/ == 0, ((unsigned long)"%s():  %s index = %d\n") /*=0xa8ff3*/, ((unsigned long)"setNewsIndex") /*=0xa959e*/, ((unsigned long)"setNewsIndex") /*=0xa959e*/,
                         action);
    }
    return 0;
}

/* ---- not_disturb_disable_pending.c ---- */
/* readable reconstruction; identity: FUN_0003cebc @ 0x0003cebc
 * public-name: not_disturb_disable_pending
 * durable-map: recon/catalogs/function_names_app.json
 * address symbols (name @ address):
 *   g_even_ai_mic_icon_visible               @ 0x2001b9ab
 */
/* Reconstructed ext3cebc @ 0x3cebc.
 * Readable identity: not_disturb_disable_pending.
 * Exact standalone extent: 0x72 bytes; 0x3cf2e is alignment.
 */


extern int not_disturb_sync_data(const uint8_t *value, uint32_t length);
extern void update_not_disturb_settings(void);
extern void update_persist_task_status(void *device, uint32_t kind,
                                       uint32_t state);

int not_disturb_disable_pending(uint8_t value)
{
    uint8_t *device = get_device_info();
    uint8_t *state = *(uint8_t **)(device + 0x1010);
    int result;

    if (state[1] == 0U) {
        return 0;
    }
    result = not_disturb_sync_data(&value, 1U);
    if (result != 0) {
        return result;
    }
    device = get_device_info();
    state = *(uint8_t **)(device + 0x1010);
    state[1] = 0U;
    device = get_device_info();
    if (device[0] != 1U) {
        return 0;
    }

    update_not_disturb_settings();
    *(volatile uint8_t *)((unsigned long)&g_even_ai_mic_icon_visible) /*=0x2001b9ab*/ = value;
    device = get_device_info();
    device[0xcd] = *(volatile uint8_t *)((unsigned long)&g_even_ai_mic_icon_visible) /*=0x2001b9ab*/;
    device = get_device_info();
    state = *(uint8_t **)(device + 0x1010);
    state[0] = 1U;
    device = get_device_info();
    update_persist_task_status(device, 7U, 2U);
    return 0;
}

/* ---- panel_set_brightness_level.c ---- */
/* readable reconstruction; identity: panel_set_brightness_level @ 0x00046ce8
 * public-name: panel_set_brightness_level
 * durable-map: recon/catalogs/function_names_app.json
 * callees (readable <= raw @ address):
 *   log_message                              <= FUN_0007dda4 @ 0x0007dda4
 *   debug_print                              <= FUN_00019c70 @ 0x00019c70
 * address symbols (name @ address):
 *   rodata_d720f                             @ 0x000d720f   [INLINED -- G6 literal batch]
 *   rodata_d732c                             @ 0x000d732c   [INLINED -- G6 literal batch]
 *   g_log_level                              @ 0x2000230c
 *   g_log_use_alt_sink                       @ 0x20007554
 */
/* Reconstructed panel_set_brightness_level @ 0x46ce8 (uncatalogued: Ghidra
 * folded it into the tail of ui_set_imu_pitch_task; code 0x46ce8..0x46d1a,
 * literal pool 0x46d1c..0x46d2c).  (parity: cfg_verify PASS, 200/200 trials)
 * Vtable slot +0x20 (device_ctx + 0xb8c) written by quicknote_buffer_pool_init.
 * Name self-evidenced: the log tag 0x000d732c is "panel_set_brightness_level".
 */


uint32_t panel_set_brightness_level(uint8_t *context, uint32_t level)
{
    if (*(volatile uint8_t *)(context + 0x369) != level) {
        *(volatile uint8_t *)(context + 0x369) = (uint8_t)level;
        if (*(volatile int *)((unsigned long)&g_log_level) /*=0x2000230c*/ > 2) {
            G1_LOG_ROUTE(*(volatile int *)((unsigned long)&g_log_use_alt_sink) /*=0x20007554*/ == 0, ((unsigned long)"%s(): new: %d\n") /*=0xd720f*/, ((unsigned long)"panel_set_brightness_level") /*=0xd732c*/, level);
        }
    }
    return level;
}

/* ---- panel_suspend.c ---- */
/* readable reconstruction; identity: panel_suspend @ 0x00046d8c
 * public-name: panel_suspend
 * durable-map: recon/catalogs/function_names_app.json
 * callees (readable <= raw @ address):
 *   log_message                              <= FUN_0007dda4 @ 0x0007dda4
 *   debug_print                              <= FUN_00019c70 @ 0x00019c70
 *   jbd_panel_suspend                        <= FUN_000475f0 @ 0x000475f0
 *   panel_off                                <= FUN_00046d2c @ 0x00046d2c
 * address symbols (name @ address):
 *   rodata_d721e                             @ 0x000d721e   [INLINED -- G6 literal batch]
 *   rodata_d72db                             @ 0x000d72db   [INLINED -- G6 literal batch]
 *   g_log_level                              @ 0x2000230c
 *   g_log_use_alt_sink                       @ 0x20007554
 */
/* Reconstructed panel_suspend @ 0x46d8c (uncatalogued: Ghidra folded it into
 * the tail of panel_off; code 0x46d8c..0x46dc6, literal pool 0x46dc8..0x46dd8).
 * (parity: cfg_verify PASS, 200/200 trials)
 * Vtable slot +0x04 (device_ctx + 0xb70) written by quicknote_buffer_pool_init
 * (0x47148) -- the pointer global_system_suspend (0x2bd7c) dispatches through.
 * Name self-evidenced: the log tag 0x000d72db is "panel_suspend".
 */

extern void jbd_panel_suspend(void);
extern uint32_t panel_off(uint8_t *context);

uint32_t panel_suspend(uint8_t *context)
{
    *(void * volatile *)(context + 0x374) = (void *)(context - 0x5c);
    if (*(volatile int *)((unsigned long)&g_log_level) /*=0x2000230c*/ > 2) {
        G1_LOG_ROUTE(*(volatile int *)((unsigned long)&g_log_use_alt_sink) /*=0x20007554*/ == 0, ((unsigned long)"%s(): panel_suspend enter!\n") /*=0xd721e*/, ((unsigned long)"panel_suspend") /*=0xd72db*/);
    }
    jbd_panel_suspend();
    panel_off(context);
    *(volatile uint32_t *)(context + 0x35c) = 0;
    return 0;
}

/* ---- panel_resume.c ---- */
/* readable reconstruction; identity: panel_resume @ 0x00046f20
 * public-name: panel_resume
 * durable-map: recon/catalogs/function_names_app.json
 * callees (readable <= raw @ address):
 *   log_message                              <= FUN_0007dda4 @ 0x0007dda4
 *   debug_print                              <= FUN_00019c70 @ 0x00019c70
 *   jbd_panel_resume                         <= FUN_00047638 @ 0x00047638
 *   spi_read_id                              <= FUN_00047724 @ 0x00047724
 *   panel_on                                 <= FUN_00046dd8 @ 0x00046dd8
 *   set_brightness_to_panel_reg              <= FUN_00046e3c @ 0x00046e3c
 * address symbols (name @ address):
 *   rodata_d7272                             @ 0x000d7272   [INLINED -- G6 literal batch]
 *   rodata_d728d                             @ 0x000d728d   [INLINED -- G6 literal batch]
 *   rodata_d72c4                             @ 0x000d72c4   [INLINED -- G6 literal batch]
 *   g_log_level                              @ 0x2000230c
 *   g_log_use_alt_sink                       @ 0x20007554
 */
/* Reconstructed panel_resume @ 0x46f20 (uncatalogued: Ghidra folded it into the
 * tail of set_brightness_to_panel_reg; code 0x46f20..0x46fa8, literal pool
 * 0x46fac..0x46fc0).  (parity: cfg_verify PASS, 200/200 trials)
 * Vtable slot +0x08 (device_ctx + 0xb74) written by quicknote_buffer_pool_init.
 * Name self-evidenced: the log tag 0x000d72c4 is "panel_resume"; the failure
 * string 0x000d728d is "%s(): JBD PANEL init failure!\n".
 * This is the E4 display bring-up path: it calls spi_read_id (0x47724) and
 * requires the JBD panel ID 0x4010.
 */

extern void jbd_panel_resume(uint8_t *context);
extern uint32_t spi_read_id(void);
extern void panel_on(uint8_t *context);
extern void set_brightness_to_panel_reg(uint32_t level);

int32_t panel_resume(uint8_t *context)
{
    int32_t state;

    *(void * volatile *)(context + 0x374) = (void *)(context - 0x5c);
    if ((*(volatile uint16_t *)(context + 0x4f0) & 0x100u) == 0)
        return -1;
    if (*(volatile int *)((unsigned long)&g_log_level) /*=0x2000230c*/ > 2) {
        G1_LOG_ROUTE(*(volatile int *)((unsigned long)&g_log_use_alt_sink) /*=0x20007554*/ == 0, ((unsigned long)"%s(): panel_resume enter!\n") /*=0xd7272*/, ((unsigned long)"panel_resume") /*=0xd72c4*/);
    }
    state = *(volatile int32_t *)(context + 0x35c);
    if (state != 0)
        return -1;
    if (*(volatile uint32_t *)(*(void * volatile *)(context + 0x374) + 0x14) == 0) {
        panel_on(context);
        set_brightness_to_panel_reg(*(volatile uint8_t *)(context + 0x369));
        return state;
    }
    jbd_panel_resume(context);
    if (spi_read_id() != 0x4010u) {
        if (*(volatile int *)((unsigned long)&g_log_level) /*=0x2000230c*/ > 0) {
            G1_LOG_ROUTE(*(volatile int *)((unsigned long)&g_log_use_alt_sink) /*=0x20007554*/ == 0, ((unsigned long)"%s(): JBD PANEL init failure!\n") /*=0xd728d*/, ((unsigned long)"panel_resume") /*=0xd72c4*/);
        }
    }
    *(volatile int32_t *)(context + 0x35c) = 1;
    return state;
}

/* ---- set_g_misc_val_27c8.c ---- */
/* readable reconstruction; identity: FUN_0004b1c0 @ 0x0004b1c0
 * public-name: set_g_misc_val_27c8
 * durable-map: recon/catalogs/function_names_app.json
 * callees (readable <= raw @ address):
 *   set_g_misc_val_27c8                      <= FUN_0004b1c0 @ 0x0004b1c0
 * address symbols (name @ address):
 *   g_misc_val_27c8                          @ 0x200027c8
 */
/* Reconstructed FUN_0004b1c0 @ 0x4b1c0  (parity: 300/300 trials, PROVEN) */

static void set_g_misc_val_27c8(uint32_t param_1) {
    *(volatile uint32_t *)((unsigned long)&g_misc_val_27c8) /*=0x200027c8*/ = param_1;
}

/* ---- extract_decimal.c ---- */
/* readable reconstruction; identity: FUN_0004bb64 @ 0x0004bb64
 * public-name: extract_decimal
 * durable-map: recon/catalogs/function_names_app.json
 * callees (readable <= raw @ address):
 *   extract_decimal                          <= FUN_0004bb64 @ 0x0004bb64
 * address symbols (name @ address):
 *   rodata_f8a6b                             @ 0x000f8a6b
 */
/* Reconstructed FUN_0004bb64 @ 0x4bb64  (parity: 300/300 trials, PROVEN) */

int extract_decimal(unsigned int *param_1)
{
  int iVar1 = 0;
  unsigned char *pbVar2 = (unsigned char *)*param_1;
  while (1) {
    unsigned char c = *pbVar2;
    unsigned char tbl = *(volatile unsigned char *)(((unsigned long)&rodata_f8a6b) /*=0xf8a6b*/ + c);
    if ((int)((unsigned int)tbl << 0x1d) >= 0) break;
    iVar1 = iVar1*10 + (int)c - 0x30;
    pbVar2 = pbVar2 + 1;
  }
  *param_1 = (unsigned int)pbVar2;
  return iVar1;
}

/* ---- cpu_idle_wfi_gate_check.c ---- */
/* readable reconstruction; identity: FUN_0004c1f0 @ 0x0004c1f0
 * public-name: cpu_idle_wfi_gate_check
 * durable-map: recon/catalogs/function_names_app.json
 * callees (readable <= raw @ address):
 *   cpu_idle_wfi_gate_check                  <= FUN_0004c1f0 @ 0x0004c1f0
 *   sys_clock_cycle_get_32                   <= FUN_00084c76 @ 0x00084c76
 * address symbols (name @ address):
 *   g_analytics_evt_tick_buf                 @ 0x2000a0b4
 *   g_analytics_evt_hist_ready               @ 0x2001d449
 *   g_analytics_evt_buf_idx                  @ 0x2001d44a
 *   REG_50005114                             @ 0x50005114
 */
/* Reconstructed FUN_0004c1f0 @ 0x4c1f0  (parity: 300/300 trials, PROVEN) */
extern uint32_t sys_clock_cycle_get_32(void);
static uint32_t cpu_idle_wfi_gate_check(void){
  volatile uint8_t *pbVar2 = (volatile uint8_t*)((unsigned long)&g_analytics_evt_buf_idx) /*=0x2001d44a*/;
  uint32_t iVar3 = ((unsigned long)&g_analytics_evt_tick_buf) /*=0x2000a0b4*/;
  volatile uint8_t *pcVar4 = (volatile uint8_t*)((unsigned long)&g_analytics_evt_hist_ready) /*=0x2001d449*/;
  uint32_t uVar7 = ((uint32_t)*pbVar2 + 1) % 5;
  int iVar5 = sys_clock_cycle_get_32();
  int enter;
  if(*pcVar4 == 0){
    enter = 1;
  } else {
    uint32_t diff = (uint32_t)(iVar5 - *(volatile int *)(iVar3 + uVar7*4));
    enter = (diff > 7);
  }
  if(!enter){
    return 0;
  }
  if(*(volatile uint32_t *)REG_50005114 /*=0x50005114*/ != 0){
    *(volatile uint32_t *)REG_50005114 /*=0x50005114*/ = 0;
    (void)*(volatile uint32_t *)REG_50005114 /*=0x50005114*/;
    *pbVar2 = (uint8_t)uVar7;
    if(uVar7 == 0){
      *pcVar4 = 1;
    }
  }
  uint8_t bVar1 = *pbVar2;
  uint32_t uVar6 = sys_clock_cycle_get_32();
  *(volatile uint32_t *)(iVar3 + (uint32_t)bVar1*4) = uVar6;
  return 1;
}

/* ---- delay_busy_wait_usec.c ---- */
/* readable reconstruction; identity: FUN_0004c254 @ 0x0004c254
 * public-name: delay_busy_wait_usec
 * durable-map: recon/catalogs/function_names_app.json
 * callees (readable <= raw @ address):
 *   delay_busy_wait_usec                     <= FUN_0004c254 @ 0x0004c254
 * address symbols (name @ address):
 *   g_20002bb8                               @ 0x20002bb8
 */
/* Reconstructed FUN_0004c254 @ 0x4c254
 * CFG_VERIFY_CALL_ARITIES=1
 * Readable identity: delay_scaled_busy_wait.
 * Raw/address backmap: delay_scaled_busy_wait <= FUN_0004c254 @ 0x0004c254.
 */


typedef void (*busy_wait_fn_t)(uint32_t cycles);

void delay_busy_wait_usec(uint32_t usec)
{
    volatile uint32_t *const cycles_per_second =
        (volatile uint32_t *)((unsigned long)&g_20002bb8) /*=0x20002bb8*/;
    /* P4 iteration 15: the literal 0x00088841 was a RAW ORIGINAL-IMAGE Thumb
     * address (the uncatalogued 6-byte busy-wait kernel `subs r0,#3 ; bhi ; bx lr`
     * at 0x88840, reached from nowhere else in the image).  Our build puts
     * unrelated rodata there, so the `bx` executed data.  MEASURED (iteration 15,
     * g1-i15d, 0.15 s): main -> jdb_panel_init -> panel_init ->
     * projector_reset_sequence -> delay_ms -> delay_scaled_busy_wait ->
     * delay_busy_wait_usec -> pc 0x88840 -> "Attempt to execute undefined
     * instruction" -> ZEPHYR FATAL ERROR 36 -> reset.  Same sub-class as
     * iteration 14 section 14.3: a hardcoded numeric literal that no PROVIDE can
     * reach, so the consumer has to NAME the symbol. */
    busy_wait_fn_t const busy_wait = (busy_wait_fn_t)ADDR_coredep_delay_cycles_THUMB;

    if (usec != 0U) {
        busy_wait(usec * (*cycles_per_second / 1000000U));
    }
}

/* ---- lookup_word_table_8acb4.c ---- */
/* readable reconstruction; identity: FUN_0004d420 @ 0x0004d420
 * public-name: lookup_word_table_8acb4
 * durable-map: recon/catalogs/function_names_app.json
 * callees (readable <= raw @ address):
 *   lookup_word_table_8acb4                  <= FUN_0004d420 @ 0x0004d420
 * address symbols (name @ address):
 *   rodata_8acb4                             @ 0x0008acb4
 */
/* Reconstructed FUN_0004d420 @ 0x4d420  (parity: 300/300 trials, PROVEN) */

static unsigned int lookup_word_table_8acb4(int param_1)
{
    return *(volatile unsigned int *)(((unsigned long)&rodata_8acb4) /*=0x8acb4*/ + (unsigned int)param_1 * 4);
}

/* ---- g1_recon_z_log_msg_alloc.c ---- */
/* readable reconstruction; identity: FUN_0004d55c @ 0x0004d55c
 * public-name: g1_recon_z_log_msg_alloc
 * durable-map: recon/catalogs/function_names_app.json
 * callees (readable <= raw @ address):
 *   g1_recon_z_log_msg_alloc                 <= FUN_0004d55c @ 0x0004d55c
 * address symbols (name @ address):
 *   g_log_msg_mpsc_buffer                    @ 0x20003648
 */
/* Reconstructed FUN_0004d55c @ 0x4d55c. */
/* mpsc_pbuf_alloc <= FUN_0004bc8c @ 0x0004bc8c.  k_timeout_t is two words. */
extern int mpsc_pbuf_alloc(void *object, unsigned int value,
                           unsigned int low, unsigned int high);

int g1_recon_z_log_msg_alloc(unsigned int param_1)
{
    return mpsc_pbuf_alloc((void *)((unsigned long)&g_log_msg_mpsc_buffer) /*=0x20003648*/, param_1, 0, 0);
}

/* ---- g1_recon_z_log_msg_commit.c ---- */
/* readable reconstruction; identity: FUN_0004d8b8 @ 0x0004d8b8
 * public-name: g1_recon_z_log_msg_commit
 * durable-map: recon/catalogs/function_names_app.json
 * callees (readable <= raw @ address):
 *   z_log_msg_post_finalize                  <= FUN_0004d7d8 @ 0x0004d7d8
 *   g1_recon_z_log_msg_commit                <= FUN_0004d8b8 @ 0x0004d8b8
 * address symbols (name @ address):
 *   g_200027f8                               @ 0x200027f8
 *   g_log_msg_mpsc_buffer                    @ 0x20003648
 */
/* Reconstructed FUN_0004d8b8 @ 0x4d8b8
 * CFG_VERIFY_CALL_ARITIES=0,2,0
 * Readable identity: z_log_msg_commit.
 * Raw/address backmap: z_log_msg_commit <= FUN_0004d8b8 @ 0x0004d8b8.
 */


typedef uint32_t (*timestamp_fn_t)(void);

/* mpsc_pbuf_commit <= FUN_0004be0c @ 0x0004be0c */
extern void mpsc_pbuf_commit(void *buffer, void *message);
extern void z_log_msg_post_finalize(void); /* z_log_msg_post_finalize */

void g1_recon_z_log_msg_commit(void *message)
{
    timestamp_fn_t timestamp =
        *(timestamp_fn_t volatile *)((unsigned long)&g_200027f8) /*=0x200027f8*/;

    *(volatile uint32_t *)((uintptr_t)message + 8U) = timestamp();
    mpsc_pbuf_commit((void *)((unsigned long)&g_log_msg_mpsc_buffer) /*=0x20003648*/, message);
    z_log_msg_post_finalize();
}

/* ---- uuid_len_from_type.c ---- */
/* readable reconstruction; identity: FUN_0004e98c @ 0x0004e98c
 * public-name: uuid_len_from_type
 * durable-map: recon/catalogs/function_names_app.json
 * callees (readable <= raw @ address):
 *   settings_invalid_index_log               <= FUN_0004e8c0 @ 0x0004e8c0
 *   uuid_len_from_type                       <= FUN_0004e98c @ 0x0004e98c
 * address symbols (name @ address):
 *   rodata_f1590                             @ 0x000f1590
 */
/* Reconstructed FUN_0004e98c @ 0x4e98c, exact code extent 16 bytes. */

extern uint32_t settings_invalid_index_log(uint32_t index, uint32_t a1,
                            uint32_t a2, uint32_t a3);

uint32_t uuid_len_from_type(uint32_t index, uint32_t a1, uint32_t a2, uint32_t a3,
                      uint32_t a4, uint32_t a5, uint32_t a6, uint32_t a7)
{
    if (index > 2u) {
        (void)a4; (void)a5; (void)a6; (void)a7;
        return settings_invalid_index_log(index, a1, a2, a3);
    }
    return *(const uint8_t *)(((unsigned long)&rodata_f1590) /*=0xf1590*/ + index);
}

