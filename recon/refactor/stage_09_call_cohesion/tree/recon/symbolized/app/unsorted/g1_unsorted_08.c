/*
 * Cohesive translation unit for the `unsorted' module.
 *
 * GENERATED by recon/refactor/transforms/t04_cohesive_tu.py.  Do not
 * edit: a stage tree is regenerated, never hand-patched
 * (recon/refactor/README.md C4).
 *
 * The 8 functions below were 8 separate translation units until this
 * stage.  Each one's text is reproduced VERBATIM and in the order the
 * generated source list gave it, and they were CONSECUTIVE in that list.
 * They were proven able to share a translation unit: no symbol is
 * declared here with two types, no identifier has internal linkage in one
 * member and is named by another, and no local typedef, macro, struct tag
 * or enum constant of one member is visible to a member that names it.
 *
 * members, in link order:
 *   send_err_rsp_alloc_failure_log.c
 *   find_cf_cfg_by_addr.c
 *   find_sc_cfg_59b94.c
 *   sc_indicate.c
 *   kobj_test_bit_get_ptr.c
 *   sys_memcpy_swap.c
 *   adc_context_start_sampling.c
 *   adc_channel_config.c
 */
/* ---- send_err_rsp_alloc_failure_log.c ---- */
#include "g1_app_symbols.h"
/* readable reconstruction; identity: FUN_00058568 @ 0x00058568
 * public-name: send_err_rsp_alloc_failure_log
 * durable-map: recon/catalogs/function_names_app.json
 * callees (readable <= raw @ address):
 *   send_err_rsp_alloc_failure_log           <= FUN_00058568 @ 0x00058568
 *   att_log_emit_3arg                        <= FUN_00081ddc @ 0x00081ddc
 * address symbols (name @ address):
 *   rodata_88100                             @ 0x00088100
 *   rodata_f4408                             @ 0x000f4408   [INLINED -- G6 literal batch]
 */
/* Reconstructed FUN_00058568 @ 0x00058568 (send_err_rsp log helper).
 * Raw/address backmap: FUN_00058568 @ 0x00058568, extent 0x0000001c.
 */
#include <stdint.h>
#include "../../../headers/g1_log.h"
#include "../../../headers/g1_dedupe.h"
#include "../../../headers/g1_nrf_regs.h"
extern void att_log_emit_3arg(uint32_t, uint32_t, const void *);
void send_err_rsp_alloc_failure_log(void)
{
    const uint32_t package[2] = { 2U, ((unsigned long)"unable to allocate buf for error response") /*=0xf4408*/ };
    att_log_emit_3arg(((unsigned long)&rodata_88100) /*=0x88100*/, 0x1040U, package);
}

/* ---- find_cf_cfg_by_addr.c ---- */
/* readable reconstruction; identity: FUN_00059b5c @ 0x00059b5c
 * public-name: find_cf_cfg_by_addr
 * durable-map: recon/catalogs/function_names_app.json
 * callees (readable <= raw @ address):
 *   find_cf_cfg_by_addr                      <= FUN_00059b5c @ 0x00059b5c
 *   bt_addr_le_eq_0                          <= FUN_000826b2 @ 0x000826b2
 * address symbols (name @ address):
 *   g_bt_gatt_cf_cfg                         @ 0x2000aed4
 *   g_2000aed5                               @ 0x2000aed5
 */
/* Reconstructed FUN_00059b5c @ 0x59b5c  (parity: 300/300 trials, PROVEN) */

extern int bt_addr_le_eq_0(unsigned int a, unsigned int b, unsigned int c, unsigned int d, unsigned int e);

int find_cf_cfg_by_addr(unsigned int param_1, unsigned int param_2, unsigned int param_3, unsigned int param_4)
{
    int iVar2 = 0;
    unsigned int iVar3 = ((unsigned long)&g_2000aed5) /*=0x2000aed5*/;
    while ((*(volatile unsigned char *)(iVar3 - 1) != param_1) ||
           (bt_addr_le_eq_0(param_2, iVar3, param_3, (unsigned int)*(volatile unsigned char *)(iVar3 - 1), param_4) == 0))
    {
        iVar2 = iVar2 + 0x10;
        iVar3 = iVar3 + 0x10;
        if (iVar2 == 0x30) {
            return 0;
        }
    }
    return ((unsigned long)&g_bt_gatt_cf_cfg) /*=0x2000aed4*/ + iVar2;
}

/* ---- find_sc_cfg_59b94.c ---- */
/* readable reconstruction; identity: FUN_00059b94 @ 0x00059b94
 * public-name: find_sc_cfg_59b94
 * durable-map: recon/catalogs/function_names_app.json
 * callees (readable <= raw @ address):
 *   find_sc_cfg_59b94                        <= FUN_00059b94 @ 0x00059b94
 *   bt_addr_le_eq_0                          <= FUN_000826b2 @ 0x000826b2
 * address symbols (name @ address):
 *   g_bt_gatt_sc_cfg                         @ 0x20006328
 *   g_bt_gatt_sc_cfg_addr                    @ 0x20006329
 */
/* Reconstructed FUN_00059b94 @ 0x59b94  (parity: 300/300 trials, PROVEN) */


int find_sc_cfg_59b94(unsigned int param_1, unsigned int param_2, unsigned int param_3, unsigned int param_4)
{
    int iVar2 = 0;
    unsigned int iVar3 = ((unsigned long)&g_bt_gatt_sc_cfg_addr) /*=0x20006329*/;
    while ((*(volatile unsigned char *)(iVar3 - 1) != param_1) ||
           (bt_addr_le_eq_0(param_2, iVar3, param_3, (unsigned int)*(volatile unsigned char *)(iVar3 - 1), param_4) == 0))
    {
        iVar2 = iVar2 + 0xc;
        iVar3 = iVar3 + 0xc;
        if (iVar2 == 0x24) {
            return 0;
        }
    }
    return ((unsigned long)&g_bt_gatt_sc_cfg) /*=0x20006328*/ + iVar2;
}

/* ---- sc_indicate.c ---- */
/* readable reconstruction; identity: FUN_0005a570 @ 0x0005a570
 * public-name: sc_indicate
 * durable-map: recon/catalogs/function_names_app.json
 * callees (readable <= raw @ address):
 *   sc_indicate                              <= FUN_0005a570 @ 0x0005a570
 *   k_work_reschedule                        <= FUN_0007350c @ 0x0007350c
 *   atomic_or_0                              <= FUN_000826e0 @ 0x000826e0
 *   read_struct_first_word                   <= FUN_0008270c @ 0x0008270c
 * address symbols (name @ address):
 *   g_service_changed_range                  @ 0x200063f8
 *   g_bt_gatt_flags                          @ 0x20006448
 */
/* Reconstructed FUN_0005a570 @ 0x5a570  (parity: 300/300 trials, PROVEN) */

extern int atomic_or_0(unsigned int a, unsigned int b, unsigned int c, unsigned int d, unsigned int e);
extern long long read_struct_first_word(unsigned int a);
extern void k_work_reschedule(unsigned int, unsigned int, unsigned int, unsigned int);

static void sc_indicate(unsigned int param_1, unsigned int param_2, unsigned int param_3, unsigned int param_4)
{
  unsigned short *puVar1;
  int iVar2;
  unsigned int uVar3;
  long long uVar4;

  uVar3 = atomic_or_0(((unsigned long)&g_bt_gatt_flags) /*=0x20006448*/,1,param_3,param_4,param_4);
  iVar2 = ((unsigned long)&g_service_changed_range) /*=0x200063f8*/;
  if ((uVar3 & 1) == 0) {
    *(volatile short *)(((unsigned long)&g_service_changed_range) /*=0x200063f8*/ + 0x18) = (short)param_1;
  } else {
    puVar1 = (unsigned short *)(((unsigned long)&g_service_changed_range) /*=0x200063f8*/ + 0x1a);
    if (param_1 < *(volatile unsigned short *)(((unsigned long)&g_service_changed_range) /*=0x200063f8*/ + 0x18)) {
      *(volatile short *)(((unsigned long)&g_service_changed_range) /*=0x200063f8*/ + 0x18) = (short)param_1;
      if (param_2 <= *(volatile unsigned short *)puVar1) goto LAB;
    } else if (param_2 <= *(volatile unsigned short *)puVar1) {
      return;
    }
  }
  *(volatile short *)(iVar2 + 0x1a) = (short)param_2;
LAB:
  uVar4 = read_struct_first_word(((unsigned long)&g_bt_gatt_flags) /*=0x20006448*/);
  if ((int)((int)uVar4 << 0x1e) < 0) {
    return;
  }
  k_work_reschedule(0, (int)(uVar4 >> 32), 0x148, 0);
}

/* ---- kobj_test_bit_get_ptr.c ---- */
/* readable reconstruction; identity: FUN_0005caa4 @ 0x0005caa4
 * public-name: kobj_test_bit_get_ptr
 * durable-map: recon/catalogs/function_names_app.json
 * callees (readable <= raw @ address):
 *   kobj_test_bit_get_ptr                    <= FUN_0005caa4 @ 0x0005caa4
 *   atomic_test_bit                          <= FUN_00082ff6 @ 0x00082ff6
 * address symbols (name @ address):
 *   g_misc_kobj_6454                         @ 0x20006454
 */
/* Reconstructed FUN_0005caa4 @ 0x5caa4  (parity: 300/300 trials, PROVEN) */

extern int atomic_test_bit(unsigned int, unsigned int, unsigned int, unsigned int, unsigned int);

int kobj_test_bit_get_ptr(unsigned int param_1, unsigned int param_2, unsigned int param_3, unsigned int param_4)
{
    unsigned int base = ((unsigned long)&g_misc_kobj_6454) /*=0x20006454*/;
    int iVar1 = atomic_test_bit(base, param_1, param_3, base, param_4);
    int iVar2 = (int)(base - 4);
    if (iVar1 == 0) {
        iVar2 = 0;
    }
    return iVar2;
}

/* ---- sys_memcpy_swap.c ---- */
/* readable reconstruction; identity: FUN_0005ec84 @ 0x0005ec84
 * public-name: sys_memcpy_swap
 * durable-map: recon/catalogs/function_names_app.json
 * callees (readable <= raw @ address):
 *   sys_memcpy_swap                          <= FUN_0005ec84 @ 0x0005ec84
 *   assert_post_action                       <= FUN_0007e2ec @ 0x0007e2ec
 *   printk                                   <= FUN_0007e2fa @ 0x0007e2fa
 * address symbols (name @ address):
 *   rodata_99cbd                             @ 0x00099cbd   [INLINED -- G6 literal batch]
 *   rodata_f3894                             @ 0x000f3894   [INLINED -- G6 literal batch]
 *   rodata_f38c6                             @ 0x000f38c6   [INLINED -- G6 literal batch]
 *   rodata_f391d                             @ 0x000f391d   [INLINED -- G6 literal batch]
 */
/* Reconstructed FUN_0005ec84 @ 0x5ec84, exact extent 70 bytes. */

extern void assert_post_action(const char *, unsigned int);

void sys_memcpy_swap(uint8_t *destination, const uint8_t *source, uint32_t length)
{
    uintptr_t dst = (uintptr_t)destination;
    uintptr_t src = (uintptr_t)source;
    if (dst == src || (src < dst ? src + length > dst : dst + length > src)) {
        printk(((unsigned long)"ASSERTION FAIL [%s] @ %s:%d\n") /*=0x99cbd*/, ((unsigned long)"((psrc < pdst && (psrc + length) <= pdst) || (psrc > pdst && (pdst + length) <= psrc))") /*=0xf38c6*/, ((unsigned long)"WEST_TOPDIR/zephyr/include/zephyr/sys/byteorder.h") /*=0xf3894*/, 0x215u);
        G1_ASSERT_FAIL((((unsigned long)"\tSource and destination buffers must not overlap\n") /*=0xf391d*/), (((unsigned long)"WEST_TOPDIR/zephyr/include/zephyr/sys/byteorder.h") /*=0xf3894*/, 0x215u));
        return;
    }

    const uint8_t *read = source + length;
    uint8_t *write = destination;
    while (write != destination + length)
        *write++ = *--read;
}

/* ---- adc_context_start_sampling.c ---- */
/* readable reconstruction; identity: FUN_0005f638 @ 0x0005f638
 * public-name: adc_context_start_sampling
 * durable-map: recon/catalogs/function_names_app.json
 * callees (readable <= raw @ address):
 *   adc_context_start_sampling               <= FUN_0005f638 @ 0x0005f638
 * address symbols (name @ address):
 *   REG_5000e000                             @ 0x5000e000
 *   REG_5000e004                             @ 0x5000e004
 *   REG_5000e00c                             @ 0x5000e00c
 *   REG_5000e500                             @ 0x5000e500
 */
/* Reconstructed FUN_0005f638 @ 0x5f638  (parity: 300/300 trials, PROVEN) */

void adc_context_start_sampling(void *param_1) {
    *(volatile uint32_t *)REG_5000e500 /*=0x5000e500*/ = 1;
    if (*(volatile char *)((char*)param_1 + 0x86) != 0) {
        *(volatile uint32_t *)REG_5000e00c /*=0x5000e00c*/ = 1;
        return;
    }
    *(volatile uint32_t *)REG_5000e000 /*=0x5000e000*/ = 1;
    *(volatile uint32_t *)REG_5000e004 /*=0x5000e004*/ = 1;
}

/* ---- adc_channel_config.c ---- */
/* readable reconstruction; identity: FUN_0005f654 @ 0x0005f654
 * public-name: adc_channel_config
 * durable-map: recon/catalogs/function_names_app.json
 * callees (readable <= raw @ address):
 *   z_log_msg_runtime_create                 <= FUN_0004d944 @ 0x0004d944
 *   adc_channel_config                       <= FUN_0005f654 @ 0x0005f654
 * address symbols (name @ address):
 *   rodata_880e0                             @ 0x000880e0
 *   rodata_f5503                             @ 0x000f5503
 *   rodata_f5522                             @ 0x000f5522
 *   rodata_f5546                             @ 0x000f5546
 *   adc_context                              @ 0x20002190
 */
/* Reconstructed FUN_0005f654 @ 0x5f654  (parity: 300/300 trials, PROVEN) */
extern void z_log_msg_runtime_create(unsigned int, unsigned int, unsigned int, unsigned int);
static unsigned adc_channel_config(unsigned param_1, unsigned char *param_2)
{
  unsigned short uVar1;
  int iVar2, iVar5;
  unsigned uVar3, uVar4;
  struct { unsigned count, format; } error;
  uVar4 = param_2[4] & 0x1f;
  if (7 < uVar4) return 0xffffffea;
  uVar3 = (unsigned)*param_2;
  switch(uVar3) {
  case 0: case 1: case 2: case 3: break;
  default: error.format = ((unsigned long)&rodata_f5503) /*=0xf5503*/; goto LAB;
  case 5: uVar3 = 4; break;
  case 8: uVar3 = 5; break;
  case 9: uVar3 = 6; break;
  case 0xb: uVar3 = 7;
  }
  if (param_2[1] == 3) { iVar5 = 1; }
  else {
    error.format = ((unsigned long)&rodata_f5522) /*=0xf5522*/;
    if (param_2[1] != 4) goto LAB;
    iVar5 = 0;
  }
  uVar1 = *(unsigned short*)(param_2 + 2);
  if (uVar1 != 0x400a) {
    error.format = ((unsigned long)&rodata_f5546) /*=0xf5546*/;
    if (0x400a < uVar1) {
      if (uVar1 == 0x4014) iVar2 = 4;
      else if (uVar1 == 0x4028) iVar2 = 5;
      else { if (uVar1 != 0x400f) goto LAB; iVar2 = 3; }
      goto LAB2;
    }
    if (uVar1 == 0x4003) { iVar2 = 0; goto LAB2; }
    if (uVar1 == 0x4005) { iVar2 = 1; goto LAB2; }
    if (uVar1 != 0) {
LAB:
      error.count = 2;
      z_log_msg_runtime_create(((unsigned long)&rodata_880e0) /*=0x880e0*/, 0x1040, &error, 0);
      return 0xffffffea;
    }
  }
  iVar2 = 2;
LAB2:
  *(volatile unsigned int *)(uVar4 * 0x10 + (G1_NRF_SAADC_S_BASE + 0x518)) =
      uVar3 << 8 | (((unsigned)param_2[4] << 0x1a) >> 0x1f) << 0x14 | iVar5 << 0xc | iVar2 << 0x10;
  *(volatile unsigned int *)(uVar4 * 0x10 + (G1_NRF_SAADC_S_BASE + 0x514)) = (unsigned)param_2[6];
  *(volatile unsigned int *)(uVar4 * 0x10 + (G1_NRF_SAADC_S_BASE + 0x510)) = 0;
  *(volatile unsigned char *)(((unsigned long)&adc_context) /*=0x20002190*/ + uVar4 + 0xa0) = param_2[5];
  return 0;
}

