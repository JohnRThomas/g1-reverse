/*
 * Cohesive translation unit for the `unsorted' module.
 *
 * GENERATED by recon/refactor/transforms/t04_cohesive_tu.py.  Do not
 * edit: a stage tree is regenerated, never hand-patched
 * (recon/refactor/README.md C4).
 *
 * The 14 functions below were 14 separate translation units until this
 * stage.  Each one's text is reproduced VERBATIM and in the order the
 * generated source list gave it, and they were CONSECUTIVE in that list.
 * They were proven able to share a translation unit: no symbol is
 * declared here with two types, no identifier has internal linkage in one
 * member and is named by another, and no local typedef, macro, struct tag
 * or enum constant of one member is visible to a member that names it.
 *
 * members, in link order:
 *   screen_render_ret0_7d1b4.c
 *   screen_render_ret0_7d1cc.c
 *   screen_render_ret0_7d240.c
 *   screen_render_ret0_7d244.c
 *   screen_render_ret0_7d2f4.c
 *   screen_render_ret0_7d356.c
 *   screen_render_ret0_7d37e.c
 *   projector_clear_canvas.c
 *   projector_flush_canvas.c
 *   u32_to_bytes_le_array.c
 *   bytes_to_u32le_array.c
 *   out.c
 *   chunk_set_used_flag.c
 *   log_msg_compute_wlen.c
 */
/* ---- screen_render_ret0_7d1b4.c ---- */
#include "g1_app_symbols.h"
#include <stdint.h>
#include "g1_unsorted.h"
/* readable reconstruction; identity: FUN_0007d1b4 @ 0x0007d1b4
 * public-name: screen_render_ret0_7d1b4
 * durable-map: recon/catalogs/function_names_app.json
 */
/* Reconstructed screen_render_ret0_7d1b4 @ 0x7d1b4 (uncatalogued: Ghidra folded it
 * into the tail of k_msleep_ticks32768_c (0x7d194)).  Iteration 17.
 *
 * Handler slot of `g_screen_render_table` (shipped `.data` at 0x20002430, the
 * 16-byte-stride screen table `panel_render_screen_dispatch` indexes) for
 * screen id 4.  That table word is the only referrer in the whole image.
 *
 * The shipped bytes are exactly four: `2000  movs r0, #0` / `4770  bx lr`.
 * PROOF: the compiled .text is `20004770`, byte-identical to the shipped
 * 0x7d1b4.
 */

int screen_render_ret0_7d1b4(void)
{
  return 0;
}

/* ---- screen_render_ret0_7d1cc.c ---- */
/* readable reconstruction; identity: FUN_0007d1cc @ 0x0007d1cc
 * public-name: screen_render_ret0_7d1cc
 * durable-map: recon/catalogs/function_names_app.json
 */
/* Reconstructed screen_render_ret0_7d1cc @ 0x7d1cc (uncatalogued: Ghidra folded it
 * into the tail of ptr_load_u32 (0x7d1c8)).  Iteration 17.
 *
 * Handler slot of `g_screen_render_table` (shipped `.data` at 0x20002430, the
 * 16-byte-stride screen table `panel_render_screen_dispatch` indexes) for
 * screen id 5.  That table word is the only referrer in the whole image.
 *
 * The shipped bytes are exactly four: `2000  movs r0, #0` / `4770  bx lr`.
 * PROOF: the compiled .text is `20004770`, byte-identical to the shipped
 * 0x7d1cc.
 */

int screen_render_ret0_7d1cc(void)
{
  return 0;
}

/* ---- screen_render_ret0_7d240.c ---- */
/* readable reconstruction; identity: FUN_0007d240 @ 0x0007d240
 * public-name: screen_render_ret0_7d240
 * durable-map: recon/catalogs/function_names_app.json
 */
/* Reconstructed screen_render_ret0_7d240 @ 0x7d240 (uncatalogued: Ghidra folded it
 * into the tail of set_device_sync_timestamp (0x7d230)).  Iteration 17.
 *
 * Handler slot of `g_screen_render_table` (shipped `.data` at 0x20002430, the
 * 16-byte-stride screen table `panel_render_screen_dispatch` indexes) for
 * screen ids 3 and 6.  That table word is the only referrer in the whole image.
 *
 * The shipped bytes are exactly four: `2000  movs r0, #0` / `4770  bx lr`.
 * PROOF: the compiled .text is `20004770`, byte-identical to the shipped
 * 0x7d240.
 */

int screen_render_ret0_7d240(void)
{
  return 0;
}

/* ---- screen_render_ret0_7d244.c ---- */
/* readable reconstruction; identity: FUN_0007d244 @ 0x0007d244
 * public-name: screen_render_ret0_7d244
 * durable-map: recon/catalogs/function_names_app.json
 */
/* Reconstructed screen_render_ret0_7d244 @ 0x7d244 (uncatalogued: Ghidra folded it
 * into the tail of set_device_sync_timestamp (0x7d230)).  Iteration 17.
 *
 * Handler slot of `g_screen_render_table` (shipped `.data` at 0x20002430, the
 * 16-byte-stride screen table `panel_render_screen_dispatch` indexes) for
 * screen id 8.  That table word is the only referrer in the whole image.
 *
 * The shipped bytes are exactly four: `2000  movs r0, #0` / `4770  bx lr`.
 * PROOF: the compiled .text is `20004770`, byte-identical to the shipped
 * 0x7d244.
 */

int screen_render_ret0_7d244(void)
{
  return 0;
}

/* ---- screen_render_ret0_7d2f4.c ---- */
/* readable reconstruction; identity: FUN_0007d2f4 @ 0x0007d2f4
 * public-name: screen_render_ret0_7d2f4
 * durable-map: recon/catalogs/function_names_app.json
 */
/* Reconstructed screen_render_ret0_7d2f4 @ 0x7d2f4 (uncatalogued: Ghidra folded it
 * into the tail of k_uptime_get_5 (0x7d2d8)).  Iteration 17.
 *
 * Handler slot of `g_screen_render_table` (shipped `.data` at 0x20002430, the
 * 16-byte-stride screen table `panel_render_screen_dispatch` indexes) for
 * screen id 7.  That table word is the only referrer in the whole image.
 *
 * The shipped bytes are exactly four: `2000  movs r0, #0` / `4770  bx lr`.
 * PROOF: the compiled .text is `20004770`, byte-identical to the shipped
 * 0x7d2f4.
 */

int screen_render_ret0_7d2f4(void)
{
  return 0;
}

/* ---- screen_render_ret0_7d356.c ---- */
/* readable reconstruction; identity: FUN_0007d356 @ 0x0007d356
 * public-name: screen_render_ret0_7d356
 * durable-map: recon/catalogs/function_names_app.json
 */
/* Reconstructed screen_render_ret0_7d356 @ 0x7d356 (uncatalogued: Ghidra folded it
 * into the tail of k_uptime_get_6 (0x7d33a)).  Iteration 17.
 *
 * Handler slot of `g_screen_render_table` (shipped `.data` at 0x20002430, the
 * 16-byte-stride screen table `panel_render_screen_dispatch` indexes) for
 * screen id 9.  That table word is the only referrer in the whole image.
 *
 * The shipped bytes are exactly four: `2000  movs r0, #0` / `4770  bx lr`.
 * PROOF: the compiled .text is `20004770`, byte-identical to the shipped
 * 0x7d356.
 */

int screen_render_ret0_7d356(void)
{
  return 0;
}

/* ---- screen_render_ret0_7d37e.c ---- */
/* readable reconstruction; identity: FUN_0007d37e @ 0x0007d37e
 * public-name: screen_render_ret0_7d37e
 * durable-map: recon/catalogs/function_names_app.json
 */
/* Reconstructed screen_render_ret0_7d37e @ 0x7d37e (uncatalogued: Ghidra folded it
 * into the tail of FUN_0007d37a (0x7d37a)).  Iteration 17.
 *
 * Handler slot of `g_screen_render_table` (shipped `.data` at 0x20002430, the
 * 16-byte-stride screen table `panel_render_screen_dispatch` indexes) for
 * screen id 10.  That table word is the only referrer in the whole image.
 *
 * The shipped bytes are exactly four: `2000  movs r0, #0` / `4770  bx lr`.
 * PROOF: the compiled .text is `20004770`, byte-identical to the shipped
 * 0x7d37e.
 */

int screen_render_ret0_7d37e(void)
{
  return 0;
}

/* ---- projector_clear_canvas.c ---- */
/* readable reconstruction; identity: projector_clear_canvas @ 0x0007d4ca
 * public-name: projector_clear_canvas
 * durable-map: recon/catalogs/function_names_app.json
 * callees (readable <= raw @ address):
 *   memset_bytes                             <= FUN_00086c78 @ 0x00086c78
 */
/* Reconstructed projector_clear_canvas @ 0x7d4ca (uncatalogued: Ghidra folded
 * it into the tail of get_localized_weekday_name; code 0x7d4ca..0x7d4d6).
 * (parity: cfg_verify PASS, 200/200 trials)
 * Vtable slot +0x1c (device_ctx + 0xb88) written by quicknote_buffer_pool_init.
 */

extern uint32_t memset_bytes(uint32_t dst, uint32_t value, uint32_t length);

uint32_t projector_clear_canvas(uint8_t *context)
{
    return memset_bytes(*(volatile uint32_t *)(context + 0x24), 0,
                        *(volatile uint32_t *)(context + 0x350));
}

/* ---- projector_flush_canvas.c ---- */
/* readable reconstruction; identity: projector_flush_canvas @ 0x0007d4d6
 * public-name: projector_flush_canvas
 * durable-map: recon/catalogs/function_names_app.json
 * callees (readable <= raw @ address):
 *   projector_write_pixel_data               <= FUN_0007d70a @ 0x0007d70a
 */
/* Reconstructed projector_flush_canvas @ 0x7d4d6 (uncatalogued: Ghidra folded
 * it into the tail of get_localized_weekday_name; code 0x7d4d6..0x7d4ec).
 * (parity: cfg_verify PASS, 200/200 trials)
 * Vtable slot +0x18 (device_ctx + 0xb84) written by quicknote_buffer_pool_init.
 * Gated on the panel-on flag ctx+0x35c; on the early-out path the original
 * leaves r0 untouched, i.e. returns its own argument.
 */

extern uint32_t projector_write_pixel_data(uint32_t x, uint32_t y, uint32_t buf, uint32_t length);

uint32_t projector_flush_canvas(uint8_t *context)
{
    if (*(volatile uint32_t *)(context + 0x35c) == 0)
        return (uint32_t)context;
    return projector_write_pixel_data(*(volatile uint32_t *)(context + 0x348),
                                      *(volatile uint32_t *)(context + 0x34c),
                                      *(volatile uint32_t *)(context + 0x24),
                                      *(volatile uint32_t *)(context + 0x350));
}

/* ---- u32_to_bytes_le_array.c ---- */
/* readable reconstruction; identity: FUN_0007d894 @ 0x0007d894
 * public-name: u32_to_bytes_le_array
 * durable-map: recon/catalogs/function_names_app.json
 * callees (readable <= raw @ address):
 *   u32_to_bytes_le_array                    <= FUN_0007d894 @ 0x0007d894
 */
/* Reconstructed FUN_0007d894 @ 0x7d894. */

/* Copy little-endian 32-bit words bytewise.  Like the firmware, a non-multiple
 * of four byte count still copies the complete final word. */
void u32_to_bytes_le_array(uint8_t *dst, const uint8_t *src, uint32_t byte_count)
{
    uint32_t copied = 0;

    while (copied < byte_count) {
        dst[copied] = src[copied];
        dst[copied + 1] = src[copied + 1];
        dst[copied + 2] = src[copied + 2];
        dst[copied + 3] = src[copied + 3];
        copied += 4;
    }
}

/* ---- bytes_to_u32le_array.c ---- */
/* readable reconstruction; identity: FUN_0007d8c4 @ 0x0007d8c4
 * public-name: bytes_to_u32le_array
 * durable-map: recon/catalogs/function_names_app.json
 * callees (readable <= raw @ address):
 *   bytes_to_u32le_array                     <= FUN_0007d8c4 @ 0x0007d8c4
 */
/* Reconstructed FUN_0007d8c4 @ 0x7d8c4. */

/* Assemble little-endian input bytes into aligned destination words. */
void bytes_to_u32le_array(uint32_t *dst, const uint8_t *src, uint32_t byte_count)
{
    uint32_t offset = 0;

    while (offset < byte_count) {
        uint32_t word = (uint32_t)src[offset]
                      | (uint32_t)src[offset + 1] << 8
                      | (uint32_t)src[offset + 2] << 16
                      | (uint32_t)src[offset + 3] << 24;
        dst[offset / 4] = word;
        offset += 4;
    }
}

/* ---- out.c ---- */
/* readable reconstruction; identity: FUN_0007dd7e @ 0x0007dd7e
 * public-name: out
 * durable-map: recon/catalogs/function_names_app.json
 */
/* Reconstructed out @ 0x7dd7e  (parity: 300/300 trials, PROVEN) */

void out(unsigned char param_1, int *param_2){
    int iVar1 = param_2[2];
    int iVar3 = param_2[0];
    int iVar4 = iVar1+1;
    if(iVar3==0 || param_2[1] <= iVar1){
        param_2[2]=iVar4;
    } else {
        int iVar2 = param_2[1]-1;
        int bVar5 = (iVar2==iVar1);
        if(bVar5) iVar1=0;
        param_2[2]=iVar4;
        if(bVar5) *(char*)(iVar3+iVar2) = (char)iVar1;
        if(!bVar5) *(unsigned char*)(iVar3+iVar1) = param_1;
    }
}

/* ---- chunk_set_used_flag.c ---- */
/* readable reconstruction; identity: FUN_0007de54 @ 0x0007de54
 * public-name: chunk_set_used_flag
 * durable-map: recon/catalogs/function_names_app.json
 * callees (readable <= raw @ address):
 *   chunk_set                                <= FUN_0007de02 @ 0x0007de02
 *   chunk_set_used_flag                      <= FUN_0007de54 @ 0x0007de54
 */
/* Reconstructed FUN_0007de54 @ 0x7de54  (parity: 300/300 trials, PROVEN) */

void chunk_set_used_flag(unsigned int param_1, unsigned int param_2, int param_3)
{
    chunk_set(param_1, param_2, 1, (unsigned int)(param_3 << 1));
}

/* ---- log_msg_compute_wlen.c ---- */
/* readable reconstruction; identity: FUN_0007de70 @ 0x0007de70
 * public-name: log_msg_compute_wlen
 * durable-map: recon/catalogs/function_names_app.json
 * callees (readable <= raw @ address):
 *   log_msg_compute_wlen                     <= FUN_0007de70 @ 0x0007de70
 */
/* Reconstructed FUN_0007de70 @ 0x7de70  (parity: 300/300 trials, PROVEN) */

unsigned int log_msg_compute_wlen(unsigned int param_1, int param_2)
{
    unsigned int iVar1;
    if (param_1 < 0x8000) {
        iVar1 = 4;
    } else {
        iVar1 = 8;
    }
    return (unsigned int)(param_2 + 7 + iVar1) >> 3;
}

