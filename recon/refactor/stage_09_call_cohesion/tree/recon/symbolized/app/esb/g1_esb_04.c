/*
 * Cohesive translation unit for the `esb' module.
 *
 * GENERATED by recon/refactor/transforms/t04_cohesive_tu.py.  Do not
 * edit: a stage tree is regenerated, never hand-patched
 * (recon/refactor/README.md C4).
 *
 * The 6 functions below were 6 separate translation units until this
 * stage.  Each one's text is reproduced VERBATIM and in the order the
 * generated source list gave it, and they were CONSECUTIVE in that list.
 * They were proven able to share a translation unit: no symbol is
 * declared here with two types, no identifier has internal linkage in one
 * member and is named by another, and no local typedef, macro, struct tag
 * or enum constant of one member is visible to a member that names it.
 *
 * members, in link order:
 *   rtc_channel_cc_read.c
 *   nrf_rtc_set_alarm_channel.c
 *   sync_buffer_available_space.c
 *   ext_flash_sync_noop.c
 *   reset_esb_sync_state.c
 *   set_device_sync_timestamp.c
 */
/* ---- rtc_channel_cc_read.c ---- */
#include "g1_app_symbols.h"
#include "../../../headers/g1_log.h"
#include "../../../headers/g1_dedupe.h"
#include "g1_esb.h"
#include <stdint.h>
/* readable reconstruction; identity: FUN_000635d8 @ 0x000635d8
 * public-name: rtc_channel_cc_read
 * durable-map: recon/catalogs/function_names_app.json
 * callees (readable <= raw @ address):
 *   rtc_channel_cc_read                      <= FUN_000635d8 @ 0x000635d8
 *   assert_post_action                       <= FUN_0007e2ec @ 0x0007e2ec
 *   printk                                   <= FUN_0007e2fa @ 0x0007e2fa
 * address symbols (name @ address):
 *   rodata_99cbd                             @ 0x00099cbd   [INLINED -- G6 literal batch]
 *   rodata_f6659                             @ 0x000f6659
 *   rodata_f668a                             @ 0x000f668a   [INLINED -- G6 literal batch]
 */
/* Reconstructed FUN_000635d8 @ 0x635d8  (parity: 300/300 trials, PROVEN) */

extern void assert_post_action(const char *, unsigned int);

unsigned int rtc_channel_cc_read(unsigned int param_1, unsigned int param_2, unsigned int param_3, unsigned int param_4)
{
  if (param_1 > 1) {
    G1_ASSERT_FAIL((((unsigned long)"ASSERTION FAIL [%s] @ %s:%d\n") /*=0x99cbd*/, ((unsigned long)"chan >= 0 && chan < (1 + 1)") /*=0xf668a*/, ((unsigned long)&rodata_f6659) /*=0xf6659*/, 0xc3, param_4), (((unsigned long)&rodata_f6659) /*=0xf6659*/, 0xc3));
  }
  return *(volatile unsigned int *)(0x50015000UL + (param_1 + 0x150) * 4);
}

/* ---- nrf_rtc_set_alarm_channel.c ---- */
/* readable reconstruction; identity: FUN_00063778 @ 0x00063778
 * public-name: nrf_rtc_set_alarm_channel
 * durable-map: recon/catalogs/function_names_app.json
 * callees (readable <= raw @ address):
 *   compare_set                              <= FUN_00063654 @ 0x00063654
 *   nrf_rtc_set_alarm_channel                <= FUN_00063778 @ 0x00063778
 *   assert_post_action                       <= FUN_0007e2ec @ 0x0007e2ec
 *   printk                                   <= FUN_0007e2fa @ 0x0007e2fa
 * address symbols (name @ address):
 *   rodata_99cbd                             @ 0x00099cbd   [INLINED -- G6 literal batch]
 *   rodata_f6659                             @ 0x000f6659
 *   rodata_f66a6                             @ 0x000f66a6   [INLINED -- G6 literal batch]
 */
/* Reconstructed FUN_00063778 @ 0x63778  (parity: 300/300 trials, PROVEN) */

extern void compare_set(unsigned int, unsigned int, unsigned int,
                         unsigned int, unsigned int, unsigned int,
                         unsigned int);

void nrf_rtc_set_alarm_channel(int param_1, unsigned int param_2, unsigned int param_3,
                  unsigned int param_4, unsigned int param_5,
                  unsigned int param_6)
{
    if (param_1 != 1) {
        G1_ASSERT_FAIL((((unsigned long)"ASSERTION FAIL [%s] @ %s:%d\n") /*=0x99cbd*/, ((unsigned long)"chan > 0 && chan < (1 + 1)") /*=0xf66a6*/, ((unsigned long)&rodata_f6659) /*=0xf6659*/, 0x18dUL, param_1, param_2, param_3, param_4), (((unsigned long)&rodata_f6659) /*=0xf6659*/, 0x18dUL));
    }
    compare_set((unsigned int)param_1, param_5, param_3, param_4,
                 param_5, param_6, 0);
}

/* ---- sync_buffer_available_space.c ---- */
/* readable reconstruction; identity: FUN_00071314 @ 0x00071314
 * public-name: sync_buffer_available_space
 * durable-map: recon/catalogs/function_names_app.json
 * callees (readable <= raw @ address):
 *   sync_buffer_available_space              <= FUN_00071314 @ 0x00071314
 *   mutex_lock_wait_forever_dup              <= FUN_000859b6 @ 0x000859b6
 */
/* Reconstructed FUN_00071314 @ 0x71314  (parity: 300/300 trials, PROVEN) */

extern void mutex_lock_wait_forever_dup(int a);

int sync_buffer_available_space(int param_1)
{
    int iVar1;

    iVar1 = 0xfffff82d;
    if (param_1 != 0) {
        mutex_lock_wait_forever_dup(param_1 + 0x58);
        iVar1 = 0xfffff82e;
        if (*(volatile int *)(*(volatile int *)(param_1 + 0xa0) + 0x18) == 0) {
            iVar1 = *(volatile int *)(param_1 + 0x94) + -0x10;
            if (iVar1 < 1) {
                iVar1 = -0x7d2;
            }
        }
        process_sync_buffer(param_1 + 0x58);
    }
    return iVar1;
}

/* ---- ext_flash_sync_noop.c ---- */
/* readable reconstruction; identity: FUN_0007c080 @ 0x0007c080
 * public-name: ext_flash_sync_noop
 * durable-map: recon/catalogs/function_names_app.json
 * callees (readable <= raw @ address):
 *   ext_flash_sync_noop                      <= FUN_0007c080 @ 0x0007c080
 */
/* Reconstructed FUN_0007c080 @ 0x7c080  (parity: 300/300 trials, PROVEN) */

void ext_flash_sync_noop(void){}

/* ---- reset_esb_sync_state.c ---- */
/* readable reconstruction; identity: FUN_0007ce60 @ 0x0007ce60
 * public-name: reset_esb_sync_state
 * durable-map: recon/catalogs/function_names_app.json
 * callees (readable <= raw @ address):
 *   get_device_info                          <= FUN_000167a8 @ 0x000167a8
 *   reset_esb_sync_state                     <= FUN_0007ce60 @ 0x0007ce60
 *   memset_bytes                             <= FUN_00086c78 @ 0x00086c78
 */
/* Reconstructed FUN_0007ce60 @ 0x7ce60  (parity: 300/300 trials, PROVEN) */
extern int get_device_info(void);
extern void memset_bytes(int,int,int,unsigned int);
void reset_esb_sync_state(int param_1,unsigned int param_2,unsigned int param_3,unsigned int param_4){
  int iVar1;
  iVar1=get_device_info(); *(volatile unsigned char *)(iVar1+0xe9)=0;
  iVar1=get_device_info(); *(volatile unsigned char *)(iVar1+0xea)=0;
  iVar1=get_device_info(); *(volatile unsigned char *)(iVar1+0xcc)=0;
  iVar1=get_device_info(); *(volatile unsigned char *)(iVar1+0xcd)=0;
  iVar1=get_device_info(); *(volatile unsigned char *)(iVar1+0xce)=0;
  iVar1=get_device_info(); *(volatile unsigned char *)(iVar1+0xcf)=0;
  if(param_1==0){
    iVar1=get_device_info(); *(volatile unsigned char *)(*(volatile int *)(iVar1+0x100c)+7)=0xd;
  } else {
    iVar1=get_device_info(); *(volatile unsigned char *)(*(volatile int *)(iVar1+0x100c)+7)=0;
    iVar1=get_device_info(); **(volatile unsigned char**)(iVar1+0x100c)=0;
  }
  iVar1=get_device_info();
  memset_bytes(*(volatile int *)(iVar1+0x100c)+8,0,399,param_4);
}

/* ---- set_device_sync_timestamp.c ---- */
/* readable reconstruction; identity: FUN_0007d230 @ 0x0007d230
 * public-name: set_device_sync_timestamp
 * durable-map: recon/catalogs/function_names_app.json
 * callees (readable <= raw @ address):
 *   get_device_info                          <= FUN_000167a8 @ 0x000167a8
 *   set_device_sync_timestamp                <= FUN_0007d230 @ 0x0007d230
 */
/* Reconstructed FUN_0007d230 @ 0x7d230  (parity: 300/300 trials, PROVEN) */

unsigned int set_device_sync_timestamp(unsigned long param_1) {
  unsigned int r = get_device_info();
  *(unsigned int*)(r + 0xd0) = param_1;
  return param_1;
}

