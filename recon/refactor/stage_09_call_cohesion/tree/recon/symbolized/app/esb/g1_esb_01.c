/*
 * Cohesive translation unit for the `esb' module.
 *
 * GENERATED by recon/refactor/transforms/t04_cohesive_tu.py.  Do not
 * edit: a stage tree is regenerated, never hand-patched
 * (recon/refactor/README.md C4).
 *
 * The 4 functions below were 4 separate translation units until this
 * stage.  Each one's text is reproduced VERBATIM and in the order the
 * generated source list gave it, and they were CONSECUTIVE in that list.
 * They were proven able to share a translation unit: no symbol is
 * declared here with two types, no identifier has internal linkage in one
 * member and is named by another, and no local typedef, macro, struct tag
 * or enum constant of one member is visible to a member that names it.
 *
 * members, in link order:
 *   runtime_info_sync.c
 *   spi_master_trans_data_tx_rx.c
 *   spi_master_init.c
 *   spi_master_install_ops.c
 */

/* File-scope forward declarations for every struct/union tag this
 * unit names.  Without them a tag whose only appearance in a member
 * is inside a parameter list has PARAMETER-LIST scope, so two
 * textually IDENTICAL declarations in two members declare two
 * different incomplete types and the second is a conflicting
 * redeclaration (C11 6.2.1p7).  Incomplete-type forward
 * declarations emit no code. */
struct runtime_sync_packet;
struct spi_map;
/* ---- runtime_info_sync.c ---- */
#include "g1_app_symbols.h"
/* readable reconstruction; identity: FUN_00016268 @ 0x00016268
 * public-name: runtime_info_sync
 * durable-map: recon/catalogs/function_names_app.json
 * callees (readable <= raw @ address):
 *   debug_print                              <= FUN_00019c70 @ 0x00019c70
 *   global_ipc_service_send                  <= FUN_00025b78 @ 0x00025b78
 * address symbols (name @ address):
 *   rodata_9957c                             @ 0x0009957c   [INLINED -- G6 literal batch]
 *   rodata_99bee                             @ 0x00099bee   [INLINED -- G6 literal batch]
 *   g_log_level                              @ 0x2000230c
 *   g_esb_bringup_log_pending_flag           @ 0x20002fe0
 *   g_log_use_alt_sink                       @ 0x20007554
 */
/* Reconstructed runtime_info_sync @ 0x16268 */

#include <stdint.h>
#include "../../../headers/g1_log.h"
#include "../../../headers/g1_dedupe.h"

struct __attribute__((packed)) runtime_sync_packet {
    uint16_t marker;
    uint8_t runtime[5];
    uint8_t reserved;
};

extern uint32_t global_ipc_service_send(const void *packet, uint32_t length);

uint32_t runtime_info_sync(const uint8_t *runtime)
{
    struct runtime_sync_packet packet = {
        .marker = 1,
        .runtime = {runtime[0], runtime[1], runtime[2], runtime[3], runtime[4]},
        .reserved = 0,
    };

    uint32_t result = global_ipc_service_send(&packet, sizeof(packet));
    if (*(volatile uint8_t *)((unsigned long)&g_esb_bringup_log_pending_flag) /*=0x20002fe0*/ != 0) {
        *(volatile uint8_t *)((unsigned long)&g_esb_bringup_log_pending_flag) /*=0x20002fe0*/ = 0;
        if (*(volatile int32_t *)((unsigned long)&g_log_level) /*=0x2000230c*/ > 1) {
            G1_LOG_ROUTE(*(volatile uint32_t *)((unsigned long)&g_log_use_alt_sink) /*=0x20007554*/ == 0, ((unsigned long)"%s(): --role:%d --mode:%d, esb_channel %d --ret:%d esb_master_addr %02X esb_slave_addr %02X\n") /*=0x9957c*/, ((unsigned long)"runtime_info_sync") /*=0x99bee*/,
                            runtime[0], runtime[1], runtime[2], result,
                            runtime[3], runtime[4]);
        }
    }
    return result;
}

/* ---- spi_master_trans_data_tx_rx.c ---- */
/* readable reconstruction; identity: FUN_000262ac @ 0x000262ac
 * public-name: spi_master_trans_data_tx_rx
 * durable-map: recon/catalogs/function_names_app.json
 * callees (readable <= raw @ address):
 *   debug_print                              <= FUN_00019c70 @ 0x00019c70
 *   nrfx_spim_xfer                           <= FUN_00067304 @ 0x00067304
 *   log_message                              <= FUN_0007dda4 @ 0x0007dda4
 * address symbols (name @ address):
 *   rodata_9fb42                             @ 0x0009fb42   [INLINED -- refactor stage 01]
 *   rodata_9fb59                             @ 0x0009fb59   [INLINED -- refactor stage 01]
 *   rodata_9fc5d                             @ 0x0009fc5d   [INLINED -- refactor stage 01]
 *   g_log_level                              @ 0x2000230c
 *   g_log_use_alt_sink                       @ 0x20007554
 */
/* Reconstructed spi_master_trans_data_tx_rx @ 0x262ac  (parity: 300/300 trials, PROVEN) */

extern int nrfx_spim_xfer(void*, void*, int);

unsigned int spi_master_trans_data_tx_rx(int param_1, unsigned int param_2, unsigned int param_3, unsigned int param_4, unsigned int param_5)
{
    int iVar1;
    struct {
        unsigned int tx_buffer;
        unsigned int tx_length;
        unsigned int rx_buffer;
        unsigned int rx_length;
    } transfer = { param_2, param_3, param_4, param_5 };
    if (*(volatile int *)(param_1 + 0x14) == 0) {
        if (0 < *(volatile int *)((unsigned long)&g_log_level) /*=0x2000230c*/) {
            G1_LOG_ROUTE(*(volatile unsigned int *)((unsigned long)&g_log_use_alt_sink) /*=0x20007554*/ == 0, ((unsigned long)"%s(): wait init_done.\n") /*=0x9fb42*/, ((unsigned long)"spi_master_trans_data_tx_rx") /*=0x9fc5d*/);
        }
    } else {
        iVar1 = nrfx_spim_xfer((void*)(param_1+0xc), &transfer, 0);
        if ((unsigned int)iVar1 == 0x0bad0000) {
            return 0;
        }
        if (0 < *(volatile int *)((unsigned long)&g_log_level) /*=0x2000230c*/) {
            G1_LOG_ROUTE(*(volatile unsigned int *)((unsigned long)&g_log_use_alt_sink) /*=0x20007554*/ == 0, ((unsigned long)"%s(): sipm(bus=%d)-sync fail: status: %d -- %d\n") /*=0x9fb59*/, ((unsigned long)"spi_master_trans_data_tx_rx") /*=0x9fc5d*/, *(volatile unsigned char *)(param_1+0x18), iVar1, 0x0bad0000);
        }
    }
    return 0xffffffff;
}

/* ---- spi_master_init.c ---- */
/* readable reconstruction; identity: FUN_00026418 @ 0x00026418
 * public-name: spi_master_init
 * durable-map: recon/catalogs/function_names_app.json
 * callees (readable <= raw @ address):
 *   debug_print                              <= FUN_00019c70 @ 0x00019c70
 *   spi_master_init                          <= FUN_00026418 @ 0x00026418
 *   arch_irq_priority_set                    <= FUN_0005010c @ 0x0005010c
 *   nrfx_spim_init                           <= FUN_000671d8 @ 0x000671d8
 *   assert_post_action                       <= FUN_0007e2ec @ 0x0007e2ec
 *   printk                                   <= FUN_0007e2fa @ 0x0007e2fa
 *   memset_bytes                             <= FUN_00086c78 @ 0x00086c78
 * address symbols (name @ address):
 *   rodata_883b0                             @ 0x000883b0
 *   rodata_883b4                             @ 0x000883b4
 *   rodata_99cbd                             @ 0x00099cbd   [INLINED -- G6 literal batch]
 *   rodata_9fb89                             @ 0x0009fb89   [INLINED -- G6 literal batch]
 *   rodata_9fb9f                             @ 0x0009fb9f   [INLINED -- G6 literal batch]
 *   rodata_9fbfd                             @ 0x0009fbfd   [INLINED -- G6 literal batch]
 *   rodata_9fc15                             @ 0x0009fc15   [INLINED -- G6 literal batch]
 *   rodata_9fc2c                             @ 0x0009fc2c   [INLINED -- G6 literal batch]
 *   rodata_9fc4d                             @ 0x0009fc4d   [INLINED -- G6 literal batch]
 *   g_log_level                              @ 0x2000230c
 *   g_log_use_alt_sink                       @ 0x20007554
 *   g_20018c6c                               @ 0x20018c6c
 *   g_20018c6d                               @ 0x20018c6d
 */
/* Full reconstruction FUN_00026418 @ 0x26418, exact extent 320 bytes.
 * CFG_VERIFY_CALL_ARITIES=3,4,2 */
extern void arch_irq_priority_set(uint32_t,uint32_t);
extern uint32_t nrfx_spim_init(void*,void*,uintptr_t,uintptr_t);
extern void assert_post_action(const char *, unsigned int);
extern void memset_bytes(void*, int, int);
struct spi_map { uint32_t base, tag; };
unsigned spi_master_init(uintptr_t event)
{
    struct spi_map mode3;
    mode3.base=0x5000c000u; *(uint8_t *)&mode3.tag=0;
    struct spi_map mode4;
    mode4.base=*(volatile uint32_t *)((unsigned long)&rodata_883b0) /*=0x883b0*/;
    *(uint32_t*)((uint8_t*)&mode4+4)=*(volatile uint32_t *)((unsigned long)&rodata_883b4) /*=0x883b4*/;
    uint32_t cfg[10];
    memset_bytes(&cfg,0,0x28);
    cfg[4]=0x00ff0700u;
    cfg[7]=0xffffffffu;
    cfg[8]=0x00020002u;
    if(*(volatile uint32_t *)(event+0x14)==1)return 0;
    cfg[5]=*(volatile uint8_t *)(event+0x1d)*1000000u;
    uint32_t mode=*(volatile uint8_t *)(event+0x18);
    cfg[0]=*(volatile uint8_t *)(event+0x19);
    cfg[1]=*(volatile uint8_t *)(event+0x1a);
    cfg[2]=*(volatile uint8_t *)(event+0x1b);
    cfg[3]=*(volatile uint8_t *)(event+0x1c);
    int level=*(volatile int *)((unsigned long)&g_log_level) /*=0x2000230c*/;
    struct spi_map *map;
    if(mode==3)map=&mode3; else if(mode==4)map=&mode4; else {
        if(level>0){int alt=*(volatile int *)((unsigned long)&g_log_use_alt_sink) /*=0x20007554*/;if(alt)debug_print(((unsigned long)"%s():  SPIM BUS ERR!\n") /*=0x9fb89*/,((unsigned long)"spi_master_init") /*=0x9fc4d*/);else log_message(((unsigned long)"%s():  SPIM BUS ERR!\n") /*=0x9fb89*/,((unsigned long)"spi_master_init") /*=0x9fc4d*/);} return 0;
    }
    *(volatile uint32_t *)(event+0xc)=map->base;
    *(volatile uint32_t *)(event+0x10)=map->tag;
    if(level>2){
        if(*(volatile int *)((unsigned long)&g_log_use_alt_sink) /*=0x20007554*/)debug_print(((unsigned long)"%s(): *SPIM(%d)speed=%dM, sck=%d, mosi=%d, miso=%d, ss=%d\n") /*=0x9fb9f*/,((unsigned long)"spi_master_init") /*=0x9fc4d*/,mode,*(uint8_t*)(event+0x1d),*(uint8_t*)(event+0x19),*(uint8_t*)(event+0x1a),*(uint8_t*)(event+0x1b),*(uint8_t*)(event+0x1c));
        else log_message(((unsigned long)"%s(): *SPIM(%d)speed=%dM, sck=%d, mosi=%d, miso=%d, ss=%d\n") /*=0x9fb9f*/,((unsigned long)"spi_master_init") /*=0x9fc4d*/,mode,*(uint8_t*)(event+0x1d),*(uint8_t*)(event+0x19),*(uint8_t*)(event+0x1a),*(uint8_t*)(event+0x1b),*(uint8_t*)(event+0x1c));
    }
    uintptr_t callback=mode==3?0x0007ca77u:0;
    uintptr_t callback_context=mode==3?event:0;
    if(nrfx_spim_init((void*)(event+0xc),&cfg,callback,callback_context)!=0x0bad0000u){
        G1_ASSERT_FAIL((((unsigned long)"ASSERTION FAIL [%s] @ %s:%d\n") /*=0x99cbd*/,((unsigned long)"status == NRFX_SUCCESS") /*=0x9fc15*/,((unsigned long)"../src/spim_spis/spim.c") /*=0x9fbfd*/,0x68), (((unsigned long)"../src/spim_spis/spim.c") /*=0x9fbfd*/,0x68));
    }
    volatile uint8_t *once=(volatile uint8_t*)(mode==3?((unsigned long)&g_20018c6c) /*=0x20018c6c*/:((unsigned long)&g_20018c6d) /*=0x20018c6d*/);
    if(!*once){*once=1;arch_irq_priority_set(mode==3?12:10,6);}
    if(*(volatile int *)((unsigned long)&g_log_level) /*=0x2000230c*/>2){if(*(volatile int *)((unsigned long)&g_log_use_alt_sink) /*=0x20007554*/)debug_print(((unsigned long)"%s(): spim(bus=%d): init finish\n") /*=0x9fc2c*/,((unsigned long)"spi_master_init") /*=0x9fc4d*/,mode);else log_message(((unsigned long)"%s(): spim(bus=%d): init finish\n") /*=0x9fc2c*/,((unsigned long)"spi_master_init") /*=0x9fc4d*/,mode);}
    *(volatile uint32_t *)(event+0x14)=1;
    return 0;
}

/* ---- spi_master_install_ops.c ---- */
/* readable reconstruction; identity: FUN_0002659c @ 0x0002659c
 * public-name: spi_master_install_ops
 * durable-map: recon/catalogs/function_names_app.json
 * callees (readable <= raw @ address):
 *   spi_master_install_ops                   <= FUN_0002659c @ 0x0002659c
 * address symbols (name @ address):
 *   ADDR_spi_master_trans_data_tx_rx_THUMB   @ 0x000262ad
 *   ADDR_spim_select_instance_by_mode_THUMB  @ 0x00026339
 *   ADDR_spi_master_init_THUMB               @ 0x00026419
 */
/* Reconstructed FUN_0002659c @ 0x2659c  (parity: 300/300 trials, PROVEN) */

void spi_master_install_ops(unsigned int *param_1)
{
  *param_1 = ADDR_spi_master_init_THUMB /*=0x26419*/;
  param_1[2] = ADDR_spi_master_trans_data_tx_rx_THUMB /*=0x262ad*/;
  param_1[1] = ADDR_spim_select_instance_by_mode_THUMB /*=0x26339*/;
  return;
}

