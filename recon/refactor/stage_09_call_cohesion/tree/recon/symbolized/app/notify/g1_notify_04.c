/*
 * Cohesive translation unit for the `notify' module.
 *
 * GENERATED by recon/refactor/transforms/t04_cohesive_tu.py.  Do not
 * edit: a stage tree is regenerated, never hand-patched
 * (recon/refactor/README.md C4).
 *
 * The 4 functions below were 4 separate translation units until this
 * stage.  Each one's text is reproduced VERBATIM and in the order the
 * generated source list gave it, and they were CONSECUTIVE in that list.
 * They were proven able to share a translation unit: no symbol is
 * declared here with two types, no identifier has internal linkage in one
 * member and is named by another, and no local typedef, macro, struct tag
 * or enum constant of one member is visible to a member that names it.
 *
 * members, in link order:
 *   ancs_c_init.c
 *   ancs_discover_params_reset.c
 *   request_ancs_attr_ext.c
 *   ancs_notification_forward.c
 */

/* File-scope forward declarations for every struct/union tag this
 * unit names.  Without them a tag whose only appearance in a member
 * is inside a parameter list has PARAMETER-LIST scope, so two
 * textually IDENTICAL declarations in two members declare two
 * different incomplete types and the second is a conflicting
 * redeclaration (C11 6.2.1p7).  Incomplete-type forward
 * declarations emit no code. */
struct ancs_record;
struct command_record;
/* ---- ancs_c_init.c ---- */
#include "g1_app_symbols.h"
/* readable reconstruction; identity: FUN_0001905c @ 0x0001905c
 * public-name: ancs_c_init
 * durable-map: recon/catalogs/function_names_app.json
 * callees (readable <= raw @ address):
 *   ancs_c_init                              <= FUN_0001905c @ 0x0001905c
 *   debug_print                              <= FUN_00019c70 @ 0x00019c70
 *   ancs_service_ctx_clear                   <= FUN_0007f69e @ 0x0007f69e
 *   bt_ancs_register_attr                    <= FUN_0007f772 @ 0x0007f772
 *   bt_ancs_register_app_attr                <= FUN_0007f79e @ 0x0007f79e
 * address symbols (name @ address):
 *   rodata_9ab0c                             @ 0x0009ab0c   [INLINED -- G6 literal batch]
 *   rodata_9b15e                             @ 0x0009b15e   [INLINED -- G6 literal batch]
 *   g_log_level                              @ 0x2000230c
 *   g_ancs_client                            @ 0x20006ae8
 *   g_log_use_alt_sink                       @ 0x20007554
 */
/* Reconstructed FUN_0001905c @ 0x1905c  (parity: 300/300 trials, PROVEN) */
#include <stdint.h>
#include "../../../headers/g1_log.h"
extern int ancs_service_ctx_clear(int,...);
/* P4 iteration 20 -- the shipped firmware VENDORS ancs_client.c: its
 * bt_ancs_register_attr accepts len <= 256 and writes
 * ancs_notif_attr_list at +0x868/+0x870/+0x874, while upstream NCS 2.5.1
 * accepts len <= 32 and writes +0x108/+0x110/+0x114 (proven by disassembly of
 * 0x0007f772 / 0x0007f79e against the linked stock bodies; the recovered
 * ancs_service_ctx_clear memsets 0xa2c bytes at g_ancs_client, so the shipped
 * struct really is that large).  adoption_manifest.json excluded both
 * reconstructions on a 1.0 instruction-SHAPE match, which cannot see a
 * changed immediate or a changed struct offset.  MEASURED: with bt_enable()
 * finally succeeding, the fifth registration (id = 3, len = 0x100) failed the
 * stock `cmp r4,#31` guard, ancs_c_init returned -EINVAL and ancs_main
 * rebooted the SoC at t = 6.6 s -- so bt_start() (advertising) was never
 * reached.  Call the raw identities, which recon/application/app/CMakeLists.txt
 * links alongside (not instead of) the stock owner. */
extern int FUN_0007f772(int,...);
extern int FUN_0007f79e(int,...);
#define bt_ancs_register_attr     FUN_0007f772
#define bt_ancs_register_app_attr FUN_0007f79e
#define C8 (*(volatile int *)((unsigned long)&g_log_level) /*=0x2000230c*/)
#define CC (*(volatile int *)((unsigned long)&g_log_use_alt_sink) /*=0x20007554*/)

int ancs_c_init(int param_1, unsigned param_2, unsigned param_3, unsigned param_4)
{
    int iVar1; unsigned uVar2;
    iVar1 = ancs_service_ctx_clear(((unsigned long)&g_ancs_client) /*=0x20006ae8*/);
    if(iVar1 == 0){
        iVar1 = bt_ancs_register_attr(((unsigned long)&g_ancs_client) /*=0x20006ae8*/, 0, param_1+0x10, 0x20, param_4);
        if(iVar1 == 0){
            iVar1 = bt_ancs_register_app_attr(((unsigned long)&g_ancs_client) /*=0x20006ae8*/, 0, param_1+0x30, 0x20);
            if(iVar1 == 0){
                iVar1 = bt_ancs_register_attr(((unsigned long)&g_ancs_client) /*=0x20006ae8*/, 1, param_1+0x50, 0x20, param_4);
                if(iVar1 == 0){
                    iVar1 = bt_ancs_register_attr(((unsigned long)&g_ancs_client) /*=0x20006ae8*/, 2, param_1+0x70, 0x20, param_4);
                    if(iVar1 == 0){
                        iVar1 = bt_ancs_register_attr(((unsigned long)&g_ancs_client) /*=0x20006ae8*/, 3, param_1+0x90, 0x100);
                        if(iVar1 == 0){
                            iVar1 = bt_ancs_register_attr(((unsigned long)&g_ancs_client) /*=0x20006ae8*/, 5, param_1+400, 0x20);
                            if(iVar1 == 0) return 0;
                            if(C8 < 1) return iVar1;
                            if(CC == 0){ uVar2 = 0x3e4; goto LAB_00019090; }
                            uVar2 = 0x3e4;
                        } else {
                            if(C8 < 1) return iVar1;
                            if(CC == 0){ uVar2 = 0x3dc;
LAB_00019090:
                                log_message(((unsigned long)"%s(): %d: err=%d\n") /*=0x9ab0c*/, ((unsigned long)"ancs_c_init") /*=0x9b15e*/, uVar2, iVar1); return iVar1; }
                            uVar2 = 0x3dc;
                        }
                    } else {
                        if(C8 < 1) return iVar1;
                        if(CC == 0){ uVar2 = 0x3d4; goto LAB_00019090; }
                        uVar2 = 0x3d4;
                    }
                } else {
                    if(C8 < 1) return iVar1;
                    if(CC == 0){ uVar2 = 0x3cc; goto LAB_00019090; }
                    uVar2 = 0x3cc;
                }
            } else {
                if(C8 < 1) return iVar1;
                if(CC == 0){ uVar2 = 0x3c4; goto LAB_00019090; }
                uVar2 = 0x3c4;
            }
        } else {
            if(C8 < 1) return iVar1;
            if(CC == 0){ uVar2 = 0x3bc; goto LAB_00019090; }
            uVar2 = 0x3bc;
        }
    } else {
        if(C8 < 1) return iVar1;
        if(CC == 0){ uVar2 = 0x3b4; goto LAB_00019090; }
        uVar2 = 0x3b4;
    }
    debug_print(((unsigned long)"%s(): %d: err=%d\n") /*=0x9ab0c*/, ((unsigned long)"ancs_c_init") /*=0x9b15e*/, uVar2, iVar1);
    return iVar1;
}

/* ---- ancs_discover_params_reset.c ---- */
/* readable reconstruction; identity: FUN_000191d8 @ 0x000191d8
 * public-name: ancs_discover_params_reset
 * durable-map: recon/catalogs/function_names_app.json
 * callees (readable <= raw @ address):
 *   ancs_discover_params_reset               <= FUN_000191d8 @ 0x000191d8
 *   ancs_discover_ctx_clear                  <= FUN_0007f8c6 @ 0x0007f8c6
 * address symbols (name @ address):
 *   g_ancs_discover_params                   @ 0x20006abc
 */
/* Reconstructed FUN_000191d8 @ 0x191d8  (parity: 300/300 trials, PROVEN) */

extern void ancs_discover_ctx_clear(unsigned int);
void ancs_discover_params_reset(void)
{
    ancs_discover_ctx_clear(((unsigned long)&g_ancs_discover_params) /*=0x20006abc*/);
}

/* ---- request_ancs_attr_ext.c ---- */
/* readable reconstruction; identity: FUN_000191e4 @ 0x000191e4
 * public-name: request_ancs_attr_ext
 * durable-map: recon/catalogs/function_names_app.json
 * callees (readable <= raw @ address):
 *   strlen                                   <= FUN_0000ef12 @ 0x0000ef12
 *   ancs_get_conn_ctx                        <= FUN_000181fc @ 0x000181fc
 *   debug_print                              <= FUN_00019c70 @ 0x00019c70
 *   bt_ancs_request_attrs                    <= FUN_0007f6b6 @ 0x0007f6b6
 *   thunk_FUN_0007f7d2                       <= FUN_0007f7c4 @ 0x0007f7c4
 * address symbols (name @ address):
 *   rodata_1827d                             @ 0x0001827d
 *   rodata_9ab1e                             @ 0x0009ab1e   [INLINED -- G6 literal batch]
 *   rodata_9abbd                             @ 0x0009abbd   [INLINED -- G6 literal batch]
 *   rodata_9abdc                             @ 0x0009abdc   [INLINED -- G6 literal batch]
 *   rodata_9ac14                             @ 0x0009ac14   [INLINED -- G6 literal batch]
 *   rodata_9b148                             @ 0x0009b148   [INLINED -- G6 literal batch]
 *   g_log_level                              @ 0x2000230c
 *   g_ancs_notif_attr_id_latest              @ 0x20006aa0
 *   g_ancs_notif_evt_id_latest               @ 0x20006aac
 *   g_ancs_client                            @ 0x20006ae8
 *   g_log_use_alt_sink                       @ 0x20007554
 */
/* Reconstructed request_ancs_attr_ext @ 0x191e4  (parity: 300/300 trials, PROVEN) */
#include "../../../headers/g1_dedupe.h"
extern int strlen(int);
extern int ancs_get_conn_ctx(void);
extern int bt_ancs_request_attrs(unsigned,unsigned,unsigned);
extern void FUN_0007c0a4(int,int);
extern int thunk_FUN_0007f7d2(void*, const unsigned char*, unsigned long, void*);
int request_ancs_attr_ext(unsigned param_1, unsigned param_2, unsigned param_3)
{
  unsigned uVar1, uVar2; unsigned short *puVar3; int iVar4, iVar5; unsigned uVar6;
  iVar4 = ancs_get_conn_ctx();
  iVar5 = bt_ancs_request_attrs(((unsigned long)&g_ancs_client) /*=0x20006ae8*/, ((unsigned long)&g_ancs_notif_evt_id_latest) /*=0x20006aac*/, ((unsigned long)&rodata_1827d) /*=0x1827d*/);
  puVar3 = (unsigned short*)((unsigned long)&g_ancs_notif_attr_id_latest) /*=0x20006aa0*/;
  uVar6 = 0;
  do {
    if ((((*(int*)(puVar3+2) == 0) && (*puVar3 != 0)) && (**(char**)(puVar3+4) != 0)) &&
        (*(char*)(iVar4+0x44) != 0)) goto LAB_5a;
    FUN_0007c0a4(0x21, 0);
    uVar6 = uVar6 + 1 & 0xffff;
  } while (uVar6 != 0x3e9);
  if (0 < *(int*)((unsigned long)&g_log_level) /*=0x2000230c*/) {
    param_1 = strlen(*(unsigned*)(puVar3+4));
    param_2 = (unsigned)*(unsigned char*)(iVar4+0x44);
    unsigned sink = *(int*)((unsigned long)&g_log_use_alt_sink) /*=0x20007554*/;
    if (sink == 0)
      log_message(((unsigned long)"%s(): notif_attr_app_id_latest.attr_id %d notif_attr_app_id_latest.attr_len %d strlen(notif_attr_app_id_latest.attr_data) %d c->notifi_data.app_identifier %d\n") /*=0x9ab1e*/, ((unsigned long)"request_ancs_attr_ext") /*=0x9b148*/, *(unsigned*)(puVar3+2), (unsigned)*puVar3, param_1, param_2);
    else
      debug_print(((unsigned long)"%s(): notif_attr_app_id_latest.attr_id %d notif_attr_app_id_latest.attr_len %d strlen(notif_attr_app_id_latest.attr_data) %d c->notifi_data.app_identifier %d\n") /*=0x9ab1e*/, ((unsigned long)"request_ancs_attr_ext") /*=0x9b148*/,
                   *(unsigned*)(puVar3+2), (unsigned)*puVar3,
                   param_1, param_2);
  }
  if (*(int*)(puVar3+2) == 0) {
LAB_5a:
    if ((*puVar3 != 0) && (**(char**)(puVar3+4) != 0)) {
      unsigned sink = *(int*)((unsigned long)&g_log_use_alt_sink) /*=0x20007554*/;
      G1_LOG_ROUTE(sink == 0, ((unsigned long)"Request for %s: retry_time %d\n") /*=0x9abbd*/, *(char**)(puVar3+4), uVar6, sink, param_1, param_2, param_3);
        uVar1 = ((unsigned long)&g_ancs_client) /*=0x20006ae8*/; uVar2 = ((unsigned long)&rodata_1827d);
      for (; uVar6 < 200; uVar6 = uVar6 + 1 & 0xffff) {
        iVar5 = thunk_FUN_0007f7d2(uVar1, *(unsigned*)(puVar3+4), *puVar3, uVar2);
        if (iVar5 == 0) goto LAB_86;
        FUN_0007c0a4(0xa4, 0);
      }
      if (iVar5 != 0) log_message(((unsigned long)"Failed requesting attributes for a given app (err: %d)\n") /*=0x9abdc*/, iVar5);
    }
  }
LAB_86:
  if (*(int*)((unsigned long)&g_log_use_alt_sink) /*=0x20007554*/ == 0)
    log_message(((unsigned long)"notif_attr_app_id_latest.attr_id (%d/%d) retry_time %d\n") /*=0x9ac14*/, *(unsigned*)(puVar3+2), (unsigned)*puVar3, uVar6, param_1, param_2);
  else
    debug_print(((unsigned long)"notif_attr_app_id_latest.attr_id (%d/%d) retry_time %d\n") /*=0x9ac14*/, *(unsigned*)(puVar3+2),
                 (unsigned)*puVar3, uVar6, param_1, param_2, param_3);
  return iVar5;
}

/* ---- ancs_notification_forward.c ---- */
/* readable reconstruction; identity: FUN_0001965c @ 0x0001965c
 * public-name: ancs_notification_forward
 * durable-map: recon/catalogs/function_names_app.json
 * callees (readable <= raw @ address):
 *   dequeue_ancs                             <= FUN_00018d94 @ 0x00018d94
 *   ancs_notification_forward                <= FUN_0001965c @ 0x0001965c
 *   debug_print                              <= FUN_00019c70 @ 0x00019c70
 *   ble_process_req_dispatch                 <= FUN_00021460 @ 0x00021460
 *   send_data_in_ble_chunks                  <= FUN_0003384c @ 0x0003384c
 *   is_on_whitelist_by_identifier            <= FUN_00034bd4 @ 0x00034bd4
 *   log_notification_fields_debug            <= FUN_0004a3d0 @ 0x0004a3d0
 *   format_log_timestamp_mmdd_hhmm           <= FUN_0007ca80 @ 0x0007ca80
 *   get_timestamp                            <= FUN_0007d224 @ 0x0007d224
 *   memset_bytes                             <= FUN_00086c78 @ 0x00086c78
 *   strncpy_zero_pad                         <= FUN_0008705a @ 0x0008705a
 * address symbols (name @ address):
 *   rodata_9ad7c                             @ 0x0009ad7c   [INLINED -- G6 literal batch]
 *   rodata_9ad86                             @ 0x0009ad86   [INLINED -- G6 literal batch]
 *   rodata_9adaa                             @ 0x0009adaa
 *   g_ancs_notif_evt_id_latest               @ 0x20006aac
 *   g_20006ab2                               @ 0x20006ab2
 *   g_log_use_alt_sink                       @ 0x20007554
 */
/* Reconstructed FUN_0001965c @ 0x1965c  (parity: 300/300 trials, PROVEN) */

#include "g1_notify.h"
extern int dequeue_ancs(void*);
extern unsigned int ble_process_req_dispatch(unsigned char*, unsigned char*, unsigned char*);
extern void send_data_in_ble_chunks(const unsigned char *);
extern void log_notification_fields_debug(uint32_t, void*);
extern int format_log_timestamp_mmdd_hhmm(unsigned char *);
extern int get_timestamp(void);
extern void memset_bytes(void*, int, int);
extern void strncpy_zero_pad(void*, uint32_t, int);

struct ancs_record {
  uint32_t uid[2];
  uint32_t device_state;
  uint32_t reserved;
  char text[384];
  uint8_t work[32];
  uint32_t status;
};

struct command_record {
  uint32_t opcode;
  struct ancs_record notification;
};

_Static_assert(sizeof(struct ancs_record) == 0x1b4, "ANCS record layout");
_Static_assert(sizeof(struct command_record) == 0x1b8, "command record layout");

void ancs_notification_forward(uint32_t channel)
{
  struct command_record local;
  int kind;
  uint8_t mode;

  local.opcode = 0x4b;
  memset_bytes(&local.notification, 0, sizeof(local.notification));
  if (dequeue_ancs(&local.notification) != 0 ||
      (local.notification.status <= 1 && local.notification.text[0] == 0)) {
    return;
  }

  local.notification.uid[0] = (uint32_t)get_timestamp();
  if (local.notification.uid[0] == 0) {
    local.notification.uid[0] = 1;
  }
  local.notification.device_state = *(volatile uint32_t *)((unsigned long)&g_ancs_notif_evt_id_latest) /*=0x20006aac*/;
  log_notification_fields_debug(((unsigned long)"FROM:ancs") /*=0x9ad7c*/, &local.notification);

  if (local.notification.status < 2) {
    kind = is_on_whitelist_by_identifier(local.notification.text);
    if (kind != 2) {
      if (kind == 3) {
        mode = 4;
      } else {
        if (kind != 1) {
          return;
        }
        G1_LOG_ROUTE(*(volatile uint32_t *)((unsigned long)&g_log_use_alt_sink) /*=0x20007554*/ == 0, ((unsigned long)"blocked! app(%s) not in whitelist \n") /*=0x9ad86*/, local.notification.text);
        send_data_in_ble_chunks(&local.notification);
        return;
      }
    } else {
      mode = 2;
    }
  } else {
    mode = 2;
  }

  ((uint8_t*)&local.opcode)[1] = mode;
  if (*(volatile uint8_t *)((unsigned long)&g_20006ab2) /*=0x20006ab2*/ == 2) {
    strncpy_zero_pad(local.notification.text, ((unsigned long)&rodata_9adaa) /*=0x9adaa*/, 0x20);
  }
  format_log_timestamp_mmdd_hhmm(local.notification.work);
  ble_process_req_dispatch(channel, &local.opcode, &local.notification);
}

