/*
 * Cohesive translation unit for the `notify' module.
 *
 * GENERATED by recon/refactor/transforms/t04_cohesive_tu.py.  Do not
 * edit: a stage tree is regenerated, never hand-patched
 * (recon/refactor/README.md C4).
 *
 * The 4 functions below were 4 separate translation units until this
 * stage.  Each one's text is reproduced VERBATIM and in the order the
 * generated source list gave it, and they were CONSECUTIVE in that list.
 * They were proven able to share a translation unit: no symbol is
 * declared here with two types, no identifier has internal linkage in one
 * member and is named by another, and no local typedef, macro, struct tag
 * or enum constant of one member is visible to a member that names it.
 *
 * members, in link order:
 *   ancs_main.c
 *   ancs_set_notification_enabled.c
 *   get_ancs_conn_handle.c
 *   parse_receiver_pack_pkcs7.c
 */

/* File-scope forward declarations for every struct/union tag this
 * unit names.  Without them a tag whose only appearance in a member
 * is inside a parameter list has PARAMETER-LIST scope, so two
 * textually IDENTICAL declarations in two members declare two
 * different incomplete types and the second is a conflicting
 * redeclaration (C11 6.2.1p7).  Incomplete-type forward
 * declarations emit no code. */
struct device_info_view;
struct k_sem;
/* ---- ancs_main.c ---- */
#include "g1_app_symbols.h"
/* readable reconstruction; identity: FUN_00019950 @ 0x00019950
 * public-name: ancs_main
 * durable-map: recon/catalogs/function_names_app.json
 * callees (readable <= raw @ address):
 *   ancs_notify_sync_init                    <= FUN_000181f0 @ 0x000181f0
 *   bt_conn_auth_cb_register                 <= FUN_000572fc @ 0x000572fc
 *   k_msleep_ticks32768_d                    <= FUN_0007c0a8 @ 0x0007c0a8
 * address symbols (name @ address):
 *   ADDR_check_bonded_addr_THUMB             @ 0x000183e5
 *   rodata_9af3b                             @ 0x0009af3b   [INLINED -- G6 literal batch]
 *   rodata_9af75                             @ 0x0009af75   [INLINED -- G6 literal batch]
 *   rodata_9afa1                             @ 0x0009afa1   [INLINED -- G6 literal batch]
 *   rodata_9afc3                             @ 0x0009afc3   [INLINED -- G6 literal batch]
 *   rodata_9afed                             @ 0x0009afed   [INLINED -- G6 literal batch]
 *   rodata_9b019                             @ 0x0009b019   [INLINED -- G6 literal batch]
 *   rodata_9b04b                             @ 0x0009b04b   [INLINED -- G6 literal batch]
 *   rodata_9b060                             @ 0x0009b060   [INLINED -- G6 literal batch]
 *   rodata_9b089                             @ 0x0009b089   [INLINED -- G6 literal batch]
 *   rodata_9b0ae                             @ 0x0009b0ae   [INLINED -- G6 literal batch]
 *   rodata_9b135                             @ 0x0009b135   [INLINED -- G6 literal batch]
 *   g_log_level                              @ 0x2000230c
 *   g_20002320                               @ 0x20002320
 *   g_20002328                               @ 0x20002328
 *   g_20002338                               @ 0x20002338
 *   g_ancs_active_conn                       @ 0x20006ab8
 *   g_log_use_alt_sink                       @ 0x20007554
 *   g_2000ff87                               @ 0x2000ff87
 */
/* Readable reconstruction of FUN_00019950 @ 0x00019950. */
#include <stdint.h>
#include "../../../headers/g1_log.h"
#include "../../../headers/g1_dedupe.h"
#include "g1_notify.h"

/* Callee back-map: every semantic alias retains the firmware identity used by
 * the parity linker. */
extern int get_device_info(void);                 /* FUN_000167a8 @ 0x000167a8 */
extern int ancs_c_init(void *client);                   /* FUN_0001905c @ 0x0001905c */
extern int ancs_discover_params_reset(void);            /* FUN_000191d8 @ 0x000191d8 */
extern int bt_start(void);                              /* FUN_00019308 @ 0x00019308 */
extern void start_ancs_work_thread(uintptr_t context);  /* FUN_000198cc @ 0x000198cc */
extern int bt_enable(void *ready_cb);                   /* FUN_00054a44 @ 0x00054a44 */
extern void bt_hci_driver_close(void);                  /* FUN_00054b70 @ 0x00054b70 */
extern int bt_conn_auth_info_cb_register(const void *); /* FUN_00057330 @ 0x00057330 */
extern void bt_gatt_cb_register(const void *);          /* FUN_0005a9d8 @ 0x0005a9d8 */
extern void bt_foreach_bond(unsigned int, const void *, void *);/* FUN_0005e6d4 @ 0x0005e6d4 */
extern int settings_load(void);                         /* FUN_0007f192 @ 0x0007f192 */

extern int bt_conn_auth_cb_register(const void *callbacks);
extern int ancs_notify_sync_init(void);

#define ancs_sleep_ms                 k_msleep_ticks32768_d /* k_msleep adapter @ 0x0007c0a8 */
#define bt_conn_auth_cb_register      bt_conn_auth_cb_register /* FUN_000572fc @ 0x000572fc */
#define ancs_notify_sync_init         ancs_notify_sync_init /* FUN_000181f0 @ 0x000181f0 */

/* Absolute object and string identities are intentionally retained.  Their
 * names describe use here; the address is the durable back-map. */
#define ANCS_ACTIVE_CONTEXT       (*(volatile uintptr_t *)((unsigned long)&g_ancs_active_conn) /*=0x20006ab8*/)
#define LOG_LEVEL                 (*(volatile int *)((unsigned long)&g_log_level) /*=0x2000230c*/)
#define LOG_USE_ALT_SINK          (*(volatile uint32_t *)((unsigned long)&g_log_use_alt_sink) /*=0x20007554*/)
#define ANCS_AUTH_CALLBACKS       ((const void *)((unsigned long)&g_20002338) /*=0x20002338*/)
#define ANCS_AUTH_INFO_CALLBACKS  ((const void *)((unsigned long)&g_20002328) /*=0x20002328*/)
#define ANCS_GATT_CALLBACKS       ((const void *)((unsigned long)&g_20002320) /*=0x20002320*/)
#define CHECK_BONDED_ADDR_CB      ((const void *)ADDR_check_bonded_addr_THUMB /*=0x183e5*/) /* check_bonded_addr + Thumb bit */
#define ADVERTISING_KIND          ((const char *)((unsigned long)&g_2000ff87) /*=0x2000ff87*/)

#define STR_ANCS_START            ((const char *)((unsigned long)"%s(): Starting Apple Notification Center Service client\n\n") /*=0x9af3b*/)
#define STR_ANCS_MAIN             ((const char *)((unsigned long)"ancs_main") /*=0x9b135*/)
#define STR_BT_INIT_FAILED        ((const char *)((unsigned long)"BLE init failed (err %d) bt_retry_count %d\n") /*=0x9af75*/)
#define STR_ANCS_INIT_FAILED      ((const char *)((unsigned long)"ANCS client init failed (err %d)\n") /*=0x9afa1*/)
#define STR_INIT_REBOOT           ((const char *)((unsigned long)"ancs or ncs init failure, reboot it\n") /*=0x9b089*/)
#define STR_REBOOT_REASON         ((const char *)((unsigned long)"%s(): reboot because ancs start failed\r\n\n") /*=0x9b0ae*/)
#define STR_DISCOVERY_INIT_FAILED ((const char *)((unsigned long)"GATT Service client init failed (err %d)\n") /*=0x9afc3*/)
#define STR_AUTH_CB_FAILED        ((const char *)((unsigned long)"Failed to register authorization callbacks\n") /*=0x9afed*/)
#define STR_AUTH_INFO_FAILED      ((const char *)((unsigned long)"Failed to register authorization info callbacks.\n") /*=0x9b019*/)
#define STR_NOTIFY_INIT_FAILED    ((const char *)((unsigned long)"Failed to init nus.\n") /*=0x9b04b*/)
#define STR_ADVERTISING_FAILED    ((const char *)((unsigned long)"Advertising %s failed to start (err %d)\n") /*=0x9b060*/)

struct device_info_view {
    uint8_t opaque[0x1058];
    uint8_t initialized;
};

static inline __attribute__((always_inline)) void log_start_if_enabled(void)
{
    if (LOG_LEVEL > 0) {
        G1_LOG_ROUTE(LOG_USE_ALT_SINK == 0, STR_ANCS_START, STR_ANCS_MAIN);
    }
}

static inline __attribute__((always_inline)) void reboot_after_ancs_failure(void)
{
    log_message(STR_INIT_REBOOT);
    ancs_sleep_ms(1000);

    if (LOG_LEVEL > 0) {
        G1_LOG_ROUTE(LOG_USE_ALT_SINK == 0, STR_REBOOT_REASON, STR_ANCS_MAIN);
    }

    ancs_sleep_ms(500);
    sys_reboot(1);
}

int ancs_main(uintptr_t context)
{
    int error;
    unsigned int ready_retries = 50;
    unsigned int send_retries = 5;

    ANCS_ACTIVE_CONTEXT = context;
    log_start_if_enabled();

    do {
        while (((const struct device_info_view *)get_device_info())->initialized == 0 &&
               ready_retries != 0) {
            --ready_retries;
            ancs_sleep_ms(100);
        }

        error = bt_enable(0);
        if (error == 0) {
            break;
        }

        bt_hci_driver_close();
        log_message(STR_BT_INIT_FAILED, error, send_retries);
        --send_retries;
        ancs_sleep_ms(1000);
    } while (send_retries != 0);

    bt_foreach_bond(0, CHECK_BONDED_ADDR_CB, 0);
    settings_load();

    error = ancs_c_init((void *)(context + 0x34));
    if (error != 0) {
        log_message(STR_ANCS_INIT_FAILED, error);
        reboot_after_ancs_failure();
        return error;
    }

    error = ancs_discover_params_reset();
    if (error != 0) {
        log_message(STR_DISCOVERY_INIT_FAILED, error);
        reboot_after_ancs_failure();
        return error;
    }

    error = bt_conn_auth_cb_register(ANCS_AUTH_CALLBACKS);
    if (error != 0) {
        log_message(STR_AUTH_CB_FAILED);
        reboot_after_ancs_failure();
        return error;
    }

    error = bt_conn_auth_info_cb_register(ANCS_AUTH_INFO_CALLBACKS);
    if (error != 0) {
        log_message(STR_AUTH_INFO_FAILED);
        reboot_after_ancs_failure();
        return error;
    }

    bt_gatt_cb_register(ANCS_GATT_CALLBACKS);
    error = ancs_notify_sync_init();
    if (error != 0) {
        log_message(STR_NOTIFY_INIT_FAILED);
        reboot_after_ancs_failure();
        return error;
    }

    error = bt_start();
    if (error != 0) {
        log_message(STR_ADVERTISING_FAILED, ADVERTISING_KIND, error);
        reboot_after_ancs_failure();
        return error;
    }

    start_ancs_work_thread(context);
    return 0;
}

/* ---- ancs_set_notification_enabled.c ---- */
struct k_sem;
/* readable reconstruction; identity: FUN_00019ac0 @ 0x00019ac0
 * public-name: ancs_set_notification_enabled
 * durable-map: recon/catalogs/function_names_app.json
 * callees (readable <= raw @ address):
 *   get_device_info                          <= FUN_000167a8 @ 0x000167a8
 *   ancs_discover_start                      <= FUN_000182c8 @ 0x000182c8
 *   ancs_cancel_timers                       <= FUN_00018ab0 @ 0x00018ab0
 *   ancs_set_notification_enabled            <= FUN_00019ac0 @ 0x00019ac0
 *   k_sem_give                               <= FUN_00072880 @ 0x00072880
 * address symbols (name @ address):
 *   g_ancs_conn                              @ 0x20007518
 */
/* Reconstructed FUN_00019ac0 @ 0x19ac0  (parity: 300/300 trials, PROVEN) */
extern void ancs_discover_start(uint32_t);
extern void k_sem_give(struct k_sem *);
int ancs_set_notification_enabled(int param_1){
  int iVar1;
  ancs_cancel_timers();
  if(param_1==0){
    iVar1=get_device_info();
    if(*(volatile uint8_t *)(iVar1+0x1070)!=1) return 0;
    iVar1=get_device_info();
    *(volatile uint8_t *)(iVar1+0x1070)=0;
  } else {
    uint32_t active = *(volatile uint32_t *)((unsigned long)&g_ancs_conn) /*=0x20007518*/;
    if(active==0) return 0;
    ancs_discover_start(active);
    iVar1=get_device_info();
    if(*(volatile uint8_t *)(iVar1+0x1070)!=0) return 0;
    iVar1=get_device_info();
    *(volatile uint8_t *)(iVar1+0x1070)=1;
  }
  iVar1=get_device_info();
  *(volatile uint32_t *)(iVar1+0x104c)=0;
  iVar1=get_device_info();
  k_sem_give(iVar1+0x80);
  return 0;
}

/* ---- get_ancs_conn_handle.c ---- */
/* readable reconstruction; identity: FUN_00019b2c @ 0x00019b2c
 * public-name: get_ancs_conn_handle
 * durable-map: recon/catalogs/function_names_app.json
 * callees (readable <= raw @ address):
 *   get_ancs_conn_handle                     <= FUN_00019b2c @ 0x00019b2c
 * address symbols (name @ address):
 *   g_ancs_conn                              @ 0x20007518
 */
/* Reconstructed FUN_00019b2c @ 0x19b2c  (parity: 300/300 trials, PROVEN) */

unsigned int get_ancs_conn_handle(void) {
    return *(volatile unsigned int *)((unsigned long)&g_ancs_conn) /*=0x20007518*/;
}

/* ---- parse_receiver_pack_pkcs7.c ---- */
/* readable reconstruction; identity: FUN_00019cd0 @ 0x00019cd0
 * public-name: parse_receiver_pack_pkcs7
 * durable-map: recon/catalogs/function_names_app.json
 * callees (readable <= raw @ address):
 *   debug_print                              <= FUN_00019c70 @ 0x00019c70
 *   memcpy                                   <= FUN_00086c04 @ 0x00086c04
 * address symbols (name @ address):
 *   rodata_9b371                             @ 0x0009b371   [INLINED -- G6 literal batch]
 *   rodata_9b3b5                             @ 0x0009b3b5   [INLINED -- G6 literal batch]
 *   rodata_9b3e0                             @ 0x0009b3e0   [INLINED -- G6 literal batch]
 *   rodata_9e0d0                             @ 0x0009e0d0   [INLINED -- G6 literal batch]
 *   g_log_use_alt_sink                       @ 0x20007554
 *   g_pkcs7_pack_offset                      @ 0x2000d6f4
 *   g_pkcs7_pack_cmd_id                      @ 0x20010320
 */
/* Reconstructed parse_receiver_pack_pkcs7 @ 0x19cd0  (parity: 300/300 trials, PROVEN) */
extern void memcpy(int, ...);

unsigned int parse_receiver_pack_pkcs7(int param_1, unsigned char *param_2, unsigned int param_3)
{
    unsigned char bVar1, bVar2;
    unsigned short uVar3;
    unsigned char *pbVar4 = (unsigned char*)((unsigned long)&g_pkcs7_pack_cmd_id) /*=0x20010320*/;
    unsigned short *puVar5 = (unsigned short*)((unsigned long)&g_pkcs7_pack_offset) /*=0x2000d6f4*/;
    unsigned int uVar6;
    unsigned int uVar7;
    int iVar8;
    unsigned int uVar9;

    if (param_2 == (unsigned char*)0) {
        uVar7 = 0xb0;
        iVar8 = *(volatile int *)((unsigned long)&g_log_use_alt_sink) /*=0x20007554*/;
        uVar6 = ((unsigned long)"[%s-%d]error, req is NULL ! \n") /*=0x9b371*/;
    } else {
        if (param_1 != 0) {
            if (param_3 < 3) {
                if (*(volatile int *)((unsigned long)&g_log_use_alt_sink) /*=0x20007554*/ != 0) {
                    debug_print(((unsigned long)"[%s-%d]error, req_len is %d, too short ! \n") /*=0x9b3b5*/, ((unsigned long)"parse_receiver_pack_pkcs7") /*=0x9e0d0*/, 0xbbUL, param_3);
                    return 0xca;
                }
                log_message(((unsigned long)"[%s-%d]error, req_len is %d, too short ! \n") /*=0x9b3b5*/, ((unsigned long)"parse_receiver_pack_pkcs7") /*=0x9e0d0*/, 0xbbUL, param_3);
                return 0xca;
            }
            bVar1 = param_2[2];
            uVar9 = (unsigned int)*param_2;
            bVar2 = param_2[1];
            if (bVar1 == 0) {
                *pbVar4 = *param_2;
                *puVar5 = (unsigned short)bVar1;
            }
            if (*pbVar4 != uVar9) {
                if (*(volatile int *)((unsigned long)&g_log_use_alt_sink) /*=0x20007554*/ != 0) {
                    debug_print(((unsigned long)"[%s-%d]error, curCmd is %d, but parseCmd is %d ! \n") /*=0x9b3e0*/, ((unsigned long)"parse_receiver_pack_pkcs7") /*=0x9e0d0*/);
                    return 0xca;
                }
                log_message(((unsigned long)"[%s-%d]error, curCmd is %d, but parseCmd is %d ! \n") /*=0x9b3e0*/, ((unsigned long)"parse_receiver_pack_pkcs7") /*=0x9e0d0*/, 0xd0UL, uVar9, (unsigned int)*pbVar4);
                return 0xca;
            }
            uVar3 = *puVar5;
            memcpy(param_1 + (unsigned int)uVar3, param_2 + 3, param_3 - 3, uVar9, param_1, param_2);
            if ((unsigned int)bVar1 == (unsigned int)(bVar2 - 1)) {
                uVar6 = 0xc9;
            } else {
                uVar6 = 0xcb;
            }
            *puVar5 = (unsigned short)((int)param_3 + (uVar3 - 3));
            return uVar6;
        }
        uVar7 = 0xb5;
        iVar8 = *(volatile int *)((unsigned long)&g_log_use_alt_sink) /*=0x20007554*/;
        uVar6 = 0x0009b38fUL;
    }
    G1_LOG_ROUTE(iVar8 == 0, uVar6, ((unsigned long)"parse_receiver_pack_pkcs7") /*=0x9e0d0*/, uVar7);
    return 0xca;
}

