/*
 * Cohesive translation unit for the `display' module.
 *
 * GENERATED by recon/refactor/transforms/t04_cohesive_tu.py.  Do not
 * edit: a stage tree is regenerated, never hand-patched
 * (recon/refactor/README.md C4).
 *
 * The 6 functions below were 6 separate translation units until this
 * stage.  Each one's text is reproduced VERBATIM and in the order the
 * generated source list gave it, and they were CONSECUTIVE in that list.
 * They were proven able to share a translation unit: no symbol is
 * declared here with two types, no identifier has internal linkage in one
 * member and is named by another, and no local typedef, macro, struct tag
 * or enum constant of one member is visible to a member that names it.
 *
 * members, in link order:
 *   panel_init.c
 *   jbd_panel_suspend.c
 *   jbd_panel_resume.c
 *   projector_bus_lock.c
 *   projector_bus_unlock.c
 *   projector_transfer_pixel_chunk.c
 */

/* File-scope forward declarations for every struct/union tag this
 * unit names.  Without them a tag whose only appearance in a member
 * is inside a parameter list has PARAMETER-LIST scope, so two
 * textually IDENTICAL declarations in two members declare two
 * different incomplete types and the second is a conflicting
 * redeclaration (C11 6.2.1p7).  Incomplete-type forward
 * declarations emit no code. */
struct k_mutex;
struct spi_api_476b4;
struct spi_state_476b4;
/* ---- panel_init.c ---- */
#include "g1_app_symbols.h"
/* readable reconstruction; identity: FUN_00047538 @ 0x00047538
 * public-name: panel_init
 * durable-map: recon/catalogs/function_names_app.json
 * callees (readable <= raw @ address):
 *   debug_print                              <= FUN_00019c70 @ 0x00019c70
 *   projector_send_cmd1                      <= FUN_0007d642 @ 0x0007d642
 *   projector_send_cmd_c0                    <= FUN_0007d658 @ 0x0007d658
 *   projector_send_cmd_0x46                  <= FUN_0007d67e @ 0x0007d67e
 *   projector_fill_framebuffer               <= FUN_0007d6ae @ 0x0007d6ae
 *   projector_reset_sequence                 <= FUN_0007d74e @ 0x0007d74e
 *   delay_ms                                 <= FUN_0007d772 @ 0x0007d772
 *   projector_send_cmd_immediate             <= FUN_0007d77c @ 0x0007d77c
 * address symbols (name @ address):
 *   rodata_99969                             @ 0x00099969   [INLINED -- refactor stage 01]
 *   rodata_d741b                             @ 0x000d741b   [INLINED -- G6 literal batch]
 *   g_log_level                              @ 0x2000230c
 *   g_log_use_alt_sink                       @ 0x20007554
 */
/* Reconstructed panel_init @ 0x47538. */
#include <stdint.h>
#include "../../../headers/g1_log.h"
#include "../../../headers/g1_dedupe.h"
#include "g1_display.h"

extern void projector_send_cmd1(uint32_t a, uint32_t b);
extern void projector_send_cmd_c0(uint32_t a, uint32_t b);
extern void projector_send_cmd_0x46(uint32_t a);
extern void projector_reset_sequence(void);
extern void delay_ms(int);
extern void projector_send_cmd_immediate(uint32_t a);

void panel_init(void)
{
    if (*(volatile int *)((unsigned long)&g_log_level) /*=0x2000230c*/ > 3) {
        G1_LOG_ROUTE(*(volatile uint32_t *)((unsigned long)&g_log_use_alt_sink) /*=0x20007554*/ == 0, ((unsigned long)"%s(): enter\n") /*=0x99969*/, ((unsigned long)"panel_init") /*=0xd741b*/);
    }
    projector_reset_sequence();
    projector_send_cmd_immediate(6);
    projector_send_cmd1(1, 0x10);
    projector_fill_framebuffer(0);
    projector_send_cmd_c0(0, 0);
    projector_send_cmd_c0(0, 0x14);
    projector_send_cmd_c0(0x18, 0);
    projector_send_cmd_c0(0x18, 0x14);
    projector_send_cmd_c0(0xc, 10);
    projector_send_cmd_immediate(0x71);
    projector_send_cmd_immediate(0x97);
    delay_ms(1);
    projector_send_cmd_immediate(0x73);
    projector_send_cmd_immediate(0x97);
    delay_ms(1);
    projector_send_cmd_0x46(0xf);
    projector_send_cmd1(0x31, 4);
    projector_send_cmd_immediate(0xa3);
    projector_send_cmd_immediate(0x97);
    delay_ms(1);
}

/* ---- jbd_panel_suspend.c ---- */
/* readable reconstruction; identity: FUN_000475f0 @ 0x000475f0
 * public-name: jbd_panel_suspend
 * durable-map: recon/catalogs/function_names_app.json
 * callees (readable <= raw @ address):
 *   debug_print                              <= FUN_00019c70 @ 0x00019c70
 *   projector_send_command                   <= FUN_0007d82e @ 0x0007d82e
 * address symbols (name @ address):
 *   rodata_d73a1                             @ 0x000d73a1   [INLINED -- G6 literal batch]
 *   rodata_d7409                             @ 0x000d7409   [INLINED -- G6 literal batch]
 *   g_log_level                              @ 0x2000230c
 *   g_log_use_alt_sink                       @ 0x20007554
 */
/* Reconstructed jbd_panel_suspend @ 0x475f0  (parity: 300/300 trials, PROVEN) */

extern void projector_send_command(unsigned int,const void *,unsigned int);

unsigned int jbd_panel_suspend(unsigned int param_1, unsigned int param_2, unsigned int param_3)
{
    if (*(volatile int *)((unsigned long)&g_log_level) /*=0x2000230c*/ > 2) {
        unsigned int sink = *(volatile unsigned int *)((unsigned long)&g_log_use_alt_sink) /*=0x20007554*/;
        G1_LOG_ROUTE(sink == 0, ((unsigned long)"%s(): SPI_DEEP_POWER_DOWN\n") /*=0xd73a1*/,((unsigned long)"jbd_panel_suspend") /*=0xd7409*/,param_3,sink,param_1,param_2);
    }
    const unsigned char command = 0xff;
    projector_send_command(0xb9,&command,1);
    return 0;
}

/* ---- jbd_panel_resume.c ---- */
/* readable reconstruction; identity: FUN_00047638 @ 0x00047638
 * public-name: jbd_panel_resume
 * durable-map: recon/catalogs/function_names_app.json
 * callees (readable <= raw @ address):
 *   debug_print                              <= FUN_00019c70 @ 0x00019c70
 *   set_brightness_to_panel_reg              <= FUN_00046e3c @ 0x00046e3c
 *   panel_init                               <= FUN_00047538 @ 0x00047538
 * address symbols (name @ address):
 *   rodata_d73bc                             @ 0x000d73bc   [INLINED -- G6 literal batch]
 *   rodata_d73e0                             @ 0x000d73e0   [INLINED -- G6 literal batch]
 *   rodata_d73f8                             @ 0x000d73f8   [INLINED -- G6 literal batch]
 *   g_log_level                              @ 0x2000230c
 *   g_log_use_alt_sink                       @ 0x20007554
 */
/* Reconstructed jbd_panel_resume @ 0x47638  (parity: 300/300 trials, PROVEN) */


unsigned int jbd_panel_resume(int param_1, unsigned int param_2, unsigned int param_3, unsigned int param_4)
{
  volatile int *piVar1 = (volatile int*)((unsigned long)&g_log_level) /*=0x2000230c*/;

  if (*piVar1 > 2) {
    unsigned int sink = *(volatile unsigned int *)((unsigned long)&g_log_use_alt_sink) /*=0x20007554*/;
    G1_LOG_ROUTE(sink == 0, (unsigned long)((unsigned long)"%s(): release from deep power down\n") /*=0xd73bc*/, (void*)((unsigned long)"jbd_panel_resume") /*=0xd73f8*/, param_3, sink, param_4);
  }
  panel_init();
  set_brightness_to_panel_reg(*(unsigned char*)(param_1+0x369));
  if (*piVar1 > 2) {
    unsigned int sink = *(volatile unsigned int *)((unsigned long)&g_log_use_alt_sink) /*=0x20007554*/;
    G1_LOG_ROUTE(sink == 0, (unsigned long)((unsigned long)"%s(): resume completed\n") /*=0xd73e0*/, (void*)((unsigned long)"jbd_panel_resume") /*=0xd73f8*/, param_3, sink, param_4);
  }
  return 0;
}

/* ---- projector_bus_lock.c ---- */
/* readable reconstruction; identity: FUN_00047698 @ 0x00047698
 * public-name: projector_bus_lock
 * durable-map: recon/catalogs/function_names_app.json
 * callees (readable <= raw @ address):
 *   projector_bus_lock                       <= FUN_00047698 @ 0x00047698
 *   k_mutex_lock                             <= FUN_000723b8 @ 0x000723b8
 * address symbols (name @ address):
 *   g_projector_bus_lock                     @ 0x2000a060
 */
/* Reconstructed FUN_00047698 @ 0x47698  (parity: 300/300 trials, PROVEN) */

extern void k_mutex_lock(unsigned int a0, unsigned int a1, unsigned int a2, unsigned int a3);
void projector_bus_lock(unsigned int param_1, unsigned int param_2)
{
  k_mutex_lock(((unsigned long)&g_projector_bus_lock) /*=0x2000a060*/, param_2, param_1, param_2);
}

/* ---- projector_bus_unlock.c ---- */
struct k_mutex;
/* readable reconstruction; identity: FUN_000476a8 @ 0x000476a8
 * public-name: projector_bus_unlock
 * durable-map: recon/catalogs/function_names_app.json
 * callees (readable <= raw @ address):
 *   projector_bus_unlock                     <= FUN_000476a8 @ 0x000476a8
 *   k_mutex_unlock                           <= FUN_00072558 @ 0x00072558
 * address symbols (name @ address):
 *   g_projector_bus_lock                     @ 0x2000a060
 */
/* Reconstructed FUN_000476a8 @ 0x476a8  (parity: 300/300 trials, PROVEN) */

extern int k_mutex_unlock(struct k_mutex *);
void projector_bus_unlock(void) {
    k_mutex_unlock(((unsigned long)&g_projector_bus_lock) /*=0x2000a060*/);
}

/* ---- projector_transfer_pixel_chunk.c ---- */
/* readable reconstruction; identity: FUN_000476b4 @ 0x000476b4
 * public-name: projector_transfer_pixel_chunk
 * durable-map: recon/catalogs/function_names_app.json
 * callees (readable <= raw @ address):
 *   projector_bus_lock                       <= FUN_00047698 @ 0x00047698
 *   projector_bus_unlock                     <= FUN_000476a8 @ 0x000476a8
 *   projector_transfer_pixel_chunk           <= FUN_000476b4 @ 0x000476b4
 *   get_projector_controller                 <= FUN_0007d4ec @ 0x0007d4ec
 */
/* Full reconstruction of FUN_000476b4 @ 0x476b4 (108-byte extent).
 * CFG_VERIFY_CALL_ARITIES=0,2,4,0
 * The caller-owned RX local is narrowly stack-pointer-normalized while all
 * four register arguments remain compared. */

typedef void (*spi_transfer_476b4_t)(void *device, const void *tx,
                                     uint32_t tx_length, void *rx,
                                     uint32_t rx_length, uint32_t y,
                                     uint32_t value);
struct spi_api_476b4 { uint32_t reserved[2]; spi_transfer_476b4_t transfer; };
struct spi_state_476b4 {
    uint8_t reserved0[0x344];
    uint8_t *cursor;
    uint8_t reserved1[0x2c];
    struct spi_api_476b4 *device;
};

extern struct spi_state_476b4 *get_projector_controller(void);

void projector_transfer_pixel_chunk(unsigned short x, unsigned short y, unsigned long value, long length) {
    uint32_t received = 0;
    struct spi_state_476b4 *state = get_projector_controller();
    volatile uint8_t *packet = state->cursor - 5;
    uint32_t packed = (x & 0x3ffu) | ((y << 10) & 0x0007fc00u);

    packet[0] = 2;
    packet[2] = (uint8_t)(packed >> 8);
    packet[1] = (uint8_t)(packed >> 16);
    packet[3] = (uint8_t)packed;
    packet[4] = 0xff;

    projector_bus_lock(UINT32_MAX, UINT32_MAX);
    state->device->transfer(state->device, (const void *)packet, length + 6, &received,
                            1, y, value);
    projector_bus_unlock();
}

