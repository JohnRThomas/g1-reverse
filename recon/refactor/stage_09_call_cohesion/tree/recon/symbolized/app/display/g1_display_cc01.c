/*
 * Call-cohesive translation unit for the `display' module.
 *
 * GENERATED by recon/refactor/transforms/t09_call_cohesion.py.  Do
 * not edit: a stage tree is regenerated, never hand-patched
 * (recon/refactor/README.md C4).
 *
 * The 5 translation units below were grouped because they CALL ONE
 * ANOTHER, not because they were adjacent in the generated source
 * list.  Each member's text is reproduced VERBATIM.  Every member was
 * checked pairwise against every other member already in this unit by
 * stage 04's seven refusal rules, unchanged: no symbol is declared
 * here with two types, no identifier has internal linkage in one
 * member and is named by another, and no local typedef, macro, struct
 * tag or enum constant of one member is visible to a member that
 * names it.
 *
 * members, in generated-source-list order:
 *   power_down_panel.c
 *   g1_display_08.c
 *   net_pkt_write_be16.c
 *   delay_ms.c
 *   g1_display_15.c
 *
 * call edges inside this unit (caller -> callee): 4
 *   g1_display_08.c -> delay_ms.c
 *   g1_display_08.c -> net_pkt_write_be16.c
 *   g1_display_08.c -> power_down_panel.c
 *   net_pkt_write_be16.c -> g1_display_15.c
 */

/* File-scope forward declarations for every struct/union tag this
 * unit names.  Without them a tag whose only appearance in a member
 * is inside a parameter list has PARAMETER-LIST scope, so two
 * textually IDENTICAL declarations in two members declare two
 * different incomplete types and the second is a conflicting
 * redeclaration (C11 6.2.1p7).  Incomplete-type forward
 * declarations emit no code. */
struct display_state_438d0;
/* ================================================================ */
/* member unit: power_down_panel.c */
/* ================================================================ */
#include "g1_app_symbols.h"
/* readable reconstruction; identity: FUN_00015fdc @ 0x00015fdc
 * public-name: power_down_panel
 * durable-map: recon/catalogs/function_names_app.json
 * callees (readable <= raw @ address):
 *   panel_pwr_gpio_deassert                  <= FUN_000179e0 @ 0x000179e0
 *   debug_print                              <= FUN_00019c70 @ 0x00019c70
 *   app_msleep_thunk_a                       <= FUN_0007c038 @ 0x0007c038
 *   dev_write_reg3                           <= FUN_00083dc8 @ 0x00083dc8
 * address symbols (name @ address):
 *   rodata_99329                             @ 0x00099329
 *   rodata_9940b                             @ 0x0009940b
 *   rodata_9949a                             @ 0x0009949a   [INLINED -- G6 literal batch]
 *   rodata_994b9                             @ 0x000994b9   [INLINED -- G6 literal batch]
 *   rodata_99c17                             @ 0x00099c17   [INLINED -- G6 literal batch]
 *   g_log_level                              @ 0x2000230c
 *   g_log_use_alt_sink                       @ 0x20007554
 */
/* Reconstructed power_down_panel @ 0x15fdc  (parity: 300/300 trials, PROVEN) */
#include <stdint.h>
#include "../../../headers/g1_log.h"
#include "../../../headers/g1_dedupe.h"
extern void panel_pwr_gpio_deassert(void);
extern int app_msleep_thunk_a(int);
extern int dev_write_reg3(unsigned int, unsigned int, unsigned int, unsigned int);

unsigned int power_down_panel(void)
{
    volatile int *piVar1 = (volatile int*)((unsigned long)&g_log_level) /*=0x2000230c*/;
    int iVar2;
    unsigned int format_string;

    app_msleep_thunk_a(2);
    panel_pwr_gpio_deassert();
    if (0 < *piVar1) {
        G1_LOG_ROUTE(*(volatile int *)((unsigned long)&g_log_use_alt_sink) /*=0x20007554*/ == 0, ((unsigned long)"%s(): turn off -2v for panel.\n") /*=0x9949a*/, ((unsigned long)"power_down_panel") /*=0x99c17*/);
    }
    app_msleep_thunk_a(0x10);
    iVar2 = dev_write_reg3(*(volatile uint32_t *)(*(volatile uint32_t *)((unsigned long)&rodata_87d10 + 4) /*=0x87d10*/ + 0x1c), 4, 3, 1);
    if (iVar2 < 0) {
        if (*piVar1 < 1) {
            return 0;
        }
        iVar2 = *(volatile int *)((unsigned long)&g_log_use_alt_sink) /*=0x20007554*/;
        format_string = ((unsigned long)&rodata_9940b) /*=0x9940b*/;
    } else {
        if (0 < *piVar1) {
            G1_LOG_ROUTE(*(volatile int *)((unsigned long)&g_log_use_alt_sink) /*=0x20007554*/ == 0, ((unsigned long)"%s(): disable buck2 1.2v\n") /*=0x994b9*/, ((unsigned long)"power_down_panel") /*=0x99c17*/);
        }
        app_msleep_thunk_a(5);
        iVar2 = dev_write_reg3(*(volatile uint32_t *)(*(volatile uint32_t *)((unsigned long)&rodata_87cf8 + 4) /*=0x87cf8*/ + 0x1c), 8, 1, 1);
        if (iVar2 < 0) {
            if (*piVar1 < 1) {
                return 0;
            }
            iVar2 = *(volatile int *)((unsigned long)&g_log_use_alt_sink) /*=0x20007554*/;
            format_string = ((unsigned long)&rodata_99329) /*=0x99329*/;
        } else {
            if (*piVar1 < 1) {
                return 0;
            }
            iVar2 = *(volatile int *)((unsigned long)&g_log_use_alt_sink) /*=0x20007554*/;
            format_string = ((unsigned long)"%s(): disable ldsw1 1.8v for panel\n") /*=0x994d3*/;
        }
    }
    G1_LOG_ROUTE(iVar2 == 0, format_string, ((unsigned long)"power_down_panel") /*=0x99c17*/);
    return 0;
}

/* ================================================================ */
/* member unit: g1_display_08.c */
/* ================================================================ */
/*
 * Cohesive translation unit for the `display' module.
 *
 * GENERATED by recon/refactor/transforms/t04_cohesive_tu.py.  Do not
 * edit: a stage tree is regenerated, never hand-patched
 * (recon/refactor/README.md C4).
 *
 * The 6 functions below were 6 separate translation units until this
 * stage.  Each one's text is reproduced VERBATIM and in the order the
 * generated source list gave it, and they were CONSECUTIVE in that list.
 * They were proven able to share a translation unit: no symbol is
 * declared here with two types, no identifier has internal linkage in one
 * member and is named by another, and no local typedef, macro, struct tag
 * or enum constant of one member is visible to a member that names it.
 *
 * members, in link order:
 *   display_fade_out_mask_bands.c
 *   set_imu_pitch_reflash.c
 *   panel_off.c
 *   panel_on.c
 *   set_brightness_to_panel_reg.c
 *   jdb_panel_init.c
 */

/* File-scope forward declarations for every struct/union tag this
 * unit names.  Without them a tag whose only appearance in a member
 * is inside a parameter list has PARAMETER-LIST scope, so two
 * textually IDENTICAL declarations in two members declare two
 * different incomplete types and the second is a conflicting
 * redeclaration (C11 6.2.1p7).  Incomplete-type forward
 * declarations emit no code. */
struct display_state_438d0;
/* ---- display_fade_out_mask_bands.c ---- */
#include "g1_app_symbols.h"
/* readable reconstruction; identity: FUN_000438d0 @ 0x000438d0
 * public-name: display_fade_out_mask_bands
 * durable-map: recon/catalogs/function_names_app.json
 * callees (readable <= raw @ address):
 *   get_device_info                          <= FUN_000167a8 @ 0x000167a8
 *   gui_screen_clear                         <= FUN_000431c0 @ 0x000431c0
 *   display_fade_out_mask_bands              <= FUN_000438d0 @ 0x000438d0
 *   reflash_fb_data_to_lcd                   <= FUN_00047260 @ 0x00047260
 * address symbols (name @ address):
 *   rodata_aae20                             @ 0x000aae20
 *   g_gui_active_canvas                      @ 0x2000a034
 */
/* Full reconstruction of FUN_000438d0 @ 0x438d0 (156-byte extent).
 * CFG_VERIFY_PREFIX_FIRST
 * The fixed 509,440-pixel sweep exceeds the generic instruction budget;
 * compare its first externally visible pixel write under reviewed state. */
#include <stdint.h>
#include "g1_display.h"

struct display_state_438d0 {
    uint8_t reserved[0xeb4];
    void *destination;
    uint32_t destination_stride;
};

extern int get_device_info(void);
extern void reflash_fb_data_to_lcd(void *destination, uint32_t stride,
                         uint32_t x, uint32_t y, uint32_t width,
                         uint32_t height, uint32_t flags);

int display_fade_out_mask_bands(uint32_t unused_a, uint32_t unused_b, uint32_t flags)
{
    uint8_t **rows = *(uint8_t ***)(uintptr_t)((unsigned long)&g_gui_active_canvas) /*=0x2000a034*/;
    const uint8_t *masks = (const uint8_t *)(uintptr_t)((unsigned long)&rodata_aae20) /*=0xaae20*/;

    (void)unused_a;
    (void)unused_b;
    for (uint32_t band = 0; band != 8; ++band) {
        for (uint32_t row = 0; row != 199; ++row) {
            uint8_t *pixels = rows[row];
            const uint8_t *mask = masks + (row % 26u) * 0xa00u
                                  + 0x8c0u - band * 0x140u;
            for (uint32_t column = 0; column != 0x140; ++column) {
                if (pixels[column] != 0)
                    pixels[column] &= mask[column];
            }
        }

        struct display_state_438d0 *state = get_device_info();
        void *destination = state->destination;
        state = get_device_info();
        reflash_fb_data_to_lcd(destination, state->destination_stride, 0, 0,
                     0x280, 199, flags);
    }
    gui_screen_clear();
    return 0;
}

/* ---- set_imu_pitch_reflash.c ---- */
/* readable reconstruction; identity: FUN_000469bc @ 0x000469bc
 * public-name: set_imu_pitch_reflash
 * durable-map: recon/catalogs/function_names_app.json
 * callees (readable <= raw @ address):
 *   get_device_info                          <= FUN_000167a8 @ 0x000167a8
 *   debug_print                              <= FUN_00019c70 @ 0x00019c70
 *   get_ui_mode_flag_byte1                   <= FUN_00023ee0 @ 0x00023ee0
 *   gui_screen_clear                         <= FUN_000431c0 @ 0x000431c0
 *   gui_bmp_bitmap_draw                      <= FUN_00043484 @ 0x00043484
 *   gui_utf_draw                             <= FUN_00043e90 @ 0x00043e90
 *   set_imu_pitch_reflash                    <= FUN_000469bc @ 0x000469bc
 *   device_info_text_width_get               <= FUN_0007d3ee @ 0x0007d3ee
 *   device_info_text_height_get_clamped      <= FUN_0007d446 @ 0x0007d446
 *   get_localized_weekday_name               <= FUN_0007d4b2 @ 0x0007d4b2
 * address symbols (name @ address):
 *   rodata_d7173                             @ 0x000d7173   [INLINED -- G6 literal batch]
 *   rodata_d71f9                             @ 0x000d71f9   [INLINED -- G6 literal batch]
 *   g_log_level                              @ 0x2000230c
 *   g_log_use_alt_sink                       @ 0x20007554
 *   g_imu_pitch_last_state                   @ 0x2001cf91
 */
/* Full reconstruction of FUN_000469bc @ 0x469bc, exact extent 430 bytes.
 * Call arities are derived by target because optional logging and cache
 * refresh calls do not have stable ordinals. */
#include "../../../headers/g1_log.h"

extern int get_ui_mode_flag_byte1(void);
extern int device_info_text_width_get(void);
extern int device_info_text_height_get_clamped(void);
extern uintptr_t get_localized_weekday_name(unsigned id);
extern int gui_bmp_bitmap_draw(unsigned int, int, int, int, int, int);
extern unsigned gui_utf_draw(unsigned, uintptr_t, unsigned, int, int, int, int,
                            unsigned, unsigned, int, void *, int);

static __attribute__((always_inline)) inline void draw_pair(uintptr_t text, int x, unsigned second_id)
{
    int y0 = device_info_text_width_get();
    int x0 = device_info_text_height_get_clamped();
    int y1 = device_info_text_width_get();
    int x1 = device_info_text_height_get_clamped();
    gui_utf_draw(0, text, 0, x + y0, x0 + 0x3c, y1 + 0x240,
                 x1 + 0x57, 1, 0, 0, 0, 0);

    x = (get_ui_mode_flag_byte1() == 6)
        ? (second_id == 5 ? 0x78 : 0x22)
        : (second_id == 5 ? 0x9e : 0x6e);
    text = get_localized_weekday_name(second_id);
    y0 = device_info_text_width_get(); x0 = device_info_text_height_get_clamped();
    y1 = device_info_text_width_get(); x1 = device_info_text_height_get_clamped();
    gui_utf_draw(0, text, 0, x + y0, x0 + 0x71, y1 + 0x240,
                 x1 + 0x8c, 1, 0, 0, 0, 0);
}

unsigned set_imu_pitch_reflash(void)
{
    uintptr_t state = get_device_info();
    uint8_t mode = *(volatile uint8_t *)(state + 0xf0);
    volatile uint8_t *cached_mode = (volatile uint8_t *)((unsigned long)&g_imu_pitch_last_state) /*=0x2001cf91*/;

    if (mode >= 2) {
        if (*(volatile int *)((unsigned long)&g_log_level) /*=0x2000230c*/ > 0) {
            if (*(volatile int *)((unsigned long)&g_log_use_alt_sink) /*=0x20007554*/ == 0)
                log_message(((unsigned long)"%s(): set_imu_pitch:horiz_step over E_IMU_PITCH_STEP_MAX\n") /*=0xd7173*/, ((unsigned long)"set_imu_pitch_reflash") /*=0xd71f9*/);
            else
                debug_print(((unsigned long)"%s(): set_imu_pitch:horiz_step over E_IMU_PITCH_STEP_MAX\n") /*=0xd7173*/, ((unsigned long)"set_imu_pitch_reflash") /*=0xd71f9*/);
        }
        return UINT32_MAX;
    }
    if (*cached_mode != mode) {
        gui_screen_clear();
        *cached_mode = *(volatile uint8_t *)(state + 0xf0);
    }

    int y = device_info_text_width_get();
    int x = device_info_text_height_get_clamped();
    gui_bmp_bitmap_draw(0x7c, y + 0x52, x + 0x65, 0, 0, 0);

    if (*(volatile int8_t *)(state + 0xf0) == 1) {
        int first_x = (get_ui_mode_flag_byte1() == 6) ? 0xb6 : 0xba;
        draw_pair(get_localized_weekday_name(4), first_x, 5);
    } else {
        int first_x = (get_ui_mode_flag_byte1() == 6) ? 0xd0 : 0xc0;
        draw_pair(get_localized_weekday_name(2), first_x, 3);
    }
    return 0;
}

/* ---- panel_off.c ---- */
/* readable reconstruction; identity: FUN_00046d2c @ 0x00046d2c
 * public-name: panel_off
 * durable-map: recon/catalogs/function_names_app.json
 * callees (readable <= raw @ address):
 *   power_down_panel                         <= FUN_00015fdc @ 0x00015fdc
 *   get_ambient_light_sensor_ready_flag      <= FUN_0001655c @ 0x0001655c
 *   debug_print                              <= FUN_00019c70 @ 0x00019c70
 *   opt3007_chip_deinit                      <= FUN_0002e8b4 @ 0x0002e8b4
 * address symbols (name @ address):
 *   rodata_d721e                             @ 0x000d721e   [INLINED -- G6 literal batch]
 *   rodata_d72d1                             @ 0x000d72d1   [INLINED -- G6 literal batch]
 *   g_log_level                              @ 0x2000230c
 *   g_log_use_alt_sink                       @ 0x20007554
 */
/* Reconstructed panel_off @ 0x46d2c. */
#include "../../../headers/g1_dedupe.h"

typedef void (*panel_callback_t)(void *panel);
extern void opt3007_chip_deinit(void);
extern unsigned int power_down_panel(void);

uint32_t panel_off(uint8_t *context)
{
    void *panel = context - 0x5c;

    *(void **)(context + 0x374) = panel;
    if (*(uint32_t *)(context - 0x48) != 0) {
        *(uint32_t *)(context + 0x35c) = 0;
        if (*(volatile int *)((unsigned long)&g_log_level) /*=0x2000230c*/ > 2) {
            G1_LOG_ROUTE(*(volatile int *)((unsigned long)&g_log_use_alt_sink) /*=0x20007554*/ == 0, ((unsigned long)"%s(): panel_suspend enter!\n") /*=0xd721e*/, ((unsigned long)"panel_off") /*=0xd72d1*/);
        }
        if (get_ambient_light_sensor_ready_flag() == 0)
            opt3007_chip_deinit();
        ((panel_callback_t)*(uintptr_t *)(context - 0x58))(panel);
        power_down_panel();
    }
    return 0;
}

/* ---- panel_on.c ---- */
/* readable reconstruction; identity: FUN_00046dd8 @ 0x00046dd8
 * public-name: panel_on
 * durable-map: recon/catalogs/function_names_app.json
 * callees (readable <= raw @ address):
 *   power_for_panel                          <= FUN_00015df4 @ 0x00015df4
 *   get_ambient_light_sensor_ready_flag      <= FUN_0001655c @ 0x0001655c
 *   debug_print                              <= FUN_00019c70 @ 0x00019c70
 *   opt3007_chip_init                        <= FUN_0002e67c @ 0x0002e67c
 *   panel_init                               <= FUN_00047538 @ 0x00047538
 * address symbols (name @ address):
 *   rodata_d723a                             @ 0x000d723a   [INLINED -- G6 literal batch]
 *   rodata_d72bb                             @ 0x000d72bb   [INLINED -- G6 literal batch]
 *   g_log_level                              @ 0x2000230c
 *   g_log_use_alt_sink                       @ 0x20007554
 */
/* Reconstructed panel_on @ 0x46dd8  (parity: 300/300 trials, PROVEN) */
extern int power_for_panel(void);
extern int opt3007_chip_init(void);
int panel_on(int param_1){
  *(volatile int *)(param_1+0x374) = param_1 - 0x5c;
  if(*(volatile int *)(param_1-0x48)==0){
    if(*(volatile int *)((unsigned long)&g_log_level) /*=0x2000230c*/ > 2){
      G1_LOG_ROUTE(*(volatile int *)((unsigned long)&g_log_use_alt_sink) /*=0x20007554*/ == 0, ((unsigned long)"%s(): panel_on enter!\n") /*=0xd723a*/, ((unsigned long)"panel_on") /*=0xd72bb*/);
    }
    power_for_panel();
    void (*fp)(int) = *(void(* volatile*)(int))(param_1-0x5c);
    fp(*(volatile int *)(param_1+0x374));
    panel_init();
    *(volatile int *)(param_1+0x35c) = 1;
    int iVar1 = get_ambient_light_sensor_ready_flag();
    if(iVar1==0){
      opt3007_chip_init();
    }
  }
  return 0;
}

/* ---- set_brightness_to_panel_reg.c ---- */
/* readable reconstruction; identity: FUN_00046e3c @ 0x00046e3c
 * public-name: set_brightness_to_panel_reg
 * durable-map: recon/catalogs/function_names_app.json
 * callees (readable <= raw @ address):
 *   get_device_info                          <= FUN_000167a8 @ 0x000167a8
 *   debug_print                              <= FUN_00019c70 @ 0x00019c70
 *   thunk_FUN_0007d77c                       <= FUN_0007d63e @ 0x0007d63e
 *   projector_send_cmd1                      <= FUN_0007d642 @ 0x0007d642
 *   projector_send_cmd_0x46                  <= FUN_0007d67e @ 0x0007d67e
 *   net_pkt_write_be16                       <= FUN_0007d696 @ 0x0007d696
 *   delay_ms                                 <= FUN_0007d772 @ 0x0007d772
 * address symbols (name @ address):
 *   rodata_d7251                             @ 0x000d7251   [INLINED -- G6 literal batch]
 *   rodata_d7310                             @ 0x000d7310   [INLINED -- G6 literal batch]
 *   g_log_level                              @ 0x2000230c
 *   g_log_use_alt_sink                       @ 0x20007554
 */
/* Reconstructed set_brightness_to_panel_reg @ 0x46e3c  (parity: 300/300 trials, PROVEN) */
extern void projector_send_cmd1(int, int);
extern void projector_send_cmd_0x46(unsigned int);
extern void delay_ms(int);

void set_brightness_to_panel_reg(unsigned int param_1)
{
    unsigned int uVar1;
    short sVar2;
    int iVar3;
    unsigned int uVar4;
    int iVar5;

    if (2 < *(volatile int *)((unsigned long)&g_log_level) /*=0x2000230c*/) {
        G1_LOG_ROUTE(*(volatile int *)((unsigned long)&g_log_use_alt_sink) /*=0x20007554*/ == 0, ((unsigned long)"%s(): set brightness level = %d\n") /*=0xd7251*/, ((unsigned long)"set_brightness_to_panel_reg") /*=0xd7310*/, param_1);
    }
    thunk_FUN_0007d77c(6);
    thunk_FUN_0007d77c(0xa9);
    if (5 < param_1) {
        iVar3 = (int)(intptr_t)get_device_info();
        net_pkt_write_be16((int)((*(short*)(intptr_t)(iVar3 + 0xed8) + 1) * 0x6f));
        uVar4 = (param_1 - 6) & 0xff;
        goto LAB_00046ea0;
    }
    iVar3 = (int)(intptr_t)get_device_info();
    uVar1 = ((unsigned int)*(unsigned short*)(intptr_t)(iVar3 + 0xed8) << 1) / 9;
    iVar3 = (int)uVar1;
    if (iVar3 == 0) {
LAB_00046e7a:
        iVar3 = (int)(intptr_t)get_device_info();
        sVar2 = (short)(((short)((param_1 * 0x6f) / 6) + 1) * (*(short*)(intptr_t)(iVar3 + 0xed8) + 1));
    } else {
        iVar5 = (int)(intptr_t)get_device_info();
        if (*(unsigned short*)(intptr_t)(iVar5 + 0xed8) < 6) goto LAB_00046e7a;
        iVar5 = (int)(intptr_t)get_device_info();
        sVar2 = (short)(((short)((int)(param_1 * ((unsigned int)*(unsigned short*)(intptr_t)(iVar5 + 0xed8) - iVar3)) / 6) + (short)uVar1) * 0x6f);
    }
    net_pkt_write_be16(sVar2);
    uVar4 = 0;
LAB_00046ea0:
    projector_send_cmd_0x46(uVar4);
    projector_send_cmd1(0x31, 4);
    thunk_FUN_0007d77c(0xa3);
    thunk_FUN_0007d77c(0x97);
    delay_ms(1);
    return;
}

/* ---- jdb_panel_init.c ---- */
/* readable reconstruction; identity: FUN_00046fc0 @ 0x00046fc0
 * public-name: jdb_panel_init
 * durable-map: recon/catalogs/function_names_app.json
 * callees (readable <= raw @ address):
 *   debug_print                              <= FUN_00019c70 @ 0x00019c70
 *   set_brightness_to_panel_reg              <= FUN_00046e3c @ 0x00046e3c
 *   panel_init                               <= FUN_00047538 @ 0x00047538
 *   spi_read_id                              <= FUN_00047724 @ 0x00047724
 * address symbols (name @ address):
 *   rodata_d728d                             @ 0x000d728d   [INLINED -- G6 literal batch]
 *   rodata_d72ac                             @ 0x000d72ac   [INLINED -- G6 literal batch]
 *   g_log_level                              @ 0x2000230c
 *   g_log_use_alt_sink                       @ 0x20007554
 *   g_panel_spi_id                           @ 0x2000a074
 */
/* Reconstructed jdb_panel_init @ 0x46fc0  (parity: 300/300 trials, PROVEN) */

extern int spi_read_id(void);

unsigned int jdb_panel_init(unsigned char *param_1)
{
    *(unsigned int*)(param_1+0x374) = (unsigned int)(param_1 - 0x5c);
    panel_init();
    set_brightness_to_panel_reg(param_1[0x369]);
    int iVar1 = spi_read_id();
    *(volatile unsigned int *)((unsigned long)&g_panel_spi_id) /*=0x2000a074*/ = iVar1;
    unsigned int uVar2;
    if (iVar1 == 0x4010) {
        uVar2 = 0;
        *(unsigned int*)(param_1+0x35c) = 1;
    } else {
        if (*(volatile int *)((unsigned long)&g_log_level) /*=0x2000230c*/ > 2) {
            G1_LOG_ROUTE(*(volatile unsigned int *)((unsigned long)&g_log_use_alt_sink) /*=0x20007554*/ == 0, ((unsigned long)"%s(): JBD PANEL init failure!\n") /*=0xd728d*/,((unsigned long)"jdb_panel_init") /*=0xd72ac*/);
        }
        uVar2 = 0xffffffffUL;
    }
    return uVar2;
}

/* ================================================================ */
/* member unit: net_pkt_write_be16.c */
/* ================================================================ */
#include "g1_app_symbols.h"
/* readable reconstruction; identity: FUN_0007d696 @ 0x0007d696
 * public-name: net_pkt_write_be16
 * durable-map: recon/catalogs/function_names_app.json
 * callees (readable <= raw @ address):
 *   net_pkt_write_be16                       <= FUN_0007d696 @ 0x0007d696
 *   projector_send_command                   <= FUN_0007d82e @ 0x0007d82e
 */
/* Reconstructed FUN_0007d696 @ 0x7d696  (parity: 300/300 trials, PROVEN) */

extern void projector_send_command(unsigned int, const void *, unsigned int);

void net_pkt_write_be16(unsigned int value)
{
    unsigned short big_endian =
        (unsigned short)((value << 8) | ((value >> 8) & 0xffu));
    projector_send_command(0x36, &big_endian, sizeof(big_endian));
}

/* ================================================================ */
/* member unit: delay_ms.c */
/* ================================================================ */
#include "g1_app_symbols.h"
/* readable reconstruction; identity: FUN_0007d772 @ 0x0007d772
 * public-name: delay_ms
 * durable-map: recon/catalogs/function_names_app.json
 * callees (readable <= raw @ address):
 *   delay_ms                                 <= FUN_0007d772 @ 0x0007d772
 *   delay_scaled_busy_wait                   <= FUN_00086384 @ 0x00086384
 */
/* Reconstructed FUN_0007d772 @ 0x7d772  (parity: 300/300 trials, PROVEN) */

extern void delay_scaled_busy_wait(int a0);
void delay_ms(int param_1)
{
  delay_scaled_busy_wait(param_1 * 1000);
}

/* ================================================================ */
/* member unit: g1_display_15.c */
/* ================================================================ */
/*
 * Cohesive translation unit for the `display' module.
 *
 * GENERATED by recon/refactor/transforms/t04_cohesive_tu.py.  Do not
 * edit: a stage tree is regenerated, never hand-patched
 * (recon/refactor/README.md C4).
 *
 * The 6 functions below were 6 separate translation units until this
 * stage.  Each one's text is reproduced VERBATIM and in the order the
 * generated source list gave it, and they were CONSECUTIVE in that list.
 * They were proven able to share a translation unit: no symbol is
 * declared here with two types, no identifier has internal linkage in one
 * member and is named by another, and no local typedef, macro, struct tag
 * or enum constant of one member is visible to a member that names it.
 *
 * members, in link order:
 *   projector_send_cmd_immediate.c
 *   projector_spi_write_chunked.c
 *   projector_send_command.c
 *   projector_reflash_and_release.c
 *   dev_write_reg4.c
 *   uptime_ticks_get.c
 */
/* ---- projector_send_cmd_immediate.c ---- */
#include "g1_app_symbols.h"
#include "g1_display.h"
#include <stdint.h>
/* readable reconstruction; identity: FUN_0007d77c @ 0x0007d77c
 * public-name: projector_send_cmd_immediate
 * durable-map: recon/catalogs/function_names_app.json
 * callees (readable <= raw @ address):
 *   projector_bus_lock                       <= FUN_00047698 @ 0x00047698
 *   projector_bus_unlock                     <= FUN_000476a8 @ 0x000476a8
 *   get_projector_controller                 <= FUN_0007d4ec @ 0x0007d4ec
 *   projector_send_cmd_immediate             <= FUN_0007d77c @ 0x0007d77c
 */
/* Reconstructed FUN_0007d77c @ 0x7d77c  (parity: 300/300 trials, PROVEN) */

extern int get_projector_controller(void);

void projector_send_cmd_immediate(unsigned char param_1)
{
    int iVar1;
    unsigned char local_11[5];
    unsigned char local_c[4];

    local_c[0] = 0;
    local_11[0] = param_1;
    iVar1 = get_projector_controller();
    projector_bus_lock(0xffffffff, 0xffffffff);
    (*(void (**)(int, void *, int, void *, int))(*(volatile int *)(iVar1 + 0x374) + 8))(
        *(volatile int *)(iVar1 + 0x374), local_11, 1, local_c, 1);
    projector_bus_unlock();
}

/* ---- projector_spi_write_chunked.c ---- */
/* readable reconstruction; identity: FUN_0007d7b6 @ 0x0007d7b6
 * public-name: projector_spi_write_chunked
 * durable-map: recon/catalogs/function_names_app.json
 * callees (readable <= raw @ address):
 *   projector_bus_lock                       <= FUN_00047698 @ 0x00047698
 *   projector_bus_unlock                     <= FUN_000476a8 @ 0x000476a8
 *   get_projector_controller                 <= FUN_0007d4ec @ 0x0007d4ec
 *   projector_spi_write_chunked              <= FUN_0007d7b6 @ 0x0007d7b6
 * address symbols (name @ address):
 *   rodata_f000                              @ 0x0000f000
 */
/* Reconstructed FUN_0007d7b6 @ 0x7d7b6  (parity: 60/60 trials, PROVEN) */
static void projector_spi_write_chunked(int param_1,unsigned int param_2){
  int iVar1=get_projector_controller();
  unsigned char local_24[8]; int iVar2;
  local_24[0]=0;
  iVar2=param_1+(int)((param_2/((unsigned long)&rodata_f000) /*=0xf000*/)*((unsigned long)&rodata_f000) /*=0xf000*/);
  for(; param_1!=iVar2; param_1=param_1+((unsigned long)&rodata_f000) /*=0xf000*/){
    projector_bus_lock(0xffffffff,0xffffffff);
    (*(void(**)(int,int,unsigned int,void*,int))(*(int*)(iVar1+0x374)+8))(*(int*)(iVar1+0x374),param_1,((unsigned long)&rodata_f000) /*=0xf000*/,local_24,1);
    projector_bus_unlock();
  }
  projector_bus_lock(0xffffffff,0xffffffff);
  (*(void(**)(int,int,unsigned int,void*,int))(*(int*)(iVar1+0x374)+8))(*(int*)(iVar1+0x374),param_1,param_2%((unsigned long)&rodata_f000) /*=0xf000*/,local_24,1);
  projector_bus_unlock();
}

/* ---- projector_send_command.c ---- */
/* readable reconstruction; identity: FUN_0007d82e @ 0x0007d82e
 * public-name: projector_send_command
 * durable-map: recon/catalogs/function_names_app.json
 * callees (readable <= raw @ address):
 *   projector_spi_write_chunked              <= FUN_0007d7b6 @ 0x0007d7b6
 *   projector_send_command                   <= FUN_0007d82e @ 0x0007d82e
 *   safe_memcpy_checked                      <= FUN_00086c1e @ 0x00086c1e
 */
/* Reconstructed FUN_0007d82e @ 0x7d82e  (parity: 300/300 trials, PROVEN) */

extern void safe_memcpy_checked(void *, const void *, unsigned int, unsigned int);
static void projector_spi_write_chunked(int, unsigned int);

void projector_send_command(unsigned int opcode, const void *payload,
                  unsigned int payload_length)
{
  unsigned char command[8];

  command[0] = (unsigned char)opcode;
  safe_memcpy_checked(command + 1, payload, payload_length, 5);
  projector_spi_write_chunked(command, payload_length + 1);
}

/* ---- projector_reflash_and_release.c ---- */
/* readable reconstruction; identity: FUN_0007d874 @ 0x0007d874
 * public-name: projector_reflash_and_release
 * durable-map: recon/catalogs/function_names_app.json
 * callees (readable <= raw @ address):
 *   display_reflash                          <= FUN_0004967c @ 0x0004967c
 *   mutex_unlock_syscall_handler             <= FUN_000745c8 @ 0x000745c8
 *   projector_reflash_and_release            <= FUN_0007d874 @ 0x0007d874
 */
/* Reconstructed FUN_0007d874 @ 0x7d874  (parity: 300/300 trials, PROVEN) */

extern void display_reflash(void*,unsigned int,unsigned int,unsigned int,unsigned int);
unsigned int projector_reflash_and_release(unsigned int param_1,unsigned int param_2,unsigned int param_3)
{
  unsigned char buf[2];
  buf[0] = 1;
  buf[1] = (unsigned char)param_1;
  display_reflash(buf,2,param_3,1,param_1);
  mutex_unlock_syscall_handler();
  return 0;
}

/* ---- dev_write_reg4.c ---- */
/* readable reconstruction; identity: FUN_00083de6 @ 0x00083de6
 * public-name: dev_write_reg4
 * durable-map: recon/catalogs/function_names_app.json
 * callees (readable <= raw @ address):
 *   dev_ctrl_write1                          <= FUN_00083d60 @ 0x00083d60
 *   dev_write_reg4                           <= FUN_00083de6 @ 0x00083de6
 */
/* Reconstructed FUN_00083de6 @ 0x83de6  (parity: 300/300 trials, PROVEN) */

extern void dev_ctrl_write1(int a, void *b, unsigned int c, unsigned int d, void *e);

void dev_write_reg4(int *param_1, unsigned char param_2, unsigned int param_3, unsigned char param_4, unsigned char param_5)
{
    unsigned char local_c[4];
    local_c[0] = param_2;
    local_c[1] = (unsigned char)param_3;
    local_c[2] = param_4;
    local_c[3] = param_5;
    dev_ctrl_write1(*(volatile int *)((char*)param_1 + 4), local_c, 4, param_5, param_1);
}

/* ---- uptime_ticks_get.c ---- */
/* readable reconstruction; identity: FUN_00086698 @ 0x00086698
 * public-name: uptime_ticks_get
 * durable-map: recon/catalogs/function_names_app.json
 * callees (readable <= raw @ address):
 *   k_uptime_ticks_impl                      <= FUN_00074f68 @ 0x00074f68
 */
/* Tail thunk @ 0x86698. */
extern int k_uptime_ticks_impl(int,int,int,int); int thunk_FUN_00074f68(int a,int b,int c,int d){return k_uptime_ticks_impl(a,b,c,d);}

