/*
 * Cohesive translation unit for the `display' module.
 *
 * GENERATED by recon/refactor/transforms/t04_cohesive_tu.py.  Do not
 * edit: a stage tree is regenerated, never hand-patched
 * (recon/refactor/README.md C4).
 *
 * The 4 functions below were 4 separate translation units until this
 * stage.  Each one's text is reproduced VERBATIM and in the order the
 * generated source list gave it, and they were CONSECUTIVE in that list.
 * They were proven able to share a translation unit: no symbol is
 * declared here with two types, no identifier has internal linkage in one
 * member and is named by another, and no local typedef, macro, struct tag
 * or enum constant of one member is visible to a member that names it.
 *
 * members, in link order:
 *   display_DelayClose.c
 *   display_inputEvent.c
 *   display_MasterSendClose.c
 *   display_powerEvent.c
 */

/* File-scope forward declarations for every struct/union tag this
 * unit names.  Without them a tag whose only appearance in a member
 * is inside a parameter list has PARAMETER-LIST scope, so two
 * textually IDENTICAL declarations in two members declare two
 * different incomplete types and the second is a conflicting
 * redeclaration (C11 6.2.1p7).  Incomplete-type forward
 * declarations emit no code. */
struct k_msgq;
/* ---- display_DelayClose.c ---- */
#include "g1_app_symbols.h"
#include <zephyr/sys_clock.h>
#include "../../../headers/g1_log.h"
#include "../../../headers/g1_dedupe.h"
/* readable reconstruction; identity: FUN_000498c0 @ 0x000498c0
 * public-name: display_DelayClose
 * durable-map: recon/catalogs/function_names_app.json
 * callees (readable <= raw @ address):
 *   debug_print                              <= FUN_00019c70 @ 0x00019c70
 *   k_msgq_put                               <= FUN_000720d0 @ 0x000720d0
 *   memset_bytes                             <= FUN_00086c78 @ 0x00086c78
 * address symbols (name @ address):
 *   rodata_ef058                             @ 0x000ef058   [INLINED -- G6 literal batch]
 *   rodata_f008c                             @ 0x000f008c   [INLINED -- G6 literal batch]
 *   rodata_f0164                             @ 0x000f0164   [INLINED -- G6 literal batch]
 *   g_log_level                              @ 0x2000230c
 *   g_display_msgq                           @ 0x200038c4
 *   g_log_use_alt_sink                       @ 0x20007554
 */
/* Reconstructed display_DelayClose @ 0x498c0  (parity: 300/300 trials, PROVEN) */

extern void memset_bytes(void*, int, int);
extern int k_msgq_put(struct k_msgq *, const void *, k_timeout_t);

unsigned int display_DelayClose(unsigned int param_1)
{
    unsigned char buf[0x18];
    memset_bytes(buf + 1, 0, 0x17);
    buf[0] = 4;
    *(unsigned short *)(buf + 2) = 4;
    *(unsigned int *)(buf + 4) = param_1;

    void *obj = (void *)((unsigned long)&g_display_msgq) /*=0x200038c4*/;
    int iVar1 = k_msgq_put(obj, buf, (k_timeout_t){ .ticks = 0LL });
    unsigned int uVar2;

    if (iVar1 == 0) {
        uVar2 = 0;
        if (*(volatile int *)((unsigned long)&g_log_level) /*=0x2000230c*/ > 2) {
            G1_LOG_ROUTE(*(volatile int *)((unsigned long)&g_log_use_alt_sink) /*=0x20007554*/ == 0, ((unsigned long)"%s(): send display delay close command.......\n") /*=0xf008c*/, ((unsigned long)"display_DelayClose") /*=0xf0164*/);
        }
    } else {
        log_message(((unsigned long)"message queue send failed %s\r\n") /*=0xef058*/, ((unsigned long)"display_DelayClose") /*=0xf0164*/);
        uVar2 = 0xffffffffU;
    }
    return uVar2;
}

/* ---- display_inputEvent.c ---- */
/* readable reconstruction; identity: FUN_00049938 @ 0x00049938
 * public-name: display_inputEvent
 * durable-map: recon/catalogs/function_names_app.json
 * callees (readable <= raw @ address):
 *   debug_print                              <= FUN_00019c70 @ 0x00019c70
 *   k_msgq_put                               <= FUN_000720d0 @ 0x000720d0
 *   memset_bytes                             <= FUN_00086c78 @ 0x00086c78
 * address symbols (name @ address):
 *   rodata_ef058                             @ 0x000ef058   [INLINED -- G6 literal batch]
 *   rodata_f00bb                             @ 0x000f00bb   [INLINED -- G6 literal batch]
 *   rodata_f0151                             @ 0x000f0151   [INLINED -- G6 literal batch]
 *   g_log_level                              @ 0x2000230c
 *   g_display_msgq                           @ 0x200038c4
 *   g_log_use_alt_sink                       @ 0x20007554
 */
/* Reconstructed display_inputEvent @ 0x49938 */

#include <stdint.h>


uint32_t display_inputEvent(uint8_t input, uint8_t state)
{
    uint8_t command[24];

    memset_bytes(command + 1, 0, 23);
    command[0] = 5;
    *(uint16_t *)(command + 2) = 2;
    command[4] = input;
    command[5] = state;

    if (k_msgq_put(((unsigned long)&g_display_msgq) /*=0x200038c4*/, command, (k_timeout_t){ .ticks = 0LL }) != 0) {
        log_message(((unsigned long)"message queue send failed %s\r\n") /*=0xef058*/, ((unsigned long)"display_inputEvent") /*=0xf0151*/);
        return UINT32_MAX;
    }

    if (*(volatile int32_t *)((unsigned long)&g_log_level) /*=0x2000230c*/ > 2) {
        G1_LOG_ROUTE(*(volatile uint32_t *)((unsigned long)&g_log_use_alt_sink) /*=0x20007554*/ == 0, ((unsigned long)"%s(): send display input event command.......\n") /*=0xf00bb*/, ((unsigned long)"display_inputEvent") /*=0xf0151*/);
    }
    return 0;
}

/* ---- display_MasterSendClose.c ---- */
/* readable reconstruction; identity: FUN_000499b8 @ 0x000499b8
 * public-name: display_MasterSendClose
 * durable-map: recon/catalogs/function_names_app.json
 * callees (readable <= raw @ address):
 *   debug_print                              <= FUN_00019c70 @ 0x00019c70
 *   k_msgq_put                               <= FUN_000720d0 @ 0x000720d0
 *   memset_bytes                             <= FUN_00086c78 @ 0x00086c78
 * address symbols (name @ address):
 *   rodata_ef058                             @ 0x000ef058   [INLINED -- G6 literal batch]
 *   rodata_f008c                             @ 0x000f008c   [INLINED -- G6 literal batch]
 *   rodata_f0139                             @ 0x000f0139   [INLINED -- G6 literal batch]
 *   g_log_level                              @ 0x2000230c
 *   g_display_msgq                           @ 0x200038c4
 *   g_log_use_alt_sink                       @ 0x20007554
 */
/* Reconstructed display_MasterSendClose @ 0x499b8  (parity: 300/300 trials, PROVEN) */


unsigned int display_MasterSendClose(void)
{
    unsigned char record[24];

    memset_bytes(record + 1, 0, 23);
    record[0] = 6;
    int iVar1 = k_msgq_put(((unsigned long)&g_display_msgq) /*=0x200038c4*/, record, (k_timeout_t){ .ticks = 0LL });
    unsigned int uVar2;
    if (iVar1 == 0) {
        uVar2 = 0;
        if (*(volatile int *)((unsigned long)&g_log_level) /*=0x2000230c*/ > 2) {
            G1_LOG_ROUTE(*(volatile unsigned int *)((unsigned long)&g_log_use_alt_sink) /*=0x20007554*/ == 0, ((unsigned long)"%s(): send display delay close command.......\n") /*=0xf008c*/, ((unsigned long)"display_MasterSendClose") /*=0xf0139*/);
        }
    } else {
        log_message(((unsigned long)"message queue send failed %s\r\n") /*=0xef058*/, ((unsigned long)"display_MasterSendClose") /*=0xf0139*/);
        uVar2 = 0xffffffffUL;
    }
    return uVar2;
}

/* ---- display_powerEvent.c ---- */
/* readable reconstruction; identity: FUN_00049a28 @ 0x00049a28
 * public-name: display_powerEvent
 * durable-map: recon/catalogs/function_names_app.json
 * callees (readable <= raw @ address):
 *   debug_print                              <= FUN_00019c70 @ 0x00019c70
 *   k_msgq_put                               <= FUN_000720d0 @ 0x000720d0
 *   memset_bytes                             <= FUN_00086c78 @ 0x00086c78
 * address symbols (name @ address):
 *   rodata_ef058                             @ 0x000ef058   [INLINED -- G6 literal batch]
 *   rodata_f00ea                             @ 0x000f00ea   [INLINED -- G6 literal batch]
 *   rodata_f0126                             @ 0x000f0126   [INLINED -- G6 literal batch]
 *   g_log_level                              @ 0x2000230c
 *   g_display_msgq                           @ 0x200038c4
 *   g_log_use_alt_sink                       @ 0x20007554
 */
/* Reconstructed display_powerEvent @ 0x49a28. */



int display_powerEvent(int powered_on)
{
    uint8_t packet[24];
    int result;

    memset_bytes(packet, 0, sizeof(packet));
    packet[0] = powered_on == 1 ? 7 : 8;

    result = k_msgq_put((void *)((unsigned long)&g_display_msgq) /*=0x200038c4*/, packet, (k_timeout_t){ .ticks = 0LL });
    if (result != 0) {
        log_message(((unsigned long)"message queue send failed %s\r\n") /*=0xef058*/, ((unsigned long)"display_powerEvent") /*=0xf0126*/);
        return -1;
    }

    if (*(volatile int *)((unsigned long)&g_log_level) /*=0x2000230c*/ > 2) {
        G1_LOG_ROUTE(*(volatile int *)((unsigned long)&g_log_use_alt_sink) /*=0x20007554*/ == 0, ((unsigned long)"%s(): send display power event command , low_power_en = %d\n") /*=0xf00ea*/, ((unsigned long)"display_powerEvent") /*=0xf0126*/, powered_on);
    }
    return 0;
}

