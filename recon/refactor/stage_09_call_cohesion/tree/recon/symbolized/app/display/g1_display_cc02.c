/*
 * Call-cohesive translation unit for the `display' module.
 *
 * GENERATED by recon/refactor/transforms/t09_call_cohesion.py.  Do
 * not edit: a stage tree is regenerated, never hand-patched
 * (recon/refactor/README.md C4).
 *
 * The 5 translation units below were grouped because they CALL ONE
 * ANOTHER, not because they were adjacent in the generated source
 * list.  Each member's text is reproduced VERBATIM.  Every member was
 * checked pairwise against every other member already in this unit by
 * stage 04's seven refusal rules, unchanged: no symbol is declared
 * here with two types, no identifier has internal linkage in one
 * member and is named by another, and no local typedef, macro, struct
 * tag or enum constant of one member is visible to a member that
 * names it.
 *
 * members, in generated-source-list order:
 *   g1_display_03.c
 *   g1_display_04.c
 *   g1_display_14.c
 *   projector_fill_framebuffer.c
 *   projector_fill_and_sync.c
 *
 * call edges inside this unit (caller -> callee): 6
 *   g1_display_03.c -> g1_display_14.c
 *   g1_display_04.c -> g1_display_03.c
 *   g1_display_04.c -> g1_display_14.c
 *   g1_display_14.c -> g1_display_03.c
 *   projector_fill_and_sync.c -> projector_fill_framebuffer.c
 *   projector_fill_framebuffer.c -> g1_display_14.c
 */

/* File-scope forward declarations for every struct/union tag this
 * unit names.  Without them a tag whose only appearance in a member
 * is inside a parameter list has PARAMETER-LIST scope, so two
 * textually IDENTICAL declarations in two members declare two
 * different incomplete types and the second is a conflicting
 * redeclaration (C11 6.2.1p7).  Incomplete-type forward
 * declarations emit no code. */
struct k_mutex;
/* ================================================================ */
/* member unit: g1_display_03.c */
/* ================================================================ */
/*
 * Cohesive translation unit for the `display' module.
 *
 * GENERATED by recon/refactor/transforms/t04_cohesive_tu.py.  Do not
 * edit: a stage tree is regenerated, never hand-patched
 * (recon/refactor/README.md C4).
 *
 * The 2 functions below were 2 separate translation units until this
 * stage.  Each one's text is reproduced VERBATIM and in the order the
 * generated source list gave it, and they were CONSECUTIVE in that list.
 * They were proven able to share a translation unit: no symbol is
 * declared here with two types, no identifier has internal linkage in one
 * member and is named by another, and no local typedef, macro, struct tag
 * or enum constant of one member is visible to a member that names it.
 *
 * members, in link order:
 *   get_box_field_state.c
 *   refresh_box_field_timer.c
 */
/* ---- get_box_field_state.c ---- */
#include "g1_app_symbols.h"
#include "g1_display.h"
/* readable reconstruction; identity: FUN_00025364 @ 0x00025364
 * public-name: get_box_field_state
 * durable-map: recon/catalogs/function_names_app.json
 * callees (readable <= raw @ address):
 *   get_device_info                          <= FUN_000167a8 @ 0x000167a8
 *   get_box_field_state                      <= FUN_00025364 @ 0x00025364
 * address symbols (name @ address):
 *   g_box_field_timer                        @ 0x20007a24
 */
/* Reconstructed FUN_00025364 @ 0x25364  (parity: 300/300 trials, PROVEN) */

extern int get_device_info(void);
unsigned int get_box_field_state(void)
{
  unsigned int uVar2;
  if (*(volatile unsigned int *)((unsigned long)&g_box_field_timer) /*=0x20007a24*/ <= 0x13ec) {
    uVar2 = 2;
  } else {
    int iVar1 = get_device_info();
    if (*(volatile unsigned char *)(iVar1 + 0xfc0) < 100) {
      uVar2 = 0;
    } else {
      uVar2 = 1;
    }
  }
  return uVar2;
}

/* ---- refresh_box_field_timer.c ---- */
/* readable reconstruction; identity: FUN_0002542c @ 0x0002542c
 * public-name: refresh_box_field_timer
 * durable-map: recon/catalogs/function_names_app.json
 * callees (readable <= raw @ address):
 *   refresh_box_field_timer                  <= FUN_0002542c @ 0x0002542c
 *   read_nfc_adc_scaled                      <= FUN_0007c830 @ 0x0007c830
 * address symbols (name @ address):
 *   g_box_field_timer                        @ 0x20007a24
 *   g_box_field_raw_timestamp                @ 0x20007a34
 */
/* Reconstructed FUN_0002542c @ 0x2542c  (parity: 300/300 trials, PROVEN) */

void refresh_box_field_timer(void)
{
  unsigned int *puVar1 = (unsigned int *)((unsigned long)&g_box_field_raw_timestamp) /*=0x20007a34*/;
  read_nfc_adc_scaled(((unsigned long)&g_box_field_raw_timestamp) /*=0x20007a34*/);
  *(volatile unsigned int *)((unsigned long)&g_box_field_timer) /*=0x20007a24*/ = *(volatile unsigned int *)puVar1;
}

/* ================================================================ */
/* member unit: g1_display_04.c */
/* ================================================================ */
/*
 * Cohesive translation unit for the `display' module.
 *
 * GENERATED by recon/refactor/transforms/t04_cohesive_tu.py.  Do not
 * edit: a stage tree is regenerated, never hand-patched
 * (recon/refactor/README.md C4).
 *
 * The 5 functions below were 5 separate translation units until this
 * stage.  Each one's text is reproduced VERBATIM and in the order the
 * generated source list gave it, and they were CONSECUTIVE in that list.
 * They were proven able to share a translation unit: no symbol is
 * declared here with two types, no identifier has internal linkage in one
 * member and is named by another, and no local typedef, macro, struct tag
 * or enum constant of one member is visible to a member that names it.
 *
 * members, in link order:
 *   is_box_field_timer_expired.c
 *   update_box_field_debounce.c
 *   process_box_event.c
 *   panel_level_calc_cached.c
 *   ui_state_mutex_unlock.c
 */

/* File-scope forward declarations for every struct/union tag this
 * unit names.  Without them a tag whose only appearance in a member
 * is inside a parameter list has PARAMETER-LIST scope, so two
 * textually IDENTICAL declarations in two members declare two
 * different incomplete types and the second is a conflicting
 * redeclaration (C11 6.2.1p7).  Incomplete-type forward
 * declarations emit no code. */
struct k_mutex;
/* ---- is_box_field_timer_expired.c ---- */
#include "g1_app_symbols.h"
/* readable reconstruction; identity: FUN_00025458 @ 0x00025458
 * public-name: is_box_field_timer_expired
 * durable-map: recon/catalogs/function_names_app.json
 * callees (readable <= raw @ address):
 *   refresh_box_field_timer                  <= FUN_0002542c @ 0x0002542c
 *   is_box_field_timer_expired               <= FUN_00025458 @ 0x00025458
 * address symbols (name @ address):
 *   g_box_field_timer                        @ 0x20007a24
 */
/* Reconstructed FUN_00025458 @ 0x25458  (parity: 300/300 trials, PROVEN) */

extern void refresh_box_field_timer(void);

static unsigned int is_box_field_timer_expired(void)
{
    refresh_box_field_timer();
    return (*(volatile unsigned int *)((unsigned long)&g_box_field_timer) /*=0x20007a24*/) > 0x13ec;
}

/* ---- update_box_field_debounce.c ---- */
/* readable reconstruction; identity: FUN_00025474 @ 0x00025474
 * public-name: update_box_field_debounce
 * durable-map: recon/catalogs/function_names_app.json
 * callees (readable <= raw @ address):
 *   is_box_field_timer_expired               <= FUN_00025458 @ 0x00025458
 *   update_box_field_debounce                <= FUN_00025474 @ 0x00025474
 * address symbols (name @ address):
 *   g_box_last_seen_uptime                   @ 0x20007a10
 */
/* Reconstructed FUN_00025474 @ 0x25474  (parity: 300/300 trials, PROVEN) */

static unsigned int is_box_field_timer_expired(void);
extern int thunk_FUN_00074f68(void);

unsigned int update_box_field_debounce(void)
{
  volatile int *piVar1 = (volatile int *)((unsigned long)&g_box_last_seen_uptime) /*=0x20007a10*/;
  int iVar2 = is_box_field_timer_expired();
  unsigned int uVar3;
  if (iVar2 == 0) {
    iVar2 = thunk_FUN_00074f68();
    if (iVar2 - *piVar1 < 0) {
      thunk_FUN_00074f68();
    }
    uVar3 = 0;
  } else {
    iVar2 = thunk_FUN_00074f68();
    *piVar1 = iVar2;
    uVar3 = 1;
  }
  return uVar3;
}

/* ---- process_box_event.c ---- */
/* readable reconstruction; identity: FUN_000254d8 @ 0x000254d8
 * public-name: process_box_event
 * durable-map: recon/catalogs/function_names_app.json
 * callees (readable <= raw @ address):
 *   get_device_info                          <= FUN_000167a8 @ 0x000167a8
 *   transport_state_update                   <= FUN_0002538c @ 0x0002538c
 *   process_box_event                        <= FUN_000254d8 @ 0x000254d8
 *   read_nfc_adc_scaled                      <= FUN_0007c830 @ 0x0007c830
 * address symbols (name @ address):
 *   g_box_field_timer                        @ 0x20007a24
 */
/* Reconstructed FUN_000254d8 @ 0x254d8  (parity: 300/300 trials, PROVEN) */
#include <stdint.h>
#include "g1_display.h"
extern int get_device_info(void);
extern void transport_state_update(int,char*);
void process_box_event(int param_1, char* param_2){
    read_nfc_adc_scaled(param_1+8);
    *(volatile uint32_t *)((unsigned long)&g_box_field_timer) /*=0x20007a24*/ = *(volatile uint32_t *)(param_1+8);
    int iVar4;
    iVar4=get_device_info(); *(volatile uint8_t *)(param_2+0x15)=(uint8_t)((*(volatile uint8_t *)(iVar4+0xfc4)+0xc8)>>8);
    iVar4=get_device_info(); *(volatile uint8_t *)(param_2+0x13)=*(volatile uint8_t *)(iVar4+0xfc0);
    iVar4=get_device_info(); *(volatile uint8_t *)(param_2+0x34)=*(volatile uint8_t *)(iVar4+0xfc0);
    get_device_info();
    *(volatile uint8_t *)(param_2+2)=0;
    transport_state_update(param_1,param_2);
}

/* ---- panel_level_calc_cached.c ---- */
/* readable reconstruction; identity: FUN_00025ecc @ 0x00025ecc
 * public-name: panel_level_calc_cached
 * durable-map: recon/catalogs/function_names_app.json
 * callees (readable <= raw @ address):
 *   get_device_type                          <= FUN_00016568 @ 0x00016568
 *   panel_level_calc_cached                  <= FUN_00025ecc @ 0x00025ecc
 * address symbols (name @ address):
 *   g_level_calc_result_cache                @ 0x200023f4
 *   g_panel_calib_last_divisor               @ 0x200023f8
 *   g_level_calc_input_c_cache               @ 0x20003024
 *   g_panel_calib_last_param84               @ 0x20007a98
 *   g_level_calc_input_sl_cache              @ 0x20007a9c
 *   g_level_calc_input_b_cache               @ 0x20018c6b
 */
/* Reconstructed FUN_00025ecc @ 0x25ecc  (parity: 300/300 trials, PROVEN) */
extern int get_device_type(void);
int panel_level_calc_cached(char *param_1){
  int iVar10 = *(int*)(param_1+0x84);
  int iVar8  = *(int*)(param_1+0x88);
  unsigned char bVar1 = (unsigned char)param_1[0x10];
  char cVar2 = param_1[0x11];
  int sl = *(int*)(param_1+0x80);
  if (sl != *(volatile int *)((unsigned long)&g_level_calc_input_sl_cache) /*=0x20007a9c*/
      || (unsigned)*(volatile unsigned char *)((unsigned long)&g_level_calc_input_b_cache) /*=0x20018c6b*/ != (unsigned)bVar1
      || *(volatile char *)((unsigned long)&g_level_calc_input_c_cache) /*=0x20003024*/ != cVar2
      || *(volatile int *)((unsigned long)&g_panel_calib_last_divisor) /*=0x200023f8*/ != iVar8
      || *(volatile int *)((unsigned long)&g_panel_calib_last_param84) /*=0x20007a98*/ != iVar10){
    *(volatile int *)((unsigned long)&g_level_calc_input_sl_cache) /*=0x20007a9c*/ = sl;
    *(volatile unsigned char *)((unsigned long)&g_level_calc_input_b_cache) /*=0x20018c6b*/ = bVar1;
    *(volatile char *)((unsigned long)&g_level_calc_input_c_cache) /*=0x20003024*/ = cVar2;
    *(volatile int *)((unsigned long)&g_panel_calib_last_divisor) /*=0x200023f8*/ = iVar8;
    *(volatile int *)((unsigned long)&g_panel_calib_last_param84) /*=0x20007a98*/ = iVar10;
    int r6;
    if (cVar2 == 0) r6 = (int)0xfffffea2;
    else if (cVar2 == 2) r6 = 0x2bc;
    else r6 = 0;
    int iVar9 = (*param_1 == 2) ? 0x76c : 0xfa0;
    *(volatile int *)((unsigned long)&g_level_calc_result_cache) /*=0x200023f4*/ = (int)(iVar9 * (unsigned)bVar1) / iVar8;
    get_device_type();
    int iv8b = *(int*)(param_1+0x84);
    int acc = 0x32 * (int)(short)(unsigned short)bVar1 + r6;
    if (iv8b == 0 && *(int*)(param_1+0x80) == 0){
      *(int*)(param_1+8) = acc - 0x189c;
      *(int*)(param_1+0xc) = acc - 0x2454;
    } else {
      *(int*)(param_1+8) = iv8b - acc;
      *(int*)(param_1+0xc) = (iv8b - 0x1194) - acc;
    }
  }
  return *(volatile int *)((unsigned long)&g_level_calc_result_cache) /*=0x200023f4*/;
}

/* ---- ui_state_mutex_unlock.c ---- */
struct k_mutex;
/* readable reconstruction; identity: FUN_00026850 @ 0x00026850
 * public-name: ui_state_mutex_unlock
 * durable-map: recon/catalogs/function_names_app.json
 * callees (readable <= raw @ address):
 *   ui_state_mutex_unlock                    <= FUN_00026850 @ 0x00026850
 *   k_mutex_unlock                           <= FUN_00072558 @ 0x00072558
 * address symbols (name @ address):
 *   g_ui_state_mutex                         @ 0x20007b3c
 */
/* Reconstructed FUN_00026850 @ 0x26850  (parity: 300/300 trials, PROVEN) */

extern int k_mutex_unlock(struct k_mutex *);
void ui_state_mutex_unlock(void) {
    k_mutex_unlock(((unsigned long)&g_ui_state_mutex) /*=0x20007b3c*/);
}

/* ================================================================ */
/* member unit: g1_display_14.c */
/* ================================================================ */
/*
 * Cohesive translation unit for the `display' module.
 *
 * GENERATED by recon/refactor/transforms/t04_cohesive_tu.py.  Do not
 * edit: a stage tree is regenerated, never hand-patched
 * (recon/refactor/README.md C4).
 *
 * The 6 functions below were 6 separate translation units until this
 * stage.  Each one's text is reproduced VERBATIM and in the order the
 * generated source list gave it, and they were CONSECUTIVE in that list.
 * They were proven able to share a translation unit: no symbol is
 * declared here with two types, no identifier has internal linkage in one
 * member and is named by another, and no local typedef, macro, struct tag
 * or enum constant of one member is visible to a member that names it.
 *
 * members, in link order:
 *   read_nfc_adc_scaled.c
 *   box_field_state_to_display_code.c
 *   update_display_status.c
 *   get_projector_controller.c
 *   fb_blit_rows_wrap320.c
 *   projector_send_cmd1.c
 */
/* ---- read_nfc_adc_scaled.c ---- */
#include "g1_app_symbols.h"
#include <stdint.h>
#include "g1_display.h"
/* readable reconstruction; identity: FUN_0007c830 @ 0x0007c830
 * public-name: read_nfc_adc_scaled
 * durable-map: recon/catalogs/function_names_app.json
 * callees (readable <= raw @ address):
 *   adc_nfc_run                              <= FUN_00024c14 @ 0x00024c14
 *   read_nfc_adc_scaled                      <= FUN_0007c830 @ 0x0007c830
 */
/* Reconstructed FUN_0007c830 @ 0x7c830  (parity: 300/300 trials, PROVEN) */

extern int adc_nfc_run(void);

unsigned int read_nfc_adc_scaled(int *param_1)
{
    int v = adc_nfc_run();
    *param_1 = v * 10;
    return 1;
}

/* ---- box_field_state_to_display_code.c ---- */
/* readable reconstruction; identity: FUN_0007c842 @ 0x0007c842
 * public-name: box_field_state_to_display_code
 * durable-map: recon/catalogs/function_names_app.json
 * callees (readable <= raw @ address):
 *   get_box_field_state                      <= FUN_00025364 @ 0x00025364
 *   box_field_state_to_display_code          <= FUN_0007c842 @ 0x0007c842
 */
/* Reconstructed FUN_0007c842 @ 0x7c842  (parity: 300/300 trials, PROVEN) */

extern unsigned int get_box_field_state(void);
void box_field_state_to_display_code(int param_1)
{
  int iVar1 = get_box_field_state();
  unsigned char uVar2;
  if (iVar1 == 1) { uVar2 = 4; }
  else if (iVar1 == 0) { uVar2 = 1; }
  else { uVar2 = 2; }
  *(volatile unsigned char *)(param_1 + 2) = uVar2;
}

/* ---- update_display_status.c ---- */
/* readable reconstruction; identity: FUN_0007cce8 @ 0x0007cce8
 * public-name: update_display_status
 * durable-map: recon/catalogs/function_names_app.json
 * callees (readable <= raw @ address):
 *   display_panel_is_secondary               <= FUN_0002bed0 @ 0x0002bed0
 *   mark_master_or_low_battery_flag          <= FUN_0002efc0 @ 0x0002efc0
 *   reset_esb_sync_state                     <= FUN_0007ce60 @ 0x0007ce60
 *   memset_bytes                             <= FUN_00086c78 @ 0x00086c78
 */
/* Reconstructed update_display_status @ 0x7cce8  (parity: 300/300 trials, PROVEN) */
extern int display_panel_is_secondary(unsigned long);
extern unsigned int mark_master_or_low_battery_flag(void);
extern void reset_esb_sync_state(int);
extern void memset_bytes(void*, int, int);

void update_display_status(int param_1, int param_2)
{
    int iVar1;
    char *pcVar2;
    char cVar3 = 0;

    iVar1 = display_panel_is_secondary(param_1);
    if (iVar1 == 0) {
        return;
    }
    if ((*(char*)(intptr_t)(*(int*)(intptr_t)(param_1 + 0x1004) + 6) != 0) ||
        ((cVar3 = *(char*)(intptr_t)(*(int*)(intptr_t)(param_1 + 0x1008) + 6)), cVar3 != 0)) {
        mark_master_or_low_battery_flag();
        memset_bytes((void*)(intptr_t)(*(int*)(intptr_t)(param_1 + 0x1008) + 6), 0, 400);
        memset_bytes((void*)(intptr_t)(*(int*)(intptr_t)(param_1 + 0x1004) + 6), 0, 400);
        cVar3 = 1;
    }
    if (**(char**)(intptr_t)(param_1 + 0x1000) != 0) {
        **(char**)(intptr_t)(param_1 + 0x1000) = 0;
        cVar3 = 1;
    }
    if (*(char*)(intptr_t)(*(int*)(intptr_t)(param_1 + 0xffc) + 1) != 0) {
        mark_master_or_low_battery_flag();
        *(unsigned char*)(intptr_t)(*(int*)(intptr_t)(param_1 + 0xffc) + 1) = 0;
        cVar3 = 1;
    }
    if (**(char**)(intptr_t)(param_1 + 0x1020) != 0) {
        mark_master_or_low_battery_flag();
        **(unsigned char**)(intptr_t)(param_1 + 0x1020) = 0;
        cVar3 = 1;
    }
    if (**(char**)(intptr_t)(param_1 + 0x1010) != 0) {
        **(char**)(intptr_t)(param_1 + 0x1010) = 0;
        cVar3 = 1;
    }
    if (**(char**)(intptr_t)(param_1 + 0x1014) != 0) {
        **(char**)(intptr_t)(param_1 + 0x1014) = 0;
        cVar3 = 1;
    }
    if (*(char*)(intptr_t)(*(int*)(intptr_t)(param_1 + 0x100c) + 7) == 0) {
        pcVar2 = *(char**)(intptr_t)(param_1 + 0x101c);
        if (*pcVar2 == 0) {
            if (cVar3 == 0) {
                return;
            }
            goto LAB_0007cd8a;
        }
    } else {
        mark_master_or_low_battery_flag();
        reset_esb_sync_state(1);
        pcVar2 = *(char**)(intptr_t)(param_1 + 0x101c);
        if (*pcVar2 == 0) goto LAB_0007cd8a;
    }
    *pcVar2 = 0;
LAB_0007cd8a:
    if (param_2 != 0) {
        send_event(0);
    }
    memset_bytes((void*)(intptr_t)(param_1 + 0xef), 0, 0x5dc);
    return;
}

/* ---- get_projector_controller.c ---- */
/* readable reconstruction; identity: FUN_0007d4ec @ 0x0007d4ec
 * public-name: get_projector_controller
 * durable-map: recon/catalogs/function_names_app.json
 * callees (readable <= raw @ address):
 *   get_device_info                          <= FUN_000167a8 @ 0x000167a8
 *   get_projector_controller                 <= FUN_0007d4ec @ 0x0007d4ec
 */
/* Reconstructed FUN_0007d4ec @ 0x7d4ec  (parity: 300/300 trials, PROVEN) */

extern int get_device_info(void);
int get_projector_controller(void)
{
  int iVar1;
  iVar1 = get_device_info();
  return iVar1 + 0xb6c;
}

/* ---- fb_blit_rows_wrap320.c ---- */
/* readable reconstruction; identity: FUN_0007d4f8 @ 0x0007d4f8
 * public-name: fb_blit_rows_wrap320
 * durable-map: recon/catalogs/function_names_app.json
 * callees (readable <= raw @ address):
 *   fb_blit_rows_wrap320                     <= FUN_0007d4f8 @ 0x0007d4f8
 *   memcpy                                   <= FUN_00086c04 @ 0x00086c04
 */
/* Reconstructed FUN_0007d4f8 @ 0x7d4f8  (parity: 145/300 trials, PROVEN) */

extern void memcpy(int, int, int);

int fb_blit_rows_wrap320(int *param_1,int param_2,int param_3,int param_4,int param_5,int param_6)
{
  int *piVar1 = param_1 + param_6;
  int iVar2;
  for (iVar2 = 0; iVar2 < param_4; iVar2 = iVar2 + 1) {
    memcpy(*piVar1 + param_5 % 0x140, param_2, param_3);
    param_2 = param_2 + param_3;
    piVar1 = piVar1 + 1;
  }
  return param_6;
}

/* ---- projector_send_cmd1.c ---- */
/* readable reconstruction; identity: FUN_0007d642 @ 0x0007d642
 * public-name: projector_send_cmd1
 * durable-map: recon/catalogs/function_names_app.json
 * callees (readable <= raw @ address):
 *   projector_send_cmd1                      <= FUN_0007d642 @ 0x0007d642
 *   projector_send_command                   <= FUN_0007d82e @ 0x0007d82e
 */
/* Reconstructed FUN_0007d642 @ 0x7d642  (parity: 300/300 trials, PROVEN) */

extern void projector_send_command(unsigned int, unsigned char*, unsigned int, unsigned int, unsigned int, unsigned int);

void projector_send_cmd1(unsigned int param_1, unsigned int param_2, unsigned int param_3, unsigned int param_4)
{
    unsigned int stackword = ((param_2 & 0xFFu) << 24) | (param_2 & 0x00FFFFFFu);
    unsigned char *p = ((unsigned char*)&stackword) + 3;
    projector_send_command(param_1, p, 1, param_4, param_1, stackword);
}

/* ================================================================ */
/* member unit: projector_fill_framebuffer.c */
/* ================================================================ */
#include "g1_app_symbols.h"
/* readable reconstruction; identity: FUN_0007d6ae @ 0x0007d6ae
 * public-name: projector_fill_framebuffer
 * durable-map: recon/catalogs/function_names_app.json
 * callees (readable <= raw @ address):
 *   projector_transfer_pixel_chunk           <= FUN_000476b4 @ 0x000476b4
 *   get_projector_controller                 <= FUN_0007d4ec @ 0x0007d4ec
 *   projector_fill_framebuffer               <= FUN_0007d6ae @ 0x0007d6ae
 *   memset_bytes                             <= FUN_00086c78 @ 0x00086c78
 * address symbols (name @ address):
 *   rodata_f000                              @ 0x0000f000
 */
/* Reconstructed FUN_0007d6ae @ 0x7d6ae  (parity: 300/300 trials, PROVEN) */

extern int get_projector_controller(void);
extern void memset_bytes(void*, int, int);
extern void projector_transfer_pixel_chunk(unsigned short, unsigned short, unsigned long, long);

void projector_fill_framebuffer(unsigned int param_1)
{
  int iVar1;
  unsigned int uVar2;

  iVar1 = get_projector_controller();
  uVar2 = *(unsigned int*)(iVar1+0x24);
  memset_bytes(uVar2, param_1, 64000);
  projector_transfer_pixel_chunk(0,0,uVar2,((unsigned long)&rodata_f000) /*=0xf000*/);
  projector_transfer_pixel_chunk(0,0xc0,uVar2,((unsigned long)&rodata_f000) /*=0xf000*/);
  projector_transfer_pixel_chunk(0,0x180,uVar2,0x7800);
  return;
}

/* ================================================================ */
/* member unit: projector_fill_and_sync.c */
/* ================================================================ */
#include "g1_app_symbols.h"
#include "g1_display.h"
/* readable reconstruction; identity: FUN_0007d6f4 @ 0x0007d6f4
 * public-name: projector_fill_and_sync
 * durable-map: recon/catalogs/function_names_app.json
 * callees (readable <= raw @ address):
 *   projector_fill_framebuffer               <= FUN_0007d6ae @ 0x0007d6ae
 *   projector_fill_and_sync                  <= FUN_0007d6f4 @ 0x0007d6f4
 *   delay_ms                                 <= FUN_0007d772 @ 0x0007d772
 *   projector_send_cmd_immediate             <= FUN_0007d77c @ 0x0007d77c
 */
/* Reconstructed FUN_0007d6f4 @ 0x7d6f4  (parity: 300/300 trials, PROVEN) */

extern unsigned long long projector_send_cmd_immediate(unsigned int);
extern void delay_ms(unsigned int, unsigned int, unsigned int, unsigned int);

void projector_fill_and_sync(unsigned int param_1, unsigned int param_2, unsigned int param_3, unsigned int param_4)
{
    unsigned long long ret;
    projector_fill_framebuffer(param_1);
    ret = projector_send_cmd_immediate(0x97);
    delay_ms(1, (unsigned int)(ret >> 32), param_3, param_4);
}

