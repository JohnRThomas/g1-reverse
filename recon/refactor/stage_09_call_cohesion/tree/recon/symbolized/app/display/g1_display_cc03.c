/*
 * Call-cohesive translation unit for the `display' module.
 *
 * GENERATED by recon/refactor/transforms/t09_call_cohesion.py.  Do
 * not edit: a stage tree is regenerated, never hand-patched
 * (recon/refactor/README.md C4).
 *
 * The 2 translation units below were grouped because they CALL ONE
 * ANOTHER, not because they were adjacent in the generated source
 * list.  Each member's text is reproduced VERBATIM.  Every member was
 * checked pairwise against every other member already in this unit by
 * stage 04's seven refusal rules, unchanged: no symbol is declared
 * here with two types, no identifier has internal linkage in one
 * member and is named by another, and no local typedef, macro, struct
 * tag or enum constant of one member is visible to a member that
 * names it.
 *
 * members, in generated-source-list order:
 *   g1_display_07.c
 *   g1_display_11.c
 *
 * call edges inside this unit (caller -> callee): 1
 *   g1_display_07.c -> g1_display_11.c
 */

/* File-scope forward declarations for every struct/union tag this
 * unit names.  Without them a tag whose only appearance in a member
 * is inside a parameter list has PARAMETER-LIST scope, so two
 * textually IDENTICAL declarations in two members declare two
 * different incomplete types and the second is a conflicting
 * redeclaration (C11 6.2.1p7).  Incomplete-type forward
 * declarations emit no code. */
struct k_sem;
struct k_timer;
struct spi_api_47724;
struct spi_state_47724;
/* ================================================================ */
/* member unit: g1_display_07.c */
/* ================================================================ */
/*
 * Cohesive translation unit for the `display' module.
 *
 * GENERATED by recon/refactor/transforms/t04_cohesive_tu.py.  Do not
 * edit: a stage tree is regenerated, never hand-patched
 * (recon/refactor/README.md C4).
 *
 * The 6 functions below were 6 separate translation units until this
 * stage.  Each one's text is reproduced VERBATIM and in the order the
 * generated source list gave it, and they were CONSECUTIVE in that list.
 * They were proven able to share a translation unit: no symbol is
 * declared here with two types, no identifier has internal linkage in one
 * member and is named by another, and no local typedef, macro, struct tag
 * or enum constant of one member is visible to a member that names it.
 *
 * members, in link order:
 *   get_demo_image_source.c
 *   set_display_page_index.c
 *   advance_display_page_index.c
 *   update_demo_image_display.c
 *   ui_raster_height_task.c
 *   display_mode_globals_configure.c
 */

/* File-scope forward declarations for every struct/union tag this
 * unit names.  Without them a tag whose only appearance in a member
 * is inside a parameter list has PARAMETER-LIST scope, so two
 * textually IDENTICAL declarations in two members declare two
 * different incomplete types and the second is a conflicting
 * redeclaration (C11 6.2.1p7).  Incomplete-type forward
 * declarations emit no code. */
struct k_sem;
/* ---- get_demo_image_source.c ---- */
#include "g1_app_symbols.h"
#include <stddef.h>
/* readable reconstruction; identity: FUN_00036820 @ 0x00036820
 * public-name: get_demo_image_source
 * durable-map: recon/catalogs/function_names_app.json
 * callees (readable <= raw @ address):
 *   get_device_info                          <= FUN_000167a8 @ 0x000167a8
 *   pixelto4bithex                           <= FUN_0003678c @ 0x0003678c
 *   get_demo_image_source                    <= FUN_00036820 @ 0x00036820
 *   malloc                                   <= FUN_00076d6c @ 0x00076d6c
 *   free                                     <= FUN_00076d7c @ 0x00076d7c
 *   printf                                   <= FUN_000777f0 @ 0x000777f0
 *   ptr_load_u32                             <= FUN_0007d1c8 @ 0x0007d1c8
 *   memcpy                                   <= FUN_00086c04 @ 0x00086c04
 *   memset_bytes                             <= FUN_00086c78 @ 0x00086c78
 *   strncmp                                  <= FUN_00087036 @ 0x00087036
 * address symbols (name @ address):
 *   rodata_a8d69                             @ 0x000a8d69   [INLINED -- G6 literal batch]
 *   rodata_a8d7f                             @ 0x000a8d7f   [INLINED -- G6 literal batch]
 *   rodata_a8da5                             @ 0x000a8da5
 *   rodata_a8da8                             @ 0x000a8da8   [INLINED -- G6 literal batch]
 *   rodata_a8dc1                             @ 0x000a8dc1   [INLINED -- refactor stage 01]
 *   rodata_a8dde                             @ 0x000a8dde   [INLINED -- G6 literal batch]
 *   rodata_a8e02                             @ 0x000a8e02   [INLINED -- G6 literal batch]
 *   g_pixel4bit_bitpos                       @ 0x20009fc4
 *   g_pixel4bit_row_buf_off                  @ 0x20009fc8
 *   g_pixel4bit_row_buf                      @ 0x20009fcc
 */
/* Reconstructed FUN_00036820 @ 0x36820. */
#include <stdint.h>
#include "../../../headers/g1_log.h"

extern int get_device_info(void);
extern void pixelto4bithex(unsigned int inverted_byte, int glyph_width);
extern void *malloc(size_t);
extern void free(void *);
extern int printf(const char *, ...);
extern unsigned int ptr_load_u32(unsigned int *);
extern void memcpy(int, int, int);
extern void memset_bytes(void*, int, int);
extern int strncmp(const char *, const char *, size_t);

typedef int (*read_callback_t)(uintptr_t context, uint32_t address,
                               void *destination, unsigned int size);

static read_callback_t get_read_callback(void)
{
    return *(read_callback_t *)(get_device_info() + 0x1030u);
}

static uintptr_t get_read_context(void)
{
    return get_device_info();
}

static void get_demo_image_source(unsigned int mode)
{
    uint8_t *buffer = (uint8_t *)malloc(0x50u);
    if (buffer == 0) {
        log_message(((unsigned long)"[%s-%d]malloc error \n") /*=0xa8d69*/, ((unsigned long)"get_demo_image_source") /*=0xa8e02*/, 0xd3u);
        return;
    }

    memset_bytes(buffer, 0, 0x50u);
    if (mode > 4u) {
        log_message(((unsigned long)"error imgIdx is %d,reset as zero !\n") /*=0xa8dde*/, mode);
        mode = 0;
    }

    read_callback_t read = get_read_callback();
    uintptr_t context = get_read_context();
    uint32_t address = mode * 0x3ebeu + 0x00180000u;
    if (read(context, address, buffer, 0x50u) != 0) {
        log_message(((unsigned long)"[%s-%d] read pic from flash failed !\n") /*=0xa8d7f*/, ((unsigned long)"get_demo_image_source") /*=0xa8e02*/, 0xdfu);
        free(buffer);
        return;
    }

    uint8_t header[14];
    for (unsigned int i = 0; i < sizeof(header); ++i)
        header[i] = buffer[i];

    if (strncmp(header, ((unsigned long)&rodata_a8da5) /*=0xa8da5*/, 2u) != 0) {
        log_message(((unsigned long)"File is not BMP format \n") /*=0xa8da8*/);
        free(buffer);
        return;
    }

    uint8_t metadata[40];
    for (unsigned int i = 0; i < sizeof(metadata); ++i)
        metadata[i] = buffer[14u + i];

    int first_offset = ptr_load_u32(header + 10);
    int glyph_width = ptr_load_u32(metadata + 4);
    int row_count = ptr_load_u32(metadata + 8);
    uint16_t format = (uint16_t)metadata[14] |
                      (uint16_t)((uint16_t)metadata[15] << 8);

    if (format != 1u) {
        printf(((unsigned long)"Unsupported bit depth - %d\r\n") /*=0xa8dc1*/);
        free(buffer);
        return;
    }

    int row_bytes = glyph_width + 7;
    *(volatile int *)((unsigned long)&g_pixel4bit_bitpos) /*=0x20009fc4*/ = 0;
    if (row_bytes < 0)
        row_bytes = glyph_width + 14;
    row_bytes >>= 3;

    *(volatile int *)((unsigned long)&g_pixel4bit_row_buf_off) /*=0x20009fc8*/ = 0;
    int row_words = glyph_width + 31;
    if (row_words < 0)
        row_words = glyph_width + 62;
    row_words >>= 5;

    address += (uint32_t)first_offset +
               (uint32_t)((row_count - 1) * row_words * 4);

    for (int row = 0; row < row_count; ++row) {
        *(volatile int *)((unsigned long)&g_pixel4bit_bitpos) /*=0x20009fc4*/ = 0;
        memset_bytes(buffer, 0, 0x50u);
        read = get_read_callback();
        context = get_read_context();
        if (read(context, address, buffer, (unsigned int)row_bytes) != 0) {
            log_message(((unsigned long)"[%s-%d] read pic from flash failed !\n") /*=0xa8d7f*/, ((unsigned long)"get_demo_image_source") /*=0xa8e02*/, 0x103u);
            free(buffer);
            return;
        }

        for (int column = 0; column < row_bytes; ++column)
            pixelto4bithex((unsigned int)(uint8_t)~buffer[column], glyph_width);

        int rendered = *(volatile int *)((unsigned long)&g_pixel4bit_row_buf) /*=0x20009fcc*/;
        if (rendered != 0) {
            *(volatile int *)((unsigned long)&g_pixel4bit_row_buf_off) /*=0x20009fc8*/ = 0;
            uintptr_t device = get_device_info();
            uintptr_t destination = *(volatile uintptr_t *)(device +
                                      0x0b90u + (unsigned int)row * 4u);
            memcpy(destination, rendered, 0x140u);
        }
        address -= (uint32_t)(row_words * 4);
    }

    free(buffer);
}

/* ---- set_display_page_index.c ---- */
/* readable reconstruction; identity: FUN_000369dc @ 0x000369dc
 * public-name: set_display_page_index
 * durable-map: recon/catalogs/function_names_app.json
 * callees (readable <= raw @ address):
 *   set_display_page_index                   <= FUN_000369dc @ 0x000369dc
 * address symbols (name @ address):
 *   g_display_page_index                     @ 0x2001b810
 *   g_display_page_dirty_flag                @ 0x2001b811
 */
/* Reconstructed FUN_000369dc @ 0x369dc  (parity: 300/300 trials, PROVEN) */

void set_display_page_index(unsigned int param_1)
{
  if (param_1 > 4) {
    param_1 = 0;
  }
  *(volatile unsigned char *)((unsigned long)&g_display_page_dirty_flag) /*=0x2001b811*/ = 1;
  *(volatile unsigned char *)((unsigned long)&g_display_page_index) /*=0x2001b810*/ = (unsigned char)param_1;
}

/* ---- advance_display_page_index.c ---- */
/* readable reconstruction; identity: FUN_000369f8 @ 0x000369f8
 * public-name: advance_display_page_index
 * durable-map: recon/catalogs/function_names_app.json
 * callees (readable <= raw @ address):
 *   advance_display_page_index               <= FUN_000369f8 @ 0x000369f8
 * address symbols (name @ address):
 *   g_display_page_index                     @ 0x2001b810
 *   g_display_page_dirty_flag                @ 0x2001b811
 */
/* Reconstructed FUN_000369f8 @ 0x369f8  (parity: 300/300 trials, PROVEN) */

void advance_display_page_index(void)
{
    *(volatile unsigned char *)((unsigned long)&g_display_page_dirty_flag) /*=0x2001b811*/ = 1;
    unsigned char bVar1 = (unsigned char)(*(volatile unsigned char *)((unsigned long)&g_display_page_index) /*=0x2001b810*/ + 1);
    if (bVar1 >= 5) {
        bVar1 = 0;
    }
    *(volatile unsigned char *)((unsigned long)&g_display_page_index) /*=0x2001b810*/ = bVar1;
}

/* ---- update_demo_image_display.c ---- */
/* readable reconstruction; identity: FUN_00036a18 @ 0x00036a18
 * public-name: update_demo_image_display
 * durable-map: recon/catalogs/function_names_app.json
 * callees (readable <= raw @ address):
 *   get_device_info                          <= FUN_000167a8 @ 0x000167a8
 *   get_demo_image_source                    <= FUN_00036820 @ 0x00036820
 *   update_demo_image_display                <= FUN_00036a18 @ 0x00036a18
 *   gui_screen_clear                         <= FUN_000431c0 @ 0x000431c0
 *   reflash_fb_data_to_lcd                   <= FUN_00047260 @ 0x00047260
 *   demo_image_get_position                  <= FUN_00047a84 @ 0x00047a84
 *   fb_blit_rows_copy                        <= FUN_0007d53a @ 0x0007d53a
 * address symbols (name @ address):
 *   g_demo_img_cached_height                 @ 0x200024e0
 *   g_demo_img_cached_width                  @ 0x200024e4
 *   g_demo_image_last_page_idx               @ 0x200033d4
 *   g_display_page_index                     @ 0x2001b810
 *   g_display_page_dirty_flag                @ 0x2001b811
 */
/* Reconstructed FUN_00036a18 @ 0x36a18  (parity: 300/300 trials, PROVEN) */
#include "g1_display.h"
static void get_demo_image_source(unsigned int);
extern void reflash_fb_data_to_lcd(unsigned,unsigned,unsigned,unsigned,int,int);
extern int demo_image_get_position(int, int *, int *);
extern int fb_blit_rows_copy(int, int, int, int, int, int);

unsigned update_demo_image_display(int param_1,unsigned param_2,int param_3,int param_4){
  int local_18 = param_3;
  int local_14 = param_4;
  if(param_3==2){
    gui_screen_clear();
    *(volatile uint32_t *)((unsigned long)&g_demo_img_cached_width) /*=0x200024e4*/ = 0xffffffffU;
    *(volatile uint32_t *)((unsigned long)&g_demo_img_cached_height) /*=0x200024e0*/ = 0xffffffffU;
    *(volatile uint8_t *)((unsigned long)&g_demo_image_last_page_idx) /*=0x200033d4*/ = 0xff;
    return 0;
  }
  if(*(volatile uint8_t *)((unsigned long)&g_display_page_dirty_flag) /*=0x2001b811*/ == 0){
    int iVar4 = get_device_info();
    unsigned r2 = *(uint16_t*)(iVar4+0x1072);
    if(!(r2 == *(volatile uint32_t *)((unsigned long)&g_demo_img_cached_width) /*=0x200024e4*/ &&
         (iVar4=get_device_info(), (unsigned)*(uint16_t*)(iVar4+0x1074) == *(volatile uint32_t *)((unsigned long)&g_demo_img_cached_height) /*=0x200024e0*/))){
      gui_screen_clear();
      iVar4=get_device_info();
      *(volatile uint32_t *)((unsigned long)&g_demo_img_cached_width) /*=0x200024e4*/ = *(uint16_t*)(iVar4+0x1072);
      iVar4=get_device_info();
      *(volatile uint32_t *)((unsigned long)&g_demo_img_cached_height) /*=0x200024e0*/ = *(uint16_t*)(iVar4+0x1074);
      unsigned uVar5 = demo_image_get_position(0,&local_18,&local_14);
      fb_blit_rows_copy(param_1+0x24, uVar5, local_18/2, local_14,
                   *(volatile uint32_t *)((unsigned long)&g_demo_img_cached_width) /*=0x200024e4*/, *(volatile uint32_t *)((unsigned long)&g_demo_img_cached_height) /*=0x200024e0*/);
      iVar4=get_device_info();
      unsigned uVar5b = *(uint32_t*)(iVar4+0xeb4);
      iVar4=get_device_info();
      unsigned uVar10 = *(volatile uint32_t *)((unsigned long)&g_demo_img_cached_height) /*=0x200024e0*/;
      unsigned uVar9 = *(volatile uint32_t *)((unsigned long)&g_demo_img_cached_width) /*=0x200024e4*/;
      int iVar6 = local_14 + (int)uVar10;
      int iVar7 = local_18 + (int)uVar9;
      unsigned uVar8 = *(uint32_t*)(iVar4+0xeb8);
      reflash_fb_data_to_lcd(uVar5b, uVar8, uVar9, uVar10, iVar7, iVar6);
    }
    return 0;
  } else {
    if(*(volatile uint8_t *)((unsigned long)&g_demo_image_last_page_idx) /*=0x200033d4*/ == *(volatile uint8_t *)((unsigned long)&g_display_page_index) /*=0x2001b810*/) return 0;
    *(volatile uint8_t *)((unsigned long)&g_demo_image_last_page_idx) /*=0x200033d4*/ = *(volatile uint8_t *)((unsigned long)&g_display_page_index) /*=0x2001b810*/;
    gui_screen_clear();
    *(volatile uint32_t *)((unsigned long)&g_demo_img_cached_width) /*=0x200024e4*/ = 0;
    *(volatile uint32_t *)((unsigned long)&g_demo_img_cached_height) /*=0x200024e0*/ = 0;
    demo_image_get_position(0,&local_18,&local_14);
    get_demo_image_source(*(volatile uint8_t *)((unsigned long)&g_display_page_index) /*=0x2001b810*/);
    int iVar4=get_device_info();
    unsigned uVar5 = *(uint32_t*)(iVar4+0xeb4);
    iVar4=get_device_info();
    unsigned uVar10 = *(volatile uint32_t *)((unsigned long)&g_demo_img_cached_height) /*=0x200024e0*/;
    unsigned uVar9 = *(volatile uint32_t *)((unsigned long)&g_demo_img_cached_width) /*=0x200024e4*/;
    int iVar6 = local_14 + (int)uVar10;
    int iVar7 = local_18 + (int)uVar9;
    unsigned uVar8 = *(uint32_t*)(iVar4+0xeb8);
    reflash_fb_data_to_lcd(uVar5, uVar8, uVar9, uVar10, iVar7, iVar6);
    return 0;
  }
}

/* ---- ui_raster_height_task.c ---- */
#include "../../../headers/g1_dedupe.h"
struct k_sem;
/* readable reconstruction; identity: FUN_000430c0 @ 0x000430c0
 * public-name: ui_raster_height_task
 * durable-map: recon/catalogs/function_names_app.json
 * callees (readable <= raw @ address):
 *   get_device_info                          <= FUN_000167a8 @ 0x000167a8
 *   debug_print                              <= FUN_00019c70 @ 0x00019c70
 *   ui_DashBoard_task                        <= FUN_0003af78 @ 0x0003af78
 *   cal_panel_canvas_coord                   <= FUN_00042fb0 @ 0x00042fb0
 *   gui_screen_clear                         <= FUN_000431c0 @ 0x000431c0
 *   k_sem_give                               <= FUN_00072880 @ 0x00072880
 * address symbols (name @ address):
 *   rodata_aa7f2                             @ 0x000aa7f2   [INLINED -- G6 literal batch]
 *   rodata_aa817                             @ 0x000aa817   [INLINED -- G6 literal batch]
 *   rodata_aa83f                             @ 0x000aa83f   [INLINED -- G6 literal batch]
 *   g_log_level                              @ 0x2000230c
 *   g_display_canvas_y_cache                 @ 0x2000253c
 *   g_display_canvas_x_cache                 @ 0x20002540
 *   g_log_use_alt_sink                       @ 0x20007554
 */
/* Reconstructed ui_raster_height_task @ 0x430c0  (parity: 300/300 trials, PROVEN) */
extern void ui_DashBoard_task(uint32_t, uint32_t, int);
extern void k_sem_give(struct k_sem *);

unsigned int ui_raster_height_task(unsigned int param_1, unsigned int param_2, int param_3)
{
    volatile int *piVar2 = (volatile int*)((unsigned long)&g_display_canvas_x_cache) /*=0x20002540*/;
    volatile int *piVar1 = (volatile int*)((unsigned long)&g_display_canvas_y_cache) /*=0x2000253c*/;
    int iVar3;
    int iVar4;
    int iVar5;
    int local_20 = -1;
    int local_1c = -1;

    if (param_3 == 2) {
        if (2 < *(volatile int *)((unsigned long)&g_log_level) /*=0x2000230c*/) {
            G1_LOG_ROUTE(*(volatile int *)((unsigned long)&g_log_use_alt_sink) /*=0x20007554*/ == 0, ((unsigned long)"%s(): ui_raster_height_task exit...\n") /*=0xaa7f2*/, ((unsigned long)"ui_raster_height_task") /*=0xaa83f*/);
        }
        ui_DashBoard_task(param_1, param_2, 2);
        *piVar2 = -1;
        *piVar1 = -1;
    } else {
        cal_panel_canvas_coord(&local_20, &local_1c);
        iVar5 = local_20;
        if ((local_20 != *piVar2) || (local_1c != *piVar1)) {
            if (2 < *(volatile int *)((unsigned long)&g_log_level) /*=0x2000230c*/) {
                G1_LOG_ROUTE(*(volatile int *)((unsigned long)&g_log_use_alt_sink) /*=0x20007554*/ == 0, ((unsigned long)"%s(): ui_raster_height_task reflash...\n") /*=0xaa817*/, ((unsigned long)"ui_raster_height_task") /*=0xaa83f*/);
            }
            gui_screen_clear();
            iVar3 = local_1c;
            *piVar2 = iVar5;
            *piVar1 = local_1c;
            iVar4 = (int)(intptr_t)get_device_info();
            *(int*)(intptr_t)(iVar4 + 0xec4) = iVar5;
            iVar5 = (int)(intptr_t)get_device_info();
            *(int*)(intptr_t)(iVar5 + 0xeb8) = iVar3;
            ui_DashBoard_task(param_1, param_2, 1);
            iVar5 = (int)(intptr_t)get_device_info();
            *(unsigned int*)(intptr_t)(iVar5 + 0x104c) = 0x26;
            iVar5 = (int)(intptr_t)get_device_info();
            k_sem_give(iVar5 + 0x80);
        }
    }
    return 0;
}

/* ---- display_mode_globals_configure.c ---- */
/* readable reconstruction; identity: FUN_0004372c @ 0x0004372c
 * public-name: display_mode_globals_configure
 * durable-map: recon/catalogs/function_names_app.json
 * callees (readable <= raw @ address):
 *   debug_print                              <= FUN_00019c70 @ 0x00019c70
 *   display_mode_globals_configure           <= FUN_0004372c @ 0x0004372c
 * address symbols (name @ address):
 *   rodata_aa951                             @ 0x000aa951   [INLINED -- G6 literal batch]
 *   rodata_aad1a                             @ 0x000aad1a   [INLINED -- G6 literal batch]
 *   g_log_level                              @ 0x2000230c
 *   g_log_use_alt_sink                       @ 0x20007554
 */
/* Reconstructed FUN_0004372c @ 0x0004372c, extent 0xc8.
 * Readable identity: display_mode_globals_configure.
 * Raw/address backmap: display_mode_globals_configure <= FUN_0004372c @ 0x0004372c.
 * CFG_VERIFY_CALL_ARITIES=2
 */


int display_mode_globals_configure(unsigned mode, ...)
{
    volatile uint32_t *const first = (volatile uint32_t *)0x2000a014UL;
    volatile uint32_t *const second = (volatile uint32_t *)0x2000a010UL;
    volatile uint32_t *const third = (volatile uint32_t *)0x2000a00cUL;
    volatile uint32_t *const fourth = (volatile uint32_t *)0x2000a008UL;
    volatile uint8_t *const fifth = (volatile uint8_t *)0x2001cdd6UL;
    volatile uint32_t *const sixth = (volatile uint32_t *)0x2000a004UL;
    volatile uint32_t *const seventh = (volatile uint32_t *)0x2000a000UL;
    volatile uint32_t *const eighth = (volatile uint32_t *)0x20009ffcUL;
    volatile uint32_t *const ninth = (volatile uint32_t *)0x20009ff8UL;
    volatile uint8_t *const tenth = (volatile uint8_t *)0x2001cdd5UL;
    __builtin_va_list ap;
    uint32_t arg1, arg2;

    __builtin_va_start(ap, mode);
    arg1 = __builtin_va_arg(ap, uint32_t);
    arg2 = __builtin_va_arg(ap, uint32_t);
    __builtin_va_end(ap);

    switch (mode) {
    case 4:
        *first = arg1;
        *second = arg2;
        *third = 0;
        *fourth = 4;
        *fifth = 0;
        *sixth = 0;
        *seventh = 0;
        *eighth = 1;
        break;
    case 5:
        *first = 0;
        *second = 0;
        *third = 3;
        *fourth = 5;
        *fifth = 0;
        *sixth = 0;
        *ninth = 0;
        *seventh = 0;
        *eighth = 1;
        break;
    case 6:
        *third = 2;
        *fourth = 6;
        *fifth = 0;
        *sixth = 0;
        *ninth = 0;
        *seventh = 0;
        *eighth = 1;
        break;
    case 8:
        *first = 0;
        *second = 0;
        *third = 0;
        *fourth = 0;
        *fifth = 0;
        *sixth = 0;
        *seventh = 0;
        *eighth = 0;
        *ninth = 0;
        *tenth = 0;
        break;
    default:
        if (*(volatile int32_t *)((unsigned long)&g_log_level) /*=0x2000230c*/ > 0) {
            if (*(volatile uint32_t *)((unsigned long)&g_log_use_alt_sink) /*=0x20007554*/ != 0)
                debug_print(((unsigned long)"%s(): unkonown adv command\n") /*=0xaa951*/, ((unsigned long)"gui_utf_adv_draw_configure") /*=0xaad1a*/);
            else
                log_message(((unsigned long)"%s(): unkonown adv command\n") /*=0xaa951*/, ((unsigned long)"gui_utf_adv_draw_configure") /*=0xaad1a*/);
        }
        break;
    }
    return -1;
}

/* ================================================================ */
/* member unit: g1_display_11.c */
/* ================================================================ */
/*
 * Cohesive translation unit for the `display' module.
 *
 * GENERATED by recon/refactor/transforms/t04_cohesive_tu.py.  Do not
 * edit: a stage tree is regenerated, never hand-patched
 * (recon/refactor/README.md C4).
 *
 * The 6 functions below were 6 separate translation units until this
 * stage.  Each one's text is reproduced VERBATIM and in the order the
 * generated source list gave it, and they were CONSECUTIVE in that list.
 * They were proven able to share a translation unit: no symbol is
 * declared here with two types, no identifier has internal linkage in one
 * member and is named by another, and no local typedef, macro, struct tag
 * or enum constant of one member is visible to a member that names it.
 *
 * members, in link order:
 *   spi_read_id.c
 *   demo_image_get_position.c
 *   display_reflash_handler.c
 *   stop_some_timer.c
 *   setDelayExitValue.c
 *   submit_display_reflash_work.c
 */

/* File-scope forward declarations for every struct/union tag this
 * unit names.  Without them a tag whose only appearance in a member
 * is inside a parameter list has PARAMETER-LIST scope, so two
 * textually IDENTICAL declarations in two members declare two
 * different incomplete types and the second is a conflicting
 * redeclaration (C11 6.2.1p7).  Incomplete-type forward
 * declarations emit no code. */
struct k_timer;
struct spi_api_47724;
struct spi_state_47724;
/* ---- spi_read_id.c ---- */
#include "g1_app_symbols.h"
/* readable reconstruction; identity: FUN_00047724 @ 0x00047724
 * public-name: spi_read_id
 * durable-map: recon/catalogs/function_names_app.json
 * callees (readable <= raw @ address):
 *   debug_print                              <= FUN_00019c70 @ 0x00019c70
 *   projector_bus_lock                       <= FUN_00047698 @ 0x00047698
 *   projector_bus_unlock                     <= FUN_000476a8 @ 0x000476a8
 *   get_projector_controller                 <= FUN_0007d4ec @ 0x0007d4ec
 * address symbols (name @ address):
 *   rodata_d7459                             @ 0x000d7459   [INLINED -- G6 literal batch]
 *   rodata_d748d                             @ 0x000d748d   [INLINED -- G6 literal batch]
 *   g_log_level                              @ 0x2000230c
 *   g_log_use_alt_sink                       @ 0x20007554
 */
/* Full reconstruction of spi_read_id @ 0x47724 (108-byte extent).
 * CFG_VERIFY_CALL_ARITIES=0,2,4,0,4
 * The caller-owned TX/RX locals are narrowly stack-pointer-normalized while
 * all four register arguments remain compared. */
#include <stdint.h>
#include "../../../headers/g1_log.h"
#include "g1_display.h"

typedef void (*spi_transfer_47724_t)(void *device, const void *tx,
                                    uint32_t tx_length, void *rx,
                                    uint32_t rx_length, uint32_t options);
struct spi_api_47724 { uint32_t reserved[2]; spi_transfer_47724_t transfer; };
struct spi_state_47724 {
    uint8_t reserved[0x374];
    struct spi_api_47724 *device;
};

extern struct spi_state_47724 *get_projector_controller(void);

uint32_t spi_read_id(uint32_t unused, uint32_t options, uint32_t ignored)
{
    uint32_t command = 0x9f;
    uint32_t response = 0;
    (void)unused;
    (void)ignored;

    struct spi_state_47724 *state = get_projector_controller();
    projector_bus_lock(UINT32_MAX, UINT32_MAX);
    state->device->transfer(state->device, &command, 4, &response, 4, options);
    projector_bus_unlock();

    if (*(volatile int32_t *)(uintptr_t)((unsigned long)&g_log_level) /*=0x2000230c*/ > 2) {
        uint32_t b0 = (response >> 0) & 0xff;
        uint32_t b1 = (response >> 8) & 0xff;
        uint32_t b2 = (response >> 16) & 0xff;
        uint32_t b3 = (response >> 24) & 0xff;
        if (*(volatile uint32_t *)(uintptr_t)((unsigned long)&g_log_use_alt_sink) /*=0x20007554*/ == 0)
            log_message(((unsigned long)"%s(): jbd panel devicve id: %02x, %02x, %02x, %02x\n") /*=0xd7459*/, ((unsigned long)"spi_read_id") /*=0xd748d*/, b0, b1, b2, b3);
        else
            debug_print(((unsigned long)"%s(): jbd panel devicve id: %02x, %02x, %02x, %02x\n") /*=0xd7459*/, ((unsigned long)"spi_read_id") /*=0xd748d*/, b0, b1, b2, b3);
    }

    return ((response >> 16) & 0xffu) << 8 | ((response >> 24) & 0xffu);
}

/* ---- demo_image_get_position.c ---- */
/* readable reconstruction; identity: FUN_00047a84 @ 0x00047a84
 * public-name: demo_image_get_position
 * durable-map: recon/catalogs/function_names_app.json
 * callees (readable <= raw @ address):
 *   demo_image_get_position                  <= FUN_00047a84 @ 0x00047a84
 * address symbols (name @ address):
 *   rodata_8ac20                             @ 0x0008ac20
 *   g_display_page_dirty_flag                @ 0x2001b811
 */
/* Reconstructed FUN_00047a84 @ 0x47a84  (parity: 300/300 trials, PROVEN) */

int demo_image_get_position(int param_1, int *param_2, int *param_3)
{
    *param_3 = 200;
    if (*(volatile unsigned char *)((unsigned long)&g_display_page_dirty_flag) /*=0x2001b811*/ != 0) {
        *param_2 = 0x27e;
        *param_3 = 199;
        return 0;
    }
    *param_2 = 0x240;
    *param_3 = 0x88;
    return *(volatile int *)(((unsigned long)&rodata_8ac20) /*=0x8ac20*/ + param_1 * 4);
}

/* ---- display_reflash_handler.c ---- */
/* readable reconstruction; identity: FUN_00048e28 @ 0x00048e28
 * public-name: display_reflash_handler
 * durable-map: recon/catalogs/function_names_app.json
 * callees (readable <= raw @ address):
 *   debug_print                              <= FUN_00019c70 @ 0x00019c70
 *   ui_refalsh_warp                          <= FUN_00048b5c @ 0x00048b5c
 *   display_reflash_handler                  <= FUN_00048e28 @ 0x00048e28
 * address symbols (name @ address):
 *   rodata_ef7bb                             @ 0x000ef7bb   [INLINED -- G6 literal batch]
 *   rodata_ef7ef                             @ 0x000ef7ef   [INLINED -- G6 literal batch]
 *   rodata_ef87a                             @ 0x000ef87a   [INLINED -- G6 literal batch]
 *   rodata_ef8d7                             @ 0x000ef8d7   [INLINED -- G6 literal batch]
 *   rodata_ef937                             @ 0x000ef937   [INLINED -- G6 literal batch]
 *   rodata_ef9bf                             @ 0x000ef9bf   [INLINED -- G6 literal batch]
 *   rodata_efa29                             @ 0x000efa29   [INLINED -- G6 literal batch]
 *   rodata_efaa5                             @ 0x000efaa5   [INLINED -- G6 literal batch]
 *   rodata_f01d3                             @ 0x000f01d3   [INLINED -- G6 literal batch]
 *   g_log_level                              @ 0x2000230c
 *   g_log_use_alt_sink                       @ 0x20007554
 *   g_2001d447                               @ 0x2001d447
 */
/* Reconstructed FUN_00048e28 @ 0x48e28 */

extern int ui_refalsh_warp(unsigned int, unsigned int, unsigned int, int);

unsigned int display_reflash_handler(unsigned int owner, unsigned int requested,
                         unsigned int payload, int mode)
{
    volatile uint8_t *state = (volatile uint8_t *)((unsigned long)&g_2001d447) /*=0x2001d447*/;
    volatile int *log_level = (volatile int *)((unsigned long)&g_log_level) /*=0x2000230c*/;
    volatile int *alternate_log = (volatile int *)((unsigned long)&g_log_use_alt_sink) /*=0x20007554*/;
    unsigned int current = state[1];

    if (mode == 2) {
        if (requested != current && current != 0) {
            if (*log_level > 0) {
                if (*alternate_log == 0)
                    log_message(((unsigned long)"%s(): !!!!!!!!!!!!!!!!!!!!!!!!!!!!!!!!!!!!!!!!!!!!\n") /*=0xef7bb*/, ((unsigned long)"display_reflash_handler") /*=0xf01d3*/, payload, 0);
                else
                    debug_print(((unsigned long)"%s(): !!!!!!!!!!!!!!!!!!!!!!!!!!!!!!!!!!!!!!!!!!!!\n") /*=0xef7bb*/, ((unsigned long)"display_reflash_handler") /*=0xf01d3*/, payload,
                                 *alternate_log);

                if (*log_level > 0) {
                    current = state[1];
                    if (*alternate_log == 0)
                        log_message(((unsigned long)"%s(): The wrong screen ID has appeared, and the exception handling is closed,The message ID at startup is %d. The current message ID is%d\n") /*=0xef7ef*/, ((unsigned long)"display_reflash_handler") /*=0xf01d3*/, current, requested);
                    else
                        debug_print(((unsigned long)"%s(): The wrong screen ID has appeared, and the exception handling is closed,The message ID at startup is %d. The current message ID is%d\n") /*=0xef7ef*/, ((unsigned long)"display_reflash_handler") /*=0xf01d3*/,
                                     current, requested);

                    if (*log_level > 0) {
                        current = state[1];
                        if (*alternate_log == 0)
                            log_message(((unsigned long)"%s(): To perform exception handling, close the previous SCREEN ID = %d UI application first\n") /*=0xef87a*/, ((unsigned long)"display_reflash_handler") /*=0xf01d3*/, current, 0);
                        else
                            debug_print(((unsigned long)"%s(): To perform exception handling, close the previous SCREEN ID = %d UI application first\n") /*=0xef87a*/, ((unsigned long)"display_reflash_handler") /*=0xf01d3*/, current,
                                         *alternate_log);
                    }
                }
            }
            ui_refalsh_warp(owner, requested, payload, 2);
            return 0xffffffff;
        }
    } else if (mode == 1) {
        if (requested != current && current != 0) {
            if (*log_level > 0) {
                if (*alternate_log == 0)
                    log_message(((unsigned long)"%s(): ----------------------------------------------------------------------------------------\n") /*=0xef8d7*/, ((unsigned long)"display_reflash_handler") /*=0xf01d3*/, payload, 0);
                else
                    debug_print(((unsigned long)"%s(): ----------------------------------------------------------------------------------------\n") /*=0xef8d7*/, ((unsigned long)"display_reflash_handler") /*=0xf01d3*/, payload,
                                 *alternate_log);

                if (*log_level > 0) {
                    current = state[1];
                    if (*alternate_log == 0)
                        log_message(((unsigned long)"%s(): There is a screen ID error. The previous screen iD was %d, the current screen ID is %d, and the UI process to be performed is %d\n") /*=0xef937*/, ((unsigned long)"display_reflash_handler") /*=0xf01d3*/, current,
                                    requested);
                    else
                        debug_print(((unsigned long)"%s(): There is a screen ID error. The previous screen iD was %d, the current screen ID is %d, and the UI process to be performed is %d\n") /*=0xef937*/, ((unsigned long)"display_reflash_handler") /*=0xf01d3*/, current,
                                     requested);

                    if (*log_level > 0) {
                        current = state[1];
                        if (*alternate_log == 0)
                            log_message(((unsigned long)"%s(): The UI framework closes the opened UI application first, and the closed application ScreenID is %d\n") /*=0xef9bf*/, ((unsigned long)"display_reflash_handler") /*=0xf01d3*/, current, 0);
                        else
                            debug_print(((unsigned long)"%s(): The UI framework closes the opened UI application first, and the closed application ScreenID is %d\n") /*=0xef9bf*/, ((unsigned long)"display_reflash_handler") /*=0xf01d3*/, current,
                                         *alternate_log);
                    }
                }
            }

            ui_refalsh_warp(owner, state[1], payload, 2);
            if (*log_level > 0) {
                if (*alternate_log == 0)
                    log_message(((unsigned long)"%s(): Because ScreenID has changed, close the old screenID application first and update the backup value of screenID to %d\n") /*=0xefa29*/, ((unsigned long)"display_reflash_handler") /*=0xf01d3*/, requested, 0);
                else
                    debug_print(((unsigned long)"%s(): Because ScreenID has changed, close the old screenID application first and update the backup value of screenID to %d\n") /*=0xefa29*/, ((unsigned long)"display_reflash_handler") /*=0xf01d3*/, requested,
                                 *alternate_log);
            }
            state[1] = (uint8_t)requested;
        }
    } else if (requested != current && *log_level > 0) {
        if (*alternate_log == 0)
            log_message(((unsigned long)"%s(): *************************************************************************************************\n") /*=0xefaa5*/, ((unsigned long)"display_reflash_handler") /*=0xf01d3*/, payload, 0);
        else
            debug_print(((unsigned long)"%s(): *************************************************************************************************\n") /*=0xefaa5*/, ((unsigned long)"display_reflash_handler") /*=0xf01d3*/, payload,
                         *alternate_log);

        if (*log_level > 0) {
            current = state[1];
            if (*alternate_log == 0)
                log_message(((unsigned long)"%s(): There is a screen ID error. The previous screen iD was %d, the current screen ID is %d, and the UI process to be performed is %d\n") /*=0xef937*/, ((unsigned long)"display_reflash_handler") /*=0xf01d3*/, current, requested);
            else
                debug_print(((unsigned long)"%s(): There is a screen ID error. The previous screen iD was %d, the current screen ID is %d, and the UI process to be performed is %d\n") /*=0xef937*/, ((unsigned long)"display_reflash_handler") /*=0xf01d3*/, current, requested);
        }
    }

    ui_refalsh_warp(owner, requested, payload, mode);
    return 0;
}

/* ---- stop_some_timer.c ---- */
/* readable reconstruction; identity: FUN_00048ff4 @ 0x00048ff4
 * public-name: stop_some_timer
 * durable-map: recon/catalogs/function_names_app.json
 * callees (readable <= raw @ address):
 *   stop_some_timer                          <= FUN_00048ff4 @ 0x00048ff4
 *   z_impl_k_timer_stop                      <= FUN_0008673e @ 0x0008673e
 * address symbols (name @ address):
 *   g_some_k_timer                           @ 0x20004ce0
 */
/* Reconstructed FUN_00048ff4 @ 0x48ff4  (parity: 300/300 trials, PROVEN) */

extern void z_impl_k_timer_stop(struct k_timer *);
void stop_some_timer(void) {
    z_impl_k_timer_stop(((unsigned long)&g_some_k_timer) /*=0x20004ce0*/);
}

/* ---- setDelayExitValue.c ---- */
#include "../../../headers/g1_dedupe.h"
/* readable reconstruction; identity: FUN_00049000 @ 0x00049000
 * public-name: setDelayExitValue
 * durable-map: recon/catalogs/function_names_app.json
 * callees (readable <= raw @ address):
 *   debug_print                              <= FUN_00019c70 @ 0x00019c70
 * address symbols (name @ address):
 *   rodata_efb0e                             @ 0x000efb0e   [INLINED -- G6 literal batch]
 *   rodata_f01c1                             @ 0x000f01c1   [INLINED -- G6 literal batch]
 *   g_log_level                              @ 0x2000230c
 *   g_log_use_alt_sink                       @ 0x20007554
 *   g_delayexitvalue                         @ 0x2000a094
 */
/* Reconstructed setDelayExitValue @ 0x49000  (parity: 300/300 trials, PROVEN) */

unsigned int setDelayExitValue(unsigned int param_1){
    if(*(volatile int *)((unsigned long)&g_log_level) /*=0x2000230c*/ > 2){
        G1_LOG_ROUTE(*(volatile unsigned int *)((unsigned long)&g_log_use_alt_sink) /*=0x20007554*/==0, ((unsigned long)"%s(): set delay exit time = %d\n") /*=0xefb0e*/,((unsigned long)"setDelayExitValue") /*=0xf01c1*/,param_1);
    }
    *(volatile unsigned int *)((unsigned long)&g_delayexitvalue) /*=0x2000a094*/ = param_1;
    return 0;
}

/* ---- submit_display_reflash_work.c ---- */
/* readable reconstruction; identity: FUN_0004904c @ 0x0004904c
 * public-name: submit_display_reflash_work
 * durable-map: recon/catalogs/function_names_app.json
 * callees (readable <= raw @ address):
 *   submit_display_reflash_work              <= FUN_0004904c @ 0x0004904c
 *   k_thread_priority_set                    <= FUN_00074554 @ 0x00074554
 * address symbols (name @ address):
 *   g_display_thread_id                      @ 0x2000a09c
 *   g_display_reflash_pending                @ 0x2001d446
 */
/* Reconstructed FUN_0004904c @ 0x4904c  (parity: 300/300 trials, PROVEN) */

extern void k_thread_priority_set(unsigned int a, unsigned int b, unsigned int c, unsigned int d, unsigned int e);

void submit_display_reflash_work(unsigned int param_1, unsigned int param_2, unsigned int param_3, unsigned int param_4)
{
    volatile uint32_t *p = (volatile uint32_t *)((unsigned long)&g_display_thread_id) /*=0x2000a09c*/;
    k_thread_priority_set(*p, 0xfffffff0U, param_3, (unsigned int)(uintptr_t)p, param_4);
    *(volatile uint8_t *)((unsigned long)&g_display_reflash_pending) /*=0x2001d446*/ = 1;
}

