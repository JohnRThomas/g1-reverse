/*
 * Cohesive translation unit for the `display' module.
 *
 * GENERATED by recon/refactor/transforms/t04_cohesive_tu.py.  Do not
 * edit: a stage tree is regenerated, never hand-patched
 * (recon/refactor/README.md C4).
 *
 * The 2 functions below were 2 separate translation units until this
 * stage.  Each one's text is reproduced VERBATIM and in the order the
 * generated source list gave it, and they were CONSECUTIVE in that list.
 * They were proven able to share a translation unit: no symbol is
 * declared here with two types, no identifier has internal linkage in one
 * member and is named by another, and no local typedef, macro, struct tag
 * or enum constant of one member is visible to a member that names it.
 *
 * members, in link order:
 *   compute_lux_brightness_bucket.c
 *   power_for_panel.c
 */
/* ---- compute_lux_brightness_bucket.c ---- */
#include "g1_app_symbols.h"
#include <stdint.h>
#include "../../../headers/g1_log.h"
#include "../../../headers/g1_dedupe.h"
/* readable reconstruction; identity: FUN_00010840 @ 0x00010840
 * public-name: compute_lux_brightness_bucket
 * durable-map: recon/catalogs/function_names_app.json
 * callees (readable <= raw @ address):
 *   __floatsidf                              <= FUN_0000d824 @ 0x0000d824
 *   __extendsfdf2                            <= FUN_0000d848 @ 0x0000d848
 *   __muldf3                                 <= FUN_0000d8f8 @ 0x0000d8f8
 *   __divdf3                                 <= FUN_0000db4c @ 0x0000db4c
 *   __aeabi_dcmplt                           <= FUN_0000dddc @ 0x0000dddc
 *   __aeabi_dcmpgt                           <= FUN_0000de18 @ 0x0000de18
 *   __truncdfsf2                             <= FUN_0000dee8 @ 0x0000dee8
 *   compute_lux_brightness_bucket            <= FUN_00010840 @ 0x00010840
 *   get_device_info                          <= FUN_000167a8 @ 0x000167a8
 *   opt3001_read_lux_raw                     <= FUN_0002e648 @ 0x0002e648
 * address symbols (name @ address):
 *   g_battery_level_bucket                   @ 0x20018da0
 *   g_opt3007_chip_ready                     @ 0x20018da1
 */
/* Reconstructed FUN_00010840 @ 0x10840  (parity: 300/300 trials, PROVEN) */
typedef unsigned char byte;
typedef unsigned int uint;
typedef unsigned long long u64;

extern u64 __floatsidf(int a);
extern u64 __extendsfdf2(void);
extern u64 __divdf3(int a, int b, int c, int d);
extern void __muldf3(int a, int b, int c, int d);
extern int __aeabi_dcmplt(int a, int b, int c, int d);
extern int __aeabi_dcmpgt(int a, int b, int c, int d);
extern int __truncdfsf2(void);
extern int get_device_info(void);
extern int opt3001_read_lux_raw(int a);

static float BF(unsigned int h) { union { unsigned int i; float f; } u; u.i = h; return u.f; }

byte compute_lux_brightness_bucket(void)
{
  volatile byte *DAT_a40 = (volatile byte*)((unsigned long)&g_opt3007_chip_ready) /*=0x20018da1*/;
  volatile byte *DAT_a44 = (volatile byte*)((unsigned long)&g_battery_level_bucket) /*=0x20018da0*/;
  byte bVar5;
  int iVar2, iVar3;
  u64 uVar6, uVar7;
  float fVar4;
  int r0val;

  if (*DAT_a40 == 0) {
    return 0xff;
  }
  iVar2 = opt3001_read_lux_raw(0);
  if ((uint)(iVar2 + 1) < 2) {
    return 0xff;
  }

  iVar3 = get_device_info();
  if ( (*(volatile int *)(long)(iVar3+0xfb0) == 0)
    || (iVar3 = get_device_info(), *(volatile int *)(long)(iVar3+0xfb0) == -1)
    || (iVar3 = get_device_info(), *(volatile int *)(long)(iVar3+0xfb0) < 0xea61) ) {
    if (iVar2 < 0x32) {
      bVar5 = (byte)(iVar2 / 5);
    } else if (iVar2 < 200) {
      bVar5 = (byte)((((uint)iVar2 - 0x32u) / 10u) + 10u);
    } else if (iVar2 < 1000) {
      bVar5 = (byte)((((uint)iVar2 - 200u) / 0x32u) + 0x19u);
    } else if (iVar2 < 10000) {
      bVar5 = (byte)((((uint)iVar2 - 1000u) / 1000u) + 0x29u);
    } else {
      if (0x1387f < iVar2) {
        return 0x2a;
      }
      bVar5 = (byte)((((uint)iVar2 - 10000u) / 5000u) + 0x32u);
    }
    if (0x29 < bVar5) bVar5 = 0x2a;
  } else {
    uVar6 = __floatsidf(iVar2);
    iVar2 = get_device_info();
    uVar7 = __floatsidf(*(volatile int *)(long)(iVar2+0xfb0));
    uVar7 = __divdf3((int)uVar7, (int)(uVar7>>32), 0, 0);
    __muldf3((int)uVar7, (int)(uVar7>>32), (int)uVar6, (int)(uVar6>>32));
    r0val = __truncdfsf2();
    { union { int i; float f; } u; u.i = r0val; fVar4 = u.f; }
    bVar5 = *DAT_a44;
    if (bVar5 == 0xc) {
      if (fVar4 > BF(0x42f00000)) {
        bVar5 = 0x13;
      } else if (fVar4 < 8.0f) {
        bVar5 = 6;
      }
    } else if (bVar5 > 0xc) {
      if (bVar5 == 0x1a) {
        if (fVar4 > BF(0x44b40000)) {
          bVar5 = 0x2a;
        } else if (fVar4 < BF(0x43ba0000)) {
          bVar5 = 0x13;
        }
      } else if (bVar5 == 0x2a) {
        if (fVar4 < BF(0x44700000)) {
          bVar5 = 0x1a;
        }
      } else if (bVar5 == 0x13) {
        if (fVar4 > BF(0x43f80000)) {
          bVar5 = 0x1a;
        } else if (fVar4 < BF(0x42960000)) {
          bVar5 = 0xc;
        }
      }
    } else {
      if (bVar5 == 3) {
        if (fVar4 > 6.0f) {
          bVar5 = 6;
        } else {
          uVar6 = __extendsfdf2();
          iVar2 = __aeabi_dcmplt((int)uVar6,(int)(uVar6>>32),0,0);
          if (iVar2 != 0) bVar5 = 0;
        }
      } else if (bVar5 == 6) {
        if (fVar4 > 12.0f) {
          bVar5 = 0xc;
        } else if (fVar4 < 4.0f) {
          bVar5 = 3;
        }
      } else if (bVar5 == 0) {
        uVar6 = __extendsfdf2();
        iVar2 = __aeabi_dcmpgt((int)uVar6,(int)(uVar6>>32),0,0);
        if (iVar2 != 0) bVar5 = 3;
      }
    }
    *DAT_a44 = bVar5;
  }
  return bVar5;
}

/* ---- power_for_panel.c ---- */
/* readable reconstruction; identity: FUN_00015df4 @ 0x00015df4
 * public-name: power_for_panel
 * durable-map: recon/catalogs/function_names_app.json
 * callees (readable <= raw @ address):
 *   power_for_panel                          <= FUN_00015df4 @ 0x00015df4
 *   gpio_dt_spec_activate                    <= FUN_000179ec @ 0x000179ec
 *   debug_print                              <= FUN_00019c70 @ 0x00019c70
 *   app_msleep_thunk_a                       <= FUN_0007c038 @ 0x0007c038
 *   dev_write_reg3                           <= FUN_00083dc8 @ 0x00083dc8
 *   dev_reg_modify_bits                      <= FUN_00083e0e @ 0x00083e0e
 * address symbols (name @ address):
 *   rodata_99329                             @ 0x00099329
 *   rodata_99345                             @ 0x00099345   [INLINED -- G6 literal batch]
 *   rodata_9938c                             @ 0x0009938c
 *   rodata_9940b                             @ 0x0009940b
 *   rodata_99427                             @ 0x00099427   [INLINED -- G6 literal batch]
 *   rodata_99c3e                             @ 0x00099c3e   [INLINED -- G6 literal batch]
 *   g_log_level                              @ 0x2000230c
 *   device_info                              @ 0x200069fc
 *   g_log_use_alt_sink                       @ 0x20007554
 */
/* Reconstructed FUN_00015df4 @ 0x15df4  (parity: 300/300 trials, PROVEN) */
extern int gpio_dt_spec_activate(int,...);
extern int app_msleep_thunk_a(int,...);
extern int dev_write_reg3(int,...);
extern int dev_reg_modify_bits(int, unsigned int, unsigned int, unsigned int, unsigned char);

unsigned power_for_panel(unsigned param_1, unsigned param_2)
{
    int *piVar1; int iVar2; unsigned char *puVar3; int iVar4;
    iVar2 = dev_write_reg3(*(unsigned*)(*(volatile int *)((unsigned long)&rodata_87cf8 + 4) /*=0x87cf8*/+0x1c), 8, 0, 1, param_1, param_2);
    piVar1 = (int*)((unsigned long)&g_log_level) /*=0x2000230c*/;
    if(iVar2 < 0){
        if(*(volatile int *)((unsigned long)&g_log_level) /*=0x2000230c*/ < 1) return 0;
        iVar2 = *(volatile int *)((unsigned long)&g_log_use_alt_sink) /*=0x20007554*/;
        puVar3 = (unsigned char*)((unsigned long)&rodata_99329) /*=0x99329*/;
        goto LAB_00015e1a;
    }
    if(0 < *(volatile int *)((unsigned long)&g_log_level) /*=0x2000230c*/){
        G1_LOG_ROUTE(*(volatile int *)((unsigned long)&g_log_use_alt_sink) /*=0x20007554*/ == 0, ((unsigned long)"%s(): enable ldsw1 1.8v for panel\n") /*=0x99345*/, ((unsigned long)"power_for_panel") /*=0x99c3e*/);
    }
    app_msleep_thunk_a(1);
    iVar2 = *(volatile int *)((unsigned long)&rodata_87d10 + 4) /*=0x87d10*/;
    if(*(char*)(*(volatile int *)((unsigned long)&device_info) /*=0x200069fc*/ + 0xed4) == 1){
        iVar4 = dev_write_reg3(*(unsigned*)(iVar2+0x1c), 4, 10, 1, param_1, param_2);
        if(iVar4 < 0){
            if(*piVar1 < 1) return 0;
            iVar2 = *(volatile int *)((unsigned long)&g_log_use_alt_sink) /*=0x20007554*/;
            puVar3 = (unsigned char*)0x00099368;
            goto LAB_00015e1a;
        }
        if(0 < *piVar1){
            iVar4 = *(volatile int *)((unsigned long)&g_log_use_alt_sink) /*=0x20007554*/;
            puVar3 = (unsigned char*)((unsigned long)&rodata_9938c) /*=0x9938c*/;
LAB_00015e82:
            G1_LOG_ROUTE(iVar4 == 0, (int)puVar3, ((unsigned long)"power_for_panel") /*=0x99c3e*/);
        }
    } else {
        iVar4 = dev_write_reg3(*(unsigned*)(iVar2+0x1c), 4, 10, 2, param_1, param_2);
        if(iVar4 < 0){
            if(*piVar1 < 1) return 0;
            iVar2 = *(volatile int *)((unsigned long)&g_log_use_alt_sink) /*=0x20007554*/;
            puVar3 = (unsigned char*)0x000993a5;
            goto LAB_00015e1a;
        }
        if(0 < *piVar1){
            iVar4 = *(volatile int *)((unsigned long)&g_log_use_alt_sink) /*=0x20007554*/;
            puVar3 = (unsigned char*)((unsigned long)"%s(): set buck2 to 1.2v\n") /*=0x993c9*/;
            goto LAB_00015e82;
        }
    }
    iVar4 = dev_reg_modify_bits(*(unsigned*)(iVar2+0x1c), 4, 0xf, 2, 2);
    if(iVar4 < 0){
        if(*piVar1 < 1) return 0;
        iVar2 = *(volatile int *)((unsigned long)&g_log_use_alt_sink) /*=0x20007554*/;
        puVar3 = (unsigned char*)0x000993e2;
    } else {
        iVar2 = dev_write_reg3(*(unsigned*)(iVar2+0x1c), 4, 2, 1);
        if(iVar2 < 0){
            if(*piVar1 < 1) return 0;
            iVar2 = *(volatile int *)((unsigned long)&g_log_use_alt_sink) /*=0x20007554*/;
            puVar3 = (unsigned char*)((unsigned long)&rodata_9940b) /*=0x9940b*/;
        } else {
            if(0 < *piVar1){
                G1_LOG_ROUTE(*(volatile int *)((unsigned long)&g_log_use_alt_sink) /*=0x20007554*/ == 0, ((unsigned long)"%s(): enable buck2.\n") /*=0x99427*/, ((unsigned long)"power_for_panel") /*=0x99c3e*/);
            }
            app_msleep_thunk_a(1);
            gpio_dt_spec_activate(0);
            app_msleep_thunk_a(0xf);
            if(*piVar1 < 1) return 0;
            iVar2 = *(volatile int *)((unsigned long)&g_log_use_alt_sink) /*=0x20007554*/;
            puVar3 = (unsigned char*)((unsigned long)"%s(): turn on -2v for panel.\n") /*=0x9943c*/;
        }
    }
LAB_00015e1a:
    G1_LOG_ROUTE(iVar2 == 0, (int)puVar3, ((unsigned long)"power_for_panel") /*=0x99c3e*/);
    return 0;
}

