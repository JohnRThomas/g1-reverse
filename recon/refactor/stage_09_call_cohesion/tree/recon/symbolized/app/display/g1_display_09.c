/*
 * Cohesive translation unit for the `display' module.
 *
 * GENERATED by recon/refactor/transforms/t04_cohesive_tu.py.  Do not
 * edit: a stage tree is regenerated, never hand-patched
 * (recon/refactor/README.md C4).
 *
 * The 3 functions below were 3 separate translation units until this
 * stage.  Each one's text is reproduced VERBATIM and in the order the
 * generated source list gave it, and they were CONSECUTIVE in that list.
 * They were proven able to share a translation unit: no symbol is
 * declared here with two types, no identifier has internal linkage in one
 * member and is named by another, and no local typedef, macro, struct tag
 * or enum constant of one member is visible to a member that names it.
 *
 * members, in link order:
 *   panel_write_xy_reg_cached.c
 *   set_brightness_to_panel_reg_in_running.c
 *   reflash_fb_data_to_lcd.c
 */

/* File-scope forward declarations for every struct/union tag this
 * unit names.  Without them a tag whose only appearance in a member
 * is inside a parameter list has PARAMETER-LIST scope, so two
 * textually IDENTICAL declarations in two members declare two
 * different incomplete types and the second is a conflicting
 * redeclaration (C11 6.2.1p7).  Incomplete-type forward
 * declarations emit no code. */
struct k_mutex;
/* ---- panel_write_xy_reg_cached.c ---- */
#include "g1_app_symbols.h"
#include "g1_display.h"
/* readable reconstruction; identity: FUN_00047028 @ 0x00047028
 * public-name: panel_write_xy_reg_cached
 * durable-map: recon/catalogs/function_names_app.json
 * callees (readable <= raw @ address):
 *   panel_write_xy_reg_cached                <= FUN_00047028 @ 0x00047028
 *   projector_send_cmd_0x46                  <= FUN_0007d67e @ 0x0007d67e
 *   net_pkt_write_be16                       <= FUN_0007d696 @ 0x0007d696
 * address symbols (name @ address):
 *   g_panel_reg_y_cache                      @ 0x2000a058
 *   g_panel_reg_x_cache                      @ 0x2000a05c
 */
/* Reconstructed FUN_00047028 @ 0x47028  (parity: 300/300 trials, PROVEN) */

extern void projector_send_cmd_0x46(int a0);

static void panel_write_xy_reg_cached(int param_1, int param_2)
{
  volatile int *piVar1;
  piVar1 = (volatile int *)((unsigned long)&g_panel_reg_x_cache) /*=0x2000a05c*/;
  if (param_1 != *piVar1) {
    net_pkt_write_be16(param_1);
    *piVar1 = param_1;
  }
  piVar1 = (volatile int *)((unsigned long)&g_panel_reg_y_cache) /*=0x2000a058*/;
  if (param_2 != *piVar1) {
    projector_send_cmd_0x46(param_2);
    *piVar1 = param_2;
  }
}

/* ---- set_brightness_to_panel_reg_in_running.c ---- */
/* readable reconstruction; identity: FUN_00047058 @ 0x00047058
 * public-name: set_brightness_to_panel_reg_in_running
 * durable-map: recon/catalogs/function_names_app.json
 * callees (readable <= raw @ address):
 *   get_device_info                          <= FUN_000167a8 @ 0x000167a8
 *   debug_print                              <= FUN_00019c70 @ 0x00019c70
 *   panel_write_xy_reg_cached                <= FUN_00047028 @ 0x00047028
 *   set_brightness_to_panel_reg_in_running   <= FUN_00047058 @ 0x00047058
 *   thunk_FUN_0007d77c                       <= FUN_0007d63e @ 0x0007d63e
 *   projector_send_cmd1                      <= FUN_0007d642 @ 0x0007d642
 *   delay_ms                                 <= FUN_0007d772 @ 0x0007d772
 * address symbols (name @ address):
 *   rodata_d7251                             @ 0x000d7251   [INLINED -- G6 literal batch]
 *   rodata_d72e9                             @ 0x000d72e9   [INLINED -- G6 literal batch]
 *   g_log_level                              @ 0x2000230c
 *   g_log_use_alt_sink                       @ 0x20007554
 */
/* Reconstructed FUN_00047058 @ 0x47058  (parity: 300/300 trials, PROVEN) */
#include <stdint.h>
#include "../../../headers/g1_log.h"
typedef unsigned int uint;
extern int get_device_info(void);
static void panel_write_xy_reg_cached(int,int);
extern void projector_send_cmd1(int,int);
extern void delay_ms(int);
void set_brightness_to_panel_reg_in_running(uint param_1){
    if(*(volatile int *)((unsigned long)&g_log_level) /*=0x2000230c*/ > 2){
        if(*(volatile int *)((unsigned long)&g_log_use_alt_sink) /*=0x20007554*/ == 0)
            log_message(((unsigned long)"%s(): set brightness level = %d\n") /*=0xd7251*/, ((unsigned long)"set_brightness_to_panel_reg_in_running") /*=0xd72e9*/, param_1,
                        *(volatile uint32_t *)((unsigned long)&g_log_use_alt_sink) /*=0x20007554*/);
        else
            debug_print(((unsigned long)"%s(): set brightness level = %d\n") /*=0xd7251*/, ((unsigned long)"set_brightness_to_panel_reg_in_running") /*=0xd72e9*/, param_1,
                         *(volatile uint32_t *)((unsigned long)&g_log_use_alt_sink) /*=0x20007554*/);
    }
    int iVar2=get_device_info();
    if(*(volatile int *)(iVar2+0xec8)==0) return;
    short sVar4=0; uint uVar5=0;
    if(param_1>5){
        iVar2=get_device_info();
        sVar4=(short)((*(volatile short *)(iVar2+0xed8)+1)*0x6f);
        uVar5=(param_1-6)&0xff;
    } else {
        iVar2=get_device_info();
        uint64_t uVar1=((uint64_t)*(volatile uint16_t *)(iVar2+0xed8)<<1)/9;
        int iv=(int)uVar1;
        int need96=(iv==0);
        if(!need96){
            int iVar3=get_device_info();
            if(*(volatile uint16_t *)(iVar3+0xed8)<6) need96=1;
            else{ iVar3=get_device_info();
                sVar4=(short)((short)(((int)(param_1*((uint)*(volatile uint16_t *)(iVar3+0xed8)-iv))/6)+(short)uVar1)*0x6f); }
        }
        if(need96){ iVar2=get_device_info();
            sVar4=(short)(((short)((param_1*0x6f)/6)+1)*(*(volatile short *)(iVar2+0xed8)+1)); }
        uVar5=0;
    }
    thunk_FUN_0007d77c(6); thunk_FUN_0007d77c(0xa9);
    panel_write_xy_reg_cached(sVar4,uVar5); projector_send_cmd1(0x31,4);
    thunk_FUN_0007d77c(0xa3); thunk_FUN_0007d77c(0x97);
    delay_ms(1);
}

/* ---- reflash_fb_data_to_lcd.c ---- */
#include "../../../headers/g1_dedupe.h"
struct k_mutex;
/* readable reconstruction; identity: FUN_00047260 @ 0x00047260
 * public-name: reflash_fb_data_to_lcd
 * durable-map: recon/catalogs/function_names_app.json
 * callees (readable <= raw @ address):
 *   debug_print                              <= FUN_00019c70 @ 0x00019c70
 *   reflash_fb_data_to_lcd                   <= FUN_00047260 @ 0x00047260
 *   k_mutex_lock                             <= FUN_000723b8 @ 0x000723b8
 *   k_mutex_unlock                           <= FUN_00072558 @ 0x00072558
 *   get_projector_controller                 <= FUN_0007d4ec @ 0x0007d4ec
 *   delay_ms                                 <= FUN_0007d772 @ 0x0007d772
 *   projector_send_cmd_immediate             <= FUN_0007d77c @ 0x0007d77c
 * address symbols (name @ address):
 *   rodata_aa891                             @ 0x000aa891   [INLINED -- refactor stage 01]
 *   rodata_d7383                             @ 0x000d7383   [INLINED -- G6 literal batch]
 *   rodata_d7441                             @ 0x000d7441   [INLINED -- G6 literal batch]
 *   g_log_level                              @ 0x2000230c
 *   g_log_use_alt_sink                       @ 0x20007554
 *   g_projector_bus_lock                     @ 0x2000a060
 */
/* Reconstructed FUN_00047260 @ 0x47260  (parity: 300/300 trials, PROVEN) */
extern int k_mutex_lock(int,...);
extern int k_mutex_unlock(struct k_mutex *);
extern long long get_projector_controller(void);
extern int projector_send_cmd_immediate(int,...);

unsigned reflash_fb_data_to_lcd(int param_1,int param_2,int param_3,int param_4,int param_5,int param_6)
{
    unsigned char uVar1; int iVar2; unsigned uVar3; int iVar4; unsigned uVar5,uVar6;
    unsigned lock_arg;
    int iVar7,iVar8,iVar9,iVar10;
    unsigned char local_38[4]; unsigned local_34; unsigned local_30; unsigned char local_2c;

    local_38[0] = 0;
    {
        unsigned long long context_result = (unsigned long long)get_projector_controller();
        iVar2 = (int)context_result;
        lock_arg = (unsigned)(context_result >> 32);
    }
    if(*(int*)(iVar2+0x35c) == 0){
        if(0 < *(volatile int *)((unsigned long)&g_log_level) /*=0x2000230c*/){
            G1_LOG_ROUTE(*(volatile int *)((unsigned long)&g_log_use_alt_sink) /*=0x20007554*/ == 0, ((unsigned long)"%s(): c->init_done = 0,init failed, can't write data!\n") /*=0xaa891*/, ((unsigned long)"_reflash_fb_data_to_lcd") /*=0xd7441*/);
        }
        uVar3 = 0xffffffff;
    } else {
        if(199 < param_6) param_6 = 200;
        if(0x27f < param_5) param_5 = 0x280;
        iVar7 = (5 - param_3/2) + param_5/2;
        uVar5 = (param_3 + param_1) & 0x3ff;
        for(; param_4 <= param_6; param_4 = param_4 + 1){
            iVar10 = *(int*)(iVar2+0x344);
            iVar9 = param_4*0x140 + param_3/2 - 5;
            iVar8 = iVar10 + iVar9;
            volatile unsigned char *pixel = (volatile unsigned char *)iVar8;
            local_2c = *(unsigned char*)(iVar8+4);
            local_30 = *(unsigned*)(iVar10+iVar9);
            uVar6 = 0x0007fc00 & (unsigned)((param_2+param_4)*0x400);
            local_34 = uVar6 | uVar5;
            pixel[0] = 2;
            pixel[1] = (unsigned char)(uVar6>>0x10);
            pixel[2] = (unsigned char)(local_34>>8);
            pixel[3] = (unsigned char)uVar5;
            pixel[4] = 0xff;
            uVar1 = *(unsigned char*)(iVar8+iVar7);
            *(unsigned char*)(iVar8+iVar7) = 0;
            k_mutex_lock(((unsigned long)&g_projector_bus_lock) /*=0x2000a060*/, lock_arg, -1, -1);
            iVar4 = (*(int(**)(int,...))(*(int*)(iVar2+0x374)+8))(*(int*)(iVar2+0x374), iVar8, iVar7, (int)local_38, 1);
            k_mutex_unlock(((unsigned long)&g_projector_bus_lock) /*=0x2000a060*/);
            if(iVar4 != 0 && 0 < *(volatile int *)((unsigned long)&g_log_level) /*=0x2000230c*/){
                G1_LOG_ROUTE(*(volatile int *)((unsigned long)&g_log_use_alt_sink) /*=0x20007554*/ == 0, ((unsigned long)"%s(): spi transfer error....\n") /*=0xd7383*/, ((unsigned long)"_reflash_fb_data_to_lcd") /*=0xd7441*/);
            }
            *(unsigned char*)(iVar8+iVar7) = uVar1;
            *(unsigned*)(iVar10+iVar9) = local_30;
            *(unsigned char*)(iVar8+4) = local_2c;
        }
        projector_send_cmd_immediate(0x97);
        delay_ms(1);
        uVar3 = 0;
    }
    return uVar3;
}

